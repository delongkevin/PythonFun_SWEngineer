/******************************************************************************
* ASAP2 file: THA_VC_Ref.a2l
* Code generation for model "THA_VC_Ref".
* Model version : 1.2042
* Simulink Coder version : 9.2 (R2019b) 18-Jul-2019
* C source code generated on : Thu Aug 7 17:42:34 2025
* Target selection: ert.tlc
* Embedded hardware selection: Custom Processor->Custom Processor
* Code generation objectives:
* 1. MISRA C:2012 guidelines
* 2. RAM efficiency
* 3. ROM efficiency
* Validation result: Not run
* (add additional file header information here)
******************************************************************************/ ASAP2_VERSION 1 31
/* Version 1.31 */
/begin PROJECT ProjectName "Project Comment Goes Here"
/begin HEADER "Header Comments go here" /end HEADER
/begin MODULE ModuleName "Module Comment Goes Here"
/begin MOD_PAR "MOD PAR Comment Goes Here" /end MOD_PAR
/begin MOD_COMMON "Mod Common Comment Here" BYTE_ORDER MSB_LAST /end MOD_COMMON
/begin RECORD_LAYOUT Scalar_BOOLEAN FNC_VALUES 1 UBYTE COLUMN_DIR DIRECT /end RECORD_LAYOUT
/begin RECORD_LAYOUT Scalar_UBYTE FNC_VALUES 1 UBYTE COLUMN_DIR DIRECT /end RECORD_LAYOUT
/begin RECORD_LAYOUT Scalar_BYTE FNC_VALUES 1 SBYTE COLUMN_DIR DIRECT /end RECORD_LAYOUT
/begin RECORD_LAYOUT Scalar_UWORD FNC_VALUES 1 UWORD COLUMN_DIR DIRECT /end RECORD_LAYOUT
/begin RECORD_LAYOUT Scalar_SWORD FNC_VALUES 1 SWORD COLUMN_DIR DIRECT /end RECORD_LAYOUT
/begin RECORD_LAYOUT Scalar_ULONG FNC_VALUES 1 ULONG COLUMN_DIR DIRECT /end RECORD_LAYOUT
/begin RECORD_LAYOUT Scalar_LONG FNC_VALUES 1 SLONG COLUMN_DIR DIRECT /end RECORD_LAYOUT
/begin RECORD_LAYOUT Scalar_FLOAT32_IEEE FNC_VALUES 1 FLOAT32_IEEE COLUMN_DIR DIRECT /end RECORD_LAYOUT
/begin RECORD_LAYOUT Scalar_FLOAT64_IEEE FNC_VALUES 1 FLOAT64_IEEE COLUMN_DIR DIRECT /end RECORD_LAYOUT
/begin RECORD_LAYOUT Lookup1D_BOOLEAN FNC_VALUES 1 UBYTE COLUMN_DIR DIRECT /end RECORD_LAYOUT
/begin RECORD_LAYOUT Lookup1D_X_BOOLEAN AXIS_PTS_X 1 UBYTE INDEX_INCR DIRECT /end RECORD_LAYOUT
/begin RECORD_LAYOUT Lookup1D_BYTE FNC_VALUES 1 SBYTE COLUMN_DIR DIRECT /end RECORD_LAYOUT
/begin RECORD_LAYOUT Lookup1D_X_BYTE AXIS_PTS_X 1 SBYTE INDEX_INCR DIRECT /end RECORD_LAYOUT
/begin RECORD_LAYOUT Lookup1D_UBYTE FNC_VALUES 1 UBYTE COLUMN_DIR DIRECT /end RECORD_LAYOUT
/begin RECORD_LAYOUT Lookup1D_X_UBYTE AXIS_PTS_X 1 UBYTE INDEX_INCR DIRECT /end RECORD_LAYOUT
/begin RECORD_LAYOUT Lookup1D_UWORD FNC_VALUES 1 UWORD COLUMN_DIR DIRECT /end RECORD_LAYOUT
/begin RECORD_LAYOUT Lookup1D_X_UWORD AXIS_PTS_X 1 UWORD INDEX_INCR DIRECT /end RECORD_LAYOUT
/begin RECORD_LAYOUT Lookup1D_WORD FNC_VALUES 1 SWORD COLUMN_DIR DIRECT /end RECORD_LAYOUT
/begin RECORD_LAYOUT Lookup1D_X_WORD AXIS_PTS_X 1 SWORD INDEX_INCR DIRECT /end RECORD_LAYOUT
/begin RECORD_LAYOUT Lookup1D_ULONG FNC_VALUES 1 ULONG COLUMN_DIR DIRECT /end RECORD_LAYOUT
/begin RECORD_LAYOUT Lookup1D_X_ULONG AXIS_PTS_X 1 ULONG INDEX_INCR DIRECT /end RECORD_LAYOUT
/begin RECORD_LAYOUT Lookup1D_SLONG FNC_VALUES 1 SLONG COLUMN_DIR DIRECT /end RECORD_LAYOUT
/begin RECORD_LAYOUT Lookup1D_X_LONG AXIS_PTS_X 1 SLONG INDEX_INCR DIRECT /end RECORD_LAYOUT
/begin RECORD_LAYOUT Lookup1D_FLOAT32_IEEE FNC_VALUES 1 FLOAT32_IEEE COLUMN_DIR DIRECT /end RECORD_LAYOUT
/begin RECORD_LAYOUT Lookup1D_X_FLOAT32_IEEE AXIS_PTS_X 1 FLOAT32_IEEE INDEX_INCR DIRECT /end RECORD_LAYOUT
/begin RECORD_LAYOUT Lookup1D_FLOAT64_IEEE FNC_VALUES 1 FLOAT64_IEEE COLUMN_DIR DIRECT /end RECORD_LAYOUT
/begin RECORD_LAYOUT Lookup1D_X_FLOAT64_IEEE AXIS_PTS_X 1 FLOAT64_IEEE INDEX_INCR DIRECT /end RECORD_LAYOUT
/begin RECORD_LAYOUT Lookup2D_BOOLEAN FNC_VALUES 1 UBYTE COLUMN_DIR DIRECT /end RECORD_LAYOUT
/begin RECORD_LAYOUT Lookup2D_X_BOOLEAN AXIS_PTS_X 1 UBYTE INDEX_INCR DIRECT /end RECORD_LAYOUT
/begin RECORD_LAYOUT Lookup2D_UBYTE FNC_VALUES 1 UBYTE COLUMN_DIR DIRECT /end RECORD_LAYOUT
/begin RECORD_LAYOUT Lookup2D_X_UBYTE AXIS_PTS_X 1 UBYTE INDEX_INCR DIRECT /end RECORD_LAYOUT
/begin RECORD_LAYOUT Lookup2D_BYTE FNC_VALUES 1 SBYTE COLUMN_DIR DIRECT /end RECORD_LAYOUT
/begin RECORD_LAYOUT Lookup2D_X_BYTE AXIS_PTS_X 1 SBYTE INDEX_INCR DIRECT /end RECORD_LAYOUT
/begin RECORD_LAYOUT Lookup2D_UWORD FNC_VALUES 1 UWORD COLUMN_DIR DIRECT /end RECORD_LAYOUT
/begin RECORD_LAYOUT Lookup2D_X_UWORD AXIS_PTS_X 1 UWORD INDEX_INCR DIRECT /end RECORD_LAYOUT
/begin RECORD_LAYOUT Lookup2D_WORD FNC_VALUES 1 SWORD COLUMN_DIR DIRECT /end RECORD_LAYOUT
/begin RECORD_LAYOUT Lookup2D_X_WORD AXIS_PTS_X 1 SWORD INDEX_INCR DIRECT /end RECORD_LAYOUT
/begin RECORD_LAYOUT Lookup2D_ULONG FNC_VALUES 1 ULONG COLUMN_DIR DIRECT /end RECORD_LAYOUT
/begin RECORD_LAYOUT Lookup2D_X_ULONG AXIS_PTS_X 1 ULONG INDEX_INCR DIRECT /end RECORD_LAYOUT
/begin RECORD_LAYOUT Lookup2D_LONG FNC_VALUES 1 SLONG COLUMN_DIR DIRECT /end RECORD_LAYOUT
/begin RECORD_LAYOUT Lookup2D_X_LONG AXIS_PTS_X 1 SLONG INDEX_INCR DIRECT /end RECORD_LAYOUT
/begin RECORD_LAYOUT Lookup2D_FLOAT32_IEEE FNC_VALUES 1 FLOAT32_IEEE COLUMN_DIR DIRECT /end RECORD_LAYOUT
/begin RECORD_LAYOUT Lookup2D_X_FLOAT32_IEEE AXIS_PTS_X 1 FLOAT32_IEEE INDEX_INCR DIRECT /end RECORD_LAYOUT
/begin RECORD_LAYOUT Lookup2D_FLOAT64_IEEE FNC_VALUES 1 FLOAT64_IEEE COLUMN_DIR DIRECT /end RECORD_LAYOUT
/begin RECORD_LAYOUT Lookup2D_X_FLOAT64_IEEE AXIS_PTS_X 1 FLOAT64_IEEE INDEX_INCR DIRECT /end RECORD_LAYOUT
/begin CHARACTERISTIC KeTHA_dpx_CplrPntRateLimitMax "Max allowable change in coupler point per second." VALUE 0x0000 /* @ECU_Address@KeTHA_dpx_CplrPntRateLimitMax@ */ Scalar_LONG 0 THA_VC_Ref_CM_int32_pixel_s 0.0 10000.0 /end CHARACTERISTIC
/begin CHARACTERISTIC KeTHA_Hz_StrCtrlLowPassFiltFreq "Steering control low pass filter frequency." VALUE 0x0000 /* @ECU_Address@KeTHA_Hz_StrCtrlLowPassFiltFreq@ */ Scalar_FLOAT32_IEEE 0 THA_VC_Ref_CM_single 0.0 1000.0 /end CHARACTERISTIC
/begin CHARACTERISTIC KeTHA_M_AbortStrTrq "Steering torque for maneuver abort." VALUE 0x0000 /* @ECU_Address@KeTHA_M_AbortStrTrq@ */ Scalar_FLOAT32_IEEE 0 THA_VC_Ref_CM_single_nm 0.0 2.5 /end CHARACTERISTIC
/begin CHARACTERISTIC KeTHA_M_SteerTweakTrq "Steering tweak torque amplitude." VALUE 0x0000 /* @ECU_Address@KeTHA_M_SteerTweakTrq@ */ Scalar_FLOAT32_IEEE 0 THA_VC_Ref_CM_single_Nm 0.0 5.0 /end CHARACTERISTIC
/begin CHARACTERISTIC KeTHA_M_StrTrqValLimit "Steering torque value limit." VALUE 0x0000 /* @ECU_Address@KeTHA_M_StrTrqValLimit@ */ Scalar_FLOAT32_IEEE 0 THA_VC_Ref_CM_single_Nm 0.0 50.0 /end CHARACTERISTIC
/begin CHARACTERISTIC KeTHA_dM_EpsRampOutSlewRate "Slew rate at which EPS torque shall be set." VALUE 0x0000 /* @ECU_Address@KeTHA_dM_EpsRampOutSlewRate@ */ Scalar_FLOAT32_IEEE 0 THA_VC_Ref_CM_single_Nm_s 0.0 500.0 /end CHARACTERISTIC
/begin CHARACTERISTIC KeTHA_dM_TrqCtrlSlewRate "Slew rate at which EPS torque shall be set." VALUE 0x0000 /* @ECU_Address@KeTHA_dM_TrqCtrlSlewRate@ */ Scalar_FLOAT32_IEEE 0 THA_VC_Ref_CM_single_Nm_s 0.0 2000.0 /end CHARACTERISTIC
/begin CHARACTERISTIC KeTHA_deg_LowerSteeringAngLim "Lower steering angle limit of the vehicle." VALUE 0x0000 /* @ECU_Address@KeTHA_deg_LowerSteeringAngLim@ */ Scalar_FLOAT32_IEEE 0 THA_VC_Ref_CM_single_deg -1200.0 0.0 /end CHARACTERISTIC
/begin CHARACTERISTIC KeTHA_deg_UpperSteeringAngLim "Upper steering angle limit of the vehicle." VALUE 0x0000 /* @ECU_Address@KeTHA_deg_UpperSteeringAngLim@ */ Scalar_FLOAT32_IEEE 0 THA_VC_Ref_CM_single_deg 0.0 1200.0 /end CHARACTERISTIC
/begin CHARACTERISTIC KeTHA_k_NumTweakPulse "Number of PWM pulse, keep it single type" VALUE 0x0000 /* @ECU_Address@KeTHA_k_NumTweakPulse@ */ Scalar_FLOAT32_IEEE 0 THA_VC_Ref_CM_single 0.0 10.0 /end CHARACTERISTIC
/begin CHARACTERISTIC KeTHA_k_SteerTrqCtrlKp "Steer torque control Kp." VALUE 0x0000 /* @ECU_Address@KeTHA_k_SteerTrqCtrlKp@ */ Scalar_FLOAT32_IEEE 0 THA_VC_Ref_CM_single -10.0 10.0 /end CHARACTERISTIC
/begin CHARACTERISTIC KeTHA_k_TrqCtrlDMultiplier_CF55 "Torque controller Differential multiplier KeTHA_k_TrqCtrlDMultiplier" VALUE 0x0000 /* @ECU_Address@KeTHA_k_TrqCtrlDMultiplier_CF55@ */ Scalar_FLOAT32_IEEE 0 THA_VC_Ref_CM_single 0.0 5.0 /end CHARACTERISTIC
/begin CHARACTERISTIC KeTHA_k_TrqCtrlDMultiplier_CF60_CF63 "Torque controller Differential multiplier KeTHA_k_TrqCtrlDMultiplier" VALUE 0x0000 /* @ECU_Address@KeTHA_k_TrqCtrlDMultiplier_CF60_CF63@ */ Scalar_FLOAT32_IEEE 0 THA_VC_Ref_CM_single 0.0 5.0 /end CHARACTERISTIC
/begin CHARACTERISTIC KeTHA_k_TrqCtrlDMultiplier_WB144_CF63 "Torque controller Differential multiplier KeTHA_k_TrqCtrlDMultiplier" VALUE 0x0000 /* @ECU_Address@KeTHA_k_TrqCtrlDMultiplier_WB144_CF63@ */ Scalar_FLOAT32_IEEE 0 THA_VC_Ref_CM_single 0.0 5.0 /end CHARACTERISTIC
/begin CHARACTERISTIC KeTHA_k_TrqCtrlIMultiplier_CF55 "Torque controller Integral multiplier KeTHA_k_TrqCtrlIMultiplier  for CF 55" VALUE 0x0000 /* @ECU_Address@KeTHA_k_TrqCtrlIMultiplier_CF55@ */ Scalar_FLOAT32_IEEE 0 THA_VC_Ref_CM_single 0.0 5.0 /end CHARACTERISTIC
/begin CHARACTERISTIC KeTHA_k_TrqCtrlIMultiplier_CF60_CF63 "Torque controller Integral multiplier KeTHA_k_TrqCtrlIMultiplier" VALUE 0x0000 /* @ECU_Address@KeTHA_k_TrqCtrlIMultiplier_CF60_CF63@ */ Scalar_FLOAT32_IEEE 0 THA_VC_Ref_CM_single 0.0 5.0 /end CHARACTERISTIC
/begin CHARACTERISTIC KeTHA_k_TrqCtrlIMultiplier_WB144_CF63 "Torque controller Integral multiplier KeTHA_k_TrqCtrlIMultiplier" VALUE 0x0000 /* @ECU_Address@KeTHA_k_TrqCtrlIMultiplier_WB144_CF63@ */ Scalar_FLOAT32_IEEE 0 THA_VC_Ref_CM_single 0.0 5.0 /end CHARACTERISTIC
/begin CHARACTERISTIC KeTHA_k_TrqCtrlKd "Steering wheel angle to steering torque controller - Derivative gain." VALUE 0x0000 /* @ECU_Address@KeTHA_k_TrqCtrlKd@ */ Scalar_FLOAT32_IEEE 0 THA_VC_Ref_CM_single 0.0 10.0 /end CHARACTERISTIC
/begin CHARACTERISTIC KeTHA_k_TrqCtrlKi "Steering wheel angle to steering torque controller - Integral gain." VALUE 0x0000 /* @ECU_Address@KeTHA_k_TrqCtrlKi@ */ Scalar_FLOAT32_IEEE 0 THA_VC_Ref_CM_single 0.0 10.0 /end CHARACTERISTIC
/begin CHARACTERISTIC KeTHA_k_TrqCtrlPMultiplier_CF55 "Torque controller Propotional multiplier KeTHA_k_TrqCtrlPMultiplier for CF 55" VALUE 0x0000 /* @ECU_Address@KeTHA_k_TrqCtrlPMultiplier_CF55@ */ Scalar_FLOAT32_IEEE 0 THA_VC_Ref_CM_single 0.0 5.0 /end CHARACTERISTIC
/begin CHARACTERISTIC KeTHA_k_TrqCtrlPMultiplier_CF60 "Torque controller Propotional multiplier KeTHA_k_TrqCtrlPMultiplier" VALUE 0x0000 /* @ECU_Address@KeTHA_k_TrqCtrlPMultiplier_CF60@ */ Scalar_FLOAT32_IEEE 0 THA_VC_Ref_CM_single 0.0 5.0 /end CHARACTERISTIC
/begin CHARACTERISTIC KeTHA_k_TrqCtrlPMultiplier_CF63 "Torque controller Propotional multiplier KeTHA_k_TrqCtrlPMultiplier" VALUE 0x0000 /* @ECU_Address@KeTHA_k_TrqCtrlPMultiplier_CF63@ */ Scalar_FLOAT32_IEEE 0 THA_VC_Ref_CM_single 0.0 5.0 /end CHARACTERISTIC
/begin CHARACTERISTIC KeTHA_k_TrqCtrlPMultiplier_WB144_CF63 "Torque controller Propotional multiplier KeTHA_k_TrqCtrlPMultiplier" VALUE 0x0000 /* @ECU_Address@KeTHA_k_TrqCtrlPMultiplier_WB144_CF63@ */ Scalar_FLOAT32_IEEE 0 THA_VC_Ref_CM_single 0.0 5.0 /end CHARACTERISTIC
/begin CHARACTERISTIC KeTHA_mps_SpdThreshold "THA speed limit threshold stability " VALUE 0x0000 /* @ECU_Address@KeTHA_mps_SpdThreshold@ */ Scalar_FLOAT32_IEEE 0 THA_VC_Ref_CM_single_s 0.0 10.0 /end CHARACTERISTIC
/begin CHARACTERISTIC KeTHA_pct_StrDampDefault "Default value of THA steering damping." VALUE 0x0000 /* @ECU_Address@KeTHA_pct_StrDampDefault@ */ Scalar_FLOAT32_IEEE 0 THA_VC_Ref_CM_single__ 0.0 100.0 /end CHARACTERISTIC
/begin CHARACTERISTIC KeTHA_s_SpdLimConfDur "THA speed limit stability duration." VALUE 0x0000 /* @ECU_Address@KeTHA_s_SpdLimConfDur@ */ Scalar_FLOAT32_IEEE 0 THA_VC_Ref_CM_single_s 0.0 10.0 /end CHARACTERISTIC
/begin CHARACTERISTIC KeTHA_s_SteerTweakTime "Steering tweak profile duration.
      " VALUE 0x0000 /* @ECU_Address@KeTHA_s_SteerTweakTime@ */ Scalar_FLOAT32_IEEE 0 THA_VC_Ref_CM_single_s 0.0 5.0 /end CHARACTERISTIC
/begin CHARACTERISTIC KeTHA_s_ThaSampleTime "Sample time of THA feature for counter/timer operations within logic." VALUE 0x0000 /* @ECU_Address@KeTHA_s_ThaSampleTime@ */ Scalar_FLOAT32_IEEE 0 THA_VC_Ref_CM_single_s 0.001 1.0 /end CHARACTERISTIC
/begin CHARACTERISTIC KsTHA_k_TrqCtrlDampGainTD "Damping gain table data corresponding to vehicle speed [0,2,5,10]." VAL_BLK 0x0000 /* @ECU_Address@KsTHA_k_TrqCtrlDampGainTD@ */ Scalar_FLOAT32_IEEE 0 THA_VC_Ref_CM_single 0.0 1.0 NUMBER 4 /end CHARACTERISTIC
/begin CHARACTERISTIC KsTHA_k_TrqCtrlDiffGainTD_C55 "Differential gain table data corresponding to vehicle speed [0,2,5,10] for default variant 5." VAL_BLK 0x0000 /* @ECU_Address@KsTHA_k_TrqCtrlDiffGainTD_C55@ */ Scalar_FLOAT32_IEEE 0 THA_VC_Ref_CM_single 0.0 1.0 NUMBER 4 /end CHARACTERISTIC
/begin CHARACTERISTIC KsTHA_k_TrqCtrlDiffGainTD_C60_C63 "Differential gain table data corresponding to vehicle speed [0,2,5,10] for default variant 5." VAL_BLK 0x0000 /* @ECU_Address@KsTHA_k_TrqCtrlDiffGainTD_C60_C63@ */ Scalar_FLOAT32_IEEE 0 THA_VC_Ref_CM_single 0.0 1.0 NUMBER 4 /end CHARACTERISTIC
/begin CHARACTERISTIC KsTHA_k_TrqCtrlDiffGainTD_WB144_C63 "Differential gain table data corresponding to vehicle speed [0,2,5,10] for default variant 5." VAL_BLK 0x0000 /* @ECU_Address@KsTHA_k_TrqCtrlDiffGainTD_WB144_C63@ */ Scalar_FLOAT32_IEEE 0 THA_VC_Ref_CM_single 0.0 1.0 NUMBER 4 /end CHARACTERISTIC
/begin CHARACTERISTIC KsTHA_k_TrqCtrlIntExtSatTD "Integrator external saturation table data corresponding to vehicle speed [0,2,5,10]." VAL_BLK 0x0000 /* @ECU_Address@KsTHA_k_TrqCtrlIntExtSatTD@ */ Scalar_FLOAT32_IEEE 0 THA_VC_Ref_CM_single 0.0 100.0 NUMBER 4 /end CHARACTERISTIC
/begin CHARACTERISTIC KsTHA_k_TrqCtrlIntGainTD_C55 "Integrator gain table data corresponding to vehicle speed [0,2,5,10] for default variant 5.." VAL_BLK 0x0000 /* @ECU_Address@KsTHA_k_TrqCtrlIntGainTD_C55@ */ Scalar_FLOAT32_IEEE 0 THA_VC_Ref_CM_single 0.0 1.0 NUMBER 4 /end CHARACTERISTIC
/begin CHARACTERISTIC KsTHA_k_TrqCtrlIntGainTD_C60_C63 "Integrator gain table data corresponding to vehicle speed [0,2,5,10] for default variant 5.." VAL_BLK 0x0000 /* @ECU_Address@KsTHA_k_TrqCtrlIntGainTD_C60_C63@ */ Scalar_FLOAT32_IEEE 0 THA_VC_Ref_CM_single 0.0 1.0 NUMBER 4 /end CHARACTERISTIC
/begin CHARACTERISTIC KsTHA_k_TrqCtrlIntGainTD_WB144_C63 "Integrator gain table data corresponding to vehicle speed [0,2,5,10] for default variant 5.." VAL_BLK 0x0000 /* @ECU_Address@KsTHA_k_TrqCtrlIntGainTD_WB144_C63@ */ Scalar_FLOAT32_IEEE 0 THA_VC_Ref_CM_single 0.0 1.0 NUMBER 4 /end CHARACTERISTIC
/begin CHARACTERISTIC KsTHA_k_TrqCtrlPropGainTD_C55 "Kp gain LUT corresponding to vehicle speed [0,2,5,10] and steering angle [0,25,50,100,570] for default variant 5." VAL_BLK 0x0000 /* @ECU_Address@KsTHA_k_TrqCtrlPropGainTD_C55@ */ Scalar_FLOAT32_IEEE 0 THA_VC_Ref_CM_single 0.0 1.0 NUMBER 20 /end CHARACTERISTIC
/begin CHARACTERISTIC KsTHA_k_TrqCtrlPropGainTD_C60 "Kp gain LUT corresponding to vehicle speed [0,2,5,10] and steering angle [0,25,50,100,570] for default variant 5." VAL_BLK 0x0000 /* @ECU_Address@KsTHA_k_TrqCtrlPropGainTD_C60@ */ Scalar_FLOAT32_IEEE 0 THA_VC_Ref_CM_single 0.0 1.0 NUMBER 20 /end CHARACTERISTIC
/begin CHARACTERISTIC KsTHA_k_TrqCtrlPropGainTD_C63 "Kp gain LUT corresponding to vehicle speed [0,2,5,10] and steering angle [0,25,50,100,570] for default variant 5." VAL_BLK 0x0000 /* @ECU_Address@KsTHA_k_TrqCtrlPropGainTD_C63@ */ Scalar_FLOAT32_IEEE 0 THA_VC_Ref_CM_single 0.0 1.0 NUMBER 20 /end CHARACTERISTIC
/begin CHARACTERISTIC KsTHA_k_TrqCtrlPropGainTD_WB144_C63 "Kp gain LUT corresponding to vehicle speed [0,2,5,10] and steering angle [0,25,50,100,570] for default variant 5." VAL_BLK 0x0000 /* @ECU_Address@KsTHA_k_TrqCtrlPropGainTD_WB144_C63@ */ Scalar_FLOAT32_IEEE 0 THA_VC_Ref_CM_single 0.0 1.0 NUMBER 20 /end CHARACTERISTIC
/begin CHARACTERISTIC KsTHA_mps_DistSpdTD "THA speed limit array for the longitudinal pixel difference between hitch and coupler/trailer of [60, 112, 137, 147, 155, 164]." VAL_BLK 0x0000 /* @ECU_Address@KsTHA_mps_DistSpdTD@ */ Scalar_FLOAT32_IEEE 0 THA_VC_Ref_CM_single_km_hr 0.0 3.0 NUMBER 6 /end CHARACTERISTIC
/begin CHARACTERISTIC KeTHA_b_EnblTrlrAngStrTrqCalc "Calibration to enable Steering torque calculation based on trailer angle." VALUE 0x0000 /* @ECU_Address@KeTHA_b_EnblTrlrAngStrTrqCalc@ */ Scalar_BOOLEAN 0 THA_VC_Ref_CM_boolean 0.0 1.0 /end CHARACTERISTIC
/begin CHARACTERISTIC KeTHA_b_SpdCndEnable "Calibration to enable updated torque control logic." VALUE 0x0000 /* @ECU_Address@KeTHA_b_SpdCndEnable@ */ Scalar_BOOLEAN 0 THA_VC_Ref_CM_boolean 0.0 1.0 /end CHARACTERISTIC
/begin CHARACTERISTIC KeTHA_b_UseNewTrqCtrl "Calibration to enable updated torque control logic." VALUE 0x0000 /* @ECU_Address@KeTHA_b_UseNewTrqCtrl@ */ Scalar_BOOLEAN 0 THA_VC_Ref_CM_boolean 0.0 1.0 /end CHARACTERISTIC
/begin CHARACTERISTIC KeTHA_b_UsePreProcessor "Calibration to enable updated torque control logic." VALUE 0x0000 /* @ECU_Address@KeTHA_b_UsePreProcessor@ */ Scalar_BOOLEAN 0 THA_VC_Ref_CM_boolean 0.0 1.0 /end CHARACTERISTIC
/begin MEASUREMENT MeTHA_deg_RelAngle "Initial angle made by coupler with Hitch when THA is engaged." /* Data type */ FLOAT32_IEEE /* Conversion method */ THA_VC_Ref_CM_single_deg /* Resolution (Not used) */ 0 /* Accuracy (Not used) */ 0 /* Lower limit */ -570.0 /* Upper limit */ 570.0 ECU_ADDRESS 0x0000 /* @ECU_Address@MeTHA_deg_RelAngle@ */ /end MEASUREMENT
/begin MEASUREMENT MeTHA_deg_StrAngCmd "Required steering angle calculated by steering control block of VC." /* Data type */ FLOAT32_IEEE /* Conversion method */ THA_VC_Ref_CM_single_deg /* Resolution (Not used) */ 0 /* Accuracy (Not used) */ 0 /* Lower limit */ -570.0 /* Upper limit */ 570.0 ECU_ADDRESS 0x0000 /* @ECU_Address@MeTHA_deg_StrAngCmd@ */ /end MEASUREMENT
/begin COMPU_METHOD THA_VC_Ref_CM_int32_pixel_s "Q = V" RAT_FUNC "%10.0" "pixel/s" COEFFS 0 1 0 0 0 1 /end COMPU_METHOD
/begin COMPU_METHOD THA_VC_Ref_CM_single "Q = V" RAT_FUNC "%8.6" "" COEFFS 0 1 0 0 0 1 /end COMPU_METHOD
/begin COMPU_METHOD THA_VC_Ref_CM_single_nm "Q = V" RAT_FUNC "%8.6" "nm" COEFFS 0 1 0 0 0 1 /end COMPU_METHOD
/begin COMPU_METHOD THA_VC_Ref_CM_single_Nm "Q = V" RAT_FUNC "%8.6" "Nm" COEFFS 0 1 0 0 0 1 /end COMPU_METHOD
/begin COMPU_METHOD THA_VC_Ref_CM_single_Nm_s "Q = V" RAT_FUNC "%8.6" "Nm/s" COEFFS 0 1 0 0 0 1 /end COMPU_METHOD
/begin COMPU_METHOD THA_VC_Ref_CM_single_deg "Q = V" RAT_FUNC "%8.6" "deg" COEFFS 0 1 0 0 0 1 /end COMPU_METHOD
/begin COMPU_METHOD THA_VC_Ref_CM_single_s "Q = V" RAT_FUNC "%8.6" "s" COEFFS 0 1 0 0 0 1 /end COMPU_METHOD
/begin COMPU_METHOD THA_VC_Ref_CM_single__ "Q = V" RAT_FUNC "%8.6" "%" COEFFS 0 1 0 0 0 1 /end COMPU_METHOD
/begin COMPU_METHOD THA_VC_Ref_CM_single_km_hr "Q = V" RAT_FUNC "%8.6" "km/hr" COEFFS 0 1 0 0 0 1 /end COMPU_METHOD
/begin COMPU_METHOD THA_VC_Ref_CM_boolean "Q = V" RAT_FUNC "%1.0" "" COEFFS 0 1 0 0 0 1 /end COMPU_METHOD
/begin GROUP THA_VC_Ref "THA_VC_Ref" /* Root */ ROOT /begin SUB_GROUP Root_THA_VC_Controller Root_THA_VC_InputProcessing /end SUB_GROUP /end GROUP
/begin GROUP Root_THA_VC_Controller "THA_VC_Ref/THA_VC_Controller"
 /begin SUB_GROUP S1_THA_Distance_SpeedLimit_Processing S1_THA_KM_SteerTorque_Processing S1_THA_MnvrAbort_SteerTorque_Processing S1_THA_SteerTweakProfile_Processing2 /end SUB_GROUP
 /begin REF_CHARACTERISTIC KeTHA_M_SteerTweakTrq KeTHA_dM_EpsRampOutSlewRate KeTHA_dM_TrqCtrlSlewRate KeTHA_pct_StrDampDefault KeTHA_s_SteerTweakTime KeTHA_s_ThaSampleTime /end REF_CHARACTERISTIC
/end GROUP
/begin GROUP Root_THA_VC_InputProcessing "THA_VC_Ref/THA_VC_InputProcessing" /begin SUB_GROUP S2_InitCplrAngSelect /end SUB_GROUP /end GROUP
/begin GROUP S1_THA_Distance_SpeedLimit_Processing "THA_VC_Ref/THA_VC_Controller/THA_Distance_SpeedLimit_Processing"
 /begin SUB_GROUP S9_DynamicRateLimiterX S9_DynamicRateLimiterY S9_enum_max_speed_output S9_max_speed_decider /end SUB_GROUP
 /begin REF_CHARACTERISTIC KeTHA_dpx_CplrPntRateLimitMax /end REF_CHARACTERISTIC
/end GROUP
/begin GROUP S1_THA_KM_SteerTorque_Processing "THA_VC_Ref/THA_VC_Controller/THA_KM_SteerTorque_Processing"
 /begin SUB_GROUP S10_PreProcessor S10_STR_Control S10_TrqControlOld S10_TrqControl_PID_Error /end SUB_GROUP
 /begin REF_CHARACTERISTIC KeTHA_Hz_StrCtrlLowPassFiltFreq KeTHA_b_UseNewTrqCtrl KeTHA_s_ThaSampleTime /end REF_CHARACTERISTIC
/end GROUP
/begin GROUP S1_THA_MnvrAbort_SteerTorque_Processing "THA_VC_Ref/THA_VC_Controller/THA_MnvrAbort_SteerTorque_Processing" /begin REF_CHARACTERISTIC KeTHA_M_AbortStrTrq /end REF_CHARACTERISTIC /end GROUP
/begin GROUP S1_THA_SteerTweakProfile_Processing2 "THA_VC_Ref/THA_VC_Controller/THA_SteerTweakProfile_Processing2" /begin REF_CHARACTERISTIC KeTHA_k_NumTweakPulse /end REF_CHARACTERISTIC /end GROUP
/begin GROUP S2_InitCplrAngSelect "THA_VC_Ref/THA_VC_InputProcessing/InitCplrAngSelect" /begin REF_MEASUREMENT MeTHA_deg_RelAngle /end REF_MEASUREMENT /end GROUP
/begin GROUP S9_DynamicRateLimiterX "THA_VC_Ref/THA_VC_Controller/THA_Distance_SpeedLimit_Processing/DynamicRateLimiterX" /begin REF_CHARACTERISTIC KeTHA_s_ThaSampleTime /end REF_CHARACTERISTIC /end GROUP
/begin GROUP S9_DynamicRateLimiterY "THA_VC_Ref/THA_VC_Controller/THA_Distance_SpeedLimit_Processing/DynamicRateLimiterY" /begin REF_CHARACTERISTIC KeTHA_s_ThaSampleTime /end REF_CHARACTERISTIC /end GROUP
/begin GROUP S9_enum_max_speed_output "THA_VC_Ref/THA_VC_Controller/THA_Distance_SpeedLimit_Processing/enum_max_speed_output" /begin REF_CHARACTERISTIC KeTHA_s_SpdLimConfDur KeTHA_s_ThaSampleTime /end REF_CHARACTERISTIC /end GROUP
/begin GROUP S9_max_speed_decider "THA_VC_Ref/THA_VC_Controller/THA_Distance_SpeedLimit_Processing/max_speed_decider" /begin REF_CHARACTERISTIC KsTHA_mps_DistSpdTD /end REF_CHARACTERISTIC /end GROUP
/begin GROUP S10_PreProcessor "THA_VC_Ref/THA_VC_Controller/THA_KM_SteerTorque_Processing/PreProcessor"
 /begin REF_CHARACTERISTIC KeTHA_b_SpdCndEnable KeTHA_b_UsePreProcessor KeTHA_deg_UpperSteeringAngLim KeTHA_mps_SpdThreshold KeTHA_s_SteerTweakTime KeTHA_s_ThaSampleTime /end REF_CHARACTERISTIC
 /begin REF_MEASUREMENT MeTHA_deg_StrAngCmd /end REF_MEASUREMENT
/end GROUP
/begin GROUP S10_STR_Control "THA_VC_Ref/THA_VC_Controller/THA_KM_SteerTorque_Processing/STR_Control"
 /begin REF_CHARACTERISTIC KeTHA_b_EnblTrlrAngStrTrqCalc KeTHA_b_SpdCndEnable KeTHA_deg_LowerSteeringAngLim KeTHA_deg_UpperSteeringAngLim KeTHA_mps_SpdThreshold /end REF_CHARACTERISTIC
/end GROUP
/begin GROUP S10_TrqControlOld "THA_VC_Ref/THA_VC_Controller/THA_KM_SteerTorque_Processing/TrqControlOld" /begin REF_CHARACTERISTIC KeTHA_k_SteerTrqCtrlKp KeTHA_k_TrqCtrlKd KeTHA_k_TrqCtrlKi /end REF_CHARACTERISTIC /end GROUP
/begin GROUP S10_TrqControl_PID_Error "THA_VC_Ref/THA_VC_Controller/THA_KM_SteerTorque_Processing/TrqControl_PID_Error"
 /begin REF_CHARACTERISTIC KeTHA_M_StrTrqValLimit KeTHA_dM_TrqCtrlSlewRate KeTHA_k_TrqCtrlDMultiplier_CF55 KeTHA_k_TrqCtrlDMultiplier_CF60_CF63 KeTHA_k_TrqCtrlDMultiplier_WB144_CF63 KeTHA_k_TrqCtrlIMultiplier_CF55 KeTHA_k_TrqCtrlIMultiplier_CF60_CF63 KeTHA_k_TrqCtrlIMultiplier_WB144_CF63 KeTHA_k_TrqCtrlPMultiplier_CF55 KeTHA_k_TrqCtrlPMultiplier_CF60 KeTHA_k_TrqCtrlPMultiplier_CF63 KeTHA_k_TrqCtrlPMultiplier_WB144_CF63 KsTHA_k_TrqCtrlDampGainTD KsTHA_k_TrqCtrlDiffGainTD_C55 KsTHA_k_TrqCtrlDiffGainTD_C60_C63 KsTHA_k_TrqCtrlDiffGainTD_WB144_C63 KsTHA_k_TrqCtrlIntExtSatTD KsTHA_k_TrqCtrlIntGainTD_C55 KsTHA_k_TrqCtrlIntGainTD_C60_C63 KsTHA_k_TrqCtrlIntGainTD_WB144_C63 KsTHA_k_TrqCtrlPropGainTD_C55 KsTHA_k_TrqCtrlPropGainTD_C60 KsTHA_k_TrqCtrlPropGainTD_C63 KsTHA_k_TrqCtrlPropGainTD_WB144_C63 /end REF_CHARACTERISTIC
/end GROUP
/end MODULE
/end PROJECT
/* (add any file trailer comments here) */
/* EOF THA_VC_Ref.a2l */
