/******************************************************************************
* ASAP2 file: THA_SM_Ref.a2l
* Code generation for model "THA_SM_Ref".
* Model version : 1.1861
* Simulink Coder version : 9.2 (R2019b) 18-Jul-2019
* C source code generated on : Thu Aug 7 17:42:07 2025
* Target selection: ert.tlc
* Embedded hardware selection: Custom Processor->Custom Processor
* Code generation objectives:
* 1. MISRA C:2012 guidelines
* 2. RAM efficiency
* 3. ROM efficiency
* Validation result: Not run
* (add additional file header information here)
******************************************************************************/ ASAP2_VERSION 1 31
/* Version 1.31 */
/begin PROJECT ProjectName "Project Comment Goes Here"
/begin HEADER "Header Comments go here" /end HEADER
/begin MODULE ModuleName "Module Comment Goes Here"
/begin MOD_PAR "MOD PAR Comment Goes Here" /end MOD_PAR
/begin MOD_COMMON "Mod Common Comment Here" BYTE_ORDER MSB_LAST /end MOD_COMMON
/begin RECORD_LAYOUT Scalar_BOOLEAN FNC_VALUES 1 UBYTE COLUMN_DIR DIRECT /end RECORD_LAYOUT
/begin RECORD_LAYOUT Scalar_UBYTE FNC_VALUES 1 UBYTE COLUMN_DIR DIRECT /end RECORD_LAYOUT
/begin RECORD_LAYOUT Scalar_BYTE FNC_VALUES 1 SBYTE COLUMN_DIR DIRECT /end RECORD_LAYOUT
/begin RECORD_LAYOUT Scalar_UWORD FNC_VALUES 1 UWORD COLUMN_DIR DIRECT /end RECORD_LAYOUT
/begin RECORD_LAYOUT Scalar_SWORD FNC_VALUES 1 SWORD COLUMN_DIR DIRECT /end RECORD_LAYOUT
/begin RECORD_LAYOUT Scalar_ULONG FNC_VALUES 1 ULONG COLUMN_DIR DIRECT /end RECORD_LAYOUT
/begin RECORD_LAYOUT Scalar_LONG FNC_VALUES 1 SLONG COLUMN_DIR DIRECT /end RECORD_LAYOUT
/begin RECORD_LAYOUT Scalar_FLOAT32_IEEE FNC_VALUES 1 FLOAT32_IEEE COLUMN_DIR DIRECT /end RECORD_LAYOUT
/begin RECORD_LAYOUT Scalar_FLOAT64_IEEE FNC_VALUES 1 FLOAT64_IEEE COLUMN_DIR DIRECT /end RECORD_LAYOUT
/begin RECORD_LAYOUT Lookup1D_BOOLEAN FNC_VALUES 1 UBYTE COLUMN_DIR DIRECT /end RECORD_LAYOUT
/begin RECORD_LAYOUT Lookup1D_X_BOOLEAN AXIS_PTS_X 1 UBYTE INDEX_INCR DIRECT /end RECORD_LAYOUT
/begin RECORD_LAYOUT Lookup1D_BYTE FNC_VALUES 1 SBYTE COLUMN_DIR DIRECT /end RECORD_LAYOUT
/begin RECORD_LAYOUT Lookup1D_X_BYTE AXIS_PTS_X 1 SBYTE INDEX_INCR DIRECT /end RECORD_LAYOUT
/begin RECORD_LAYOUT Lookup1D_UBYTE FNC_VALUES 1 UBYTE COLUMN_DIR DIRECT /end RECORD_LAYOUT
/begin RECORD_LAYOUT Lookup1D_X_UBYTE AXIS_PTS_X 1 UBYTE INDEX_INCR DIRECT /end RECORD_LAYOUT
/begin RECORD_LAYOUT Lookup1D_UWORD FNC_VALUES 1 UWORD COLUMN_DIR DIRECT /end RECORD_LAYOUT
/begin RECORD_LAYOUT Lookup1D_X_UWORD AXIS_PTS_X 1 UWORD INDEX_INCR DIRECT /end RECORD_LAYOUT
/begin RECORD_LAYOUT Lookup1D_WORD FNC_VALUES 1 SWORD COLUMN_DIR DIRECT /end RECORD_LAYOUT
/begin RECORD_LAYOUT Lookup1D_X_WORD AXIS_PTS_X 1 SWORD INDEX_INCR DIRECT /end RECORD_LAYOUT
/begin RECORD_LAYOUT Lookup1D_ULONG FNC_VALUES 1 ULONG COLUMN_DIR DIRECT /end RECORD_LAYOUT
/begin RECORD_LAYOUT Lookup1D_X_ULONG AXIS_PTS_X 1 ULONG INDEX_INCR DIRECT /end RECORD_LAYOUT
/begin RECORD_LAYOUT Lookup1D_SLONG FNC_VALUES 1 SLONG COLUMN_DIR DIRECT /end RECORD_LAYOUT
/begin RECORD_LAYOUT Lookup1D_X_LONG AXIS_PTS_X 1 SLONG INDEX_INCR DIRECT /end RECORD_LAYOUT
/begin RECORD_LAYOUT Lookup1D_FLOAT32_IEEE FNC_VALUES 1 FLOAT32_IEEE COLUMN_DIR DIRECT /end RECORD_LAYOUT
/begin RECORD_LAYOUT Lookup1D_X_FLOAT32_IEEE AXIS_PTS_X 1 FLOAT32_IEEE INDEX_INCR DIRECT /end RECORD_LAYOUT
/begin RECORD_LAYOUT Lookup1D_FLOAT64_IEEE FNC_VALUES 1 FLOAT64_IEEE COLUMN_DIR DIRECT /end RECORD_LAYOUT
/begin RECORD_LAYOUT Lookup1D_X_FLOAT64_IEEE AXIS_PTS_X 1 FLOAT64_IEEE INDEX_INCR DIRECT /end RECORD_LAYOUT
/begin RECORD_LAYOUT Lookup2D_BOOLEAN FNC_VALUES 1 UBYTE COLUMN_DIR DIRECT /end RECORD_LAYOUT
/begin RECORD_LAYOUT Lookup2D_X_BOOLEAN AXIS_PTS_X 1 UBYTE INDEX_INCR DIRECT /end RECORD_LAYOUT
/begin RECORD_LAYOUT Lookup2D_UBYTE FNC_VALUES 1 UBYTE COLUMN_DIR DIRECT /end RECORD_LAYOUT
/begin RECORD_LAYOUT Lookup2D_X_UBYTE AXIS_PTS_X 1 UBYTE INDEX_INCR DIRECT /end RECORD_LAYOUT
/begin RECORD_LAYOUT Lookup2D_BYTE FNC_VALUES 1 SBYTE COLUMN_DIR DIRECT /end RECORD_LAYOUT
/begin RECORD_LAYOUT Lookup2D_X_BYTE AXIS_PTS_X 1 SBYTE INDEX_INCR DIRECT /end RECORD_LAYOUT
/begin RECORD_LAYOUT Lookup2D_UWORD FNC_VALUES 1 UWORD COLUMN_DIR DIRECT /end RECORD_LAYOUT
/begin RECORD_LAYOUT Lookup2D_X_UWORD AXIS_PTS_X 1 UWORD INDEX_INCR DIRECT /end RECORD_LAYOUT
/begin RECORD_LAYOUT Lookup2D_WORD FNC_VALUES 1 SWORD COLUMN_DIR DIRECT /end RECORD_LAYOUT
/begin RECORD_LAYOUT Lookup2D_X_WORD AXIS_PTS_X 1 SWORD INDEX_INCR DIRECT /end RECORD_LAYOUT
/begin RECORD_LAYOUT Lookup2D_ULONG FNC_VALUES 1 ULONG COLUMN_DIR DIRECT /end RECORD_LAYOUT
/begin RECORD_LAYOUT Lookup2D_X_ULONG AXIS_PTS_X 1 ULONG INDEX_INCR DIRECT /end RECORD_LAYOUT
/begin RECORD_LAYOUT Lookup2D_LONG FNC_VALUES 1 SLONG COLUMN_DIR DIRECT /end RECORD_LAYOUT
/begin RECORD_LAYOUT Lookup2D_X_LONG AXIS_PTS_X 1 SLONG INDEX_INCR DIRECT /end RECORD_LAYOUT
/begin RECORD_LAYOUT Lookup2D_FLOAT32_IEEE FNC_VALUES 1 FLOAT32_IEEE COLUMN_DIR DIRECT /end RECORD_LAYOUT
/begin RECORD_LAYOUT Lookup2D_X_FLOAT32_IEEE AXIS_PTS_X 1 FLOAT32_IEEE INDEX_INCR DIRECT /end RECORD_LAYOUT
/begin RECORD_LAYOUT Lookup2D_FLOAT64_IEEE FNC_VALUES 1 FLOAT64_IEEE COLUMN_DIR DIRECT /end RECORD_LAYOUT
/begin RECORD_LAYOUT Lookup2D_X_FLOAT64_IEEE AXIS_PTS_X 1 FLOAT64_IEEE INDEX_INCR DIRECT /end RECORD_LAYOUT
/begin CHARACTERISTIC KeTHA_px_EngageRejLatpxdiff "Lat pixel diff in case coupler detected above 3m , To engage Regection logic" VALUE 0x0000 /* @ECU_Address@KeTHA_px_EngageRejLatpxdiff@ */ Scalar_LONG 0 THA_SM_Ref_CM_int32_pixel 0.0 150.0 /end CHARACTERISTIC
/begin CHARACTERISTIC KsTHA_px_EngageRejLatOffset "Max allowable lateral offset array for following longitudinal pixel difference range: 0-1m, 1-2m, 2-4m, 4-6m." VAL_BLK 0x0000 /* @ECU_Address@KsTHA_px_EngageRejLatOffset@ */ Scalar_LONG 0 THA_SM_Ref_CM_int32_pixel 0.0 960.0 /* Array Size */ NUMBER 4 /end CHARACTERISTIC
/begin CHARACTERISTIC KeTHA_a_AcclOfstBsmSNA "" VALUE 0x0000 /* @ECU_Address@KeTHA_a_AcclOfstBsmSNA@ */ Scalar_FLOAT32_IEEE 0 THA_SM_Ref_CM_single_m_s_sec 0.0 3.0 /end CHARACTERISTIC
/begin CHARACTERISTIC KeTHA_a_VehAccSNA "" VALUE 0x0000 /* @ECU_Address@KeTHA_a_VehAccSNA@ */ Scalar_FLOAT32_IEEE 0 THA_SM_Ref_CM_single_m_s_sec 0.0 41.0 /end CHARACTERISTIC
/begin CHARACTERISTIC KeTHA_ddeg_YawRateBsmSNA "" VALUE 0x0000 /* @ECU_Address@KeTHA_ddeg_YawRateBsmSNA@ */ Scalar_FLOAT32_IEEE 0 THA_SM_Ref_CM_single_deg_s 0.0 164.0 /end CHARACTERISTIC
/begin CHARACTERISTIC KeTHA_deg_StrWhlAngSNA "LWS Angle SNA Value" VALUE 0x0000 /* @ECU_Address@KeTHA_deg_StrWhlAngSNA@ */ Scalar_FLOAT32_IEEE 0 THA_SM_Ref_CM_single_deg 0.0 5834.0 /end CHARACTERISTIC
/begin CHARACTERISTIC KeTHA_deg_VehTrlrInitAngMax "Maximum initial host vehicle angle from trailer ball to trailer coupler to initiate THA maneuver." VALUE 0x0000 /* @ECU_Address@KeTHA_deg_VehTrlrInitAngMax@ */ Scalar_FLOAT32_IEEE 0 THA_SM_Ref_CM_single_deg 0.0 360.0 /end CHARACTERISTIC
/begin CHARACTERISTIC KeTHA_kph_ActvSpdThd "If vehicle speed goes above THA speed limit by this threshold value, then THA shall be aborted." VALUE 0x0000 /* @ECU_Address@KeTHA_kph_ActvSpdThd@ */ Scalar_FLOAT32_IEEE 0 THA_SM_Ref_CM_single_km_hr 0.0 100.0 /end CHARACTERISTIC
/begin CHARACTERISTIC KeTHA_kph_VehSpdVSOSigSNA "SNA Value for average vehicle speed calculated " VALUE 0x0000 /* @ECU_Address@KeTHA_kph_VehSpdVSOSigSNA@ */ Scalar_FLOAT32_IEEE 0 THA_SM_Ref_CM_single_km_hr 0.0 512.0 /end CHARACTERISTIC
/begin CHARACTERISTIC KeTHA_kph_WhlSpdSNA "" VALUE 0x0000 /* @ECU_Address@KeTHA_kph_WhlSpdSNA@ */ Scalar_FLOAT32_IEEE 0 THA_SM_Ref_CM_single_km_hr 0.0 512.0 /end CHARACTERISTIC
/begin CHARACTERISTIC KeTHA_s_BsmHandshake "BSM handshake duration." VALUE 0x0000 /* @ECU_Address@KeTHA_s_BsmHandshake@ */ Scalar_FLOAT32_IEEE 0 THA_SM_Ref_CM_single_s 0.0 2.0 /end CHARACTERISTIC
/begin CHARACTERISTIC KeTHA_s_ChimeActvTime "THA completion chime activation duration." VALUE 0x0000 /* @ECU_Address@KeTHA_s_ChimeActvTime@ */ Scalar_FLOAT32_IEEE 0 THA_SM_Ref_CM_single_s 0.0 5.0 /end CHARACTERISTIC
/begin CHARACTERISTIC KeTHA_s_CplrAngFoundTimeout "Wait time for CplrAngFound signal value to be updated from THA detection side." VALUE 0x0000 /* @ECU_Address@KeTHA_s_CplrAngFoundTimeout@ */ Scalar_FLOAT32_IEEE 0 THA_SM_Ref_CM_single_s 0.0 10.0 /end CHARACTERISTIC
/begin CHARACTERISTIC KeTHA_s_CplrDetStsBufEnabled "Coupler status detection buffer duration for Enabled state." VALUE 0x0000 /* @ECU_Address@KeTHA_s_CplrDetStsBufEnabled@ */ Scalar_FLOAT32_IEEE 0 THA_SM_Ref_CM_single_s 0.0 10.0 /end CHARACTERISTIC
/begin CHARACTERISTIC KeTHA_s_CplrDetStsBufEngaged "Coupler status detection buffer duration for Engaged state." VALUE 0x0000 /* @ECU_Address@KeTHA_s_CplrDetStsBufEngaged@ */ Scalar_FLOAT32_IEEE 0 THA_SM_Ref_CM_single_s 0.0 10.0 /end CHARACTERISTIC
/begin CHARACTERISTIC KeTHA_s_DistConfDur "Coupler to hitch distance stability duration." VALUE 0x0000 /* @ECU_Address@KeTHA_s_DistConfDur@ */ Scalar_FLOAT32_IEEE 0 THA_SM_Ref_CM_single_s 0.0 10.0 /end CHARACTERISTIC
/begin CHARACTERISTIC KeTHA_s_EcmHandshake "ECM handshake duration.
      " VALUE 0x0000 /* @ECU_Address@KeTHA_s_EcmHandshake@ */ Scalar_FLOAT32_IEEE 0 THA_SM_Ref_CM_single_s 0.0 2.0 /end CHARACTERISTIC
/begin CHARACTERISTIC KeTHA_s_EpsHandshake "EPS handshake duration." VALUE 0x0000 /* @ECU_Address@KeTHA_s_EpsHandshake@ */ Scalar_FLOAT32_IEEE 0 THA_SM_Ref_CM_single_s 0.0 2.0 /end CHARACTERISTIC
/begin CHARACTERISTIC KeTHA_s_GearEnggConfDur "Duration to detrmine vehicle gear confidence during Engaged Suppression state." VALUE 0x0000 /* @ECU_Address@KeTHA_s_GearEnggConfDur@ */ Scalar_FLOAT32_IEEE 0 THA_SM_Ref_CM_single_s 0.0 10.0 /end CHARACTERISTIC
/begin CHARACTERISTIC KeTHA_s_HitchCplrDetctTimeout "Max wait duration for hitch and coupler detection status from THA detection after giving request." VALUE 0x0000 /* @ECU_Address@KeTHA_s_HitchCplrDetctTimeout@ */ Scalar_FLOAT32_IEEE 0 THA_SM_Ref_CM_single_s 0.0 20.0 /end CHARACTERISTIC
/begin CHARACTERISTIC KeTHA_s_HitchDetStsBufEnabled "Hitch status detection buffer duration for Enabled state." VALUE 0x0000 /* @ECU_Address@KeTHA_s_HitchDetStsBufEnabled@ */ Scalar_FLOAT32_IEEE 0 THA_SM_Ref_CM_single_s 0.0 10.0 /end CHARACTERISTIC
/begin CHARACTERISTIC KeTHA_s_HitchDetStsBufEngaged "Hitch status detection buffer duration for Engaged state." VALUE 0x0000 /* @ECU_Address@KeTHA_s_HitchDetStsBufEngaged@ */ Scalar_FLOAT32_IEEE 0 THA_SM_Ref_CM_single_s 0.0 10.0 /end CHARACTERISTIC
/begin CHARACTERISTIC KeTHA_s_HmiFaultPopUpDur "THA fault HMI popup message duration." VALUE 0x0000 /* @ECU_Address@KeTHA_s_HmiFaultPopUpDur@ */ Scalar_FLOAT32_IEEE 0 THA_SM_Ref_CM_single_s 0.0 20.0 /end CHARACTERISTIC
/begin CHARACTERISTIC KeTHA_s_MnvTimeout "THA Maneuver Timeout." VALUE 0x0000 /* @ECU_Address@KeTHA_s_MnvTimeout@ */ Scalar_FLOAT32_IEEE 0 THA_SM_Ref_CM_single_s 100.0 1000.0 /end CHARACTERISTIC
/begin CHARACTERISTIC KeTHA_s_SpdOvrdTimeout "Wait time to abort THA if vehicle speed is greater than THA speed limit." VALUE 0x0000 /* @ECU_Address@KeTHA_s_SpdOvrdTimeout@ */ Scalar_FLOAT32_IEEE 0 THA_SM_Ref_CM_single_s 0.0 10.0 /end CHARACTERISTIC
/begin CHARACTERISTIC KeTHA_s_Standstill "Vehicle standstill time." VALUE 0x0000 /* @ECU_Address@KeTHA_s_Standstill@ */ Scalar_FLOAT32_IEEE 0 THA_SM_Ref_CM_single_s 0.0 10.0 /end CHARACTERISTIC
/begin CHARACTERISTIC KeTHA_s_ThaSampleTime "Sample time of THA feature for counter/timer operations within logic." VALUE 0x0000 /* @ECU_Address@KeTHA_s_ThaSampleTime@ */ Scalar_FLOAT32_IEEE 0 THA_SM_Ref_CM_single_s 0.001 1.0 /end CHARACTERISTIC
/begin CHARACTERISTIC KeTHA_s_TrajLostDur "Duration to detrmine if hitch to coupler distance is increased continuously in reverse." VALUE 0x0000 /* @ECU_Address@KeTHA_s_TrajLostDur@ */ Scalar_FLOAT32_IEEE 0 THA_SM_Ref_CM_single_s 0.0 10.0 /end CHARACTERISTIC
/begin CHARACTERISTIC KeTHA_b_EnblEngageRejectReq "Calibration to enable trailer posrion based engaged rejection strategy." VALUE 0x0000 /* @ECU_Address@KeTHA_b_EnblEngageRejectReq@ */ Scalar_BOOLEAN 0 THA_SM_Ref_CM_boolean 0.0 1.0 /end CHARACTERISTIC
/begin CHARACTERISTIC KeTHA_cnt_FastPlsCntrSNA "" VALUE 0x0000 /* @ECU_Address@KeTHA_cnt_FastPlsCntrSNA@ */ Scalar_UBYTE 0 THA_SM_Ref_CM_uint8 0.0 255.0 /end CHARACTERISTIC
/begin MEASUREMENT MeTHA_deg_CplrAng "Coupler angle." FLOAT32_IEEE THA_SM_Ref_CM_single 0 0 -90.0 90.0 ECU_ADDRESS 0x0000 /* @ECU_Address@MeTHA_deg_CplrAng@ */ /end MEASUREMENT
/begin MEASUREMENT MeTHA_px_HitchCplrPixDiffLong "Longitudinal Pixel Y difference from hitch to coupler." SLONG THA_SM_Ref_CM_int32 0 0 -1080.0 1080.0 ECU_ADDRESS 0x0000 /* @ECU_Address@MeTHA_px_HitchCplrPixDiffLong@ */ /end MEASUREMENT
/begin MEASUREMENT MeTHA_px_HitchCplrPixDiffLat "Longitudinal Pixel X difference from hitch to coupler." SLONG THA_SM_Ref_CM_int32 0 0 -1920.0 1920.0 ECU_ADDRESS 0x0000 /* @ECU_Address@MeTHA_px_HitchCplrPixDiffLat@ */ /end MEASUREMENT
/begin MEASUREMENT MeSVS_e_THAScrResp "THA screen request acknowledgement from HMI." SLONG THA_SM_Ref_CM_TeTHA_e_ScreenRequest 0 0 0 2147483647 ECU_ADDRESS 0x0000 /* @ECU_Address@MeSVS_e_THAScrResp@ */ /end MEASUREMENT
/begin MEASUREMENT MeTHA_e_HitchDetctStatus "Hitch detection status.
      0 - Not_Valid
      1 - Not_Detected
      2 - Detected" SLONG THA_SM_Ref_CM_TeTHA_e_HitchDetctStatus 0 0 0 2147483647 ECU_ADDRESS 0x0000 /* @ECU_Address@MeTHA_e_HitchDetctStatus@ */ /end MEASUREMENT
/begin MEASUREMENT MeTHA_e_CplrDetctStatus "Coupler detection status.
      0 - Not valid
      1 - Not_Detected
      2 - Detected" SLONG THA_SM_Ref_CM_TeTHA_e_CplrDetctStatus 0 0 0 2147483647 ECU_ADDRESS 0x0000 /* @ECU_Address@MeTHA_e_CplrDetctStatus@ */ /end MEASUREMENT
/begin MEASUREMENT MeSVS_b_THASftBtnPrsdStsToTHA "THA soft button pressed status." UBYTE THA_SM_Ref_CM_boolean 0 0 0.0 1.0 ECU_ADDRESS 0x0000 /* @ECU_Address@MeSVS_b_THASftBtnPrsdStsToTHA@ */ /end MEASUREMENT
/begin MEASUREMENT MeSVS_b_ImgDefeatReqSts "Cancel Button" UBYTE THA_SM_Ref_CM_boolean 0 0 0.0 1.0 ECU_ADDRESS 0x0000 /* @ECU_Address@MeSVS_b_ImgDefeatReqSts@ */ /end MEASUREMENT
/begin MEASUREMENT MeSVS_b_IsConfirmBtnPrsd "Confirm button pressed." UBYTE THA_SM_Ref_CM_boolean 0 0 0.0 1.0 ECU_ADDRESS 0x0000 /* @ECU_Address@MeSVS_b_IsConfirmBtnPrsd@ */ /end MEASUREMENT
/begin MEASUREMENT MeTHA_b_FidDisabled "" UBYTE THA_SM_Ref_CM_boolean 0 0 0.0 1.0 ECU_ADDRESS 0x0000 /* @ECU_Address@MeTHA_b_FidDisabled@ */ /end MEASUREMENT
/begin MEASUREMENT MeTHA_b_FidCamCalAbort "" UBYTE THA_SM_Ref_CM_boolean 0 0 0.0 1.0 ECU_ADDRESS 0x0000 /* @ECU_Address@MeTHA_b_FidCamCalAbort@ */ /end MEASUREMENT
/begin MEASUREMENT MePRX_b_CanNod63 "PROXI parameter CAN node 63 (TTM)." UBYTE THA_SM_Ref_CM_boolean 0 0 0.0 1.0 ECU_ADDRESS 0x0000 /* @ECU_Address@MePRX_b_CanNod63@ */ /end MEASUREMENT
/begin MEASUREMENT MePRX_b_CanNod95 "PROXI parameter CAN node 95 (ITBM/ITCM)." UBYTE THA_SM_Ref_CM_boolean 0 0 0.0 1.0 ECU_ADDRESS 0x0000 /* @ECU_Address@MePRX_b_CanNod95@ */ /end MEASUREMENT
/begin MEASUREMENT MeTHA_b_ActivTrns "THA activation condition transition model internal signal." UBYTE THA_SM_Ref_CM_boolean 0 0 0.0 1.0 ECU_ADDRESS 0x0000 /* @ECU_Address@MeTHA_b_ActivTrns@ */ /end MEASUREMENT
/begin MEASUREMENT MeTHA_b_AbortSteerTrqReq "THA abort request due to EPS, model internal signal." UBYTE THA_SM_Ref_CM_boolean 0 0 0.0 1.0 ECU_ADDRESS 0x0000 /* @ECU_Address@MeTHA_b_AbortSteerTrqReq@ */ /end MEASUREMENT
/begin MEASUREMENT MeTHA_b_AbortSpdLimReq "THA abort request due to BSM or ECM, model internal signal." UBYTE THA_SM_Ref_CM_boolean 0 0 0.0 1.0 ECU_ADDRESS 0x0000 /* @ECU_Address@MeTHA_b_AbortSpdLimReq@ */ /end MEASUREMENT
/begin MEASUREMENT MeTHA_b_AbortCndnFaulted "THA abort condition faulted model internal signal." UBYTE THA_SM_Ref_CM_boolean 0 0 0.0 1.0 ECU_ADDRESS 0x0000 /* @ECU_Address@MeTHA_b_AbortCndnFaulted@ */ /end MEASUREMENT
/begin MEASUREMENT MeTHA_b_FidDLDAbort "" UBYTE THA_SM_Ref_CM_boolean 0 0 0.0 1.0 ECU_ADDRESS 0x0000 /* @ECU_Address@MeTHA_b_FidDLDAbort@ */ /end MEASUREMENT
/begin MEASUREMENT MeTHA_b_FeatureOverride "THA abort condition if any other Driver Assist feature takes over actuation." UBYTE THA_SM_Ref_CM_boolean 0 0 0.0 1.0 ECU_ADDRESS 0x0000 /* @ECU_Address@MeTHA_b_FeatureOverride@ */ /end MEASUREMENT
/begin MEASUREMENT MeTHA_b_AbortCndnEnabled "THA abort condition Enabled model internal signal." UBYTE THA_SM_Ref_CM_boolean 0 0 0.0 1.0 ECU_ADDRESS 0x0000 /* @ECU_Address@MeTHA_b_AbortCndnEnabled@ */ /end MEASUREMENT
/begin MEASUREMENT MeTHA_b_OverSpeedAbort "THA abort condition if vehicle speed exceeds beyond specified limit." UBYTE THA_SM_Ref_CM_boolean 0 0 0.0 1.0 ECU_ADDRESS 0x0000 /* @ECU_Address@MeTHA_b_OverSpeedAbort@ */ /end MEASUREMENT
/begin MEASUREMENT MeTHA_b_AbortCndnEngaged "THA abort condition Engaged model internal signal." UBYTE THA_SM_Ref_CM_boolean 0 0 0.0 1.0 ECU_ADDRESS 0x0000 /* @ECU_Address@MeTHA_b_AbortCndnEngaged@ */ /end MEASUREMENT
/begin MEASUREMENT MeSVS_b_ViewZoomSts "HMI view zoom status.
      0 - Normal view
      1- Zoomed view" UBYTE THA_SM_Ref_CM_boolean 0 0 0.0 1.0 ECU_ADDRESS 0x0000 /* @ECU_Address@MeSVS_b_ViewZoomSts@ */ /end MEASUREMENT
/begin MEASUREMENT MeSVS_b_THAScrTchSts "THA screen touch status." UBYTE THA_SM_Ref_CM_boolean 0 0 0.0 1.0 ECU_ADDRESS 0x0000 /* @ECU_Address@MeSVS_b_THAScrTchSts@ */ /end MEASUREMENT
/begin MEASUREMENT MeSVS_b_THAAbortReq "THA feature abort request from HMI." UBYTE THA_SM_Ref_CM_boolean 0 0 0.0 1.0 ECU_ADDRESS 0x0000 /* @ECU_Address@MeSVS_b_THAAbortReq@ */ /end MEASUREMENT
/begin MEASUREMENT MeTHA_b_THACompleteHMITrig "THA complete HMI trigger model internal signal." UBYTE THA_SM_Ref_CM_boolean 0 0 0.0 1.0 ECU_ADDRESS 0x0000 /* @ECU_Address@MeTHA_b_THACompleteHMITrig@ */ /end MEASUREMENT
/begin MEASUREMENT MePRX_b_ParkWithStop "Park with stop." UBYTE THA_SM_Ref_CM_boolean 0 0 0.0 1.0 ECU_ADDRESS 0x0000 /* @ECU_Address@MePRX_b_ParkWithStop@ */ /end MEASUREMENT
/begin MEASUREMENT MeSVS_b_THAMnvrStartBtnPrsd "THA start manuever button pressed status." UBYTE THA_SM_Ref_CM_boolean 0 0 0.0 1.0 ECU_ADDRESS 0x0000 /* @ECU_Address@MeSVS_b_THAMnvrStartBtnPrsd@ */ /end MEASUREMENT
/begin COMPU_METHOD THA_SM_Ref_CM_int32_pixel "Q = V" RAT_FUNC "%10.0" "pixel" COEFFS 0 1 0 0 0 1 /end COMPU_METHOD
/begin COMPU_METHOD THA_SM_Ref_CM_single_m_s_sec "Q = V" RAT_FUNC "%8.6" "m/s/sec" COEFFS 0 1 0 0 0 1 /end COMPU_METHOD
/begin COMPU_METHOD THA_SM_Ref_CM_single_deg_s "Q = V" RAT_FUNC "%8.6" "deg/s" COEFFS 0 1 0 0 0 1 /end COMPU_METHOD
/begin COMPU_METHOD THA_SM_Ref_CM_single_deg "Q = V" RAT_FUNC "%8.6" "deg" COEFFS 0 1 0 0 0 1 /end COMPU_METHOD
/begin COMPU_METHOD THA_SM_Ref_CM_single_km_hr "Q = V" RAT_FUNC "%8.6" "km/hr" COEFFS 0 1 0 0 0 1 /end COMPU_METHOD
/begin COMPU_METHOD THA_SM_Ref_CM_single_s "Q = V" RAT_FUNC "%8.6" "s" COEFFS 0 1 0 0 0 1 /end COMPU_METHOD
/begin COMPU_METHOD THA_SM_Ref_CM_boolean "Q = V" RAT_FUNC "%1.0" "" COEFFS 0 1 0 0 0 1 /end COMPU_METHOD
/begin COMPU_METHOD THA_SM_Ref_CM_uint8 "Q = V" RAT_FUNC "%3.0" "" COEFFS 0 1 0 0 0 1 /end COMPU_METHOD
/begin COMPU_METHOD THA_SM_Ref_CM_single "Q = V" RAT_FUNC "%8.6" "" COEFFS 0 1 0 0 0 1 /end COMPU_METHOD
/begin COMPU_METHOD THA_SM_Ref_CM_int32 "Q = V" RAT_FUNC "%10.0" "" COEFFS 0 1 0 0 0 1 /end COMPU_METHOD
/begin COMPU_METHOD THA_SM_Ref_CM_TeTHA_e_ScreenRequest "Enumerated data type: TeTHA_e_ScreenRequest" TAB_VERB "%0.6" "" COMPU_TAB_REF VTAB_FOR_THA_SM_Ref_CM_TeTHA_e_ScreenRequest /end COMPU_METHOD
/begin COMPU_VTAB VTAB_FOR_THA_SM_Ref_CM_TeTHA_e_ScreenRequest "Enumerated data type: TeTHA_e_ScreenRequest" TAB_VERB 26 0 "TeTHA_e_ScreenRequest_THA_Default" 1 "TeTHA_e_ScreenRequest_THA_Enable" 2 "TeTHA_e_ScreenRequest_THA_TCS_Msg1" 3 "TeTHA_e_ScreenRequest_THA_TCS_Msg2" 4 "TeTHA_e_ScreenRequest_THA_TCS_Msg3" 5 "TeTHA_e_ScreenRequest_THA_TCS_Msg4" 6 "TeTHA_e_ScreenRequest_THA_TCS_Msg5" 7 "TeTHA_e_ScreenRequest_THA_SM_Msg1" 8 "TeTHA_e_ScreenRequest_THA_SM_Msg2" 9 "TeTHA_e_ScreenRequest_THA_CM_Msg1" 10 "TeTHA_e_ScreenRequest_THA_CM_Msg2" 11 "TeTHA_e_ScreenRequest_THA_CM_Msg3" 12 "TeTHA_e_ScreenRequest_THA_CM_Msg4" 13 "TeTHA_e_ScreenRequest_THA_CM_Msg5" 14 "TeTHA_e_ScreenRequest_THA_CM_Msg6" 15 "TeTHA_e_ScreenRequest_THA_CM_Msg7" 16 "TeTHA_e_ScreenRequest_THA_CM_Msg8" 17 "TeTHA_e_ScreenRequest_THA_CM_Msg9" 18 "TeTHA_e_ScreenRequest_THA_CM_Msg10" 19 "TeTHA_e_ScreenRequest_THA_EOM_Msg1" 20 "TeTHA_e_ScreenRequest_THA_EOM_Msg2" 21 "TeTHA_e_ScreenRequest_THA_EOM_Msg3" 22 "TeTHA_e_ScreenRequest_THA_EOM_Msg4" 23 "TeTHA_e_ScreenRequest_THA_ERR_Msg1" 24 "TeTHA_e_ScreenRequest_THA_ERR_Msg2" 2147483647 "TeTHA_e_ScreenRequest_Dummy" /end COMPU_VTAB
/begin COMPU_METHOD THA_SM_Ref_CM_TeTHA_e_HitchDetctStatus "Enumerated data type: TeTHA_e_HitchDetctStatus" TAB_VERB "%0.6" "" COMPU_TAB_REF VTAB_FOR_THA_SM_Ref_CM_TeTHA_e_HitchDetctStatus /end COMPU_METHOD
/begin COMPU_VTAB VTAB_FOR_THA_SM_Ref_CM_TeTHA_e_HitchDetctStatus "Enumerated data type: TeTHA_e_HitchDetctStatus" TAB_VERB 4 0 "TeTHA_e_HitchDetctStatus_Not_Valid" 1 "TeTHA_e_HitchDetctStatus_Not_Detected" 2 "TeTHA_e_HitchDetctStatus_Detected" 2147483647 "TeTHA_e_HitchDetctStatus_Dummy" /end COMPU_VTAB
/begin COMPU_METHOD THA_SM_Ref_CM_TeTHA_e_CplrDetctStatus "Enumerated data type: TeTHA_e_CplrDetctStatus" TAB_VERB "%0.6" "" COMPU_TAB_REF VTAB_FOR_THA_SM_Ref_CM_TeTHA_e_CplrDetctStatus /end COMPU_METHOD
/begin COMPU_VTAB VTAB_FOR_THA_SM_Ref_CM_TeTHA_e_CplrDetctStatus "Enumerated data type: TeTHA_e_CplrDetctStatus" TAB_VERB 4 0 "TeTHA_e_CplrDetctStatus_Not_Valid" 1 "TeTHA_e_CplrDetctStatus_Not_Detected" 2 "TeTHA_e_CplrDetctStatus_Detected" 2147483647 "TeTHA_e_CplrDetctStatus_Dummy" /end COMPU_VTAB
/begin GROUP THA_SM_Ref "THA_SM_Ref" /* Root */ ROOT /begin SUB_GROUP Root_THA_SM_Controller Root_THA_SM_InputProcessing /end SUB_GROUP /end GROUP
/begin GROUP Root_THA_SM_Controller "THA_SM_Ref/THA_SM_Controller"
 /begin SUB_GROUP S1_THA_Chime_Manager S1_THA_FaultCheck_Manager S1_THA_HMILogicFlow_Manager S1_THA_MainStateMachine_Manager S1_THA_RearParkAssist_Manager /end SUB_GROUP
/end GROUP
/begin GROUP Root_THA_SM_InputProcessing "THA_SM_Ref/THA_SM_InputProcessing" /begin SUB_GROUP S2_Subsystem1 S2_Subsystem2 S2_Subsystem3 /end SUB_GROUP
 /begin REF_MEASUREMENT MePRX_b_CanNod63 MePRX_b_CanNod95 MePRX_b_ParkWithStop MeSVS_b_ImgDefeatReqSts MeSVS_b_IsConfirmBtnPrsd MeSVS_b_THAAbortReq MeSVS_b_THAMnvrStartBtnPrsd MeSVS_b_THAScrTchSts MeSVS_b_THASftBtnPrsdStsToTHA MeSVS_b_ViewZoomSts MeSVS_e_THAScrResp MeTHA_b_FidCamCalAbort MeTHA_b_FidDLDAbort MeTHA_b_FidDisabled MeTHA_deg_CplrAng MeTHA_e_CplrDetctStatus MeTHA_e_HitchDetctStatus MeTHA_px_HitchCplrPixDiffLat MeTHA_px_HitchCplrPixDiffLong /end REF_MEASUREMENT
/end GROUP
/begin GROUP S1_THA_Chime_Manager "THA_SM_Ref/THA_SM_Controller/THA_Chime_Manager" /begin REF_CHARACTERISTIC KeTHA_s_ChimeActvTime KeTHA_s_ThaSampleTime /end REF_CHARACTERISTIC /end GROUP
/begin GROUP S1_THA_FaultCheck_Manager "THA_SM_Ref/THA_SM_Controller/THA_FaultCheck_Manager"
 /begin SUB_GROUP S5_Abort_Condition_THA_Enabled S5_Abort_Condition_THA_Engaged S5_Abort_Condition_THA_Faulted /end SUB_GROUP
 /begin REF_CHARACTERISTIC KeTHA_s_GearEnggConfDur KeTHA_s_ThaSampleTime /end REF_CHARACTERISTIC
 /begin REF_MEASUREMENT MeTHA_b_AbortCndnEnabled MeTHA_b_AbortCndnEngaged /end REF_MEASUREMENT
/end GROUP
/begin GROUP S1_THA_HMILogicFlow_Manager "THA_SM_Ref/THA_SM_Controller/THA_HMILogicFlow_Manager"
 /begin SUB_GROUP S6_InitialVehiclePositionCheck S6_THAComplete_HMITriggerCheck /end SUB_GROUP
 /begin REF_CHARACTERISTIC KeTHA_b_EnblEngageRejectReq KeTHA_deg_VehTrlrInitAngMax KeTHA_px_EngageRejLatpxdiff KeTHA_s_CplrAngFoundTimeout KeTHA_s_HitchCplrDetctTimeout KeTHA_s_HmiFaultPopUpDur KeTHA_s_ThaSampleTime /end REF_CHARACTERISTIC
/end GROUP
/begin GROUP S1_THA_MainStateMachine_Manager "THA_SM_Ref/THA_SM_Controller/THA_MainStateMachine_Manager" /begin SUB_GROUP S7_THAStates_PreProcessing /end SUB_GROUP /begin REF_CHARACTERISTIC KeTHA_s_HmiFaultPopUpDur /end REF_CHARACTERISTIC /end GROUP
/begin GROUP S1_THA_RearParkAssist_Manager "THA_SM_Ref/THA_SM_Controller/THA_RearParkAssist_Manager" /begin REF_CHARACTERISTIC KeTHA_s_DistConfDur KeTHA_s_ThaSampleTime /end REF_CHARACTERISTIC /end GROUP
/begin GROUP S2_Subsystem1 "THA_SM_Ref/THA_SM_InputProcessing/Subsystem1" /begin REF_CHARACTERISTIC KeTHA_s_HmiFaultPopUpDur /end REF_CHARACTERISTIC /end GROUP
/begin GROUP S2_Subsystem2 "THA_SM_Ref/THA_SM_InputProcessing/Subsystem2" /begin REF_CHARACTERISTIC KeTHA_s_HmiFaultPopUpDur /end REF_CHARACTERISTIC /end GROUP
/begin GROUP S2_Subsystem3 "THA_SM_Ref/THA_SM_InputProcessing/Subsystem3" /begin REF_CHARACTERISTIC KeTHA_s_HmiFaultPopUpDur /end REF_CHARACTERISTIC /end GROUP
/begin GROUP S5_Abort_Condition_THA_Enabled "THA_SM_Ref/THA_SM_Controller/THA_FaultCheck_Manager/Abort_Condition_THA_Enabled" /begin SUB_GROUP S17_Hold_2sec /end SUB_GROUP /begin REF_CHARACTERISTIC KeTHA_s_MnvTimeout KeTHA_s_ThaSampleTime /end REF_CHARACTERISTIC /begin REF_MEASUREMENT MeTHA_b_FeatureOverride /end REF_MEASUREMENT /end GROUP
/begin GROUP S5_Abort_Condition_THA_Engaged "THA_SM_Ref/THA_SM_Controller/THA_FaultCheck_Manager/Abort_Condition_THA_Engaged" /begin SUB_GROUP S18_MagnaTimer1 /end SUB_GROUP
 /begin REF_CHARACTERISTIC KeTHA_kph_ActvSpdThd KeTHA_kph_VehSpdVSOSigSNA KeTHA_s_SpdOvrdTimeout KeTHA_s_ThaSampleTime KeTHA_s_TrajLostDur /end REF_CHARACTERISTIC
/end GROUP
/begin GROUP S5_Abort_Condition_THA_Faulted "THA_SM_Ref/THA_SM_Controller/THA_FaultCheck_Manager/Abort_Condition_THA_Faulted"
 /begin REF_CHARACTERISTIC KeTHA_a_AcclOfstBsmSNA KeTHA_a_VehAccSNA KeTHA_cnt_FastPlsCntrSNA KeTHA_ddeg_YawRateBsmSNA KeTHA_deg_StrWhlAngSNA KeTHA_kph_VehSpdVSOSigSNA KeTHA_kph_WhlSpdSNA /end REF_CHARACTERISTIC
 /begin REF_MEASUREMENT MeTHA_b_AbortCndnFaulted /end REF_MEASUREMENT
/end GROUP
/begin GROUP S6_InitialVehiclePositionCheck "THA_SM_Ref/THA_SM_Controller/THA_HMILogicFlow_Manager/InitialVehiclePositionCheck" /begin REF_CHARACTERISTIC KeTHA_b_EnblEngageRejectReq KsTHA_px_EngageRejLatOffset /end REF_CHARACTERISTIC /end GROUP
/begin GROUP S6_THAComplete_HMITriggerCheck "THA_SM_Ref/THA_SM_Controller/THA_HMILogicFlow_Manager/THAComplete_HMITriggerCheck" /begin REF_MEASUREMENT MeTHA_b_THACompleteHMITrig /end REF_MEASUREMENT /end GROUP
/begin GROUP S7_THAStates_PreProcessing "THA_SM_Ref/THA_SM_Controller/THA_MainStateMachine_Manager/THAStates_PreProcessing"
 /begin SUB_GROUP S86_CompleteStateCheck S86_EngagedDeltaInquiryCheck S86_EngagedHandShakeCheck S86_THAActivationCheck /end SUB_GROUP
/end GROUP
/begin GROUP S17_Hold_2sec "THA_SM_Ref/THA_SM_Controller/THA_FaultCheck_Manager/Abort_Condition_THA_Enabled/Hold_2sec" /begin REF_CHARACTERISTIC KeTHA_s_HmiFaultPopUpDur /end REF_CHARACTERISTIC /end GROUP
/begin GROUP S18_MagnaTimer1 "THA_SM_Ref/THA_SM_Controller/THA_FaultCheck_Manager/Abort_Condition_THA_Engaged/MagnaTimer1" /begin REF_MEASUREMENT MeTHA_b_OverSpeedAbort /end REF_MEASUREMENT /end GROUP
/begin GROUP S86_CompleteStateCheck "THA_SM_Ref/THA_SM_Controller/THA_MainStateMachine_Manager/THAStates_PreProcessing/CompleteStateCheck" /begin REF_CHARACTERISTIC KeTHA_s_Standstill KeTHA_s_ThaSampleTime /end REF_CHARACTERISTIC /end GROUP
/begin GROUP S86_EngagedDeltaInquiryCheck "THA_SM_Ref/THA_SM_Controller/THA_MainStateMachine_Manager/THAStates_PreProcessing/EngagedDeltaInquiryCheck" /begin SUB_GROUP S90_DetectionStatusFilter /end SUB_GROUP /end GROUP
/begin GROUP S86_EngagedHandShakeCheck "THA_SM_Ref/THA_SM_Controller/THA_MainStateMachine_Manager/THAStates_PreProcessing/EngagedHandShakeCheck" /begin SUB_GROUP S91_BSM_ECM_SpdLimHandshake S91_EPSTrqOvrHandShake /end SUB_GROUP /end GROUP
/begin GROUP S86_THAActivationCheck "THA_SM_Ref/THA_SM_Controller/THA_MainStateMachine_Manager/THAStates_PreProcessing/THAActivationCheck" /begin REF_MEASUREMENT MeTHA_b_ActivTrns /end REF_MEASUREMENT /end GROUP
/begin GROUP S90_DetectionStatusFilter "THA_SM_Ref/THA_SM_Controller/THA_MainStateMachine_Manager/THAStates_PreProcessing/EngagedDeltaInquiryCheck/DetectionStatusFilter"
 /begin REF_CHARACTERISTIC KeTHA_s_CplrDetStsBufEnabled KeTHA_s_CplrDetStsBufEngaged KeTHA_s_HitchDetStsBufEnabled KeTHA_s_HitchDetStsBufEngaged KeTHA_s_ThaSampleTime /end REF_CHARACTERISTIC
/end GROUP
/begin GROUP S91_BSM_ECM_SpdLimHandshake "THA_SM_Ref/THA_SM_Controller/THA_MainStateMachine_Manager/THAStates_PreProcessing/EngagedHandShakeCheck/BSM_ECM_SpdLimHandshake"
 /begin REF_CHARACTERISTIC KeTHA_kph_ActvSpdThd KeTHA_s_BsmHandshake KeTHA_s_EcmHandshake KeTHA_s_ThaSampleTime /end REF_CHARACTERISTIC
 /begin REF_MEASUREMENT MeTHA_b_AbortSpdLimReq /end REF_MEASUREMENT
/end GROUP
/begin GROUP S91_EPSTrqOvrHandShake "THA_SM_Ref/THA_SM_Controller/THA_MainStateMachine_Manager/THAStates_PreProcessing/EngagedHandShakeCheck/EPSTrqOvrHandShake"
 /begin REF_CHARACTERISTIC KeTHA_kph_ActvSpdThd KeTHA_s_EpsHandshake KeTHA_s_ThaSampleTime /end REF_CHARACTERISTIC
 /begin REF_MEASUREMENT MeTHA_b_AbortSteerTrqReq /end REF_MEASUREMENT
/end GROUP
/end MODULE
/end PROJECT
/* (add any file trailer comments here) */
/* EOF THA_SM_Ref.a2l */
