/******************************************************************************
* ASAP2 file: THA_SWC.a2l
* Code generation for model "THA_SWC".
* Model version : 1.1595
* Simulink Coder version : 9.2 (R2019b) 18-Jul-2019
* C source code generated on : Thu Aug 7 17:43:08 2025
* Target selection: ert.tlc
* Embedded hardware selection: Custom Processor->Custom Processor
* Code generation objectives:
* 1. MISRA C:2012 guidelines
* 2. RAM efficiency
* 3. ROM efficiency
* Validation result: Not run
* (add additional file header information here)
******************************************************************************/ ASAP2_VERSION 1 31
/* Version 1.31 */
/begin PROJECT ProjectName "Project Comment Goes Here"
/begin HEADER "Header Comments go here" /end HEADER
/begin MODULE ModuleName "Module Comment Goes Here"
/begin MOD_PAR "MOD PAR Comment Goes Here" /end MOD_PAR
/begin MOD_COMMON "Mod Common Comment Here" BYTE_ORDER MSB_LAST /end MOD_COMMON
/begin RECORD_LAYOUT Scalar_BOOLEAN FNC_VALUES 1 UBYTE COLUMN_DIR DIRECT /end RECORD_LAYOUT
/begin RECORD_LAYOUT Scalar_UBYTE FNC_VALUES 1 UBYTE COLUMN_DIR DIRECT /end RECORD_LAYOUT
/begin RECORD_LAYOUT Scalar_BYTE FNC_VALUES 1 SBYTE COLUMN_DIR DIRECT /end RECORD_LAYOUT
/begin RECORD_LAYOUT Scalar_UWORD FNC_VALUES 1 UWORD COLUMN_DIR DIRECT /end RECORD_LAYOUT
/begin RECORD_LAYOUT Scalar_SWORD FNC_VALUES 1 SWORD COLUMN_DIR DIRECT /end RECORD_LAYOUT
/begin RECORD_LAYOUT Scalar_ULONG FNC_VALUES 1 ULONG COLUMN_DIR DIRECT /end RECORD_LAYOUT
/begin RECORD_LAYOUT Scalar_LONG FNC_VALUES 1 SLONG COLUMN_DIR DIRECT /end RECORD_LAYOUT
/begin RECORD_LAYOUT Scalar_FLOAT32_IEEE FNC_VALUES 1 FLOAT32_IEEE COLUMN_DIR DIRECT /end RECORD_LAYOUT
/begin RECORD_LAYOUT Scalar_FLOAT64_IEEE FNC_VALUES 1 FLOAT64_IEEE COLUMN_DIR DIRECT /end RECORD_LAYOUT
/begin RECORD_LAYOUT Lookup1D_BOOLEAN FNC_VALUES 1 UBYTE COLUMN_DIR DIRECT /end RECORD_LAYOUT
/begin RECORD_LAYOUT Lookup1D_X_BOOLEAN AXIS_PTS_X 1 UBYTE INDEX_INCR DIRECT /end RECORD_LAYOUT
/begin RECORD_LAYOUT Lookup1D_BYTE FNC_VALUES 1 SBYTE COLUMN_DIR DIRECT /end RECORD_LAYOUT
/begin RECORD_LAYOUT Lookup1D_X_BYTE AXIS_PTS_X 1 SBYTE INDEX_INCR DIRECT /end RECORD_LAYOUT
/begin RECORD_LAYOUT Lookup1D_UBYTE FNC_VALUES 1 UBYTE COLUMN_DIR DIRECT /end RECORD_LAYOUT
/begin RECORD_LAYOUT Lookup1D_X_UBYTE AXIS_PTS_X 1 UBYTE INDEX_INCR DIRECT /end RECORD_LAYOUT
/begin RECORD_LAYOUT Lookup1D_UWORD FNC_VALUES 1 UWORD COLUMN_DIR DIRECT /end RECORD_LAYOUT
/begin RECORD_LAYOUT Lookup1D_X_UWORD AXIS_PTS_X 1 UWORD INDEX_INCR DIRECT /end RECORD_LAYOUT
/begin RECORD_LAYOUT Lookup1D_WORD FNC_VALUES 1 SWORD COLUMN_DIR DIRECT /end RECORD_LAYOUT
/begin RECORD_LAYOUT Lookup1D_X_WORD AXIS_PTS_X 1 SWORD INDEX_INCR DIRECT /end RECORD_LAYOUT
/begin RECORD_LAYOUT Lookup1D_ULONG FNC_VALUES 1 ULONG COLUMN_DIR DIRECT /end RECORD_LAYOUT
/begin RECORD_LAYOUT Lookup1D_X_ULONG AXIS_PTS_X 1 ULONG INDEX_INCR DIRECT /end RECORD_LAYOUT
/begin RECORD_LAYOUT Lookup1D_SLONG FNC_VALUES 1 SLONG COLUMN_DIR DIRECT /end RECORD_LAYOUT
/begin RECORD_LAYOUT Lookup1D_X_LONG AXIS_PTS_X 1 SLONG INDEX_INCR DIRECT /end RECORD_LAYOUT
/begin RECORD_LAYOUT Lookup1D_FLOAT32_IEEE FNC_VALUES 1 FLOAT32_IEEE COLUMN_DIR DIRECT /end RECORD_LAYOUT
/begin RECORD_LAYOUT Lookup1D_X_FLOAT32_IEEE AXIS_PTS_X 1 FLOAT32_IEEE INDEX_INCR DIRECT /end RECORD_LAYOUT
/begin RECORD_LAYOUT Lookup1D_FLOAT64_IEEE FNC_VALUES 1 FLOAT64_IEEE COLUMN_DIR DIRECT /end RECORD_LAYOUT
/begin RECORD_LAYOUT Lookup1D_X_FLOAT64_IEEE AXIS_PTS_X 1 FLOAT64_IEEE INDEX_INCR DIRECT /end RECORD_LAYOUT
/begin RECORD_LAYOUT Lookup2D_BOOLEAN FNC_VALUES 1 UBYTE COLUMN_DIR DIRECT /end RECORD_LAYOUT
/begin RECORD_LAYOUT Lookup2D_X_BOOLEAN AXIS_PTS_X 1 UBYTE INDEX_INCR DIRECT /end RECORD_LAYOUT
/begin RECORD_LAYOUT Lookup2D_UBYTE FNC_VALUES 1 UBYTE COLUMN_DIR DIRECT /end RECORD_LAYOUT
/begin RECORD_LAYOUT Lookup2D_X_UBYTE AXIS_PTS_X 1 UBYTE INDEX_INCR DIRECT /end RECORD_LAYOUT
/begin RECORD_LAYOUT Lookup2D_BYTE FNC_VALUES 1 SBYTE COLUMN_DIR DIRECT /end RECORD_LAYOUT
/begin RECORD_LAYOUT Lookup2D_X_BYTE AXIS_PTS_X 1 SBYTE INDEX_INCR DIRECT /end RECORD_LAYOUT
/begin RECORD_LAYOUT Lookup2D_UWORD FNC_VALUES 1 UWORD COLUMN_DIR DIRECT /end RECORD_LAYOUT
/begin RECORD_LAYOUT Lookup2D_X_UWORD AXIS_PTS_X 1 UWORD INDEX_INCR DIRECT /end RECORD_LAYOUT
/begin RECORD_LAYOUT Lookup2D_WORD FNC_VALUES 1 SWORD COLUMN_DIR DIRECT /end RECORD_LAYOUT
/begin RECORD_LAYOUT Lookup2D_X_WORD AXIS_PTS_X 1 SWORD INDEX_INCR DIRECT /end RECORD_LAYOUT
/begin RECORD_LAYOUT Lookup2D_ULONG FNC_VALUES 1 ULONG COLUMN_DIR DIRECT /end RECORD_LAYOUT
/begin RECORD_LAYOUT Lookup2D_X_ULONG AXIS_PTS_X 1 ULONG INDEX_INCR DIRECT /end RECORD_LAYOUT
/begin RECORD_LAYOUT Lookup2D_LONG FNC_VALUES 1 SLONG COLUMN_DIR DIRECT /end RECORD_LAYOUT
/begin RECORD_LAYOUT Lookup2D_X_LONG AXIS_PTS_X 1 SLONG INDEX_INCR DIRECT /end RECORD_LAYOUT
/begin RECORD_LAYOUT Lookup2D_FLOAT32_IEEE FNC_VALUES 1 FLOAT32_IEEE COLUMN_DIR DIRECT /end RECORD_LAYOUT
/begin RECORD_LAYOUT Lookup2D_X_FLOAT32_IEEE AXIS_PTS_X 1 FLOAT32_IEEE INDEX_INCR DIRECT /end RECORD_LAYOUT
/begin RECORD_LAYOUT Lookup2D_FLOAT64_IEEE FNC_VALUES 1 FLOAT64_IEEE COLUMN_DIR DIRECT /end RECORD_LAYOUT
/begin RECORD_LAYOUT Lookup2D_X_FLOAT64_IEEE AXIS_PTS_X 1 FLOAT64_IEEE INDEX_INCR DIRECT /end RECORD_LAYOUT
/begin CHARACTERISTIC KeTHA_px_HitchCplrDeltaThd1 "Coupler distance threshold for transiting to Engaged Delta state in pixels. (Equivalent to 4 Feet)" VALUE 0x0000 /* @ECU_Address@KeTHA_px_HitchCplrDeltaThd1@ */ Scalar_LONG 0 THA_SWC_CM_int32_pixel 0.0 1080.0 /end CHARACTERISTIC
/begin CHARACTERISTIC KeTHA_px_HitchCplrDeltaThd2 "Coupler distance threshold for transiting to Engaged Inquiry state in pixels. (Equivalent to 2 Feet)" VALUE 0x0000 /* @ECU_Address@KeTHA_px_HitchCplrDeltaThd2@ */ Scalar_LONG 0 THA_SWC_CM_int32_pixel 0.0 1080.0 /end CHARACTERISTIC
/begin CHARACTERISTIC KeTHA_px_RearBrkSuppDist "Distance from target trailer coupler that autonomous braking will be suppressed. " VALUE 0x0000 /* @ECU_Address@KeTHA_px_RearBrkSuppDist@ */ Scalar_LONG 0 THA_SWC_CM_int32_pixel 0.0 1080.0 /end CHARACTERISTIC
/begin CHARACTERISTIC KeTHA_M_SteerTweakTrq "Steering tweak torque amplitude." VALUE 0x0000 /* @ECU_Address@KeTHA_M_SteerTweakTrq@ */ Scalar_FLOAT32_IEEE 0 THA_SWC_CM_single_Nm 0.0 5.0 /end CHARACTERISTIC
/begin CHARACTERISTIC KeTHA_k_HeadingErrGain "Heading error gain." VALUE 0x0000 /* @ECU_Address@KeTHA_k_HeadingErrGain@ */ Scalar_FLOAT32_IEEE 0 THA_SWC_CM_single -100.0 100.0 /end CHARACTERISTIC
/begin CHARACTERISTIC KeTHA_k_SteerTrqCtrlFiltCoef "Steering filter coefficient." VALUE 0x0000 /* @ECU_Address@KeTHA_k_SteerTrqCtrlFiltCoef@ */ Scalar_FLOAT32_IEEE 0 THA_SWC_CM_single 0.0 20.0 /end CHARACTERISTIC
/begin CHARACTERISTIC KeTHA_k_SteerTrqCtrlKd "Steering controller - Derivative gain" VALUE 0x0000 /* @ECU_Address@KeTHA_k_SteerTrqCtrlKd@ */ Scalar_FLOAT32_IEEE 0 THA_SWC_CM_single 0.0 10.0 /end CHARACTERISTIC
/begin CHARACTERISTIC KeTHA_k_SteerTrqCtrlKi "Steering controller - Integral gain" VALUE 0x0000 /* @ECU_Address@KeTHA_k_SteerTrqCtrlKi@ */ Scalar_FLOAT32_IEEE 0 THA_SWC_CM_single 0.0 10.0 /end CHARACTERISTIC
/begin CHARACTERISTIC KeTHA_k_SteerTrqCtrlKp "Steer torque control Kp." VALUE 0x0000 /* @ECU_Address@KeTHA_k_SteerTrqCtrlKp@ */ Scalar_FLOAT32_IEEE 0 THA_SWC_CM_single -10.0 10.0 /end CHARACTERISTIC
/begin CHARACTERISTIC KeTHA_k_TrqCtrlFiltCoef "Steering wheel angle to steering torque controller - Filter Coefficient." VALUE 0x0000 /* @ECU_Address@KeTHA_k_TrqCtrlFiltCoef@ */ Scalar_FLOAT32_IEEE 0 THA_SWC_CM_single 0.0 20.0 /end CHARACTERISTIC
/begin CHARACTERISTIC KeTHA_k_TrqCtrlKd "Steering wheel angle to steering torque controller - Derivative gain." VALUE 0x0000 /* @ECU_Address@KeTHA_k_TrqCtrlKd@ */ Scalar_FLOAT32_IEEE 0 THA_SWC_CM_single 0.0 10.0 /end CHARACTERISTIC
/begin CHARACTERISTIC KeTHA_k_TrqCtrlKi "Steering wheel angle to steering torque controller - Integral gain." VALUE 0x0000 /* @ECU_Address@KeTHA_k_TrqCtrlKi@ */ Scalar_FLOAT32_IEEE 0 THA_SWC_CM_single 0.0 10.0 /end CHARACTERISTIC
/begin CHARACTERISTIC KeTHA_k_TrqCtrlKp "Steering wheel angle to steering torque controller - proportional gain." VALUE 0x0000 /* @ECU_Address@KeTHA_k_TrqCtrlKp@ */ Scalar_FLOAT32_IEEE 0 THA_SWC_CM_single 0.0 10.0 /end CHARACTERISTIC
/begin CHARACTERISTIC KeTHA_m_WhlCircumference "Wheel circumference." VALUE 0x0000 /* @ECU_Address@KeTHA_m_WhlCircumference@ */ Scalar_FLOAT32_IEEE 0 THA_SWC_CM_single_m 0.0 4.0 /end CHARACTERISTIC
/begin CHARACTERISTIC KeTHA_s_SteerTweakTime "Steering tweak profile duration.
      " VALUE 0x0000 /* @ECU_Address@KeTHA_s_SteerTweakTime@ */ Scalar_FLOAT32_IEEE 0 THA_SWC_CM_single_s 0.0 5.0 /end CHARACTERISTIC
/begin CHARACTERISTIC KsTHA_deg_StrToRdWhlAngTD "Array of road wheel angles corresponding to steering wheel values of [-600 -525 -450 -375 -300 -225 -150 -75 0 75 150 225 300 375 450 525 600]." VAL_BLK 0x0000 /* @ECU_Address@KsTHA_deg_StrToRdWhlAngTD@ */ Scalar_FLOAT32_IEEE 0 THA_SWC_CM_single_deg -90.0 90.0 NUMBER 17 /end CHARACTERISTIC
/begin CHARACTERISTIC KsTHA_k_ErrxHeadingErrTD "Heading error for the longitudinal pixel difference between hitch and coupler/trailer of [0,50,150,200]." VAL_BLK 0x0000 /* @ECU_Address@KsTHA_k_ErrxHeadingErrTD@ */ Scalar_FLOAT32_IEEE 0 THA_SWC_CM_single 0.0 2.0 NUMBER 4 /end CHARACTERISTIC
/begin CHARACTERISTIC KsTHA_k_ErrxPropGainTD "Proportional gain array for the longitudinal pixel difference between hitch and coupler/trailer of [0,50,100,150,200]." VAL_BLK 0x0000 /* @ECU_Address@KsTHA_k_ErrxPropGainTD@ */ Scalar_FLOAT32_IEEE 0 THA_SWC_CM_single 0.0 1000.0 NUMBER 5 /end CHARACTERISTIC
/begin CHARACTERISTIC KsTHA_mps_DistSpdTD "THA speed limit array for the longitudinal pixel difference between hitch and coupler/trailer of [60, 112, 137, 147, 155, 164]." VAL_BLK 0x0000 /* @ECU_Address@KsTHA_mps_DistSpdTD@ */ Scalar_FLOAT32_IEEE 0 THA_SWC_CM_single_km_hr 0.0 3.0 NUMBER 6 /end CHARACTERISTIC
/begin CHARACTERISTIC KeTHA_ddeg_StrRateLimFinal "Steering rate limit during maneuver." VALUE 0x0000 /* @ECU_Address@KeTHA_ddeg_StrRateLimFinal@ */ Scalar_UWORD 0 THA_SWC_CM_uint16_deg_s 0.0 2000.0 /end CHARACTERISTIC
/begin CHARACTERISTIC KeTHA_ddeg_StrRateLimInit "Initial steering rate limit to avoid sudden jerk." VALUE 0x0000 /* @ECU_Address@KeTHA_ddeg_StrRateLimInit@ */ Scalar_UWORD 0 THA_SWC_CM_uint16_deg_s 0.0 2000.0 /end CHARACTERISTIC
/begin COMPU_METHOD THA_SWC_CM_int32_pixel "Q = V" RAT_FUNC "%10.0" "pixel" COEFFS 0 1 0 0 0 1 /end COMPU_METHOD
/begin COMPU_METHOD THA_SWC_CM_single_Nm "Q = V" RAT_FUNC "%8.6" "Nm" COEFFS 0 1 0 0 0 1 /end COMPU_METHOD
/begin COMPU_METHOD THA_SWC_CM_single "Q = V" RAT_FUNC "%8.6" "" COEFFS 0 1 0 0 0 1 /end COMPU_METHOD
/begin COMPU_METHOD THA_SWC_CM_single_m "Q = V" RAT_FUNC "%8.6" "m" COEFFS 0 1 0 0 0 1 /end COMPU_METHOD
/begin COMPU_METHOD THA_SWC_CM_single_s "Q = V" RAT_FUNC "%8.6" "s" COEFFS 0 1 0 0 0 1 /end COMPU_METHOD
/begin COMPU_METHOD THA_SWC_CM_single_deg "Q = V" RAT_FUNC "%8.6" "deg" COEFFS 0 1 0 0 0 1 /end COMPU_METHOD
/begin COMPU_METHOD THA_SWC_CM_single_km_hr "Q = V" RAT_FUNC "%8.6" "km/hr" COEFFS 0 1 0 0 0 1 /end COMPU_METHOD
/begin COMPU_METHOD THA_SWC_CM_uint16_deg_s "Q = V" RAT_FUNC "%5.0" "deg/s" COEFFS 0 1 0 0 0 1 /end COMPU_METHOD
/begin GROUP THA_SWC "THA_SWC" /* Root */ ROOT /begin SUB_GROUP Root_DataStoreMemoryIn mr_grp2link_THA_SmVc_Ref /end SUB_GROUP /end GROUP
/begin GROUP Root_DataStoreMemoryIn "THA_SWC/DataStoreMemoryIn" /begin SUB_GROUP S1_CodeToModelMapping /end SUB_GROUP /end GROUP
/begin GROUP S1_CodeToModelMapping "THA_SWC/DataStoreMemoryIn/CodeToModelMapping"
 /begin REF_CHARACTERISTIC KeTHA_M_SteerTweakTrq KeTHA_ddeg_StrRateLimFinal KeTHA_ddeg_StrRateLimInit KeTHA_k_HeadingErrGain KeTHA_k_SteerTrqCtrlFiltCoef KeTHA_k_SteerTrqCtrlKd KeTHA_k_SteerTrqCtrlKi KeTHA_k_SteerTrqCtrlKp KeTHA_k_TrqCtrlFiltCoef KeTHA_k_TrqCtrlKd KeTHA_k_TrqCtrlKi KeTHA_k_TrqCtrlKp KeTHA_m_WhlCircumference KeTHA_px_HitchCplrDeltaThd1 KeTHA_px_HitchCplrDeltaThd2 KeTHA_px_RearBrkSuppDist KeTHA_s_SteerTweakTime KsTHA_deg_StrToRdWhlAngTD KsTHA_k_ErrxHeadingErrTD KsTHA_k_ErrxPropGainTD KsTHA_mps_DistSpdTD /end REF_CHARACTERISTIC
/end GROUP
/end MODULE
/end PROJECT
/* (add any file trailer comments here) */
/* EOF THA_SWC.a2l */
