/******************************************************************************
* ASAP2 file: TRSC_SM_VC_Int.a2l
* Code generation for model "TRSC_SM_VC_Int".
* Model version : 1.337
* Simulink Coder version : 9.2 (R2019b) 18-Jul-2019
* C source code generated on : Thu Nov 13 09:53:44 2025
* Target selection: ert.tlc
* Embedded hardware selection: ARM Compatible->ARM Cortex
* Code generation objectives:
* 1. MISRA C:2012 guidelines
* 2. RAM efficiency
* 3. ROM efficiency
* Validation result: Not run
* (add additional file header information here)
******************************************************************************/ ASAP2_VERSION 1 31
/* Version 1.31 */
/begin PROJECT ProjectName "Project Comment Goes Here"
/begin HEADER "Header Comments go here" /end HEADER
/begin MODULE ModuleName "Module Comment Goes Here"
/begin MOD_PAR "MOD PAR Comment Goes Here" /end MOD_PAR
/begin MOD_COMMON "Mod Common Comment Here" BYTE_ORDER MSB_LAST /end MOD_COMMON
/begin RECORD_LAYOUT Scalar_BOOLEAN FNC_VALUES 1 UBYTE COLUMN_DIR DIRECT /end RECORD_LAYOUT
/begin RECORD_LAYOUT Scalar_UBYTE FNC_VALUES 1 UBYTE COLUMN_DIR DIRECT /end RECORD_LAYOUT
/begin RECORD_LAYOUT Scalar_BYTE FNC_VALUES 1 SBYTE COLUMN_DIR DIRECT /end RECORD_LAYOUT
/begin RECORD_LAYOUT Scalar_UWORD FNC_VALUES 1 UWORD COLUMN_DIR DIRECT /end RECORD_LAYOUT
/begin RECORD_LAYOUT Scalar_SWORD FNC_VALUES 1 SWORD COLUMN_DIR DIRECT /end RECORD_LAYOUT
/begin RECORD_LAYOUT Scalar_ULONG FNC_VALUES 1 ULONG COLUMN_DIR DIRECT /end RECORD_LAYOUT
/begin RECORD_LAYOUT Scalar_LONG FNC_VALUES 1 SLONG COLUMN_DIR DIRECT /end RECORD_LAYOUT
/begin RECORD_LAYOUT Scalar_FLOAT32_IEEE FNC_VALUES 1 FLOAT32_IEEE COLUMN_DIR DIRECT /end RECORD_LAYOUT
/begin RECORD_LAYOUT Scalar_FLOAT64_IEEE FNC_VALUES 1 FLOAT64_IEEE COLUMN_DIR DIRECT /end RECORD_LAYOUT
/begin RECORD_LAYOUT Lookup1D_BOOLEAN FNC_VALUES 1 UBYTE COLUMN_DIR DIRECT /end RECORD_LAYOUT
/begin RECORD_LAYOUT Lookup1D_X_BOOLEAN AXIS_PTS_X 1 UBYTE INDEX_INCR DIRECT /end RECORD_LAYOUT
/begin RECORD_LAYOUT Lookup1D_BYTE FNC_VALUES 1 SBYTE COLUMN_DIR DIRECT /end RECORD_LAYOUT
/begin RECORD_LAYOUT Lookup1D_X_BYTE AXIS_PTS_X 1 SBYTE INDEX_INCR DIRECT /end RECORD_LAYOUT
/begin RECORD_LAYOUT Lookup1D_UBYTE FNC_VALUES 1 UBYTE COLUMN_DIR DIRECT /end RECORD_LAYOUT
/begin RECORD_LAYOUT Lookup1D_X_UBYTE AXIS_PTS_X 1 UBYTE INDEX_INCR DIRECT /end RECORD_LAYOUT
/begin RECORD_LAYOUT Lookup1D_UWORD FNC_VALUES 1 UWORD COLUMN_DIR DIRECT /end RECORD_LAYOUT
/begin RECORD_LAYOUT Lookup1D_X_UWORD AXIS_PTS_X 1 UWORD INDEX_INCR DIRECT /end RECORD_LAYOUT
/begin RECORD_LAYOUT Lookup1D_WORD FNC_VALUES 1 SWORD COLUMN_DIR DIRECT /end RECORD_LAYOUT
/begin RECORD_LAYOUT Lookup1D_X_WORD AXIS_PTS_X 1 SWORD INDEX_INCR DIRECT /end RECORD_LAYOUT
/begin RECORD_LAYOUT Lookup1D_ULONG FNC_VALUES 1 ULONG COLUMN_DIR DIRECT /end RECORD_LAYOUT
/begin RECORD_LAYOUT Lookup1D_X_ULONG AXIS_PTS_X 1 ULONG INDEX_INCR DIRECT /end RECORD_LAYOUT
/begin RECORD_LAYOUT Lookup1D_SLONG FNC_VALUES 1 SLONG COLUMN_DIR DIRECT /end RECORD_LAYOUT
/begin RECORD_LAYOUT Lookup1D_X_LONG AXIS_PTS_X 1 SLONG INDEX_INCR DIRECT /end RECORD_LAYOUT
/begin RECORD_LAYOUT Lookup1D_FLOAT32_IEEE FNC_VALUES 1 FLOAT32_IEEE COLUMN_DIR DIRECT /end RECORD_LAYOUT
/begin RECORD_LAYOUT Lookup1D_X_FLOAT32_IEEE AXIS_PTS_X 1 FLOAT32_IEEE INDEX_INCR DIRECT /end RECORD_LAYOUT
/begin RECORD_LAYOUT Lookup1D_FLOAT64_IEEE FNC_VALUES 1 FLOAT64_IEEE COLUMN_DIR DIRECT /end RECORD_LAYOUT
/begin RECORD_LAYOUT Lookup1D_X_FLOAT64_IEEE AXIS_PTS_X 1 FLOAT64_IEEE INDEX_INCR DIRECT /end RECORD_LAYOUT
/begin RECORD_LAYOUT Lookup2D_BOOLEAN FNC_VALUES 1 UBYTE COLUMN_DIR DIRECT /end RECORD_LAYOUT
/begin RECORD_LAYOUT Lookup2D_X_BOOLEAN AXIS_PTS_X 1 UBYTE INDEX_INCR DIRECT /end RECORD_LAYOUT
/begin RECORD_LAYOUT Lookup2D_UBYTE FNC_VALUES 1 UBYTE COLUMN_DIR DIRECT /end RECORD_LAYOUT
/begin RECORD_LAYOUT Lookup2D_X_UBYTE AXIS_PTS_X 1 UBYTE INDEX_INCR DIRECT /end RECORD_LAYOUT
/begin RECORD_LAYOUT Lookup2D_BYTE FNC_VALUES 1 SBYTE COLUMN_DIR DIRECT /end RECORD_LAYOUT
/begin RECORD_LAYOUT Lookup2D_X_BYTE AXIS_PTS_X 1 SBYTE INDEX_INCR DIRECT /end RECORD_LAYOUT
/begin RECORD_LAYOUT Lookup2D_UWORD FNC_VALUES 1 UWORD COLUMN_DIR DIRECT /end RECORD_LAYOUT
/begin RECORD_LAYOUT Lookup2D_X_UWORD AXIS_PTS_X 1 UWORD INDEX_INCR DIRECT /end RECORD_LAYOUT
/begin RECORD_LAYOUT Lookup2D_WORD FNC_VALUES 1 SWORD COLUMN_DIR DIRECT /end RECORD_LAYOUT
/begin RECORD_LAYOUT Lookup2D_X_WORD AXIS_PTS_X 1 SWORD INDEX_INCR DIRECT /end RECORD_LAYOUT
/begin RECORD_LAYOUT Lookup2D_ULONG FNC_VALUES 1 ULONG COLUMN_DIR DIRECT /end RECORD_LAYOUT
/begin RECORD_LAYOUT Lookup2D_X_ULONG AXIS_PTS_X 1 ULONG INDEX_INCR DIRECT /end RECORD_LAYOUT
/begin RECORD_LAYOUT Lookup2D_LONG FNC_VALUES 1 SLONG COLUMN_DIR DIRECT /end RECORD_LAYOUT
/begin RECORD_LAYOUT Lookup2D_X_LONG AXIS_PTS_X 1 SLONG INDEX_INCR DIRECT /end RECORD_LAYOUT
/begin RECORD_LAYOUT Lookup2D_FLOAT32_IEEE FNC_VALUES 1 FLOAT32_IEEE COLUMN_DIR DIRECT /end RECORD_LAYOUT
/begin RECORD_LAYOUT Lookup2D_X_FLOAT32_IEEE AXIS_PTS_X 1 FLOAT32_IEEE INDEX_INCR DIRECT /end RECORD_LAYOUT
/begin RECORD_LAYOUT Lookup2D_FLOAT64_IEEE FNC_VALUES 1 FLOAT64_IEEE COLUMN_DIR DIRECT /end RECORD_LAYOUT
/begin RECORD_LAYOUT Lookup2D_X_FLOAT64_IEEE AXIS_PTS_X 1 FLOAT64_IEEE INDEX_INCR DIRECT /end RECORD_LAYOUT
/begin MEASUREMENT IbTRSC_InpBus.IbTRSC_VehInpFromCAN2.IeVBII_px_TchXCoord "" FLOAT32_IEEE TRSC_SM_VC_Int_CM_single 0 0 -3.4E+38 3.4E+38 ECU_ADDRESS 0x0000 /* @ECU_Address@IbTRSC_InpBus.IbTRSC_VehInpFromCAN2.IeVBII_px_TchXCoord@ */ /end MEASUREMENT
/begin MEASUREMENT IbTRSC_InpBus.IbTRSC_VehInpFromCAN2.IeVBII_px_TchYCoord "" FLOAT32_IEEE TRSC_SM_VC_Int_CM_single 0 0 -3.4E+38 3.4E+38 ECU_ADDRESS 0x0000 /* @ECU_Address@IbTRSC_InpBus.IbTRSC_VehInpFromCAN2.IeVBII_px_TchYCoord@ */ /end MEASUREMENT
/begin MEASUREMENT IbTRSC_InpBus.IbTRSC_VehInpFromCAN2.IeVBII_mm_VehFlLvl "" FLOAT32_IEEE TRSC_SM_VC_Int_CM_single 0 0 -3.4E+38 3.4E+38 ECU_ADDRESS 0x0000 /* @ECU_Address@IbTRSC_InpBus.IbTRSC_VehInpFromCAN2.IeVBII_mm_VehFlLvl@ */ /end MEASUREMENT
/begin MEASUREMENT IbTRSC_InpBus.IbTRSC_VehInpFromCAN2.IeVBII_mm_VehFrLvl "" FLOAT32_IEEE TRSC_SM_VC_Int_CM_single 0 0 -3.4E+38 3.4E+38 ECU_ADDRESS 0x0000 /* @ECU_Address@IbTRSC_InpBus.IbTRSC_VehInpFromCAN2.IeVBII_mm_VehFrLvl@ */ /end MEASUREMENT
/begin MEASUREMENT IbTRSC_InpBus.IbTRSC_VehInpFromCAN2.IeVBII_mm_VehRlLvl "" FLOAT32_IEEE TRSC_SM_VC_Int_CM_single 0 0 -3.4E+38 3.4E+38 ECU_ADDRESS 0x0000 /* @ECU_Address@IbTRSC_InpBus.IbTRSC_VehInpFromCAN2.IeVBII_mm_VehRlLvl@ */ /end MEASUREMENT
/begin MEASUREMENT IbTRSC_InpBus.IbTRSC_VehInpFromCAN2.IeVBII_mm_VehRrLvl "" FLOAT32_IEEE TRSC_SM_VC_Int_CM_single 0 0 -3.4E+38 3.4E+38 ECU_ADDRESS 0x0000 /* @ECU_Address@IbTRSC_InpBus.IbTRSC_VehInpFromCAN2.IeVBII_mm_VehRrLvl@ */ /end MEASUREMENT
/begin MEASUREMENT IbTRSC_InpBus.IbTRSC_VehInpFromCAN2.IeVBII_e_CmdIgnSts "" SLONG TRSC_SM_VC_Int_CM_TeVBII_e_CmdIgnSts 0 0 0 2147483647 ECU_ADDRESS 0x0000 /* @ECU_Address@IbTRSC_InpBus.IbTRSC_VehInpFromCAN2.IeVBII_e_CmdIgnSts@ */ /end MEASUREMENT
/begin MEASUREMENT IbTRSC_InpBus.IbTRSC_VehInpFromCAN2.IeVBII_e_TrailerConnectionSts "" SLONG TRSC_SM_VC_Int_CM_TeVBII_e_TrailerConnectionSts 0 0 0 2147483647 ECU_ADDRESS 0x0000 /* @ECU_Address@IbTRSC_InpBus.IbTRSC_VehInpFromCAN2.IeVBII_e_TrailerConnectionSts@ */ /end MEASUREMENT
/begin MEASUREMENT IbTRSC_InpBus.IbTRSC_VehInpFromCAN2.IeVBII_e_TrlrPrsntSts "" SLONG TRSC_SM_VC_Int_CM_TeVBII_e_TrlrPrsntSts 0 0 0 2147483647 ECU_ADDRESS 0x0000 /* @ECU_Address@IbTRSC_InpBus.IbTRSC_VehInpFromCAN2.IeVBII_e_TrlrPrsntSts@ */ /end MEASUREMENT
/begin MEASUREMENT IbTRSC_InpBus.IbTRSC_VehInpFromCAN2.IeVBII_e_TchScrSts "" SLONG TRSC_SM_VC_Int_CM_TeVBII_e_TchScrSts 0 0 0 2147483647 ECU_ADDRESS 0x0000 /* @ECU_Address@IbTRSC_InpBus.IbTRSC_VehInpFromCAN2.IeVBII_e_TchScrSts@ */ /end MEASUREMENT
/begin MEASUREMENT IbTRSC_InpBus.IbTRSC_VehInpFromCAN2.IeVBII_e_TrscEnblBtnSts "" SLONG TRSC_SM_VC_Int_CM_TeVBII_e_TrscEnblBtnSts 0 0 0 2147483647 ECU_ADDRESS 0x0000 /* @ECU_Address@IbTRSC_InpBus.IbTRSC_VehInpFromCAN2.IeVBII_e_TrscEnblBtnSts@ */ /end MEASUREMENT
/begin MEASUREMENT IbTRSC_InpBus.IbTRSC_VehInpFromCAN2.IeVBII_e_GearRptState "" SLONG TRSC_SM_VC_Int_CM_TeVBII_e_GearRptState 0 0 0 2147483647 ECU_ADDRESS 0x0000 /* @ECU_Address@IbTRSC_InpBus.IbTRSC_VehInpFromCAN2.IeVBII_e_GearRptState@ */ /end MEASUREMENT
/begin MEASUREMENT IbTRSC_InpBus.IbTRSC_VehInpFromCAN2.IeVBII_e_SBR1RowDriverSeatSts "" SLONG TRSC_SM_VC_Int_CM_TeVBII_e_SBR1RowDriverSeatSts 0 0 0 2147483647 ECU_ADDRESS 0x0000 /* @ECU_Address@IbTRSC_InpBus.IbTRSC_VehInpFromCAN2.IeVBII_e_SBR1RowDriverSeatSts@ */ /end MEASUREMENT
/begin MEASUREMENT IbTRSC_InpBus.IbTRSC_VehInpFromCAN2.IeVBII_e_VehAscmSts "" SLONG TRSC_SM_VC_Int_CM_TeVBII_e_VehAscmSts 0 0 0 2147483647 ECU_ADDRESS 0x0000 /* @ECU_Address@IbTRSC_InpBus.IbTRSC_VehInpFromCAN2.IeVBII_e_VehAscmSts@ */ /end MEASUREMENT
/begin MEASUREMENT IbTRSC_InpBus.IbTRSC_VehInpFromCAN2.IeVBII_e_GearEngagedForDsply "" SLONG TRSC_SM_VC_Int_CM_TeVBII_e_GearEngagedForDsply 0 0 0 2147483647 ECU_ADDRESS 0x0000 /* @ECU_Address@IbTRSC_InpBus.IbTRSC_VehInpFromCAN2.IeVBII_e_GearEngagedForDsply@ */ /end MEASUREMENT
/begin MEASUREMENT IbTRSC_InpBus.IbTRSC_VehInpFromCAN2.IeVBII_e_CenterBtnSts "" SLONG TRSC_SM_VC_Int_CM_TeVBII_e_CenterBtnSts 0 0 0 2147483647 ECU_ADDRESS 0x0000 /* @ECU_Address@IbTRSC_InpBus.IbTRSC_VehInpFromCAN2.IeVBII_e_CenterBtnSts@ */ /end MEASUREMENT
/begin MEASUREMENT IbTRSC_InpBus.IbTRSC_VehInpFromCAN2.IeVBII_e_EnblBtnSts "" SLONG TRSC_SM_VC_Int_CM_TeVBII_e_EnblBtnSts 0 0 0 2147483647 ECU_ADDRESS 0x0000 /* @ECU_Address@IbTRSC_InpBus.IbTRSC_VehInpFromCAN2.IeVBII_e_EnblBtnSts@ */ /end MEASUREMENT
/begin MEASUREMENT IbTRSC_InpBus.IbTRSC_VehInpFromCAN2.IeVBII_e_ShiftLvrPos "" SLONG TRSC_SM_VC_Int_CM_TeVBII_e_ShiftLvrPos 0 0 0 2147483647 ECU_ADDRESS 0x0000 /* @ECU_Address@IbTRSC_InpBus.IbTRSC_VehInpFromCAN2.IeVBII_e_ShiftLvrPos@ */ /end MEASUREMENT
/begin MEASUREMENT IbTRSC_InpBus.IbTRSC_VehInpFromCAN2.IeVBII_e_TGWCamDispSts "" SLONG TRSC_SM_VC_Int_CM_TeVBII_e_TGWCamDispSts 0 0 0 2147483647 ECU_ADDRESS 0x0000 /* @ECU_Address@IbTRSC_InpBus.IbTRSC_VehInpFromCAN2.IeVBII_e_TGWCamDispSts@ */ /end MEASUREMENT
/begin MEASUREMENT IbTRSC_InpBus.IbTRSC_VehInpFromCAN2.IeVBII_e_CamDispSts "" SLONG TRSC_SM_VC_Int_CM_TeVBII_e_CamDispSts 0 0 0 2147483647 ECU_ADDRESS 0x0000 /* @ECU_Address@IbTRSC_InpBus.IbTRSC_VehInpFromCAN2.IeVBII_e_CamDispSts@ */ /end MEASUREMENT
/begin MEASUREMENT IbTRSC_InpBus.IbTRSC_VehInpFromCAN2.IeVBII_e_CustTrlrType "" SLONG TRSC_SM_VC_Int_CM_TeVBII_e_CustTrlrType 0 0 0 2147483647 ECU_ADDRESS 0x0000 /* @ECU_Address@IbTRSC_InpBus.IbTRSC_VehInpFromCAN2.IeVBII_e_CustTrlrType@ */ /end MEASUREMENT
/begin MEASUREMENT IbTRSC_InpBus.IbTRSC_VehInpFromCAN2.IeVBII_k_KnobAngl "" UWORD TRSC_SM_VC_Int_CM_uint16 0 0 0 65535 ECU_ADDRESS 0x0000 /* @ECU_Address@IbTRSC_InpBus.IbTRSC_VehInpFromCAN2.IeVBII_k_KnobAngl@ */ /end MEASUREMENT
/begin MEASUREMENT IbTRSC_InpBus.IbTRSC_VehInpFromCAN2.IeVBII_b_DriverDoorSts "" UBYTE TRSC_SM_VC_Int_CM_boolean 0 0 0 1 ECU_ADDRESS 0x0000 /* @ECU_Address@IbTRSC_InpBus.IbTRSC_VehInpFromCAN2.IeVBII_b_DriverDoorSts@ */ /end MEASUREMENT
/begin MEASUREMENT IbTRSC_InpBus.IbTRSC_VehInpFromCAN2.IeVBII_b_TrnkStatus "" UBYTE TRSC_SM_VC_Int_CM_boolean 0 0 0 1 ECU_ADDRESS 0x0000 /* @ECU_Address@IbTRSC_InpBus.IbTRSC_VehInpFromCAN2.IeVBII_b_TrnkStatus@ */ /end MEASUREMENT
/begin MEASUREMENT IbTRSC_InpBus.IbTRSC_VehInpFromCAN2.IeVBII_e_VehFlLvlAdj "" UBYTE TRSC_SM_VC_Int_CM_boolean 0 0 0 1 ECU_ADDRESS 0x0000 /* @ECU_Address@IbTRSC_InpBus.IbTRSC_VehInpFromCAN2.IeVBII_e_VehFlLvlAdj@ */ /end MEASUREMENT
/begin MEASUREMENT IbTRSC_InpBus.IbTRSC_VehInpFromCAN2.IeVBII_e_VehFrLvlAdj "" UBYTE TRSC_SM_VC_Int_CM_boolean 0 0 0 1 ECU_ADDRESS 0x0000 /* @ECU_Address@IbTRSC_InpBus.IbTRSC_VehInpFromCAN2.IeVBII_e_VehFrLvlAdj@ */ /end MEASUREMENT
/begin MEASUREMENT IbTRSC_InpBus.IbTRSC_VehInpFromCAN2.IeVBII_e_VehRlLvlAdj "" UBYTE TRSC_SM_VC_Int_CM_boolean 0 0 0 1 ECU_ADDRESS 0x0000 /* @ECU_Address@IbTRSC_InpBus.IbTRSC_VehInpFromCAN2.IeVBII_e_VehRlLvlAdj@ */ /end MEASUREMENT
/begin MEASUREMENT IbTRSC_InpBus.IbTRSC_VehInpFromCAN2.IeVBII_e_VehRrLvlAdj "" UBYTE TRSC_SM_VC_Int_CM_boolean 0 0 0 1 ECU_ADDRESS 0x0000 /* @ECU_Address@IbTRSC_InpBus.IbTRSC_VehInpFromCAN2.IeVBII_e_VehRrLvlAdj@ */ /end MEASUREMENT
/begin MEASUREMENT IbTRSC_InpBus.IbTRSC_VehInpFromCAN2.IeVBII_b_VehAscmSysFail "" UBYTE TRSC_SM_VC_Int_CM_boolean 0 0 0 1 ECU_ADDRESS 0x0000 /* @ECU_Address@IbTRSC_InpBus.IbTRSC_VehInpFromCAN2.IeVBII_b_VehAscmSysFail@ */ /end MEASUREMENT
/begin MEASUREMENT IbTRSC_InpBus.IbTRSC_VehInpFromCAN14.IeVBII_M_StrWhlTrq "" FLOAT32_IEEE TRSC_SM_VC_Int_CM_single 0 0 -3.4E+38 3.4E+38 ECU_ADDRESS 0x0000 /* @ECU_Address@IbTRSC_InpBus.IbTRSC_VehInpFromCAN14.IeVBII_M_StrWhlTrq@ */ /end MEASUREMENT
/begin MEASUREMENT IbTRSC_InpBus.IbTRSC_VehInpFromCAN14.IeVBII_a_VehLatAcc "" FLOAT32_IEEE TRSC_SM_VC_Int_CM_single 0 0 -3.4E+38 3.4E+38 ECU_ADDRESS 0x0000 /* @ECU_Address@IbTRSC_InpBus.IbTRSC_VehInpFromCAN14.IeVBII_a_VehLatAcc@ */ /end MEASUREMENT
/begin MEASUREMENT IbTRSC_InpBus.IbTRSC_VehInpFromCAN14.IeVBII_a_VehLongAcc "" FLOAT32_IEEE TRSC_SM_VC_Int_CM_single 0 0 -3.4E+38 3.4E+38 ECU_ADDRESS 0x0000 /* @ECU_Address@IbTRSC_InpBus.IbTRSC_VehInpFromCAN14.IeVBII_a_VehLongAcc@ */ /end MEASUREMENT
/begin MEASUREMENT IbTRSC_InpBus.IbTRSC_VehInpFromCAN14.IeVBII_ddeg_VehYawRate "" FLOAT32_IEEE TRSC_SM_VC_Int_CM_single 0 0 -3.4E+38 3.4E+38 ECU_ADDRESS 0x0000 /* @ECU_Address@IbTRSC_InpBus.IbTRSC_VehInpFromCAN14.IeVBII_ddeg_VehYawRate@ */ /end MEASUREMENT
/begin MEASUREMENT IbTRSC_InpBus.IbTRSC_VehInpFromCAN14.IeVBII_kph_VehSpeedVSOSig "" FLOAT32_IEEE TRSC_SM_VC_Int_CM_single 0 0 -3.4E+38 3.4E+38 ECU_ADDRESS 0x0000 /* @ECU_Address@IbTRSC_InpBus.IbTRSC_VehInpFromCAN14.IeVBII_kph_VehSpeedVSOSig@ */ /end MEASUREMENT
/begin MEASUREMENT IbTRSC_InpBus.IbTRSC_VehInpFromCAN14.IeVBII_kph_LhfWhlSpd "" FLOAT32_IEEE TRSC_SM_VC_Int_CM_single 0 0 -3.4E+38 3.4E+38 ECU_ADDRESS 0x0000 /* @ECU_Address@IbTRSC_InpBus.IbTRSC_VehInpFromCAN14.IeVBII_kph_LhfWhlSpd@ */ /end MEASUREMENT
/begin MEASUREMENT IbTRSC_InpBus.IbTRSC_VehInpFromCAN14.IeVBII_kph_LhrWhlSpd "" FLOAT32_IEEE TRSC_SM_VC_Int_CM_single 0 0 -3.4E+38 3.4E+38 ECU_ADDRESS 0x0000 /* @ECU_Address@IbTRSC_InpBus.IbTRSC_VehInpFromCAN14.IeVBII_kph_LhrWhlSpd@ */ /end MEASUREMENT
/begin MEASUREMENT IbTRSC_InpBus.IbTRSC_VehInpFromCAN14.IeVBII_kph_RhfWhlSpd "" FLOAT32_IEEE TRSC_SM_VC_Int_CM_single 0 0 -3.4E+38 3.4E+38 ECU_ADDRESS 0x0000 /* @ECU_Address@IbTRSC_InpBus.IbTRSC_VehInpFromCAN14.IeVBII_kph_RhfWhlSpd@ */ /end MEASUREMENT
/begin MEASUREMENT IbTRSC_InpBus.IbTRSC_VehInpFromCAN14.IeVBII_kph_RhrWhlSpd "" FLOAT32_IEEE TRSC_SM_VC_Int_CM_single 0 0 -3.4E+38 3.4E+38 ECU_ADDRESS 0x0000 /* @ECU_Address@IbTRSC_InpBus.IbTRSC_VehInpFromCAN14.IeVBII_kph_RhrWhlSpd@ */ /end MEASUREMENT
/begin MEASUREMENT IbTRSC_InpBus.IbTRSC_VehInpFromCAN14.IeVBII_a_VehLatAccOffset "" FLOAT32_IEEE TRSC_SM_VC_Int_CM_single 0 0 -3.4E+38 3.4E+38 ECU_ADDRESS 0x0000 /* @ECU_Address@IbTRSC_InpBus.IbTRSC_VehInpFromCAN14.IeVBII_a_VehLatAccOffset@ */ /end MEASUREMENT
/begin MEASUREMENT IbTRSC_InpBus.IbTRSC_VehInpFromCAN14.IeVBII_a_VehLongAccOffset "" FLOAT32_IEEE TRSC_SM_VC_Int_CM_single 0 0 -3.4E+38 3.4E+38 ECU_ADDRESS 0x0000 /* @ECU_Address@IbTRSC_InpBus.IbTRSC_VehInpFromCAN14.IeVBII_a_VehLongAccOffset@ */ /end MEASUREMENT
/begin MEASUREMENT IbTRSC_InpBus.IbTRSC_VehInpFromCAN14.IeVBII_deg_StrWhlAng "" FLOAT32_IEEE TRSC_SM_VC_Int_CM_single 0 0 -3.4E+38 3.4E+38 ECU_ADDRESS 0x0000 /* @ECU_Address@IbTRSC_InpBus.IbTRSC_VehInpFromCAN14.IeVBII_deg_StrWhlAng@ */ /end MEASUREMENT
/begin MEASUREMENT IbTRSC_InpBus.IbTRSC_VehInpFromCAN14.IeVBII_ddeg_StrWhlSpd "" FLOAT32_IEEE TRSC_SM_VC_Int_CM_single 0 0 -3.4E+38 3.4E+38 ECU_ADDRESS 0x0000 /* @ECU_Address@IbTRSC_InpBus.IbTRSC_VehInpFromCAN14.IeVBII_ddeg_StrWhlSpd@ */ /end MEASUREMENT
/begin MEASUREMENT IbTRSC_InpBus.IbTRSC_VehInpFromCAN14.IeVBII_kph_RefVehSpd "" FLOAT32_IEEE TRSC_SM_VC_Int_CM_single 0 0 -3.4E+38 3.4E+38 ECU_ADDRESS 0x0000 /* @ECU_Address@IbTRSC_InpBus.IbTRSC_VehInpFromCAN14.IeVBII_kph_RefVehSpd@ */ /end MEASUREMENT
/begin MEASUREMENT IbTRSC_InpBus.IbTRSC_VehInpFromCAN14.IeVBII_e_SPMLatCtrlRespSts "" SLONG TRSC_SM_VC_Int_CM_TeVBII_e_SPMLatCtrlRespSts 0 0 0 2147483647 ECU_ADDRESS 0x0000 /* @ECU_Address@IbTRSC_InpBus.IbTRSC_VehInpFromCAN14.IeVBII_e_SPMLatCtrlRespSts@ */ /end MEASUREMENT
/begin MEASUREMENT IbTRSC_InpBus.IbTRSC_VehInpFromCAN14.IeVBII_e_EscTrscBrkResp "" SLONG TRSC_SM_VC_Int_CM_TeVBII_e_EscTrscBrkResp 0 0 0 2147483647 ECU_ADDRESS 0x0000 /* @ECU_Address@IbTRSC_InpBus.IbTRSC_VehInpFromCAN14.IeVBII_e_EscTrscBrkResp@ */ /end MEASUREMENT
/begin MEASUREMENT IbTRSC_InpBus.IbTRSC_VehInpFromCAN14.IeVBII_e_LhfWhlSpnSts "" SLONG TRSC_SM_VC_Int_CM_TeVBII_e_WhlSpnSts 0 0 0 2147483647 ECU_ADDRESS 0x0000 /* @ECU_Address@IbTRSC_InpBus.IbTRSC_VehInpFromCAN14.IeVBII_e_LhfWhlSpnSts@ */ /end MEASUREMENT
/begin MEASUREMENT IbTRSC_InpBus.IbTRSC_VehInpFromCAN14.IeVBII_e_RhfWhlSpnSts "" SLONG TRSC_SM_VC_Int_CM_TeVBII_e_WhlSpnSts 0 0 0 2147483647 ECU_ADDRESS 0x0000 /* @ECU_Address@IbTRSC_InpBus.IbTRSC_VehInpFromCAN14.IeVBII_e_RhfWhlSpnSts@ */ /end MEASUREMENT
/begin MEASUREMENT IbTRSC_InpBus.IbTRSC_VehInpFromCAN14.IeVBII_e_LhrWhlSpnSts "" SLONG TRSC_SM_VC_Int_CM_TeVBII_e_WhlSpnSts 0 0 0 2147483647 ECU_ADDRESS 0x0000 /* @ECU_Address@IbTRSC_InpBus.IbTRSC_VehInpFromCAN14.IeVBII_e_LhrWhlSpnSts@ */ /end MEASUREMENT
/begin MEASUREMENT IbTRSC_InpBus.IbTRSC_VehInpFromCAN14.IeVBII_e_RhrWhlSpnSts "" SLONG TRSC_SM_VC_Int_CM_TeVBII_e_WhlSpnSts 0 0 0 2147483647 ECU_ADDRESS 0x0000 /* @ECU_Address@IbTRSC_InpBus.IbTRSC_VehInpFromCAN14.IeVBII_e_RhrWhlSpnSts@ */ /end MEASUREMENT
/begin MEASUREMENT IbTRSC_InpBus.IbTRSC_VehInpFromCAN14.IeVBII_e_StrWhlAngleType "" SLONG TRSC_SM_VC_Int_CM_TeVBII_e_StrWhlAngleType 0 0 0 2147483647 ECU_ADDRESS 0x0000 /* @ECU_Address@IbTRSC_InpBus.IbTRSC_VehInpFromCAN14.IeVBII_e_StrWhlAngleType@ */ /end MEASUREMENT
/begin MEASUREMENT IbTRSC_InpBus.IbTRSC_VehInpFromCAN14.IeVBII_e_EngineSts "" SLONG TRSC_SM_VC_Int_CM_TeVBII_e_EngineSts 0 0 0 2147483647 ECU_ADDRESS 0x0000 /* @ECU_Address@IbTRSC_InpBus.IbTRSC_VehInpFromCAN14.IeVBII_e_EngineSts@ */ /end MEASUREMENT
/begin MEASUREMENT IbTRSC_InpBus.IbTRSC_VehInpFromCAN14.IeVBII_e_EcmTrscResp "" SLONG TRSC_SM_VC_Int_CM_TeVBII_e_EcmTrscResp 0 0 0 2147483647 ECU_ADDRESS 0x0000 /* @ECU_Address@IbTRSC_InpBus.IbTRSC_VehInpFromCAN14.IeVBII_e_EcmTrscResp@ */ /end MEASUREMENT
/begin MEASUREMENT IbTRSC_InpBus.IbTRSC_VehInpFromCAN14.IeVBII_e_VehStandStillSts "" SLONG TRSC_SM_VC_Int_CM_TeVBII_e_VehStandStillSts 0 0 0 2147483647 ECU_ADDRESS 0x0000 /* @ECU_Address@IbTRSC_InpBus.IbTRSC_VehInpFromCAN14.IeVBII_e_VehStandStillSts@ */ /end MEASUREMENT
/begin MEASUREMENT IbTRSC_InpBus.IbTRSC_VehInpFromCAN14.IeVBII_e_StrTrqResp "" SLONG TRSC_SM_VC_Int_CM_TeVBII_e_StrTrqResp 0 0 0 2147483647 ECU_ADDRESS 0x0000 /* @ECU_Address@IbTRSC_InpBus.IbTRSC_VehInpFromCAN14.IeVBII_e_StrTrqResp@ */ /end MEASUREMENT
/begin MEASUREMENT IbTRSC_InpBus.IbTRSC_VehInpFromCAN14.IeVBII_cnt_LhfPulseCtr "" UBYTE TRSC_SM_VC_Int_CM_uint8 0 0 0 255 ECU_ADDRESS 0x0000 /* @ECU_Address@IbTRSC_InpBus.IbTRSC_VehInpFromCAN14.IeVBII_cnt_LhfPulseCtr@ */ /end MEASUREMENT
/begin MEASUREMENT IbTRSC_InpBus.IbTRSC_VehInpFromCAN14.IeVBII_cnt_LhrPulseCtr "" UBYTE TRSC_SM_VC_Int_CM_uint8 0 0 0 255 ECU_ADDRESS 0x0000 /* @ECU_Address@IbTRSC_InpBus.IbTRSC_VehInpFromCAN14.IeVBII_cnt_LhrPulseCtr@ */ /end MEASUREMENT
/begin MEASUREMENT IbTRSC_InpBus.IbTRSC_VehInpFromCAN14.IeVBII_cnt_RhfPulseCtr "" UBYTE TRSC_SM_VC_Int_CM_uint8 0 0 0 255 ECU_ADDRESS 0x0000 /* @ECU_Address@IbTRSC_InpBus.IbTRSC_VehInpFromCAN14.IeVBII_cnt_RhfPulseCtr@ */ /end MEASUREMENT
/begin MEASUREMENT IbTRSC_InpBus.IbTRSC_VehInpFromCAN14.IeVBII_cnt_RhrPulseCtr "" UBYTE TRSC_SM_VC_Int_CM_uint8 0 0 0 255 ECU_ADDRESS 0x0000 /* @ECU_Address@IbTRSC_InpBus.IbTRSC_VehInpFromCAN14.IeVBII_cnt_RhrPulseCtr@ */ /end MEASUREMENT
/begin MEASUREMENT IbTRSC_InpBus.IbTRSC_VehInpFromCAN14.IeVBII_b_StrTchSts "" UBYTE TRSC_SM_VC_Int_CM_boolean 0 0 0 1 ECU_ADDRESS 0x0000 /* @ECU_Address@IbTRSC_InpBus.IbTRSC_VehInpFromCAN14.IeVBII_b_StrTchSts@ */ /end MEASUREMENT
/begin MEASUREMENT IbTRSC_InpBus.IbTRSC_TrailerDetInp.MeTRSC_deg_TADAngle "" FLOAT32_IEEE TRSC_SM_VC_Int_CM_single 0 0 -3.4E+38 3.4E+38 ECU_ADDRESS 0x0000 /* @ECU_Address@IbTRSC_InpBus.IbTRSC_TrailerDetInp.MeTRSC_deg_TADAngle@ */ /end MEASUREMENT
/begin MEASUREMENT IbTRSC_InpBus.IbTRSC_TrailerDetInp.MeTRSC_m_HitchLength "" FLOAT32_IEEE TRSC_SM_VC_Int_CM_single 0 0 -3.4E+38 3.4E+38 ECU_ADDRESS 0x0000 /* @ECU_Address@IbTRSC_InpBus.IbTRSC_TrailerDetInp.MeTRSC_m_HitchLength@ */ /end MEASUREMENT
/begin MEASUREMENT IbTRSC_InpBus.IbTRSC_TrailerDetInp.MeTRSC_deg_TADAngleRate "" FLOAT32_IEEE TRSC_SM_VC_Int_CM_single 0 0 -3.4E+38 3.4E+38 ECU_ADDRESS 0x0000 /* @ECU_Address@IbTRSC_InpBus.IbTRSC_TrailerDetInp.MeTRSC_deg_TADAngleRate@ */ /end MEASUREMENT
/begin MEASUREMENT IbTRSC_InpBus.IbTRSC_TrailerDetInp.MeTRSC_deg_DetJackknifeThrAngle "" FLOAT32_IEEE TRSC_SM_VC_Int_CM_single 0 0 -3.4E+38 3.4E+38 ECU_ADDRESS 0x0000 /* @ECU_Address@IbTRSC_InpBus.IbTRSC_TrailerDetInp.MeTRSC_deg_DetJackknifeThrAngle@ */ /end MEASUREMENT
/begin MEASUREMENT IbTRSC_InpBus.IbTRSC_TrailerDetInp.MeTRSC_m_DetTrailerBeamLen "" FLOAT32_IEEE TRSC_SM_VC_Int_CM_single 0 0 -3.4E+38 3.4E+38 ECU_ADDRESS 0x0000 /* @ECU_Address@IbTRSC_InpBus.IbTRSC_TrailerDetInp.MeTRSC_m_DetTrailerBeamLen@ */ /end MEASUREMENT
/begin MEASUREMENT IbTRSC_InpBus.IbTRSC_TrailerDetInp.MeTRSC_deg_DetJackKnifeAngle "" FLOAT32_IEEE TRSC_SM_VC_Int_CM_single 0 0 -3.4E+38 3.4E+38 ECU_ADDRESS 0x0000 /* @ECU_Address@IbTRSC_InpBus.IbTRSC_TrailerDetInp.MeTRSC_deg_DetJackKnifeAngle@ */ /end MEASUREMENT
/begin MEASUREMENT IbTRSC_InpBus.IbTRSC_TrailerDetInp.MeTRSC_cnt_TrlrCalibFailCntInfo "" ULONG TRSC_SM_VC_Int_CM_uint32 0 0 0 4294967295 ECU_ADDRESS 0x0000 /* @ECU_Address@IbTRSC_InpBus.IbTRSC_TrailerDetInp.MeTRSC_cnt_TrlrCalibFailCntInfo@ */ /end MEASUREMENT
/begin MEASUREMENT IbTRSC_InpBus.IbTRSC_TrailerDetInp.MeTRSC_e_TrlrCalInfo "" SLONG TRSC_SM_VC_Int_CM_TeTRSC_e_TrlrCalInfo 0 0 0 2147483647 ECU_ADDRESS 0x0000 /* @ECU_Address@IbTRSC_InpBus.IbTRSC_TrailerDetInp.MeTRSC_e_TrlrCalInfo@ */ /end MEASUREMENT
/begin MEASUREMENT IbTRSC_InpBus.IbTRSC_TrailerDetInp.MeTRSC_e_TrlrRecogInfo "" SLONG TRSC_SM_VC_Int_CM_TeTRSC_e_TrlrRecogInfo 0 0 0 2147483647 ECU_ADDRESS 0x0000 /* @ECU_Address@IbTRSC_InpBus.IbTRSC_TrailerDetInp.MeTRSC_e_TrlrRecogInfo@ */ /end MEASUREMENT
/begin MEASUREMENT IbTRSC_InpBus.IbTRSC_TrailerDetInp.MeTRSC_e_TrlrPrsntInfo "" SLONG TRSC_SM_VC_Int_CM_TeTRSC_e_TrlrPrsntInfo 0 0 0 2147483647 ECU_ADDRESS 0x0000 /* @ECU_Address@IbTRSC_InpBus.IbTRSC_TrailerDetInp.MeTRSC_e_TrlrPrsntInfo@ */ /end MEASUREMENT
/begin MEASUREMENT IbTRSC_InpBus.IbTRSC_TrailerDetInp.MeTRSC_e_TADState "" SLONG TRSC_SM_VC_Int_CM_TeTRSC_e_TADState 0 0 0 2147483647 ECU_ADDRESS 0x0000 /* @ECU_Address@IbTRSC_InpBus.IbTRSC_TrailerDetInp.MeTRSC_e_TADState@ */ /end MEASUREMENT
/begin MEASUREMENT IbTRSC_InpBus.IbTRSC_TrailerDetInp.MeTRSC_e_TADCalibrationSubstate "" SLONG TRSC_SM_VC_Int_CM_TeTRSC_e_TADCalibrationSubstate 0 0 0 2147483647 ECU_ADDRESS 0x0000 /* @ECU_Address@IbTRSC_InpBus.IbTRSC_TrailerDetInp.MeTRSC_e_TADCalibrationSubstate@ */ /end MEASUREMENT
/begin MEASUREMENT IbTRSC_InpBus.IbTRSC_TrailerDetInp.MeTRSC_e_TurnAroundSubState "" SLONG TRSC_SM_VC_Int_CM_TeTRSC_e_TurnAroundSubState 0 0 0 2147483647 ECU_ADDRESS 0x0000 /* @ECU_Address@IbTRSC_InpBus.IbTRSC_TrailerDetInp.MeTRSC_e_TurnAroundSubState@ */ /end MEASUREMENT
/begin MEASUREMENT IbTRSC_InpBus.IbTRSC_TrailerDetInp.MeTRSC_b_OBTLRecalibrate "" UBYTE TRSC_SM_VC_Int_CM_boolean 0 0 0 1 ECU_ADDRESS 0x0000 /* @ECU_Address@IbTRSC_InpBus.IbTRSC_TrailerDetInp.MeTRSC_b_OBTLRecalibrate@ */ /end MEASUREMENT
/begin MEASUREMENT IbTRSC_InpBus.IbTRSC_TrailerDetInp.MeTRSC_b_TrlrCalibDelayInfo "" UBYTE TRSC_SM_VC_Int_CM_boolean 0 0 0 1 ECU_ADDRESS 0x0000 /* @ECU_Address@IbTRSC_InpBus.IbTRSC_TrailerDetInp.MeTRSC_b_TrlrCalibDelayInfo@ */ /end MEASUREMENT
/begin MEASUREMENT IbTRSC_InpBus.IbTRSC_MEProxiToIpc.IePRX_mm_VehTyreSize "" FLOAT32_IEEE TRSC_SM_VC_Int_CM_single 0 0 -3.4E+38 3.4E+38 ECU_ADDRESS 0x0000 /* @ECU_Address@IbTRSC_InpBus.IbTRSC_MEProxiToIpc.IePRX_mm_VehTyreSize@ */ /end MEASUREMENT
/begin MEASUREMENT IbTRSC_InpBus.IbTRSC_MEProxiToIpc.IePRX_e_VehWhlBase "" SLONG TRSC_SM_VC_Int_CM_TeTRSC_e_VehWhlBase 0 0 0 2147483647 ECU_ADDRESS 0x0000 /* @ECU_Address@IbTRSC_InpBus.IbTRSC_MEProxiToIpc.IePRX_e_VehWhlBase@ */ /end MEASUREMENT
/begin MEASUREMENT IbTRSC_InpBus.IbTRSC_MEProxiToIpc.IePRX_e_RadDsplyTyp "" SLONG TRSC_SM_VC_Int_CM_TeTRSC_e_RadDsplyTyp 0 0 0 2147483647 ECU_ADDRESS 0x0000 /* @ECU_Address@IbTRSC_InpBus.IbTRSC_MEProxiToIpc.IePRX_e_RadDsplyTyp@ */ /end MEASUREMENT
/begin MEASUREMENT IbTRSC_InpBus.IbTRSC_MEProxiToIpc.IePRX_e_StrRackPinTyp "" SLONG TRSC_SM_VC_Int_CM_TeTRSC_e_StrRackPinTyp 0 0 0 2147483647 ECU_ADDRESS 0x0000 /* @ECU_Address@IbTRSC_InpBus.IbTRSC_MEProxiToIpc.IePRX_e_StrRackPinTyp@ */ /end MEASUREMENT
/begin MEASUREMENT IbTRSC_InpBus.IbTRSC_MEProxiToIpc.IePRX_e_BoxDelete "" UBYTE TRSC_SM_VC_Int_CM_uint8 0 0 0 255 ECU_ADDRESS 0x0000 /* @ECU_Address@IbTRSC_InpBus.IbTRSC_MEProxiToIpc.IePRX_e_BoxDelete@ */ /end MEASUREMENT
/begin MEASUREMENT IbTRSC_InpBus.IbTRSC_MEProxiToIpc.IePRX_b_CanNode63Ttm "" UBYTE TRSC_SM_VC_Int_CM_boolean 0 0 0 1 ECU_ADDRESS 0x0000 /* @ECU_Address@IbTRSC_InpBus.IbTRSC_MEProxiToIpc.IePRX_b_CanNode63Ttm@ */ /end MEASUREMENT
/begin MEASUREMENT IbTRSC_InpBus.IbTRSC_MEProxiToIpc.IePRX_b_CanNode95ItbmItcm "" UBYTE TRSC_SM_VC_Int_CM_boolean 0 0 0 1 ECU_ADDRESS 0x0000 /* @ECU_Address@IbTRSC_InpBus.IbTRSC_MEProxiToIpc.IePRX_b_CanNode95ItbmItcm@ */ /end MEASUREMENT
/begin MEASUREMENT IbTRSC_InpBus.IbTRSC_MEProxiToIpc.IePRX_b_CanNode27AsmAscm "" UBYTE TRSC_SM_VC_Int_CM_boolean 0 0 0 1 ECU_ADDRESS 0x0000 /* @ECU_Address@IbTRSC_InpBus.IbTRSC_MEProxiToIpc.IePRX_b_CanNode27AsmAscm@ */ /end MEASUREMENT
/begin MEASUREMENT IbTRSC_InpBus.IbTRSC_MEProxiToIpc.IePRX_b_SRT "" UBYTE TRSC_SM_VC_Int_CM_boolean 0 0 0 1 ECU_ADDRESS 0x0000 /* @ECU_Address@IbTRSC_InpBus.IbTRSC_MEProxiToIpc.IePRX_b_SRT@ */ /end MEASUREMENT
/begin MEASUREMENT IbTRSC_InpBus.IbTRSC_MEProxiToIpc.IePRX_b_SVSPresent "" UBYTE TRSC_SM_VC_Int_CM_boolean 0 0 0 1 ECU_ADDRESS 0x0000 /* @ECU_Address@IbTRSC_InpBus.IbTRSC_MEProxiToIpc.IePRX_b_SVSPresent@ */ /end MEASUREMENT
/begin MEASUREMENT IbTRSC_InpBus.IbTRSC_MEProxiToIpc.IePRX_b_AuxTrlrCam "" UBYTE TRSC_SM_VC_Int_CM_boolean 0 0 0 1 ECU_ADDRESS 0x0000 /* @ECU_Address@IbTRSC_InpBus.IbTRSC_MEProxiToIpc.IePRX_b_AuxTrlrCam@ */ /end MEASUREMENT
/begin MEASUREMENT IbTRSC_InpBus.IbTRSC_MEProxiToIpc.IePRX_b_TrlrSurroundPresence "" UBYTE TRSC_SM_VC_Int_CM_boolean 0 0 0 1 ECU_ADDRESS 0x0000 /* @ECU_Address@IbTRSC_InpBus.IbTRSC_MEProxiToIpc.IePRX_b_TrlrSurroundPresence@ */ /end MEASUREMENT
/begin MEASUREMENT IbTRSC_InpBus.IbTRSC_MEProxiToIpc.IePRX_b_TRSCPresent "" UBYTE TRSC_SM_VC_Int_CM_boolean 0 0 0 1 ECU_ADDRESS 0x0000 /* @ECU_Address@IbTRSC_InpBus.IbTRSC_MEProxiToIpc.IePRX_b_TRSCPresent@ */ /end MEASUREMENT
/begin MEASUREMENT IbTRSC_InpBus.IbTRSC_SVStoTRSC.MeSVS_e_DispView2Info "" SLONG TRSC_SM_VC_Int_CM_TeTRSC_e_DispView2 0 0 0 2147483647 ECU_ADDRESS 0x0000 /* @ECU_Address@IbTRSC_InpBus.IbTRSC_SVStoTRSC.MeSVS_e_DispView2Info@ */ /end MEASUREMENT
/begin MEASUREMENT IbTRSC_InpBus.IbTRSC_SVStoTRSC.IeHMI_b_MoreCamReq "" UBYTE TRSC_SM_VC_Int_CM_boolean 0 0 0 1 ECU_ADDRESS 0x0000 /* @ECU_Address@IbTRSC_InpBus.IbTRSC_SVStoTRSC.IeHMI_b_MoreCamReq@ */ /end MEASUREMENT
/begin MEASUREMENT IbTRSC_InpBus.IbDDC_DegMgrToTRSC.IeDDC_b_TRSCDisabled "" UBYTE TRSC_SM_VC_Int_CM_boolean 0 0 0 1 ECU_ADDRESS 0x0000 /* @ECU_Address@IbTRSC_InpBus.IbDDC_DegMgrToTRSC.IeDDC_b_TRSCDisabled@ */ /end MEASUREMENT
/begin MEASUREMENT IbTRSC_InpBus.IbDDC_DegMgrToTRSC.IeDDC_b_TRSCLimView "" UBYTE TRSC_SM_VC_Int_CM_boolean 0 0 0 1 ECU_ADDRESS 0x0000 /* @ECU_Address@IbTRSC_InpBus.IbDDC_DegMgrToTRSC.IeDDC_b_TRSCLimView@ */ /end MEASUREMENT
/begin MEASUREMENT IbTRSC_InpBus.IbDDC_DegMgrToTRSC.IeDDC_b_TRSCLimDefView "" UBYTE TRSC_SM_VC_Int_CM_boolean 0 0 0 1 ECU_ADDRESS 0x0000 /* @ECU_Address@IbTRSC_InpBus.IbDDC_DegMgrToTRSC.IeDDC_b_TRSCLimDefView@ */ /end MEASUREMENT
/begin MEASUREMENT IbTRSC_InpBus.IbDDC_DegMgrToTRSC.IeDDC_b_TRSCLimASCMDef "" UBYTE TRSC_SM_VC_Int_CM_boolean 0 0 0 1 ECU_ADDRESS 0x0000 /* @ECU_Address@IbTRSC_InpBus.IbDDC_DegMgrToTRSC.IeDDC_b_TRSCLimASCMDef@ */ /end MEASUREMENT
/begin MEASUREMENT IbTRSC_InpBus.IbTRSCSmVc_TunParam.KeKM_k_GyroYawCov "" FLOAT32_IEEE TRSC_SM_VC_Int_CM_single 0 0 -3.4E+38 3.4E+38 ECU_ADDRESS 0x0000 /* @ECU_Address@IbTRSC_InpBus.IbTRSCSmVc_TunParam.KeKM_k_GyroYawCov@ */ /end MEASUREMENT
/begin MEASUREMENT IbTRSC_InpBus.IbTRSCSmVc_TunParam.KeKM_k_NumWheelPulses "" FLOAT32_IEEE TRSC_SM_VC_Int_CM_single 0 0 -3.4E+38 3.4E+38 ECU_ADDRESS 0x0000 /* @ECU_Address@IbTRSC_InpBus.IbTRSCSmVc_TunParam.KeKM_k_NumWheelPulses@ */ /end MEASUREMENT
/begin MEASUREMENT IbTRSC_InpBus.IbTRSCSmVc_TunParam.KeKM_k_TADCov "" FLOAT32_IEEE TRSC_SM_VC_Int_CM_single 0 0 -3.4E+38 3.4E+38 ECU_ADDRESS 0x0000 /* @ECU_Address@IbTRSC_InpBus.IbTRSCSmVc_TunParam.KeKM_k_TADCov@ */ /end MEASUREMENT
/begin MEASUREMENT IbTRSC_InpBus.IbTRSCSmVc_TunParam.KeKM_k_UpdateIMU_H "" FLOAT32_IEEE TRSC_SM_VC_Int_CM_single 0 0 -3.4E+38 3.4E+38 ARRAY_SIZE 3 ECU_ADDRESS 0x0000 /* @ECU_Address@IbTRSC_InpBus.IbTRSCSmVc_TunParam.KeKM_k_UpdateIMU_H@ */ /end MEASUREMENT
/begin MEASUREMENT IbTRSC_InpBus.IbTRSCSmVc_TunParam.KeKM_k_UpdateRPM_H "" FLOAT32_IEEE TRSC_SM_VC_Int_CM_single 0 0 -3.4E+38 3.4E+38 ARRAY_SIZE 3 ECU_ADDRESS 0x0000 /* @ECU_Address@IbTRSC_InpBus.IbTRSCSmVc_TunParam.KeKM_k_UpdateRPM_H@ */ /end MEASUREMENT
/begin MEASUREMENT IbTRSC_InpBus.IbTRSCSmVc_TunParam.KeKM_k_UpdateTAD_H "" FLOAT32_IEEE TRSC_SM_VC_Int_CM_single 0 0 -3.4E+38 3.4E+38 ARRAY_SIZE 3 ECU_ADDRESS 0x0000 /* @ECU_Address@IbTRSC_InpBus.IbTRSCSmVc_TunParam.KeKM_k_UpdateTAD_H@ */ /end MEASUREMENT
/begin MEASUREMENT IbTRSC_InpBus.IbTRSCSmVc_TunParam.KeKM_k_WhlPlsCnt_high_lim "" FLOAT32_IEEE TRSC_SM_VC_Int_CM_single 0 0 -3.4E+38 3.4E+38 ECU_ADDRESS 0x0000 /* @ECU_Address@IbTRSC_InpBus.IbTRSCSmVc_TunParam.KeKM_k_WhlPlsCnt_high_lim@ */ /end MEASUREMENT
/begin MEASUREMENT IbTRSC_InpBus.IbTRSCSmVc_TunParam.KeKM_k_WhlPlsCnt_low_lim "" FLOAT32_IEEE TRSC_SM_VC_Int_CM_single 0 0 -3.4E+38 3.4E+38 ECU_ADDRESS 0x0000 /* @ECU_Address@IbTRSC_InpBus.IbTRSCSmVc_TunParam.KeKM_k_WhlPlsCnt_low_lim@ */ /end MEASUREMENT
/begin MEASUREMENT IbTRSC_InpBus.IbTRSCSmVc_TunParam.KeKM_k_WhlRPMYawCov "" FLOAT32_IEEE TRSC_SM_VC_Int_CM_single 0 0 -3.4E+38 3.4E+38 ECU_ADDRESS 0x0000 /* @ECU_Address@IbTRSC_InpBus.IbTRSCSmVc_TunParam.KeKM_k_WhlRPMYawCov@ */ /end MEASUREMENT
/begin MEASUREMENT IbTRSC_InpBus.IbTRSCSmVc_TunParam.KeKM_m_TrackWidth "" FLOAT32_IEEE TRSC_SM_VC_Int_CM_single 0 0 -3.4E+38 3.4E+38 ECU_ADDRESS 0x0000 /* @ECU_Address@IbTRSC_InpBus.IbTRSCSmVc_TunParam.KeKM_m_TrackWidth@ */ /end MEASUREMENT
/begin MEASUREMENT IbTRSC_InpBus.IbTRSCSmVc_TunParam.KeKM_m_WheelCircumference "" FLOAT32_IEEE TRSC_SM_VC_Int_CM_single 0 0 -3.4E+38 3.4E+38 ECU_ADDRESS 0x0000 /* @ECU_Address@IbTRSC_InpBus.IbTRSCSmVc_TunParam.KeKM_m_WheelCircumference@ */ /end MEASUREMENT
/begin MEASUREMENT IbTRSC_InpBus.IbTRSCSmVc_TunParam.KeKM_s_SampleTime "" FLOAT32_IEEE TRSC_SM_VC_Int_CM_single 0 0 -3.4E+38 3.4E+38 ECU_ADDRESS 0x0000 /* @ECU_Address@IbTRSC_InpBus.IbTRSCSmVc_TunParam.KeKM_s_SampleTime@ */ /end MEASUREMENT
/begin MEASUREMENT IbTRSC_InpBus.IbTRSCSmVc_TunParam.KeKM_k_KM_YawRateGyroBiasInit "" FLOAT32_IEEE TRSC_SM_VC_Int_CM_single 0 0 -3.4E+38 3.4E+38 ECU_ADDRESS 0x0000 /* @ECU_Address@IbTRSC_InpBus.IbTRSCSmVc_TunParam.KeKM_k_KM_YawRateGyroBiasInit@ */ /end MEASUREMENT
/begin MEASUREMENT IbTRSC_InpBus.IbTRSCSmVc_TunParam.KeKM_k_KM_SF_RelAngCov "" FLOAT32_IEEE TRSC_SM_VC_Int_CM_single 0 0 -3.4E+38 3.4E+38 ECU_ADDRESS 0x0000 /* @ECU_Address@IbTRSC_InpBus.IbTRSCSmVc_TunParam.KeKM_k_KM_SF_RelAngCov@ */ /end MEASUREMENT
/begin MEASUREMENT IbTRSC_InpBus.IbTRSCSmVc_TunParam.KeKM_k_KM_SF_RelAngRateCov "" FLOAT32_IEEE TRSC_SM_VC_Int_CM_single 0 0 -3.4E+38 3.4E+38 ECU_ADDRESS 0x0000 /* @ECU_Address@IbTRSC_InpBus.IbTRSCSmVc_TunParam.KeKM_k_KM_SF_RelAngRateCov@ */ /end MEASUREMENT
/begin MEASUREMENT IbTRSC_InpBus.IbTRSCSmVc_TunParam.KeKM_k_KM_SF_YawRateCov "" FLOAT32_IEEE TRSC_SM_VC_Int_CM_single 0 0 -3.4E+38 3.4E+38 ECU_ADDRESS 0x0000 /* @ECU_Address@IbTRSC_InpBus.IbTRSCSmVc_TunParam.KeKM_k_KM_SF_YawRateCov@ */ /end MEASUREMENT
/begin MEASUREMENT IbTRSC_InpBus.IbTRSCSmVc_TunParam.KeTRA_m_K_beta "" FLOAT32_IEEE TRSC_SM_VC_Int_CM_single 0 0 -3.4E+38 3.4E+38 ECU_ADDRESS 0x0000 /* @ECU_Address@IbTRSC_InpBus.IbTRSCSmVc_TunParam.KeTRA_m_K_beta@ */ /end MEASUREMENT
/begin MEASUREMENT IbTRSC_InpBus.IbTRSCSmVc_TunParam.KeKM_deg_AngTh "" FLOAT32_IEEE TRSC_SM_VC_Int_CM_single 0 0 -3.4E+38 3.4E+38 ECU_ADDRESS 0x0000 /* @ECU_Address@IbTRSC_InpBus.IbTRSCSmVc_TunParam.KeKM_deg_AngTh@ */ /end MEASUREMENT
/begin MEASUREMENT IbTRSC_InpBus.IbTRSCSmVc_TunParam.KaTRA_k_PGainLUTTblData "" FLOAT32_IEEE TRSC_SM_VC_Int_CM_single 0 0 -3.4E+38 3.4E+38 ARRAY_SIZE 4 ECU_ADDRESS 0x0000 /* @ECU_Address@IbTRSC_InpBus.IbTRSCSmVc_TunParam.KaTRA_k_PGainLUTTblData@ */ /end MEASUREMENT
/begin MEASUREMENT IbTRSC_InpBus.IbTRSCSmVc_TunParam.KaTRA_k_VehSpd_IGainLUTTblData "" FLOAT32_IEEE TRSC_SM_VC_Int_CM_single 0 0 -3.4E+38 3.4E+38 ARRAY_SIZE 2 ECU_ADDRESS 0x0000 /* @ECU_Address@IbTRSC_InpBus.IbTRSCSmVc_TunParam.KaTRA_k_VehSpd_IGainLUTTblData@ */ /end MEASUREMENT
/begin MEASUREMENT IbTRSC_InpBus.IbTRSCSmVc_TunParam.KaTRA_k_VehSpd_HdgDeviatLUTTblData "" FLOAT32_IEEE TRSC_SM_VC_Int_CM_single 0 0 -3.4E+38 3.4E+38 ARRAY_SIZE 3 ECU_ADDRESS 0x0000 /* @ECU_Address@IbTRSC_InpBus.IbTRSCSmVc_TunParam.KaTRA_k_VehSpd_HdgDeviatLUTTblData@ */ /end MEASUREMENT
/begin MEASUREMENT IbTRSC_InpBus.IbTRSCSmVc_TunParam.KaTRA_k_TADLUTTblData "" FLOAT32_IEEE TRSC_SM_VC_Int_CM_single 0 0 -3.4E+38 3.4E+38 ARRAY_SIZE 3 ECU_ADDRESS 0x0000 /* @ECU_Address@IbTRSC_InpBus.IbTRSCSmVc_TunParam.KaTRA_k_TADLUTTblData@ */ /end MEASUREMENT
/begin MEASUREMENT IbTRSC_InpBus.IbTRSCSmVc_TunParam.KaTRA_k_TravDistLUTTblData "" FLOAT32_IEEE TRSC_SM_VC_Int_CM_single 0 0 -3.4E+38 3.4E+38 ARRAY_SIZE 2 ECU_ADDRESS 0x0000 /* @ECU_Address@IbTRSC_InpBus.IbTRSCSmVc_TunParam.KaTRA_k_TravDistLUTTblData@ */ /end MEASUREMENT
/begin MEASUREMENT IbTRSC_InpBus.IbTRSCSmVc_TunParam.KaTRA_k_VehSpdLUTTblData "" FLOAT32_IEEE TRSC_SM_VC_Int_CM_single 0 0 -3.4E+38 3.4E+38 ARRAY_SIZE 2 ECU_ADDRESS 0x0000 /* @ECU_Address@IbTRSC_InpBus.IbTRSCSmVc_TunParam.KaTRA_k_VehSpdLUTTblData@ */ /end MEASUREMENT
/begin MEASUREMENT IbTRSC_InpBus.IbTRSCSmVc_TunParam.KeTRA_k_Kp "" FLOAT32_IEEE TRSC_SM_VC_Int_CM_single 0 0 -3.4E+38 3.4E+38 ECU_ADDRESS 0x0000 /* @ECU_Address@IbTRSC_InpBus.IbTRSCSmVc_TunParam.KeTRA_k_Kp@ */ /end MEASUREMENT
/begin MEASUREMENT IbTRSC_InpBus.IbTRSCSmVc_TunParam.KaTRA_k_TAD_IGainLUTTblData "" FLOAT32_IEEE TRSC_SM_VC_Int_CM_single 0 0 -3.4E+38 3.4E+38 ARRAY_SIZE 2 ECU_ADDRESS 0x0000 /* @ECU_Address@IbTRSC_InpBus.IbTRSCSmVc_TunParam.KaTRA_k_TAD_IGainLUTTblData@ */ /end MEASUREMENT
/begin MEASUREMENT IbTRSC_InpBus.IbTRSCSmVc_TunParam.KeTRA_deg_TrailerBeamLenYBrkPts "" FLOAT32_IEEE TRSC_SM_VC_Int_CM_single 0 0 -3.4E+38 3.4E+38 ARRAY_SIZE 3 ECU_ADDRESS 0x0000 /* @ECU_Address@IbTRSC_InpBus.IbTRSCSmVc_TunParam.KeTRA_deg_TrailerBeamLenYBrkPts@ */ /end MEASUREMENT
/begin MEASUREMENT IbTRSC_InpBus.IbTRSCSmVc_TunParam.KeTRA_m_TrailerBeamLenXBrkPts "" FLOAT32_IEEE TRSC_SM_VC_Int_CM_single 0 0 -3.4E+38 3.4E+38 ARRAY_SIZE 3 ECU_ADDRESS 0x0000 /* @ECU_Address@IbTRSC_InpBus.IbTRSCSmVc_TunParam.KeTRA_m_TrailerBeamLenXBrkPts@ */ /end MEASUREMENT
/begin MEASUREMENT IbTRSC_InpBus.IbTRSCSmVc_TunParam.KeKM_k_SWA_Res "" FLOAT32_IEEE TRSC_SM_VC_Int_CM_single 0 0 -3.4E+38 3.4E+38 ECU_ADDRESS 0x0000 /* @ECU_Address@IbTRSC_InpBus.IbTRSCSmVc_TunParam.KeKM_k_SWA_Res@ */ /end MEASUREMENT
/begin MEASUREMENT IbTRSC_InpBus.IbTRSCSmVc_TunParam.KaTRA_deg_TADLUTBrkPts "" FLOAT32_IEEE TRSC_SM_VC_Int_CM_single 0 0 -3.4E+38 3.4E+38 ARRAY_SIZE 3 ECU_ADDRESS 0x0000 /* @ECU_Address@IbTRSC_InpBus.IbTRSCSmVc_TunParam.KaTRA_deg_TADLUTBrkPts@ */ /end MEASUREMENT
/begin MEASUREMENT IbTRSC_InpBus.IbTRSCSmVc_TunParam.KaTRA_deg_TAD_IGainLUTBrkPts "" FLOAT32_IEEE TRSC_SM_VC_Int_CM_single 0 0 -3.4E+38 3.4E+38 ARRAY_SIZE 2 ECU_ADDRESS 0x0000 /* @ECU_Address@IbTRSC_InpBus.IbTRSCSmVc_TunParam.KaTRA_deg_TAD_IGainLUTBrkPts@ */ /end MEASUREMENT
/begin MEASUREMENT IbTRSC_InpBus.IbTRSCSmVc_TunParam.KaTRA_m_PGainLUTYBrkPts "" FLOAT32_IEEE TRSC_SM_VC_Int_CM_single 0 0 -3.4E+38 3.4E+38 ARRAY_SIZE 2 ECU_ADDRESS 0x0000 /* @ECU_Address@IbTRSC_InpBus.IbTRSCSmVc_TunParam.KaTRA_m_PGainLUTYBrkPts@ */ /end MEASUREMENT
/begin MEASUREMENT IbTRSC_InpBus.IbTRSCSmVc_TunParam.KaTRA_m_TravDistLUTBrkPts "" FLOAT32_IEEE TRSC_SM_VC_Int_CM_single 0 0 -3.4E+38 3.4E+38 ARRAY_SIZE 2 ECU_ADDRESS 0x0000 /* @ECU_Address@IbTRSC_InpBus.IbTRSCSmVc_TunParam.KaTRA_m_TravDistLUTBrkPts@ */ /end MEASUREMENT
/begin MEASUREMENT IbTRSC_InpBus.IbTRSCSmVc_TunParam.KaTRA_v_PGainLUTXBrkPts "" FLOAT32_IEEE TRSC_SM_VC_Int_CM_single 0 0 -3.4E+38 3.4E+38 ARRAY_SIZE 2 ECU_ADDRESS 0x0000 /* @ECU_Address@IbTRSC_InpBus.IbTRSCSmVc_TunParam.KaTRA_v_PGainLUTXBrkPts@ */ /end MEASUREMENT
/begin MEASUREMENT IbTRSC_InpBus.IbTRSCSmVc_TunParam.KaTRA_v_VehSpdLUTBrkPts "" FLOAT32_IEEE TRSC_SM_VC_Int_CM_single 0 0 -3.4E+38 3.4E+38 ARRAY_SIZE 2 ECU_ADDRESS 0x0000 /* @ECU_Address@IbTRSC_InpBus.IbTRSCSmVc_TunParam.KaTRA_v_VehSpdLUTBrkPts@ */ /end MEASUREMENT
/begin MEASUREMENT IbTRSC_InpBus.IbTRSCSmVc_TunParam.KaTRA_v_VehSpd_HdgDeviatLUTBrkPts "" FLOAT32_IEEE TRSC_SM_VC_Int_CM_single 0 0 -3.4E+38 3.4E+38 ARRAY_SIZE 3 ECU_ADDRESS 0x0000 /* @ECU_Address@IbTRSC_InpBus.IbTRSCSmVc_TunParam.KaTRA_v_VehSpd_HdgDeviatLUTBrkPts@ */ /end MEASUREMENT
/begin MEASUREMENT IbTRSC_InpBus.IbTRSCSmVc_TunParam.KaTRA_v_VehSpd_IGainLUTBrkPts "" FLOAT32_IEEE TRSC_SM_VC_Int_CM_single 0 0 -3.4E+38 3.4E+38 ARRAY_SIZE 2 ECU_ADDRESS 0x0000 /* @ECU_Address@IbTRSC_InpBus.IbTRSCSmVc_TunParam.KaTRA_v_VehSpd_IGainLUTBrkPts@ */ /end MEASUREMENT
/begin MEASUREMENT IbTRSC_InpBus.IbTRSCSmVc_TunParam.KaTRSC_deg_FtWhlAngPts "" FLOAT32_IEEE TRSC_SM_VC_Int_CM_single 0 0 -3.4E+38 3.4E+38 ARRAY_SIZE 37 ECU_ADDRESS 0x0000 /* @ECU_Address@IbTRSC_InpBus.IbTRSCSmVc_TunParam.KaTRSC_deg_FtWhlAngPts@ */ /end MEASUREMENT
/begin MEASUREMENT IbTRSC_InpBus.IbTRSCSmVc_TunParam.KaTRSC_deg_StwAngPts "" FLOAT32_IEEE TRSC_SM_VC_Int_CM_single 0 0 -3.4E+38 3.4E+38 ARRAY_SIZE 37 ECU_ADDRESS 0x0000 /* @ECU_Address@IbTRSC_InpBus.IbTRSCSmVc_TunParam.KaTRSC_deg_StwAngPts@ */ /end MEASUREMENT
/begin MEASUREMENT IbTRSC_InpBus.IbTRSCSmVc_TunParam.KeTRA_k_SteerAngRateLmt "" FLOAT32_IEEE TRSC_SM_VC_Int_CM_single 0 0 -3.4E+38 3.4E+38 ECU_ADDRESS 0x0000 /* @ECU_Address@IbTRSC_InpBus.IbTRSCSmVc_TunParam.KeTRA_k_SteerAngRateLmt@ */ /end MEASUREMENT
/begin MEASUREMENT IbTRSC_InpBus.IbTRSCSmVc_TunParam.KaTRA_rate_RateGuardXdat "" FLOAT32_IEEE TRSC_SM_VC_Int_CM_single 0 0 -3.4E+38 3.4E+38 ARRAY_SIZE 8 ECU_ADDRESS 0x0000 /* @ECU_Address@IbTRSC_InpBus.IbTRSCSmVc_TunParam.KaTRA_rate_RateGuardXdat@ */ /end MEASUREMENT
/begin MEASUREMENT IbTRSC_InpBus.IbTRSCSmVc_TunParam.KaTRA_rate_RateGuardYdat "" FLOAT32_IEEE TRSC_SM_VC_Int_CM_single 0 0 -3.4E+38 3.4E+38 ARRAY_SIZE 8 ECU_ADDRESS 0x0000 /* @ECU_Address@IbTRSC_InpBus.IbTRSCSmVc_TunParam.KaTRA_rate_RateGuardYdat@ */ /end MEASUREMENT
/begin MEASUREMENT IbTRSC_InpBus.IbTRSCSmVc_TunParam.KeTRSC_m_WheelBase "" FLOAT32_IEEE TRSC_SM_VC_Int_CM_single 0 0 -3.4E+38 3.4E+38 ECU_ADDRESS 0x0000 /* @ECU_Address@IbTRSC_InpBus.IbTRSCSmVc_TunParam.KeTRSC_m_WheelBase@ */ /end MEASUREMENT
/begin MEASUREMENT IbTRSC_InpBus.IbTRSCSmVc_TunParam.KeTRSC_deg_MaxStrAngle "" FLOAT32_IEEE TRSC_SM_VC_Int_CM_single 0 0 -3.4E+38 3.4E+38 ECU_ADDRESS 0x0000 /* @ECU_Address@IbTRSC_InpBus.IbTRSCSmVc_TunParam.KeTRSC_deg_MaxStrAngle@ */ /end MEASUREMENT
/begin MEASUREMENT IbTRSC_InpBus.IbTRSCSmVc_TunParam.KeTRSC_deg_MaxStrAngle_Up_Limit "" FLOAT32_IEEE TRSC_SM_VC_Int_CM_single 0 0 -3.4E+38 3.4E+38 ECU_ADDRESS 0x0000 /* @ECU_Address@IbTRSC_InpBus.IbTRSCSmVc_TunParam.KeTRSC_deg_MaxStrAngle_Up_Limit@ */ /end MEASUREMENT
/begin MEASUREMENT IbTRSC_InpBus.IbTRSCSmVc_TunParam.KeTRSC_deg_MaxStrAngle_Low_Limit "" FLOAT32_IEEE TRSC_SM_VC_Int_CM_single 0 0 -3.4E+38 3.4E+38 ECU_ADDRESS 0x0000 /* @ECU_Address@IbTRSC_InpBus.IbTRSCSmVc_TunParam.KeTRSC_deg_MaxStrAngle_Low_Limit@ */ /end MEASUREMENT
/begin MEASUREMENT IbTRSC_InpBus.IbTRSCSmVc_TunParam.KeTRSC_m_WheelBase_Up_Limit "" FLOAT32_IEEE TRSC_SM_VC_Int_CM_single 0 0 -3.4E+38 3.4E+38 ECU_ADDRESS 0x0000 /* @ECU_Address@IbTRSC_InpBus.IbTRSCSmVc_TunParam.KeTRSC_m_WheelBase_Up_Limit@ */ /end MEASUREMENT
/begin MEASUREMENT IbTRSC_InpBus.IbTRSCSmVc_TunParam.KeTRSC_m_WheelBase_Low_Limit "" FLOAT32_IEEE TRSC_SM_VC_Int_CM_single 0 0 -3.4E+38 3.4E+38 ECU_ADDRESS 0x0000 /* @ECU_Address@IbTRSC_InpBus.IbTRSCSmVc_TunParam.KeTRSC_m_WheelBase_Low_Limit@ */ /end MEASUREMENT
/begin MEASUREMENT IbTRSC_InpBus.IbTRSCSmVc_TunParam.KeTRSC_deg_KnobHys "" FLOAT32_IEEE TRSC_SM_VC_Int_CM_single 0 0 -3.4E+38 3.4E+38 ECU_ADDRESS 0x0000 /* @ECU_Address@IbTRSC_InpBus.IbTRSCSmVc_TunParam.KeTRSC_deg_KnobHys@ */ /end MEASUREMENT
/begin MEASUREMENT IbTRSC_InpBus.IbTRSCSmVc_TunParam.KeTRSC_pct_JackKnifePerc "" FLOAT32_IEEE TRSC_SM_VC_Int_CM_single 0 0 -3.4E+38 3.4E+38 ECU_ADDRESS 0x0000 /* @ECU_Address@IbTRSC_InpBus.IbTRSCSmVc_TunParam.KeTRSC_pct_JackKnifePerc@ */ /end MEASUREMENT
/begin MEASUREMENT IbTRSC_InpBus.IbTRSCSmVc_TunParam.KeTRSC_deg_MaxKnobAngle "" FLOAT32_IEEE TRSC_SM_VC_Int_CM_single 0 0 -3.4E+38 3.4E+38 ECU_ADDRESS 0x0000 /* @ECU_Address@IbTRSC_InpBus.IbTRSCSmVc_TunParam.KeTRSC_deg_MaxKnobAngle@ */ /end MEASUREMENT
/begin MEASUREMENT IbTRSC_InpBus.IbTRSCSmVc_TunParam.KeTRSC_deg_MaxTrlrAngl "" FLOAT32_IEEE TRSC_SM_VC_Int_CM_single 0 0 -3.4E+38 3.4E+38 ECU_ADDRESS 0x0000 /* @ECU_Address@IbTRSC_InpBus.IbTRSCSmVc_TunParam.KeTRSC_deg_MaxTrlrAngl@ */ /end MEASUREMENT
/begin MEASUREMENT IbTRSC_InpBus.IbTRSCSmVc_TunParam.KeTRSC_TADdes_k_PIDKd "" FLOAT32_IEEE TRSC_SM_VC_Int_CM_single 0 0 -3.4E+38 3.4E+38 ECU_ADDRESS 0x0000 /* @ECU_Address@IbTRSC_InpBus.IbTRSCSmVc_TunParam.KeTRSC_TADdes_k_PIDKd@ */ /end MEASUREMENT
/begin MEASUREMENT IbTRSC_InpBus.IbTRSCSmVc_TunParam.KeTRSC_TADep_k_PIDKp "" FLOAT32_IEEE TRSC_SM_VC_Int_CM_single 0 0 -3.4E+38 3.4E+38 ECU_ADDRESS 0x0000 /* @ECU_Address@IbTRSC_InpBus.IbTRSCSmVc_TunParam.KeTRSC_TADep_k_PIDKp@ */ /end MEASUREMENT
/begin MEASUREMENT IbTRSC_InpBus.IbTRSCSmVc_TunParam.KaTRA_deg_TADLUTTblData "" FLOAT32_IEEE TRSC_SM_VC_Int_CM_single 0 0 -3.4E+38 3.4E+38 ARRAY_SIZE 3 ECU_ADDRESS 0x0000 /* @ECU_Address@IbTRSC_InpBus.IbTRSCSmVc_TunParam.KaTRA_deg_TADLUTTblData@ */ /end MEASUREMENT
/begin MEASUREMENT IbTRSC_InpBus.IbTRSCSmVc_TunParam.KeTRSC_deg_TGTADdesRateChange "" FLOAT32_IEEE TRSC_SM_VC_Int_CM_single 0 0 -3.4E+38 3.4E+38 ECU_ADDRESS 0x0000 /* @ECU_Address@IbTRSC_InpBus.IbTRSCSmVc_TunParam.KeTRSC_deg_TGTADdesRateChange@ */ /end MEASUREMENT
/begin MEASUREMENT IbTRSC_InpBus.IbTRSCSmVc_TunParam.KeTRSC_deg_TAD_DesRateUpLim "" FLOAT32_IEEE TRSC_SM_VC_Int_CM_single 0 0 -3.4E+38 3.4E+38 ECU_ADDRESS 0x0000 /* @ECU_Address@IbTRSC_InpBus.IbTRSCSmVc_TunParam.KeTRSC_deg_TAD_DesRateUpLim@ */ /end MEASUREMENT
/begin MEASUREMENT IbTRSC_InpBus.IbTRSCSmVc_TunParam.KeTRSC_deg_TrqCnt_UpLimit "" FLOAT32_IEEE TRSC_SM_VC_Int_CM_single 0 0 -3.4E+38 3.4E+38 ECU_ADDRESS 0x0000 /* @ECU_Address@IbTRSC_InpBus.IbTRSCSmVc_TunParam.KeTRSC_deg_TrqCnt_UpLimit@ */ /end MEASUREMENT
/begin MEASUREMENT IbTRSC_InpBus.IbTRSCSmVc_TunParam.KeTRSC_deg_TrqCnt_LowLimit "" FLOAT32_IEEE TRSC_SM_VC_Int_CM_single 0 0 -3.4E+38 3.4E+38 ECU_ADDRESS 0x0000 /* @ECU_Address@IbTRSC_InpBus.IbTRSCSmVc_TunParam.KeTRSC_deg_TrqCnt_LowLimit@ */ /end MEASUREMENT
/begin MEASUREMENT IbTRSC_InpBus.IbTRSCSmVc_TunParam.KeTRSC_k_JKAngle_UpLimit "" FLOAT32_IEEE TRSC_SM_VC_Int_CM_single 0 0 -3.4E+38 3.4E+38 ECU_ADDRESS 0x0000 /* @ECU_Address@IbTRSC_InpBus.IbTRSCSmVc_TunParam.KeTRSC_k_JKAngle_UpLimit@ */ /end MEASUREMENT
/begin MEASUREMENT IbTRSC_InpBus.IbTRSCSmVc_TunParam.KeTRSC_k_JKAngle_LowLimit "" FLOAT32_IEEE TRSC_SM_VC_Int_CM_single 0 0 -3.4E+38 3.4E+38 ECU_ADDRESS 0x0000 /* @ECU_Address@IbTRSC_InpBus.IbTRSCSmVc_TunParam.KeTRSC_k_JKAngle_LowLimit@ */ /end MEASUREMENT
/begin MEASUREMENT IbTRSC_InpBus.IbTRSCSmVc_TunParam.KeTRSC_k_LogVecLength "" FLOAT32_IEEE TRSC_SM_VC_Int_CM_single 0 0 -3.4E+38 3.4E+38 ECU_ADDRESS 0x0000 /* @ECU_Address@IbTRSC_InpBus.IbTRSCSmVc_TunParam.KeTRSC_k_LogVecLength@ */ /end MEASUREMENT
/begin MEASUREMENT IbTRSC_InpBus.IbTRSCSmVc_TunParam.KeKM_m_BeamLength "" FLOAT32_IEEE TRSC_SM_VC_Int_CM_single 0 0 -3.4E+38 3.4E+38 ECU_ADDRESS 0x0000 /* @ECU_Address@IbTRSC_InpBus.IbTRSCSmVc_TunParam.KeKM_m_BeamLength@ */ /end MEASUREMENT
/begin MEASUREMENT IbTRSC_InpBus.IbTRSCSmVc_TunParam.KeTRSC_m_TBL_UpLimit "" FLOAT32_IEEE TRSC_SM_VC_Int_CM_single 0 0 -3.4E+38 3.4E+38 ECU_ADDRESS 0x0000 /* @ECU_Address@IbTRSC_InpBus.IbTRSCSmVc_TunParam.KeTRSC_m_TBL_UpLimit@ */ /end MEASUREMENT
/begin MEASUREMENT IbTRSC_InpBus.IbTRSCSmVc_TunParam.KeTRSC_m_TBL_LowLimit "" FLOAT32_IEEE TRSC_SM_VC_Int_CM_single 0 0 -3.4E+38 3.4E+38 ECU_ADDRESS 0x0000 /* @ECU_Address@IbTRSC_InpBus.IbTRSCSmVc_TunParam.KeTRSC_m_TBL_LowLimit@ */ /end MEASUREMENT
/begin MEASUREMENT IbTRSC_InpBus.IbTRSCSmVc_TunParam.KeTRSC_kph_DeactivationSpd "" FLOAT32_IEEE TRSC_SM_VC_Int_CM_single 0 0 -3.4E+38 3.4E+38 ECU_ADDRESS 0x0000 /* @ECU_Address@IbTRSC_InpBus.IbTRSCSmVc_TunParam.KeTRSC_kph_DeactivationSpd@ */ /end MEASUREMENT
/begin MEASUREMENT IbTRSC_InpBus.IbTRSCSmVc_TunParam.KeTRSC_pct_TrlrJackKnifePerc "" FLOAT32_IEEE TRSC_SM_VC_Int_CM_single 0 0 -3.4E+38 3.4E+38 ECU_ADDRESS 0x0000 /* @ECU_Address@IbTRSC_InpBus.IbTRSCSmVc_TunParam.KeTRSC_pct_TrlrJackKnifePerc@ */ /end MEASUREMENT
/begin MEASUREMENT IbTRSC_InpBus.IbTRSCSmVc_TunParam.KeTRSC_s_ActTransRevDbnc2 "" FLOAT32_IEEE TRSC_SM_VC_Int_CM_single 0 0 -3.4E+38 3.4E+38 ECU_ADDRESS 0x0000 /* @ECU_Address@IbTRSC_InpBus.IbTRSCSmVc_TunParam.KeTRSC_s_ActTransRevDbnc2@ */ /end MEASUREMENT
/begin MEASUREMENT IbTRSC_InpBus.IbTRSCSmVc_TunParam.KeTRSC_s_CalibDlyTh "" FLOAT32_IEEE TRSC_SM_VC_Int_CM_single 0 0 -3.4E+38 3.4E+38 ECU_ADDRESS 0x0000 /* @ECU_Address@IbTRSC_InpBus.IbTRSCSmVc_TunParam.KeTRSC_s_CalibDlyTh@ */ /end MEASUREMENT
/begin MEASUREMENT IbTRSC_InpBus.IbTRSCSmVc_TunParam.KeTRSC_s_EpsRespTmOut "" FLOAT32_IEEE TRSC_SM_VC_Int_CM_single 0 0 -3.4E+38 3.4E+38 ECU_ADDRESS 0x0000 /* @ECU_Address@IbTRSC_InpBus.IbTRSCSmVc_TunParam.KeTRSC_s_EpsRespTmOut@ */ /end MEASUREMENT
/begin MEASUREMENT IbTRSC_InpBus.IbTRSCSmVc_TunParam.KeTRSC_s_GearDbncTh "" FLOAT32_IEEE TRSC_SM_VC_Int_CM_single 0 0 -3.4E+38 3.4E+38 ECU_ADDRESS 0x0000 /* @ECU_Address@IbTRSC_InpBus.IbTRSCSmVc_TunParam.KeTRSC_s_GearDbncTh@ */ /end MEASUREMENT
/begin MEASUREMENT IbTRSC_InpBus.IbTRSCSmVc_TunParam.KeTRSC_s_LEDTmrTh "" FLOAT32_IEEE TRSC_SM_VC_Int_CM_single 0 0 -3.4E+38 3.4E+38 ECU_ADDRESS 0x0000 /* @ECU_Address@IbTRSC_InpBus.IbTRSCSmVc_TunParam.KeTRSC_s_LEDTmrTh@ */ /end MEASUREMENT
/begin MEASUREMENT IbTRSC_InpBus.IbTRSCSmVc_TunParam.KeTRSC_s_RespNotRcvdTmOut "" FLOAT32_IEEE TRSC_SM_VC_Int_CM_single 0 0 -3.4E+38 3.4E+38 ECU_ADDRESS 0x0000 /* @ECU_Address@IbTRSC_InpBus.IbTRSCSmVc_TunParam.KeTRSC_s_RespNotRcvdTmOut@ */ /end MEASUREMENT
/begin MEASUREMENT IbTRSC_InpBus.IbTRSCSmVc_TunParam.KeTRSC_s_TrlrUnkwnSet "" FLOAT32_IEEE TRSC_SM_VC_Int_CM_single 0 0 -3.4E+38 3.4E+38 ECU_ADDRESS 0x0000 /* @ECU_Address@IbTRSC_InpBus.IbTRSCSmVc_TunParam.KeTRSC_s_TrlrUnkwnSet@ */ /end MEASUREMENT
/begin MEASUREMENT IbTRSC_InpBus.IbTRSCSmVc_TunParam.KeTRSC_k_WhlAngCFWt "Wheel Angle C Factor Weight" FLOAT32_IEEE TRSC_SM_VC_Int_CM_single 0 0 -3.4E+38 3.4E+38 ECU_ADDRESS 0x0000 /* @ECU_Address@IbTRSC_InpBus.IbTRSCSmVc_TunParam.KeTRSC_k_WhlAngCFWt@ */ /end MEASUREMENT
/begin MEASUREMENT IbTRSC_InpBus.IbTRSCSmVc_TunParam.KeTRSC_k_WhlAngCFBias "Wheel Angle C Factor Bias" FLOAT32_IEEE TRSC_SM_VC_Int_CM_single 0 0 -3.4E+38 3.4E+38 ECU_ADDRESS 0x0000 /* @ECU_Address@IbTRSC_InpBus.IbTRSCSmVc_TunParam.KeTRSC_k_WhlAngCFBias@ */ /end MEASUREMENT
/begin MEASUREMENT IbTRSC_InpBus.IbTRSCSmVc_TunParam.KaTRSC_kph_InputRateLimBrkPts "" FLOAT32_IEEE TRSC_SM_VC_Int_CM_single 0 0 -3.4E+38 3.4E+38 ARRAY_SIZE 4 ECU_ADDRESS 0x0000 /* @ECU_Address@IbTRSC_InpBus.IbTRSCSmVc_TunParam.KaTRSC_kph_InputRateLimBrkPts@ */ /end MEASUREMENT
/begin MEASUREMENT IbTRSC_InpBus.IbTRSCSmVc_TunParam.KaTRSC_k_InputRateLimTblData "" FLOAT32_IEEE TRSC_SM_VC_Int_CM_single 0 0 -3.4E+38 3.4E+38 ARRAY_SIZE 4 ECU_ADDRESS 0x0000 /* @ECU_Address@IbTRSC_InpBus.IbTRSCSmVc_TunParam.KaTRSC_k_InputRateLimTblData@ */ /end MEASUREMENT
/begin MEASUREMENT IbTRSC_InpBus.IbTRSCSmVc_TunParam.KaTRSC_kph_IntegratorGainBrkPts "" FLOAT32_IEEE TRSC_SM_VC_Int_CM_single 0 0 -3.4E+38 3.4E+38 ARRAY_SIZE 4 ECU_ADDRESS 0x0000 /* @ECU_Address@IbTRSC_InpBus.IbTRSCSmVc_TunParam.KaTRSC_kph_IntegratorGainBrkPts@ */ /end MEASUREMENT
/begin MEASUREMENT IbTRSC_InpBus.IbTRSCSmVc_TunParam.KaTRSC_k_IntegratorGainTblData "" FLOAT32_IEEE TRSC_SM_VC_Int_CM_single 0 0 -3.4E+38 3.4E+38 ARRAY_SIZE 4 ECU_ADDRESS 0x0000 /* @ECU_Address@IbTRSC_InpBus.IbTRSCSmVc_TunParam.KaTRSC_k_IntegratorGainTblData@ */ /end MEASUREMENT
/begin MEASUREMENT IbTRSC_InpBus.IbTRSCSmVc_TunParam.KaTRSC_kph_IntegratorExtSatBrkPts "" FLOAT32_IEEE TRSC_SM_VC_Int_CM_single 0 0 -3.4E+38 3.4E+38 ARRAY_SIZE 4 ECU_ADDRESS 0x0000 /* @ECU_Address@IbTRSC_InpBus.IbTRSCSmVc_TunParam.KaTRSC_kph_IntegratorExtSatBrkPts@ */ /end MEASUREMENT
/begin MEASUREMENT IbTRSC_InpBus.IbTRSCSmVc_TunParam.KaTRSC_k_IntegratorExtSatTblData "" FLOAT32_IEEE TRSC_SM_VC_Int_CM_single 0 0 -3.4E+38 3.4E+38 ARRAY_SIZE 4 ECU_ADDRESS 0x0000 /* @ECU_Address@IbTRSC_InpBus.IbTRSCSmVc_TunParam.KaTRSC_k_IntegratorExtSatTblData@ */ /end MEASUREMENT
/begin MEASUREMENT IbTRSC_InpBus.IbTRSCSmVc_TunParam.KaTRSC_kph_PGainLUTXBrkPts "" FLOAT32_IEEE TRSC_SM_VC_Int_CM_single 0 0 -3.4E+38 3.4E+38 ARRAY_SIZE 4 ECU_ADDRESS 0x0000 /* @ECU_Address@IbTRSC_InpBus.IbTRSCSmVc_TunParam.KaTRSC_kph_PGainLUTXBrkPts@ */ /end MEASUREMENT
/begin MEASUREMENT IbTRSC_InpBus.IbTRSCSmVc_TunParam.KaTRSC_deg_PGainLUTYBrkPts "" FLOAT32_IEEE TRSC_SM_VC_Int_CM_single 0 0 -3.4E+38 3.4E+38 ARRAY_SIZE 5 ECU_ADDRESS 0x0000 /* @ECU_Address@IbTRSC_InpBus.IbTRSCSmVc_TunParam.KaTRSC_deg_PGainLUTYBrkPts@ */ /end MEASUREMENT
/begin MEASUREMENT IbTRSC_InpBus.IbTRSCSmVc_TunParam.KaTRSC_k_PGainLUTTblData "" FLOAT32_IEEE TRSC_SM_VC_Int_CM_single 0 0 -3.4E+38 3.4E+38 ARRAY_SIZE 20 ECU_ADDRESS 0x0000 /* @ECU_Address@IbTRSC_InpBus.IbTRSCSmVc_TunParam.KaTRSC_k_PGainLUTTblData@ */ /end MEASUREMENT
/begin MEASUREMENT IbTRSC_InpBus.IbTRSCSmVc_TunParam.KaTRSC_kph_DiffGainBrkPts "" FLOAT32_IEEE TRSC_SM_VC_Int_CM_single 0 0 -3.4E+38 3.4E+38 ARRAY_SIZE 4 ECU_ADDRESS 0x0000 /* @ECU_Address@IbTRSC_InpBus.IbTRSCSmVc_TunParam.KaTRSC_kph_DiffGainBrkPts@ */ /end MEASUREMENT
/begin MEASUREMENT IbTRSC_InpBus.IbTRSCSmVc_TunParam.KaTRSC_k_DiffGainTblData "" FLOAT32_IEEE TRSC_SM_VC_Int_CM_single 0 0 -3.4E+38 3.4E+38 ARRAY_SIZE 4 ECU_ADDRESS 0x0000 /* @ECU_Address@IbTRSC_InpBus.IbTRSCSmVc_TunParam.KaTRSC_k_DiffGainTblData@ */ /end MEASUREMENT
/begin MEASUREMENT IbTRSC_InpBus.IbTRSCSmVc_TunParam.KaTRSC_kph_DampingGainBrkPts "" FLOAT32_IEEE TRSC_SM_VC_Int_CM_single 0 0 -3.4E+38 3.4E+38 ARRAY_SIZE 4 ECU_ADDRESS 0x0000 /* @ECU_Address@IbTRSC_InpBus.IbTRSCSmVc_TunParam.KaTRSC_kph_DampingGainBrkPts@ */ /end MEASUREMENT
/begin MEASUREMENT IbTRSC_InpBus.IbTRSCSmVc_TunParam.KaTRSC_k_DampingGainTblData "" FLOAT32_IEEE TRSC_SM_VC_Int_CM_single 0 0 -3.4E+38 3.4E+38 ARRAY_SIZE 4 ECU_ADDRESS 0x0000 /* @ECU_Address@IbTRSC_InpBus.IbTRSCSmVc_TunParam.KaTRSC_k_DampingGainTblData@ */ /end MEASUREMENT
/begin MEASUREMENT IbTRSC_InpBus.IbTRSCSmVc_TunParam.KeTRSC_k_TrqConstRateLim "" FLOAT32_IEEE TRSC_SM_VC_Int_CM_single 0 0 -3.4E+38 3.4E+38 ECU_ADDRESS 0x0000 /* @ECU_Address@IbTRSC_InpBus.IbTRSCSmVc_TunParam.KeTRSC_k_TrqConstRateLim@ */ /end MEASUREMENT
/begin MEASUREMENT IbTRSC_InpBus.IbTRSCSmVc_TunParam.KeTRSC_k_TrqConstSatLim "" FLOAT32_IEEE TRSC_SM_VC_Int_CM_single 0 0 -3.4E+38 3.4E+38 ECU_ADDRESS 0x0000 /* @ECU_Address@IbTRSC_InpBus.IbTRSCSmVc_TunParam.KeTRSC_k_TrqConstSatLim@ */ /end MEASUREMENT
/begin MEASUREMENT IbTRSC_InpBus.IbTRSCSmVc_TunParam.KeTRSC_k_VariantID "" UBYTE TRSC_SM_VC_Int_CM_uint8 0 0 0 255 ECU_ADDRESS 0x0000 /* @ECU_Address@IbTRSC_InpBus.IbTRSCSmVc_TunParam.KeTRSC_k_VariantID@ */ /end MEASUREMENT
/begin MEASUREMENT IbTRSC_InpBus.IbTRSCSmVc_TunParam.KeTRSC_Cnt_FailedCnt "" UBYTE TRSC_SM_VC_Int_CM_uint8 0 0 0 255 ECU_ADDRESS 0x0000 /* @ECU_Address@IbTRSC_InpBus.IbTRSCSmVc_TunParam.KeTRSC_Cnt_FailedCnt@ */ /end MEASUREMENT
/begin MEASUREMENT IbTRSC_InpBus.IbTRSCSmVc_TunParam.KeTRSC_e_CamBlockAcceptLvl "" UBYTE TRSC_SM_VC_Int_CM_uint8 0 0 0 255 ECU_ADDRESS 0x0000 /* @ECU_Address@IbTRSC_InpBus.IbTRSCSmVc_TunParam.KeTRSC_e_CamBlockAcceptLvl@ */ /end MEASUREMENT
/begin MEASUREMENT IbTRSC_InpBus.IbTRSCSmVc_TunParam.KeTRSC_b_bValidFlag "" UBYTE TRSC_SM_VC_Int_CM_boolean 0 0 0 1 ECU_ADDRESS 0x0000 /* @ECU_Address@IbTRSC_InpBus.IbTRSCSmVc_TunParam.KeTRSC_b_bValidFlag@ */ /end MEASUREMENT
/begin MEASUREMENT IbTRSC_InpBus.MeTRSC_e_CamBlockSts "" UBYTE TRSC_SM_VC_Int_CM_uint8 0 0 0 255 ECU_ADDRESS 0x0000 /* @ECU_Address@IbTRSC_InpBus.MeTRSC_e_CamBlockSts@ */ /end MEASUREMENT
/begin MEASUREMENT IbTRSC_InpBus.MeTRSC_b_InternalFault "" UBYTE TRSC_SM_VC_Int_CM_boolean 0 0 0 1 ECU_ADDRESS 0x0000 /* @ECU_Address@IbTRSC_InpBus.MeTRSC_b_InternalFault@ */ /end MEASUREMENT
/begin MEASUREMENT IeTRSC_e_TRSCUnavailReas "Decimal value shall be converted to binary to understand bit set or resetted for below values:
      
      DID Value for TRSC Unavailable/ not able to engage TRSC Reason:
      No response or invalid from Engine Controller,
      No response or invalid from Brake Systems Module,
      No response or invalid from Electric Power steering Module,
      No response or invalid from Transmission Controller,
      No response or invalid from ORC Module,
      No response or invalid from Radio,
      Ignition not in RUN,
      Rear tailgate open,
      Engine status signal says engine OFF,
      Driver door Open,
      Vehicle not in 'P',
      Camera calibration is unknown,
      Trailer not detected by the system,
      Trailer Angle to the vehicle too steep to engage the TRSC feature,
      Trailer Calibration Failure,
      No Response or invalid data received from TRSKM Knob module,
      CVADAS ECU supply Voltage lower or higher than operating range,
      CVADAS ECU in plant mode,
      Invalid Proxi Parameter(out of range)/Vehicle Configuration mismatch,
      Fail not present,
      SNA - When internal fault present and parameter not available" ULONG TRSC_SM_VC_Int_CM_uint32 0 0 0 4294967295 ECU_ADDRESS 0x0000 /* @ECU_Address@IeTRSC_e_TRSCUnavailReas@ */ /end MEASUREMENT
/begin MEASUREMENT IeTRSC_e_TRSCAbortReas "Decimal value shall be converted to binary to understand bit set or resetted for below values:
      
      DID Value for Abort/Cancellation Reason:
      No response or invalid from Engine Controller,
      No response or invalid from Brake Systems Module,
      No response or invalid from Electric Power steering Module,
      No response or invalid from Transmission Controller,
      No response or invalid from ORC Module,
      No response or invalid from Radio,
      Ignition not in RUN,
      Rear tailgate open,
      Engine status signal says engine OFF,
      Driver door Open,
      Exceed speed in forward direction above 25 MPH,
      Trailer image in Camera view - lost in the field of view,
      Driver steering override,
      No user feedback for 600 Sec,
      TRSC button pressed on the TRSKM or radio screen,
      No Response or invalid data received from TRSKM Knob module,
      CVADAS ECU supply Voltage lower or higher than operating range,
      Trailer Angle too steep,
      Vehicle Speed exceeds the speed requested by CVADAS module during the maneuver,
      Invalid Proxi Parameter(out of range)/Vehicle Configuration mismatch,
      Fail not present,
      SNA - When internal fault present and parameter not available" ULONG TRSC_SM_VC_Int_CM_uint32 0 0 0 4294967295 ECU_ADDRESS 0x0000 /* @ECU_Address@IeTRSC_e_TRSCAbortReas@ */ /end MEASUREMENT
/begin MEASUREMENT MeTRSC_deg_TADAngleSMVC "TAD Angle" FLOAT32_IEEE TRSC_SM_VC_Int_CM_single_deg 0 0 -3.4E+38 3.4E+38 ECU_ADDRESS 0x0000 /* @ECU_Address@MeTRSC_deg_TADAngleSMVC@ */ /end MEASUREMENT
/begin MEASUREMENT IeTRSC_M_TRSCStrTrq "TRSC steering torque overlay request  information" FLOAT32_IEEE TRSC_SM_VC_Int_CM_single_nm 0 0 -3.4E+38 3.4E+38 ECU_ADDRESS 0x0000 /* @ECU_Address@IeTRSC_M_TRSCStrTrq@ */ /end MEASUREMENT
/begin MEASUREMENT IeTRSC_pct_TRSCStrDmp "TRSC Steering damping percentage" FLOAT32_IEEE TRSC_SM_VC_Int_CM_single_percent 0 0 -3.4E+38 3.4E+38 ECU_ADDRESS 0x0000 /* @ECU_Address@IeTRSC_pct_TRSCStrDmp@ */ /end MEASUREMENT
/begin MEASUREMENT MeTRSC_deg_JackKnifeAngle "" FLOAT32_IEEE TRSC_SM_VC_Int_CM_single_deg 0 0 -3.4E+38 3.4E+38 ECU_ADDRESS 0x0000 /* @ECU_Address@MeTRSC_deg_JackKnifeAngle@ */ /end MEASUREMENT
/begin MEASUREMENT MeTRSC_m_TrailerBeamLen "" FLOAT32_IEEE TRSC_SM_VC_Int_CM_single 0 0 -3.4E+38 3.4E+38 ECU_ADDRESS 0x0000 /* @ECU_Address@MeTRSC_m_TrailerBeamLen@ */ /end MEASUREMENT
/begin MEASUREMENT MeTRSC_deg_JackknifeThrAngle "" FLOAT32_IEEE TRSC_SM_VC_Int_CM_single 0 0 -3.4E+38 3.4E+38 ECU_ADDRESS 0x0000 /* @ECU_Address@MeTRSC_deg_JackknifeThrAngle@ */ /end MEASUREMENT
/begin MEASUREMENT MeTRSC_deg_MaxAllowedTADAngle "" FLOAT32_IEEE TRSC_SM_VC_Int_CM_single 0 0 -3.4E+38 3.4E+38 ECU_ADDRESS 0x0000 /* @ECU_Address@MeTRSC_deg_MaxAllowedTADAngle@ */ /end MEASUREMENT
/begin MEASUREMENT MeTRSC_deg_KnobAngle "" FLOAT32_IEEE TRSC_SM_VC_Int_CM_single 0 0 -3.4E+38 3.4E+38 ECU_ADDRESS 0x0000 /* @ECU_Address@MeTRSC_deg_KnobAngle@ */ /end MEASUREMENT
/begin MEASUREMENT IeTRSC_kph_VehSpeedVSOSig "It is the average vehicle speed calculated" FLOAT32_IEEE TRSC_SM_VC_Int_CM_single_km_h 0 0 -3.4E+38 3.4E+38 ECU_ADDRESS 0x0000 /* @ECU_Address@IeTRSC_kph_VehSpeedVSOSig@ */ /end MEASUREMENT
/begin MEASUREMENT IeTRSC_m_TrlrWhlBaseEff "DID value of Trailer Wheel Base effective" FLOAT32_IEEE TRSC_SM_VC_Int_CM_single 0 0 -3.4E+38 3.4E+38 ECU_ADDRESS 0x0000 /* @ECU_Address@IeTRSC_m_TrlrWhlBaseEff@ */ /end MEASUREMENT
/begin MEASUREMENT IeTRSC_deg_FrntWhlAng "DID Value of Front Road wheel angle" FLOAT32_IEEE TRSC_SM_VC_Int_CM_single 0 0 -3.4E+38 3.4E+38 ECU_ADDRESS 0x0000 /* @ECU_Address@IeTRSC_deg_FrntWhlAng@ */ /end MEASUREMENT
/begin MEASUREMENT IeTRSC_deg_TrlrAngKnob "DID Value of Trailer Angle requested by the knob" FLOAT32_IEEE TRSC_SM_VC_Int_CM_single 0 0 -3.4E+38 3.4E+38 ECU_ADDRESS 0x0000 /* @ECU_Address@IeTRSC_deg_TrlrAngKnob@ */ /end MEASUREMENT
/begin MEASUREMENT IeTRSC_deg_JackknifeThrAngle "DID Value of JackknifeThresholdAngle" FLOAT32_IEEE TRSC_SM_VC_Int_CM_single 0 0 -3.4E+38 3.4E+38 ECU_ADDRESS 0x0000 /* @ECU_Address@IeTRSC_deg_JackknifeThrAngle@ */ /end MEASUREMENT
/begin MEASUREMENT IeTRSC_deg_TADAngAct "IeTRSC_deg_TADAngAct signal output from TRSC SM" FLOAT32_IEEE TRSC_SM_VC_Int_CM_single_deg 0 0 -3.4E+38 3.4E+38 ECU_ADDRESS 0x0000 /* @ECU_Address@IeTRSC_deg_TADAngAct@ */ /end MEASUREMENT
/begin MEASUREMENT MeTRSC_deg_StrCMD "Steering Angle command in degree" FLOAT32_IEEE TRSC_SM_VC_Int_CM_single_deg 0 0 -3.4E+38 3.4E+38 ECU_ADDRESS 0x0000 /* @ECU_Address@MeTRSC_deg_StrCMD@ */ /end MEASUREMENT
/begin MEASUREMENT IeTRSC_kph_SpdLmtReq_DID "Speed limit request DID" FLOAT32_IEEE TRSC_SM_VC_Int_CM_single_km_h 0 0 -3.4E+38 3.4E+38 ECU_ADDRESS 0x0000 /* @ECU_Address@IeTRSC_kph_SpdLmtReq_DID@ */ /end MEASUREMENT
/begin MEASUREMENT IeTRSC_e_GearShiftSts "DID Value of Shifter Position status read from bus:
      Initialize(0)
      Gear1(1)
      Gear2(2)
      Gear3(3)
      Gear4(4)
      Gear5(5)
      Gear6(6)
      Gear7(7)
      Gear8(8)
      Gear9(9)
      NotUsed1(10)
      NotUsed2(11)
      P(12)
      N(13)
      R(14)
      D(15)
      L(16)
      M(17)
      S(18)
      SNA(31)" SLONG TRSC_SM_VC_Int_CM_TeVBII_e_GearEngagedForDsply 0 0 0 2147483647 ECU_ADDRESS 0x0000 /* @ECU_Address@IeTRSC_e_GearShiftSts@ */ /end MEASUREMENT
/begin MEASUREMENT IeTRSC_e_TRSKMBtnSts "DID Value of TRSKM Button Status
      NotPressed(0)
      Pressed(1)
      SNA(2)" SLONG TRSC_SM_VC_Int_CM_TeVBII_e_EnblBtnSts 0 0 0 2147483647 ECU_ADDRESS 0x0000 /* @ECU_Address@IeTRSC_e_TRSKMBtnSts@ */ /end MEASUREMENT
/begin MEASUREMENT IeTRSC_e_TRSKMCenBtnSts "DID Value of TRSKM Push to Center Button Status:
      NotPressed(0)
      Pressed(1)
      SNA(2)" SLONG TRSC_SM_VC_Int_CM_TeVBII_e_CenterBtnSts 0 0 0 2147483647 ECU_ADDRESS 0x0000 /* @ECU_Address@IeTRSC_e_TRSKMCenBtnSts@ */ /end MEASUREMENT
/begin MEASUREMENT IeTRSC_e_VehStpReq_DID "TRSC break activation request DID" SLONG TRSC_SM_VC_Int_CM_TeTRSC_e_VehStpReq_DID 0 0 0 2147483647 ECU_ADDRESS 0x0000 /* @ECU_Address@IeTRSC_e_VehStpReq_DID@ */ /end MEASUREMENT
/begin MEASUREMENT IeTRSC_e_VehStpReq "TRSC break activation request" SLONG TRSC_SM_VC_Int_CM_TeTRSC_e_VehStpReq 0 0 0 2147483647 ECU_ADDRESS 0x0000 /* @ECU_Address@IeTRSC_e_VehStpReq@ */ /end MEASUREMENT
/begin MEASUREMENT MeTRSC_e_TrlrPrsntInfoCAN "MeTRSC_e_TrlrPrsntInfoCAN signal output from TRSC SM" SLONG TRSC_SM_VC_Int_CM_TeTRSC_e_TrlrPrsntInfo 0 0 0 2147483647 ECU_ADDRESS 0x0000 /* @ECU_Address@MeTRSC_e_TrlrPrsntInfoCAN@ */ /end MEASUREMENT
/begin MEASUREMENT IeTRSC_e_TrlrHitchLightCtrl "Trailer Hitch light Control when trailer is connected" SLONG TRSC_SM_VC_Int_CM_TeTRSC_e_TrlrHitchLightCtrl 0 0 0 2147483647 ECU_ADDRESS 0x0000 /* @ECU_Address@IeTRSC_e_TrlrHitchLightCtrl@ */ /end MEASUREMENT
/begin MEASUREMENT MeTRSC_e_TrlrCalInfoSMVC "Trailer Calibration Information
      0 -> Not Calibrated,
      1 - >Calibrated
      2 ->undefined" SLONG TRSC_SM_VC_Int_CM_TeTRSC_e_TrlrCalInfo 0 0 0 2147483647 ECU_ADDRESS 0x0000 /* @ECU_Address@MeTRSC_e_TrlrCalInfoSMVC@ */ /end MEASUREMENT
/begin MEASUREMENT IeTRSC_e_TrlrCalInfo "Trailer Calibration Information
      0 -> Not Calibrated,
      1 - >Calibrated
      2 ->undefined" SLONG TRSC_SM_VC_Int_CM_TeTRSC_e_TrlrCalInfo 0 0 0 2147483647 ECU_ADDRESS 0x0000 /* @ECU_Address@IeTRSC_e_TrlrCalInfo@ */ /end MEASUREMENT
/begin MEASUREMENT IeTRSC_e_TRSKMSts_DID "DID Value of TRSKM Module status:
      Enabled,
      Not Enabled,
      SNA - No confirmation received by TRSKM" SLONG TRSC_SM_VC_Int_CM_TeTRSC_e_TRSKMSts_DID 0 0 0 2147483647 ECU_ADDRESS 0x0000 /* @ECU_Address@IeTRSC_e_TRSKMSts_DID@ */ /end MEASUREMENT
/begin MEASUREMENT IeTRSC_e_TRSKMSts "DID Value of TRSKM Module status:
      Enabled,
      Not Enabled,
      SNA - No confirmation received by TRSKM" SLONG TRSC_SM_VC_Int_CM_TeTRSC_e_TRSKMSts 0 0 0 2147483647 ECU_ADDRESS 0x0000 /* @ECU_Address@IeTRSC_e_TRSKMSts@ */ /end MEASUREMENT
/begin MEASUREMENT IeTRSC_e_TRSKMCenBtnSts_DID "DID Value of TRSKM Push to Center Button Status:
      NotPressed(0)
      Pressed(1)
      SNA(2)" SLONG TRSC_SM_VC_Int_CM_TeTRSC_e_TRSKMCenBtnSts_DID 0 0 0 2147483647 ECU_ADDRESS 0x0000 /* @ECU_Address@IeTRSC_e_TRSKMCenBtnSts_DID@ */ /end MEASUREMENT
/begin MEASUREMENT IeTRSC_e_TRSKMBtnSts_DID "DID Value of TRSKM Button Status
      NotPressed(0)
      Pressed(1)
      SNA(2)" SLONG TRSC_SM_VC_Int_CM_TeTRSC_e_TRSKMBtnSts_DID 0 0 0 2147483647 ECU_ADDRESS 0x0000 /* @ECU_Address@IeTRSC_e_TRSKMBtnSts_DID@ */ /end MEASUREMENT
/begin MEASUREMENT IeTRSC_e_TRSCUnavailReas_DID "TRSC Unavailable reasons DID" SLONG TRSC_SM_VC_Int_CM_TeTRSC_e_TRSCUnavailReas_DID 0 0 0 2147483647 ECU_ADDRESS 0x0000 /* @ECU_Address@IeTRSC_e_TRSCUnavailReas_DID@ */ /end MEASUREMENT
/begin MEASUREMENT IeTRSC_e_TRSCSts "TRSC Status" SLONG TRSC_SM_VC_Int_CM_TeTRSC_e_TRSCSts 0 0 0 2147483647 ECU_ADDRESS 0x0000 /* @ECU_Address@IeTRSC_e_TRSCSts@ */ /end MEASUREMENT
/begin MEASUREMENT IeTRSC_e_TRSCStrTrqActvReq "TRSC steering torque overlay activation request" SLONG TRSC_SM_VC_Int_CM_TeTRSC_e_TRSCStrTrqActvReq 0 0 0 2147483647 ECU_ADDRESS 0x0000 /* @ECU_Address@IeTRSC_e_TRSCStrTrqActvReq@ */ /end MEASUREMENT
/begin MEASUREMENT MeTRSC_e_TRSCStat "Internal Current State of TRSC feature" SLONG TRSC_SM_VC_Int_CM_TeTRSC_e_TRSCStat 0 0 0 2147483647 ECU_ADDRESS 0x0000 /* @ECU_Address@MeTRSC_e_TRSCStat@ */ /end MEASUREMENT
/begin MEASUREMENT IeTRSC_e_TRSCPopupDispInfo "TRSC Cluster PopUp Request" SLONG TRSC_SM_VC_Int_CM_TeTRSC_e_TRSCPopupDispInfo 0 0 0 2147483647 ECU_ADDRESS 0x0000 /* @ECU_Address@IeTRSC_e_TRSCPopupDispInfo@ */ /end MEASUREMENT
/begin MEASUREMENT IeTRSC_e_TRSCLedSts "TRSKM LED request" SLONG TRSC_SM_VC_Int_CM_TeTRSC_e_TRSCLedSts 0 0 0 2147483647 ECU_ADDRESS 0x0000 /* @ECU_Address@IeTRSC_e_TRSCLedSts@ */ /end MEASUREMENT
/begin MEASUREMENT IeTRSC_e_TRSCAbortReas_DID "TRSC Abort reasons DID" SLONG TRSC_SM_VC_Int_CM_TeTRSC_e_TRSCAbortReason_DID 0 0 0 2147483647 ECU_ADDRESS 0x0000 /* @ECU_Address@IeTRSC_e_TRSCAbortReas_DID@ */ /end MEASUREMENT
/begin MEASUREMENT IeTRSC_e_TADAngActSign "IeTRSC_e_TADAngActSign signal output from TRSC SM" SLONG TRSC_SM_VC_Int_CM_TeTRSC_e_TADAngActSign 0 0 0 2147483647 ECU_ADDRESS 0x0000 /* @ECU_Address@IeTRSC_e_TADAngActSign@ */ /end MEASUREMENT
/begin MEASUREMENT IeTRSC_e_SpdLmtReq "TRSC ECM Speed limit request" SLONG TRSC_SM_VC_Int_CM_TeTRSC_e_SpdLmtReq 0 0 0 2147483647 ECU_ADDRESS 0x0000 /* @ECU_Address@IeTRSC_e_SpdLmtReq@ */ /end MEASUREMENT
/begin MEASUREMENT IeTRSC_e_GraphicOverlay_Sts "Graphical Overlay DID" SLONG TRSC_SM_VC_Int_CM_TeTRSC_e_GraphicOverlay_Sts 0 0 0 2147483647 ECU_ADDRESS 0x0000 /* @ECU_Address@IeTRSC_e_GraphicOverlay_Sts@ */ /end MEASUREMENT
/begin MEASUREMENT IeTRSC_e_GearShiftSts_DID "Gear shift status DID" SLONG TRSC_SM_VC_Int_CM_TeTRSC_e_GearShiftSts_DID 0 0 0 2147483647 ECU_ADDRESS 0x0000 /* @ECU_Address@IeTRSC_e_GearShiftSts_DID@ */ /end MEASUREMENT
/begin MEASUREMENT MeSVS_e_DispView2Info_DID "CVPM Display view2 status from HMI" SLONG TRSC_SM_VC_Int_CM_TeTRSC_e_DispView2_DID 0 0 0 2147483647 ECU_ADDRESS 0x0000 /* @ECU_Address@MeSVS_e_DispView2Info_DID@ */ /end MEASUREMENT
/begin MEASUREMENT IeTRSC_cnt_KnobPos "DID Value of TRSKM Knob Position" UWORD TRSC_SM_VC_Int_CM_uint16_count 0 0 0.0 255.0 ECU_ADDRESS 0x0000 /* @ECU_Address@IeTRSC_cnt_KnobPos@ */ /end MEASUREMENT
/begin MEASUREMENT IeTRSC_b_MoreCamReqSts "Status of More Camera request Input from HMI SoftButton, ( 0 -> NotPressed, 1 -> Pressed)" UBYTE TRSC_SM_VC_Int_CM_boolean 0 0 0 1 ECU_ADDRESS 0x0000 /* @ECU_Address@IeTRSC_b_MoreCamReqSts@ */ /end MEASUREMENT
/begin MEASUREMENT MeTRSC_b_MoreCamSoftButtEnbl "More Camera Enable Soft Button Input" UBYTE TRSC_SM_VC_Int_CM_boolean 0 0 0.0 1.0 ECU_ADDRESS 0x0000 /* @ECU_Address@MeTRSC_b_MoreCamSoftButtEnbl@ */ /end MEASUREMENT
/begin MEASUREMENT MeTRSC_b_TRSCSwitchPressed "" UBYTE TRSC_SM_VC_Int_CM_boolean 0 0 0 1 ECU_ADDRESS 0x0000 /* @ECU_Address@MeTRSC_b_TRSCSwitchPressed@ */ /end MEASUREMENT
/begin MEASUREMENT MeTRSC_b_TrlrRevSteeringStsInfo "" UBYTE TRSC_SM_VC_Int_CM_boolean 0 0 0 1 ECU_ADDRESS 0x0000 /* @ECU_Address@MeTRSC_b_TrlrRevSteeringStsInfo@ */ /end MEASUREMENT
/begin MEASUREMENT MeTRSC_b_OTBLReset "OTBL Reset flag" UBYTE TRSC_SM_VC_Int_CM_boolean 0 0 0 1 ECU_ADDRESS 0x0000 /* @ECU_Address@MeTRSC_b_OTBLReset@ */ /end MEASUREMENT
/begin MEASUREMENT MeTRSC_b_TBLComputationDone "" UBYTE TRSC_SM_VC_Int_CM_boolean 0 0 0.0 1.0 ECU_ADDRESS 0x0000 /* @ECU_Address@MeTRSC_b_TBLComputationDone@ */ /end MEASUREMENT
/begin MEASUREMENT MeTRSC_b_TrlrCalibPopInfo "Trailer Calibration Popup information" UBYTE TRSC_SM_VC_Int_CM_boolean 0 0 0 1 ECU_ADDRESS 0x0000 /* @ECU_Address@MeTRSC_b_TrlrCalibPopInfo@ */ /end MEASUREMENT
/begin COMPU_METHOD TRSC_SM_VC_Int_CM_single "Q = V" RAT_FUNC "%8.6" "" COEFFS 0 1 0 0 0 1 /end COMPU_METHOD
/begin COMPU_METHOD TRSC_SM_VC_Int_CM_TeVBII_e_CmdIgnSts "Enumerated data type: TeVBII_e_CmdIgnSts" TAB_VERB "%0.6" "" COMPU_TAB_REF VTAB_FOR_TRSC_SM_VC_Int_CM_TeVBII_e_CmdIgnSts /end COMPU_METHOD
/begin COMPU_VTAB VTAB_FOR_TRSC_SM_VC_Int_CM_TeVBII_e_CmdIgnSts "Enumerated data type: TeVBII_e_CmdIgnSts" TAB_VERB 7 0 "TeVBII_e_CmdIgnSts_Initialization" 1 "TeVBII_e_CmdIgnSts_IGN_LK" 3 "TeVBII_e_CmdIgnSts_ACC" 4 "TeVBII_e_CmdIgnSts_RUN" 5 "TeVBII_e_CmdIgnSts_START" 7 "TeVBII_e_CmdIgnSts_SNA" 2147483647 "TeVBII_e_CmdIgnSts_Dummy" /end COMPU_VTAB
/begin COMPU_METHOD TRSC_SM_VC_Int_CM_TeVBII_e_TrailerConnectionSts "Enumerated data type: TeVBII_e_TrailerConnectionSts" TAB_VERB "%0.6" "" COMPU_TAB_REF VTAB_FOR_TRSC_SM_VC_Int_CM_TeVBII_e_TrailerConnectionSts /end COMPU_METHOD
/begin COMPU_VTAB VTAB_FOR_TRSC_SM_VC_Int_CM_TeVBII_e_TrailerConnectionSts "Enumerated data type: TeVBII_e_TrailerConnectionSts" TAB_VERB 5 0 "TeVBII_e_TrailerConnectionSts_NotConnected" 1 "TeVBII_e_TrailerConnectionSts_Connected" 2 "TeVBII_e_TrailerConnectionSts_NotUsed" 3 "TeVBII_e_TrailerConnectionSts_SNA" 2147483647 "TeVBII_e_TrailerConnectionSts_Dummy" /end COMPU_VTAB
/begin COMPU_METHOD TRSC_SM_VC_Int_CM_TeVBII_e_TrlrPrsntSts "Enumerated data type: TeVBII_e_TrlrPrsntSts" TAB_VERB "%0.6" "" COMPU_TAB_REF VTAB_FOR_TRSC_SM_VC_Int_CM_TeVBII_e_TrlrPrsntSts /end COMPU_METHOD
/begin COMPU_VTAB VTAB_FOR_TRSC_SM_VC_Int_CM_TeVBII_e_TrlrPrsntSts "Enumerated data type: TeVBII_e_TrlrPrsntSts" TAB_VERB 5 0 "TeVBII_e_TrlrPrsntSts_NO_TRLR" 1 "TeVBII_e_TrlrPrsntSts_TRLR_PRSNT" 2 "TeVBII_e_TrlrPrsntSts_TRLR_DCONN" 3 "TeVBII_e_TrlrPrsntSts_SNA" 2147483647 "TeVBII_e_TrlrPrsntSts_Dummy" /end COMPU_VTAB
/begin COMPU_METHOD TRSC_SM_VC_Int_CM_TeVBII_e_TchScrSts "Enumerated data type: TeVBII_e_TchScrSts" TAB_VERB "%0.6" "" COMPU_TAB_REF VTAB_FOR_TRSC_SM_VC_Int_CM_TeVBII_e_TchScrSts /end COMPU_METHOD
/begin COMPU_VTAB VTAB_FOR_TRSC_SM_VC_Int_CM_TeVBII_e_TchScrSts "Enumerated data type: TeVBII_e_TchScrSts" TAB_VERB 9 0 "TeVBII_e_TchScrSts_TCH_NOT_PSD" 1 "TeVBII_e_TchScrSts_TchPSD" 2 "TeVBII_e_TchScrSts_TchPSCan" 3 "TeVBII_e_TchScrSts_NotUsed" 4 "TeVBII_e_TchScrSts_TchCfgRes" 5 "TeVBII_e_TchScrSts_TchCfgOfst" 6 "TeVBII_e_TchScrSts_TchCfgMax" 7 "TeVBII_e_TchScrSts_SNA" 2147483647 "TeVBII_e_TchScrSts_Dummy" /end COMPU_VTAB
/begin COMPU_METHOD TRSC_SM_VC_Int_CM_TeVBII_e_TrscEnblBtnSts "Enumerated data type: TeVBII_e_TrscEnblBtnSts" TAB_VERB "%0.6" "" COMPU_TAB_REF VTAB_FOR_TRSC_SM_VC_Int_CM_TeVBII_e_TrscEnblBtnSts /end COMPU_METHOD
/begin COMPU_VTAB VTAB_FOR_TRSC_SM_VC_Int_CM_TeVBII_e_TrscEnblBtnSts "Enumerated data type: TeVBII_e_TrscEnblBtnSts" TAB_VERB 4 0 "TeVBII_e_TrscEnblBtnSts_NotPressed" 1 "TeVBII_e_TrscEnblBtnSts_Pressed" 2 "TeVBII_e_TrscEnblBtnSts_SNA" 2147483647 "TeVBII_e_TrscEnblBtnSts_Dummy" /end COMPU_VTAB
/begin COMPU_METHOD TRSC_SM_VC_Int_CM_TeVBII_e_GearRptState "Enumerated data type: TeVBII_e_GearRptState" TAB_VERB "%0.6" "" COMPU_TAB_REF VTAB_FOR_TRSC_SM_VC_Int_CM_TeVBII_e_GearRptState /end COMPU_METHOD
/begin COMPU_VTAB VTAB_FOR_TRSC_SM_VC_Int_CM_TeVBII_e_GearRptState "Enumerated data type: TeVBII_e_GearRptState" TAB_VERB 14 0 "TeVBII_e_GearRptState_Neutral" 1 "TeVBII_e_GearRptState_FwdGr1" 2 "TeVBII_e_GearRptState_FwdGr2" 3 "TeVBII_e_GearRptState_FwdGr3" 4 "TeVBII_e_GearRptState_FwdGr4" 5 "TeVBII_e_GearRptState_FwdGr5" 6 "TeVBII_e_GearRptState_FwdGr6" 7 "TeVBII_e_GearRptState_FwdGr7" 8 "TeVBII_e_GearRptState_FwdGr8" 9 "TeVBII_e_GearRptState_FwdGr9" 13 "TeVBII_e_GearRptState_Park" 14 "TeVBII_e_GearRptState_RevGr" 15 "TeVBII_e_GearRptState_SNA" 2147483647 "TeVBII_e_GearRptState_Dummy" /end COMPU_VTAB
/begin COMPU_METHOD TRSC_SM_VC_Int_CM_TeVBII_e_SBR1RowDriverSeatSts "Enumerated data type: TeVBII_e_SBR1RowDriverSeatSts" TAB_VERB "%0.6" "" COMPU_TAB_REF VTAB_FOR_TRSC_SM_VC_Int_CM_TeVBII_e_SBR1RowDriverSeatSts /end COMPU_METHOD
/begin COMPU_VTAB VTAB_FOR_TRSC_SM_VC_Int_CM_TeVBII_e_SBR1RowDriverSeatSts "Enumerated data type: TeVBII_e_SBR1RowDriverSeatSts" TAB_VERB 4 0 "TeVBII_e_SBR1RowDriverSeatSts_SeatBeltFasten" 1 "TeVBII_e_SBR1RowDriverSeatSts_SeatBeltNotFasten" 3 "TeVBII_e_SBR1RowDriverSeatSts_SNA" 2147483647 "TeVBII_e_SBR1RowDriverSeatSts_Dummy" /end COMPU_VTAB
/begin COMPU_METHOD TRSC_SM_VC_Int_CM_TeVBII_e_VehAscmSts "Enumerated data type: TeVBII_e_VehAscmSts" TAB_VERB "%0.6" "" COMPU_TAB_REF VTAB_FOR_TRSC_SM_VC_Int_CM_TeVBII_e_VehAscmSts /end COMPU_METHOD
/begin COMPU_VTAB VTAB_FOR_TRSC_SM_VC_Int_CM_TeVBII_e_VehAscmSts "Enumerated data type: TeVBII_e_VehAscmSts" TAB_VERB 15 0 "TeVBII_e_VehAscmSts_NONE" 1 "TeVBII_e_VehAscmSts_DUMP" 2 "TeVBII_e_VehAscmSts_PARK" 3 "TeVBII_e_VehAscmSts_AERO" 4 "TeVBII_e_VehAscmSts_NVL" 5 "TeVBII_e_VehAscmSts_ORL" 6 "TeVBII_e_VehAscmSts_ORL2" 7 "TeVBII_e_VehAscmSts_Lifter" 8 "TeVBII_e_VehAscmSts_RAISE" 9 "TeVBII_e_VehAscmSts_LOWER" 10 "TeVBII_e_VehAscmSts_SYSFAIL" 11 "TeVBII_e_VehAscmSts_SRVS" 12 "TeVBII_e_VehAscmSts_AERO2" 15 "TeVBII_e_VehAscmSts_SNA" 2147483647 "TeVBII_e_VehAscmSts_Dummy" /end COMPU_VTAB
/begin COMPU_METHOD TRSC_SM_VC_Int_CM_TeVBII_e_GearEngagedForDsply "Enumerated data type: TeVBII_e_GearEngagedForDsply" TAB_VERB "%0.6" "" COMPU_TAB_REF VTAB_FOR_TRSC_SM_VC_Int_CM_TeVBII_e_GearEngagedForDsply /end COMPU_METHOD
/begin COMPU_VTAB VTAB_FOR_TRSC_SM_VC_Int_CM_TeVBII_e_GearEngagedForDsply "Enumerated data type: TeVBII_e_GearEngagedForDsply" TAB_VERB 21 0 "TeVBII_e_GearEngagedForDsply_Initialize" 1 "TeVBII_e_GearEngagedForDsply_Gear1" 2 "TeVBII_e_GearEngagedForDsply_Gear2" 3 "TeVBII_e_GearEngagedForDsply_Gear3" 4 "TeVBII_e_GearEngagedForDsply_Gear4" 5 "TeVBII_e_GearEngagedForDsply_Gear5" 6 "TeVBII_e_GearEngagedForDsply_Gear6" 7 "TeVBII_e_GearEngagedForDsply_Gear7" 8 "TeVBII_e_GearEngagedForDsply_Gear8" 9 "TeVBII_e_GearEngagedForDsply_Gear9" 10 "TeVBII_e_GearEngagedForDsply_NotUsed1" 11 "TeVBII_e_GearEngagedForDsply_NotUsed2" 12 "TeVBII_e_GearEngagedForDsply_P" 13 "TeVBII_e_GearEngagedForDsply_N" 14 "TeVBII_e_GearEngagedForDsply_R" 15 "TeVBII_e_GearEngagedForDsply_D" 16 "TeVBII_e_GearEngagedForDsply_L" 17 "TeVBII_e_GearEngagedForDsply_M" 18 "TeVBII_e_GearEngagedForDsply_S" 31 "TeVBII_e_GearEngagedForDsply_SNA" 2147483647 "TeVBII_e_GearEngagedForDsply_Dummy" /end COMPU_VTAB
/begin COMPU_METHOD TRSC_SM_VC_Int_CM_TeVBII_e_CenterBtnSts "Enumerated data type: TeVBII_e_CenterBtnSts" TAB_VERB "%0.6" "" COMPU_TAB_REF VTAB_FOR_TRSC_SM_VC_Int_CM_TeVBII_e_CenterBtnSts /end COMPU_METHOD
/begin COMPU_VTAB VTAB_FOR_TRSC_SM_VC_Int_CM_TeVBII_e_CenterBtnSts "Enumerated data type: TeVBII_e_CenterBtnSts" TAB_VERB 4 0 "TeVBII_e_CenterBtnSts_NotPressed" 1 "TeVBII_e_CenterBtnSts_Pressed" 2 "TeVBII_e_CenterBtnSts_SNA" 2147483647 "TeVBII_e_CenterBtnSts_Dummy" /end COMPU_VTAB
/begin COMPU_METHOD TRSC_SM_VC_Int_CM_TeVBII_e_EnblBtnSts "Enumerated data type: TeVBII_e_EnblBtnSts" TAB_VERB "%0.6" "" COMPU_TAB_REF VTAB_FOR_TRSC_SM_VC_Int_CM_TeVBII_e_EnblBtnSts /end COMPU_METHOD
/begin COMPU_VTAB VTAB_FOR_TRSC_SM_VC_Int_CM_TeVBII_e_EnblBtnSts "Enumerated data type: TeVBII_e_EnblBtnSts" TAB_VERB 4 0 "TeVBII_e_EnblBtnSts_NotPressed" 1 "TeVBII_e_EnblBtnSts_Pressed" 2 "TeVBII_e_EnblBtnSts_SNA" 2147483647 "TeVBII_e_EnblBtnSts_Dummy" /end COMPU_VTAB
/begin COMPU_METHOD TRSC_SM_VC_Int_CM_TeVBII_e_ShiftLvrPos "Enumerated data type: TeVBII_e_ShiftLvrPos" TAB_VERB "%0.6" "" COMPU_TAB_REF VTAB_FOR_TRSC_SM_VC_Int_CM_TeVBII_e_ShiftLvrPos /end COMPU_METHOD
/begin COMPU_VTAB VTAB_FOR_TRSC_SM_VC_Int_CM_TeVBII_e_ShiftLvrPos "Enumerated data type: TeVBII_e_ShiftLvrPos" TAB_VERB 12 0 "TeVBII_e_ShiftLvrPos_No_Selection_Active_Or_Available" 1 "TeVBII_e_ShiftLvrPos_P" 2 "TeVBII_e_ShiftLvrPos_R" 3 "TeVBII_e_ShiftLvrPos_N" 4 "TeVBII_e_ShiftLvrPos_D" 5 "TeVBII_e_ShiftLvrPos_L" 6 "TeVBII_e_ShiftLvrPos_TIP_Autostick" 7 "TeVBII_e_ShiftLvrPos_Plus" 8 "TeVBII_e_ShiftLvrPos_Minus" 9 "TeVBII_e_ShiftLvrPos_Sport" 15 "TeVBII_e_ShiftLvrPos_SNA" 2147483647 "TeVBII_e_ShiftLvrPos_Dummy" /end COMPU_VTAB
/begin COMPU_METHOD TRSC_SM_VC_Int_CM_TeVBII_e_TGWCamDispSts "Enumerated data type: TeVBII_e_TGWCamDispSts" TAB_VERB "%0.6" "" COMPU_TAB_REF VTAB_FOR_TRSC_SM_VC_Int_CM_TeVBII_e_TGWCamDispSts /end COMPU_METHOD
/begin COMPU_VTAB VTAB_FOR_TRSC_SM_VC_Int_CM_TeVBII_e_TGWCamDispSts "Enumerated data type: TeVBII_e_TGWCamDispSts" TAB_VERB 11 0 "TeVBII_e_TGWCamDispSts_DISP_NON_CAMERA" 1 "TeVBII_e_TGWCamDispSts_DISP_DIGITAL_RVC_CAMERA" 2 "TeVBII_e_TGWCamDispSts_DISP_ANALOG_RVC_CAMERA" 3 "TeVBII_e_TGWCamDispSts_DISP_ANALOG_CHMSL_CAMERA" 4 "TeVBII_e_TGWCamDispSts_DISP_SURROUND_VIEW_CAMERA" 5 "TeVBII_e_TGWCamDispSts_DISP_TRAILER_CAMERA" 6 "TeVBII_e_TGWCamDispSts_DISP_WIRLESS_CAMERA" 7 "TeVBII_e_TGWCamDispSts_DISP_SVS_MORECAMS_POPUP" 8 "TeVBII_e_TGWCamDispSts_DISP_INTERIOR_CAMERA" 15 "TeVBII_e_TGWCamDispSts_SNA" 2147483647 "TeVBII_e_TGWCamDispSts_Dummy" /end COMPU_VTAB
/begin COMPU_METHOD TRSC_SM_VC_Int_CM_TeVBII_e_CamDispSts "Enumerated data type: TeVBII_e_CamDispSts" TAB_VERB "%0.6" "" COMPU_TAB_REF VTAB_FOR_TRSC_SM_VC_Int_CM_TeVBII_e_CamDispSts /end COMPU_METHOD
/begin COMPU_VTAB VTAB_FOR_TRSC_SM_VC_Int_CM_TeVBII_e_CamDispSts "Enumerated data type: TeVBII_e_CamDispSts" TAB_VERB 17 0 "TeVBII_e_CamDispSts_Default" 1 "TeVBII_e_CamDispSts_View_1" 2 "TeVBII_e_CamDispSts_View_2" 3 "TeVBII_e_CamDispSts_View_3" 4 "TeVBII_e_CamDispSts_View_4" 5 "TeVBII_e_CamDispSts_View_5" 6 "TeVBII_e_CamDispSts_View_6" 7 "TeVBII_e_CamDispSts_View_7" 8 "TeVBII_e_CamDispSts_View_8" 9 "TeVBII_e_CamDispSts_View_9" 10 "TeVBII_e_CamDispSts_View_10" 11 "TeVBII_e_CamDispSts_View_11" 12 "TeVBII_e_CamDispSts_View_12" 13 "TeVBII_e_CamDispSts_View_13" 14 "TeVBII_e_CamDispSts_View_14" 15 "TeVBII_e_CamDispSts_View_15" 2147483647 "TeVBII_e_CamDispSts_Dummy" /end COMPU_VTAB
/begin COMPU_METHOD TRSC_SM_VC_Int_CM_TeVBII_e_CustTrlrType "Enumerated data type: TeVBII_e_CustTrlrType" TAB_VERB "%0.6" "" COMPU_TAB_REF VTAB_FOR_TRSC_SM_VC_Int_CM_TeVBII_e_CustTrlrType /end COMPU_METHOD
/begin COMPU_VTAB VTAB_FOR_TRSC_SM_VC_Int_CM_TeVBII_e_CustTrlrType "Enumerated data type: TeVBII_e_CustTrlrType" TAB_VERB 4 0 "TeVBII_e_CustTrlrType_No_Selection" 1 "TeVBII_e_CustTrlrType_Conventional" 2 "TeVBII_e_CustTrlrType_Incompatible" 2147483647 "TeVBII_e_CustTrlrType_Dummy" /end COMPU_VTAB
/begin COMPU_METHOD TRSC_SM_VC_Int_CM_uint16 "Q = V" RAT_FUNC "%5.0" "" COEFFS 0 1 0 0 0 1 /end COMPU_METHOD
/begin COMPU_METHOD TRSC_SM_VC_Int_CM_boolean "Q = V" RAT_FUNC "%1.0" "" COEFFS 0 1 0 0 0 1 /end COMPU_METHOD
/begin COMPU_METHOD TRSC_SM_VC_Int_CM_TeVBII_e_SPMLatCtrlRespSts "Enumerated data type: TeVBII_e_SPMLatCtrlRespSts" TAB_VERB "%0.6" "" COMPU_TAB_REF VTAB_FOR_TRSC_SM_VC_Int_CM_TeVBII_e_SPMLatCtrlRespSts /end COMPU_METHOD
/begin COMPU_VTAB VTAB_FOR_TRSC_SM_VC_Int_CM_TeVBII_e_SPMLatCtrlRespSts "Enumerated data type: TeVBII_e_SPMLatCtrlRespSts" TAB_VERB 9 0 "TeVBII_e_SPMLatCtrlRespSts_Idle" 1 "TeVBII_e_SPMLatCtrlRespSts_PermNotAvail" 2 "TeVBII_e_SPMLatCtrlRespSts_TempNotAvail" 3 "TeVBII_e_SPMLatCtrlRespSts_HasOpen" 4 "TeVBII_e_SPMLatCtrlRespSts_HasOpenBackup" 5 "TeVBII_e_SPMLatCtrlRespSts_Init" 6 "TeVBII_e_SPMLatCtrlRespSts_DampedExit" 7 "TeVBII_e_SPMLatCtrlRespSts_Faulted" 2147483647 "TeVBII_e_SPMLatCtrlRespSts_Dummy" /end COMPU_VTAB
/begin COMPU_METHOD TRSC_SM_VC_Int_CM_TeVBII_e_EscTrscBrkResp "Enumerated data type: TeVBII_e_EscTrscBrkResp" TAB_VERB "%0.6" "" COMPU_TAB_REF VTAB_FOR_TRSC_SM_VC_Int_CM_TeVBII_e_EscTrscBrkResp /end COMPU_METHOD
/begin COMPU_VTAB VTAB_FOR_TRSC_SM_VC_Int_CM_TeVBII_e_EscTrscBrkResp "Enumerated data type: TeVBII_e_EscTrscBrkResp" TAB_VERB 5 0 "TeVBII_e_EscTrscBrkResp_Off" 1 "TeVBII_e_EscTrscBrkResp_Actv" 2 "TeVBII_e_EscTrscBrkResp_BrkOverHeated" 3 "TeVBII_e_EscTrscBrkResp_SNA" 2147483647 "TeVBII_e_EscTrscBrkResp_Dummy" /end COMPU_VTAB
/begin COMPU_METHOD TRSC_SM_VC_Int_CM_TeVBII_e_WhlSpnSts "Enumerated data type: TeVBII_e_WhlSpnSts" TAB_VERB "%0.6" "" COMPU_TAB_REF VTAB_FOR_TRSC_SM_VC_Int_CM_TeVBII_e_WhlSpnSts /end COMPU_METHOD
/begin COMPU_VTAB VTAB_FOR_TRSC_SM_VC_Int_CM_TeVBII_e_WhlSpnSts "Enumerated data type: TeVBII_e_WhlSpnSts" TAB_VERB 5 0 "TeVBII_e_WhlSpnSts_StandStill" 1 "TeVBII_e_WhlSpnSts_Forward" 2 "TeVBII_e_WhlSpnSts_Backward" 3 "TeVBII_e_WhlSpnSts_SNA" 2147483647 "TeVBII_e_WhlSpnSts_Dummy" /end COMPU_VTAB
/begin COMPU_METHOD TRSC_SM_VC_Int_CM_TeVBII_e_StrWhlAngleType "Enumerated data type: TeVBII_e_StrWhlAngleType" TAB_VERB "%0.6" "" COMPU_TAB_REF VTAB_FOR_TRSC_SM_VC_Int_CM_TeVBII_e_StrWhlAngleType /end COMPU_METHOD
/begin COMPU_VTAB VTAB_FOR_TRSC_SM_VC_Int_CM_TeVBII_e_StrWhlAngleType "Enumerated data type: TeVBII_e_StrWhlAngleType" TAB_VERB 4 0 "TeVBII_e_StrWhlAngleType_Absolute" 1 "TeVBII_e_StrWhlAngleType_Relative" 3 "TeVBII_e_StrWhlAngleType_SNA" 2147483647 "TeVBII_e_StrWhlAngleType_Dummy" /end COMPU_VTAB
/begin COMPU_METHOD TRSC_SM_VC_Int_CM_TeVBII_e_EngineSts "Enumerated data type: TeVBII_e_EngineSts" TAB_VERB "%0.6" "" COMPU_TAB_REF VTAB_FOR_TRSC_SM_VC_Int_CM_TeVBII_e_EngineSts /end COMPU_METHOD
/begin COMPU_VTAB VTAB_FOR_TRSC_SM_VC_Int_CM_TeVBII_e_EngineSts "Enumerated data type: TeVBII_e_EngineSts" TAB_VERB 5 0 "TeVBII_e_EngineSts_Engine_Off" 1 "TeVBII_e_EngineSts_Engine_Cranking" 2 "TeVBII_e_EngineSts_Engine_On" 3 "TeVBII_e_EngineSts_SNA" 2147483647 "TeVBII_e_EngineSts_Dummy" /end COMPU_VTAB
/begin COMPU_METHOD TRSC_SM_VC_Int_CM_TeVBII_e_EcmTrscResp "Enumerated data type: TeVBII_e_EcmTrscResp" TAB_VERB "%0.6" "" COMPU_TAB_REF VTAB_FOR_TRSC_SM_VC_Int_CM_TeVBII_e_EcmTrscResp /end COMPU_METHOD
/begin COMPU_VTAB VTAB_FOR_TRSC_SM_VC_Int_CM_TeVBII_e_EcmTrscResp "Enumerated data type: TeVBII_e_EcmTrscResp" TAB_VERB 4 0 "TeVBII_e_EcmTrscResp_Off" 1 "TeVBII_e_EcmTrscResp_Actv" 3 "TeVBII_e_EcmTrscResp_SNA" 2147483647 "TeVBII_e_EcmTrscResp_Dummy" /end COMPU_VTAB
/begin COMPU_METHOD TRSC_SM_VC_Int_CM_TeVBII_e_VehStandStillSts "Enumerated data type: TeVBII_e_VehStandStillSts" TAB_VERB "%0.6" "" COMPU_TAB_REF VTAB_FOR_TRSC_SM_VC_Int_CM_TeVBII_e_VehStandStillSts /end COMPU_METHOD
/begin COMPU_VTAB VTAB_FOR_TRSC_SM_VC_Int_CM_TeVBII_e_VehStandStillSts "Enumerated data type: TeVBII_e_VehStandStillSts" TAB_VERB 4 0 "TeVBII_e_VehStandStillSts_True" 1 "TeVBII_e_VehStandStillSts_False" 3 "TeVBII_e_VehStandStillSts_SNA" 2147483647 "TeVBII_e_VehStandStillSts_Dummy" /end COMPU_VTAB
/begin COMPU_METHOD TRSC_SM_VC_Int_CM_TeVBII_e_StrTrqResp "Enumerated data type: TeVBII_e_StrTrqResp" TAB_VERB "%0.6" "" COMPU_TAB_REF VTAB_FOR_TRSC_SM_VC_Int_CM_TeVBII_e_StrTrqResp /end COMPU_METHOD
/begin COMPU_VTAB VTAB_FOR_TRSC_SM_VC_Int_CM_TeVBII_e_StrTrqResp "Enumerated data type: TeVBII_e_StrTrqResp" TAB_VERB 4 0 "TeVBII_e_StrTrqResp_Off" 1 "TeVBII_e_StrTrqResp_Active" 3 "TeVBII_e_StrTrqResp_SNA" 2147483647 "TeVBII_e_StrTrqResp_Dummy" /end COMPU_VTAB
/begin COMPU_METHOD TRSC_SM_VC_Int_CM_uint8 "Q = V" RAT_FUNC "%3.0" "" COEFFS 0 1 0 0 0 1 /end COMPU_METHOD
/begin COMPU_METHOD TRSC_SM_VC_Int_CM_uint32 "Q = V" RAT_FUNC "%10.0" "" COEFFS 0 1 0 0 0 1 /end COMPU_METHOD
/begin COMPU_METHOD TRSC_SM_VC_Int_CM_TeTRSC_e_TrlrCalInfo "Enumerated data type: TeTRSC_e_TrlrCalInfo" TAB_VERB "%0.6" "" COMPU_TAB_REF VTAB_FOR_TRSC_SM_VC_Int_CM_TeTRSC_e_TrlrCalInfo /end COMPU_METHOD
/begin COMPU_VTAB VTAB_FOR_TRSC_SM_VC_Int_CM_TeTRSC_e_TrlrCalInfo "Enumerated data type: TeTRSC_e_TrlrCalInfo" TAB_VERB 4 0 "TeTRSC_e_TrlrCalInfo_NotCalibrated" 1 "TeTRSC_e_TrlrCalInfo_Calibrated" 2 "TeTRSC_e_TrlrCalInfo_Undefined" 2147483647 "TeTRSC_e_TrlrCalInfo_Dummy" /end COMPU_VTAB
/begin COMPU_METHOD TRSC_SM_VC_Int_CM_TeTRSC_e_TrlrRecogInfo "Enumerated data type: TeTRSC_e_TrlrRecogInfo" TAB_VERB "%0.6" "" COMPU_TAB_REF VTAB_FOR_TRSC_SM_VC_Int_CM_TeTRSC_e_TrlrRecogInfo /end COMPU_METHOD
/begin COMPU_VTAB VTAB_FOR_TRSC_SM_VC_Int_CM_TeTRSC_e_TrlrRecogInfo "Enumerated data type: TeTRSC_e_TrlrRecogInfo" TAB_VERB 3 0 "TeTRSC_e_TrlrRecogInfo_Unknown" 1 "TeTRSC_e_TrlrRecogInfo_Known" 2147483647 "TeTRSC_e_TrlrRecogInfo_Dummy" /end COMPU_VTAB
/begin COMPU_METHOD TRSC_SM_VC_Int_CM_TeTRSC_e_TrlrPrsntInfo "Enumerated data type: TeTRSC_e_TrlrPrsntInfo" TAB_VERB "%0.6" "" COMPU_TAB_REF VTAB_FOR_TRSC_SM_VC_Int_CM_TeTRSC_e_TrlrPrsntInfo /end COMPU_METHOD
/begin COMPU_VTAB VTAB_FOR_TRSC_SM_VC_Int_CM_TeTRSC_e_TrlrPrsntInfo "Enumerated data type: TeTRSC_e_TrlrPrsntInfo" TAB_VERB 4 0 "TeTRSC_e_TrlrPrsntInfo_Unknown" 1 "TeTRSC_e_TrlrPrsntInfo_NoTrlr" 2 "TeTRSC_e_TrlrPrsntInfo_TrlrPrsnt" 2147483647 "TeTRSC_e_TrlrPrsntInfo_Dummy" /end COMPU_VTAB
/begin COMPU_METHOD TRSC_SM_VC_Int_CM_TeTRSC_e_TADState "Enumerated data type: TeTRSC_e_TADState" TAB_VERB "%0.6" "" COMPU_TAB_REF VTAB_FOR_TRSC_SM_VC_Int_CM_TeTRSC_e_TADState /end COMPU_METHOD
/begin COMPU_VTAB VTAB_FOR_TRSC_SM_VC_Int_CM_TeTRSC_e_TADState "Enumerated data type: TeTRSC_e_TADState" TAB_VERB 9 0 "TeTRSC_e_TADState_Idle" 1 "TeTRSC_e_TADState_TrailerDetection" 2 "TeTRSC_e_TADState_TrailerRecognition" 3 "TeTRSC_e_TADState_Calibration" 4 "TeTRSC_e_TADState_ScanningForTrailer" 5 "TeTRSC_e_TADState_Turnaround" 6 "TeTRSC_e_TADState_AngleDetection" 7 "TeTRSC_e_TADState_Trackinglost" 2147483647 "TeTRSC_e_TADState_Dummy" /end COMPU_VTAB
/begin COMPU_METHOD TRSC_SM_VC_Int_CM_TeTRSC_e_TADCalibrationSubstate "Enumerated data type: TeTRSC_e_TADCalibrationSubstate" TAB_VERB "%0.6" "" COMPU_TAB_REF VTAB_FOR_TRSC_SM_VC_Int_CM_TeTRSC_e_TADCalibrationSubstate /end COMPU_METHOD
/begin COMPU_VTAB VTAB_FOR_TRSC_SM_VC_Int_CM_TeTRSC_e_TADCalibrationSubstate "Enumerated data type: TeTRSC_e_TADCalibrationSubstate" TAB_VERB 4 0 "TeTRSC_e_TADCalibrationSubstate_DriveStraight" 1 "TeTRSC_e_TADCalibrationSubstate_TurnLeftOrRight" 2 "TeTRSC_e_TADCalibrationSubstate_Wait" 2147483647 "TeTRSC_e_TADCalibrationSubstate_Dummy" /end COMPU_VTAB
/begin COMPU_METHOD TRSC_SM_VC_Int_CM_TeTRSC_e_TurnAroundSubState "Enumerated data type: TeTRSC_e_TurnAroundSubState" TAB_VERB "%0.6" "" COMPU_TAB_REF VTAB_FOR_TRSC_SM_VC_Int_CM_TeTRSC_e_TurnAroundSubState /end COMPU_METHOD
/begin COMPU_VTAB VTAB_FOR_TRSC_SM_VC_Int_CM_TeTRSC_e_TurnAroundSubState "Enumerated data type: TeTRSC_e_TurnAroundSubState" TAB_VERB 4 0 "TeTRSC_e_TurnAroundSubState_DriveStraight" 1 "TeTRSC_e_TurnAroundSubState_TurnLeftOrRight" 2 "TeTRSC_e_TurnAroundSubState_Wait" 2147483647 "TeTRSC_e_TurnAroundSubState_Dummy" /end COMPU_VTAB
/begin COMPU_METHOD TRSC_SM_VC_Int_CM_TeTRSC_e_VehWhlBase "Enumerated data type: TeTRSC_e_VehWhlBase" TAB_VERB "%0.6" "" COMPU_TAB_REF VTAB_FOR_TRSC_SM_VC_Int_CM_TeTRSC_e_VehWhlBase /end COMPU_METHOD
/begin COMPU_VTAB VTAB_FOR_TRSC_SM_VC_Int_CM_TeTRSC_e_VehWhlBase "Enumerated data type: TeTRSC_e_VehWhlBase" TAB_VERB 4 0 "TeTRSC_e_VehWhlBase_Invalid" 1 "TeTRSC_e_VehWhlBase_Type1" 2 "TeTRSC_e_VehWhlBase_Type2" 2147483647 "TeTRSC_e_VehWhlBase_Dummy" /end COMPU_VTAB
/begin COMPU_METHOD TRSC_SM_VC_Int_CM_TeTRSC_e_RadDsplyTyp "Enumerated data type: TeTRSC_e_RadDsplyTyp" TAB_VERB "%0.6" "" COMPU_TAB_REF VTAB_FOR_TRSC_SM_VC_Int_CM_TeTRSC_e_RadDsplyTyp /end COMPU_METHOD
/begin COMPU_VTAB VTAB_FOR_TRSC_SM_VC_Int_CM_TeTRSC_e_RadDsplyTyp "Enumerated data type: TeTRSC_e_RadDsplyTyp" TAB_VERB 11 0 "TeTRSC_e_RadDsplyTyp_zero" 1 "TeTRSC_e_RadDsplyTyp_one" 2 "TeTRSC_e_RadDsplyTyp_two" 3 "TeTRSC_e_RadDsplyTyp_three" 4 "TeTRSC_e_RadDsplyTyp_four" 5 "TeTRSC_e_RadDsplyTyp_five" 6 "TeTRSC_e_RadDsplyTyp_six" 7 "TeTRSC_e_RadDsplyTyp_seven" 8 "TeTRSC_e_RadDsplyTyp_eight" 9 "TeTRSC_e_RadDsplyTyp_nine" 2147483647 "TeTRSC_e_RadDsplyTyp_Dummy" /end COMPU_VTAB
/begin COMPU_METHOD TRSC_SM_VC_Int_CM_TeTRSC_e_StrRackPinTyp "Enumerated data type: TeTRSC_e_StrRackPinTyp" TAB_VERB "%0.6" "" COMPU_TAB_REF VTAB_FOR_TRSC_SM_VC_Int_CM_TeTRSC_e_StrRackPinTyp /end COMPU_METHOD
/begin COMPU_VTAB VTAB_FOR_TRSC_SM_VC_Int_CM_TeTRSC_e_StrRackPinTyp "Enumerated data type: TeTRSC_e_StrRackPinTyp" TAB_VERB 4 0 "TeTRSC_e_StrRackPinTyp_Type1" 1 "TeTRSC_e_StrRackPinTyp_Type2" 2 "TeTRSC_e_StrRackPinTyp_Type3" 2147483647 "TeTRSC_e_StrRackPinTyp_Dummy" /end COMPU_VTAB
/begin COMPU_METHOD TRSC_SM_VC_Int_CM_TeTRSC_e_DispView2 "Enumerated data type: TeTRSC_e_DispView2" TAB_VERB "%0.6" "" COMPU_TAB_REF VTAB_FOR_TRSC_SM_VC_Int_CM_TeTRSC_e_DispView2 /end COMPU_METHOD
/begin COMPU_VTAB VTAB_FOR_TRSC_SM_VC_Int_CM_TeTRSC_e_DispView2 "Enumerated data type: TeTRSC_e_DispView2" TAB_VERB 17 0 "TeTRSC_e_DispView2_Off" 1 "TeTRSC_e_DispView2_View1" 2 "TeTRSC_e_DispView2_View2" 3 "TeTRSC_e_DispView2_View3" 4 "TeTRSC_e_DispView2_View4" 5 "TeTRSC_e_DispView2_View5" 6 "TeTRSC_e_DispView2_View6" 7 "TeTRSC_e_DispView2_View7" 8 "TeTRSC_e_DispView2_View8" 9 "TeTRSC_e_DispView2_View9" 10 "TeTRSC_e_DispView2_View10" 11 "TeTRSC_e_DispView2_View11" 12 "TeTRSC_e_DispView2_View12" 13 "TeTRSC_e_DispView2_View13" 14 "TeTRSC_e_DispView2_View14" 15 "TeTRSC_e_DispView2_View15" 2147483647 "TeTRSC_e_DispView2_Dummy" /end COMPU_VTAB
/begin COMPU_METHOD TRSC_SM_VC_Int_CM_single_deg "Q = V" RAT_FUNC "%8.6" "deg" COEFFS 0 1 0 0 0 1 /end COMPU_METHOD
/begin COMPU_METHOD TRSC_SM_VC_Int_CM_single_nm "Q = V" RAT_FUNC "%8.6" "nm" COEFFS 0 1 0 0 0 1 /end COMPU_METHOD
/begin COMPU_METHOD TRSC_SM_VC_Int_CM_single_percent "Q = V" RAT_FUNC "%8.6" "percent" COEFFS 0 1 0 0 0 1 /end COMPU_METHOD
/begin COMPU_METHOD TRSC_SM_VC_Int_CM_single_km_h "Q = V" RAT_FUNC "%8.6" "km/h" COEFFS 0 1 0 0 0 1 /end COMPU_METHOD
/begin COMPU_METHOD TRSC_SM_VC_Int_CM_TeTRSC_e_VehStpReq_DID "Enumerated data type: TeTRSC_e_VehStpReq_DID" TAB_VERB "%0.6" "" COMPU_TAB_REF VTAB_FOR_TRSC_SM_VC_Int_CM_TeTRSC_e_VehStpReq_DID /end COMPU_METHOD
/begin COMPU_VTAB VTAB_FOR_TRSC_SM_VC_Int_CM_TeTRSC_e_VehStpReq_DID "Enumerated data type: TeTRSC_e_VehStpReq_DID" TAB_VERB 4 0 "TeTRSC_e_VehStpReq_DID_Active" 1 "TeTRSC_e_VehStpReq_DID_NotActive" 3 "TeTRSC_e_VehStpReq_DID_SNA" 2147483647 "TeTRSC_e_VehStpReq_DID_Dummy" /end COMPU_VTAB
/begin COMPU_METHOD TRSC_SM_VC_Int_CM_TeTRSC_e_VehStpReq "Enumerated data type: TeTRSC_e_VehStpReq" TAB_VERB "%0.6" "" COMPU_TAB_REF VTAB_FOR_TRSC_SM_VC_Int_CM_TeTRSC_e_VehStpReq /end COMPU_METHOD
/begin COMPU_VTAB VTAB_FOR_TRSC_SM_VC_Int_CM_TeTRSC_e_VehStpReq "Enumerated data type: TeTRSC_e_VehStpReq" TAB_VERB 4 0 "TeTRSC_e_VehStpReq_False" 1 "TeTRSC_e_VehStpReq_True" 3 "TeTRSC_e_VehStpReq_SNA" 2147483647 "TeTRSC_e_VehStpReq_Dummy" /end COMPU_VTAB
/begin COMPU_METHOD TRSC_SM_VC_Int_CM_TeTRSC_e_TrlrHitchLightCtrl "Enumerated data type: TeTRSC_e_TrlrHitchLightCtrl" TAB_VERB "%0.6" "" COMPU_TAB_REF VTAB_FOR_TRSC_SM_VC_Int_CM_TeTRSC_e_TrlrHitchLightCtrl /end COMPU_METHOD
/begin COMPU_VTAB VTAB_FOR_TRSC_SM_VC_Int_CM_TeTRSC_e_TrlrHitchLightCtrl "Enumerated data type: TeTRSC_e_TrlrHitchLightCtrl" TAB_VERB 4 0 "TeTRSC_e_TrlrHitchLightCtrl_ON" 1 "TeTRSC_e_TrlrHitchLightCtrl_OFF" 3 "TeTRSC_e_TrlrHitchLightCtrl_SNA" 2147483647 "TeTRSC_e_TrlrHitchLightCtrl_Dummy" /end COMPU_VTAB
/begin COMPU_METHOD TRSC_SM_VC_Int_CM_TeTRSC_e_TRSKMSts_DID "Enumerated data type: TeTRSC_e_TRSKMSts_DID" TAB_VERB "%0.6" "" COMPU_TAB_REF VTAB_FOR_TRSC_SM_VC_Int_CM_TeTRSC_e_TRSKMSts_DID /end COMPU_METHOD
/begin COMPU_VTAB VTAB_FOR_TRSC_SM_VC_Int_CM_TeTRSC_e_TRSKMSts_DID "Enumerated data type: TeTRSC_e_TRSKMSts_DID" TAB_VERB 4 0 "TeTRSC_e_TRSKMSts_DID_Enabled" 1 "TeTRSC_e_TRSKMSts_DID_NotEnabled" 2 "TeTRSC_e_TRSKMSts_DID_SNA" 2147483647 "TeTRSC_e_TRSKMSts_DID_Dummy" /end COMPU_VTAB
/begin COMPU_METHOD TRSC_SM_VC_Int_CM_TeTRSC_e_TRSKMSts "Enumerated data type: TeTRSC_e_TRSKMSts" TAB_VERB "%0.6" "" COMPU_TAB_REF VTAB_FOR_TRSC_SM_VC_Int_CM_TeTRSC_e_TRSKMSts /end COMPU_METHOD
/begin COMPU_VTAB VTAB_FOR_TRSC_SM_VC_Int_CM_TeTRSC_e_TRSKMSts "Enumerated data type: TeTRSC_e_TRSKMSts" TAB_VERB 4 0 "TeTRSC_e_TRSKMSts_NotEnabled" 1 "TeTRSC_e_TRSKMSts_Enabled" 2 "TeTRSC_e_TRSKMSts_SNA" 2147483647 "TeTRSC_e_TRSKMSts_Dummy" /end COMPU_VTAB
/begin COMPU_METHOD TRSC_SM_VC_Int_CM_TeTRSC_e_TRSKMCenBtnSts_DID "Enumerated data type: TeTRSC_e_TRSKMCenBtnSts_DID" TAB_VERB "%0.6" "" COMPU_TAB_REF VTAB_FOR_TRSC_SM_VC_Int_CM_TeTRSC_e_TRSKMCenBtnSts_DID /end COMPU_METHOD
/begin COMPU_VTAB VTAB_FOR_TRSC_SM_VC_Int_CM_TeTRSC_e_TRSKMCenBtnSts_DID "Enumerated data type: TeTRSC_e_TRSKMCenBtnSts_DID" TAB_VERB 5 0 "TeTRSC_e_TRSKMCenBtnSts_DID_NotPressed" 1 "TeTRSC_e_TRSKMCenBtnSts_DID_Pressed" 2 "TeTRSC_e_TRSKMCenBtnSts_DID_Struck" 3 "TeTRSC_e_TRSKMCenBtnSts_DID_SNA" 2147483647 "TeTRSC_e_TRSKMCenBtnSts_DID_Dummy" /end COMPU_VTAB
/begin COMPU_METHOD TRSC_SM_VC_Int_CM_TeTRSC_e_TRSKMBtnSts_DID "Enumerated data type: TeTRSC_e_TRSKMBtnSts_DID" TAB_VERB "%0.6" "" COMPU_TAB_REF VTAB_FOR_TRSC_SM_VC_Int_CM_TeTRSC_e_TRSKMBtnSts_DID /end COMPU_METHOD
/begin COMPU_VTAB VTAB_FOR_TRSC_SM_VC_Int_CM_TeTRSC_e_TRSKMBtnSts_DID "Enumerated data type: TeTRSC_e_TRSKMBtnSts_DID" TAB_VERB 5 0 "TeTRSC_e_TRSKMBtnSts_DID_NotPressed" 1 "TeTRSC_e_TRSKMBtnSts_DID_Pressed" 2 "TeTRSC_e_TRSKMBtnSts_DID_Struck" 3 "TeTRSC_e_TRSKMBtnSts_DID_SNA" 2147483647 "TeTRSC_e_TRSKMBtnSts_DID_Dummy" /end COMPU_VTAB
/begin COMPU_METHOD TRSC_SM_VC_Int_CM_TeTRSC_e_TRSCUnavailReas_DID "Enumerated data type: TeTRSC_e_TRSCUnavailReas_DID" TAB_VERB "%0.6" "" COMPU_TAB_REF VTAB_FOR_TRSC_SM_VC_Int_CM_TeTRSC_e_TRSCUnavailReas_DID /end COMPU_METHOD
/begin COMPU_VTAB VTAB_FOR_TRSC_SM_VC_Int_CM_TeTRSC_e_TRSCUnavailReas_DID "Enumerated data type: TeTRSC_e_TRSCUnavailReas_DID" TAB_VERB 22 0 "TeTRSC_e_TRSCUnavailReas_DID_No_Or_InvalidResp_Engine_Controller" 1 "TeTRSC_e_TRSCUnavailReas_DID_No_Or_InvalidResp_Brake_Systems" 2 "TeTRSC_e_TRSCUnavailReas_DID_No_Or_InvalidResp_Electric_Power_Steering" 3 "TeTRSC_e_TRSCUnavailReas_DID_No_Or_InvalidResp_Transmission_Controller" 4 "TeTRSC_e_TRSCUnavailReas_DID_No_Or_InvalidResp_ORC_Module" 5 "TeTRSC_e_TRSCUnavailReas_DID_No_Or_InvalidResp_Radio" 6 "TeTRSC_e_TRSCUnavailReas_DID_Ignition_Not_Run" 7 "TeTRSC_e_TRSCUnavailReas_DID_Rear_Tailgate_Open" 8 "TeTRSC_e_TRSCUnavailReas_DID_Engine_Off" 9 "TeTRSC_e_TRSCUnavailReas_DID_Driver_Door_Open" 10 "TeTRSC_e_TRSCUnavailReas_DID_Vehicle_NotIn_Park" 11 "TeTRSC_e_TRSCUnavailReas_DID_CameraCalibration_Unknown" 12 "TeTRSC_e_TRSCUnavailReas_DID_Trailer_Not_Detected" 13 "TeTRSC_e_TRSCUnavailReas_DID_Trailer_Angle_Too_Steep" 14 "TeTRSC_e_TRSCUnavailReas_DID_Trailer_Calibration_Failure" 15 "TeTRSC_e_TRSCUnavailReas_DID_TRSKMKnob_Module_No_Response" 16 "TeTRSC_e_TRSCUnavailReas_DID_Voltage_Low_Or_High_Than_OperatingRange" 17 "TeTRSC_e_TRSCUnavailReas_DID_ECU_Plant_Mode" 18 "TeTRSC_e_TRSCUnavailReas_DID_Invalid_Proxi" 19 "TeTRSC_e_TRSCUnavailReas_DID_Fail_Not_Present" 20 "TeTRSC_e_TRSCUnavailReas_DID_SNA" 2147483647 "TeTRSC_e_TRSCUnavailReas_DID_Dummy" /end COMPU_VTAB
/begin COMPU_METHOD TRSC_SM_VC_Int_CM_TeTRSC_e_TRSCSts "Enumerated data type: TeTRSC_e_TRSCSts" TAB_VERB "%0.6" "" COMPU_TAB_REF VTAB_FOR_TRSC_SM_VC_Int_CM_TeTRSC_e_TRSCSts /end COMPU_METHOD
/begin COMPU_VTAB VTAB_FOR_TRSC_SM_VC_Int_CM_TeTRSC_e_TRSCSts "Enumerated data type: TeTRSC_e_TRSCSts" TAB_VERB 7 0 "TeTRSC_e_TRSCSts_Standby" 1 "TeTRSC_e_TRSCSts_Calibrating" 2 "TeTRSC_e_TRSCSts_PreActive" 3 "TeTRSC_e_TRSCSts_Active" 4 "TeTRSC_e_TRSCSts_Off" 7 "TeTRSC_e_TRSCSts_SNA" 2147483647 "TeTRSC_e_TRSCSts_Dummy" /end COMPU_VTAB
/begin COMPU_METHOD TRSC_SM_VC_Int_CM_TeTRSC_e_TRSCStrTrqActvReq "Enumerated data type: TeTRSC_e_TRSCStrTrqActvReq" TAB_VERB "%0.6" "" COMPU_TAB_REF VTAB_FOR_TRSC_SM_VC_Int_CM_TeTRSC_e_TRSCStrTrqActvReq /end COMPU_METHOD
/begin COMPU_VTAB VTAB_FOR_TRSC_SM_VC_Int_CM_TeTRSC_e_TRSCStrTrqActvReq "Enumerated data type: TeTRSC_e_TRSCStrTrqActvReq" TAB_VERB 4 0 "TeTRSC_e_TRSCStrTrqActvReq_False" 1 "TeTRSC_e_TRSCStrTrqActvReq_True" 3 "TeTRSC_e_TRSCStrTrqActvReq_SNA" 2147483647 "TeTRSC_e_TRSCStrTrqActvReq_Dummy" /end COMPU_VTAB
/begin COMPU_METHOD TRSC_SM_VC_Int_CM_TeTRSC_e_TRSCStat "Enumerated data type: TeTRSC_e_TRSCStat" TAB_VERB "%0.6" "" COMPU_TAB_REF VTAB_FOR_TRSC_SM_VC_Int_CM_TeTRSC_e_TRSCStat /end COMPU_METHOD
/begin COMPU_VTAB VTAB_FOR_TRSC_SM_VC_Int_CM_TeTRSC_e_TRSCStat "Enumerated data type: TeTRSC_e_TRSCStat" TAB_VERB 9 0 "TeTRSC_e_TRSCStat_Off" 1 "TeTRSC_e_TRSCStat_Standby" 2 "TeTRSC_e_TRSCStat_Calibrating" 3 "TeTRSC_e_TRSCStat_PreActive" 4 "TeTRSC_e_TRSCStat_Active" 5 "TeTRSC_e_TRSCStat_ActiveHoldOvr" 6 "TeTRSC_e_TRSCStat_Fault" 7 "TeTRSC_e_TRSCStat_SNA" 2147483647 "TeTRSC_e_TRSCStat_Dummy" /end COMPU_VTAB
/begin COMPU_METHOD TRSC_SM_VC_Int_CM_TeTRSC_e_TRSCPopupDispInfo "Enumerated data type: TeTRSC_e_TRSCPopupDispInfo" TAB_VERB "%0.6" "" COMPU_TAB_REF VTAB_FOR_TRSC_SM_VC_Int_CM_TeTRSC_e_TRSCPopupDispInfo /end COMPU_METHOD
/begin COMPU_VTAB VTAB_FOR_TRSC_SM_VC_Int_CM_TeTRSC_e_TRSCPopupDispInfo "Enumerated data type: TeTRSC_e_TRSCPopupDispInfo" TAB_VERB 28 0 "TeTRSC_e_TRSCPopupDispInfo_Disp0" 1 "TeTRSC_e_TRSCPopupDispInfo_Disp1" 2 "TeTRSC_e_TRSCPopupDispInfo_Disp2" 3 "TeTRSC_e_TRSCPopupDispInfo_Disp3" 4 "TeTRSC_e_TRSCPopupDispInfo_Disp4" 5 "TeTRSC_e_TRSCPopupDispInfo_Disp5" 6 "TeTRSC_e_TRSCPopupDispInfo_Disp6" 7 "TeTRSC_e_TRSCPopupDispInfo_Disp7" 8 "TeTRSC_e_TRSCPopupDispInfo_Disp8" 9 "TeTRSC_e_TRSCPopupDispInfo_Disp9" 10 "TeTRSC_e_TRSCPopupDispInfo_Disp10" 11 "TeTRSC_e_TRSCPopupDispInfo_Disp11" 12 "TeTRSC_e_TRSCPopupDispInfo_Disp12" 13 "TeTRSC_e_TRSCPopupDispInfo_Disp13" 14 "TeTRSC_e_TRSCPopupDispInfo_Disp14" 15 "TeTRSC_e_TRSCPopupDispInfo_Disp15" 16 "TeTRSC_e_TRSCPopupDispInfo_Disp16" 17 "TeTRSC_e_TRSCPopupDispInfo_Disp17" 18 "TeTRSC_e_TRSCPopupDispInfo_Disp18" 19 "TeTRSC_e_TRSCPopupDispInfo_Disp19" 20 "TeTRSC_e_TRSCPopupDispInfo_Disp20" 21 "TeTRSC_e_TRSCPopupDispInfo_Disp21" 22 "TeTRSC_e_TRSCPopupDispInfo_Disp22" 23 "TeTRSC_e_TRSCPopupDispInfo_Disp23" 24 "TeTRSC_e_TRSCPopupDispInfo_Disp24" 25 "TeTRSC_e_TRSCPopupDispInfo_Disp25" 63 "TeTRSC_e_TRSCPopupDispInfo_SNA" 2147483647 "TeTRSC_e_TRSCPopupDispInfo_Dummy" /end COMPU_VTAB
/begin COMPU_METHOD TRSC_SM_VC_Int_CM_TeTRSC_e_TRSCLedSts "Enumerated data type: TeTRSC_e_TRSCLedSts" TAB_VERB "%0.6" "" COMPU_TAB_REF VTAB_FOR_TRSC_SM_VC_Int_CM_TeTRSC_e_TRSCLedSts /end COMPU_METHOD
/begin COMPU_VTAB VTAB_FOR_TRSC_SM_VC_Int_CM_TeTRSC_e_TRSCLedSts "Enumerated data type: TeTRSC_e_TRSCLedSts" TAB_VERB 5 0 "TeTRSC_e_TRSCLedSts_Off" 1 "TeTRSC_e_TRSCLedSts_Solid" 2 "TeTRSC_e_TRSCLedSts_Blink" 3 "TeTRSC_e_TRSCLedSts_SNA" 2147483647 "TeTRSC_e_TRSCLedSts_Dummy" /end COMPU_VTAB
/begin COMPU_METHOD TRSC_SM_VC_Int_CM_TeTRSC_e_TRSCAbortReason_DID "Enumerated data type: TeTRSC_e_TRSCAbortReason_DID" TAB_VERB "%0.6" "" COMPU_TAB_REF VTAB_FOR_TRSC_SM_VC_Int_CM_TeTRSC_e_TRSCAbortReason_DID /end COMPU_METHOD
/begin COMPU_VTAB VTAB_FOR_TRSC_SM_VC_Int_CM_TeTRSC_e_TRSCAbortReason_DID "Enumerated data type: TeTRSC_e_TRSCAbortReason_DID" TAB_VERB 22 0 "TeTRSC_e_TRSCAbortReason_DID_No_Or_InvalidResp_Engine_Controller" 1 "TeTRSC_e_TRSCAbortReason_DID_No_Or_InvalidResp_Brake_Systems" 2 "TeTRSC_e_TRSCAbortReason_DID_No_Or_InvalidResp_Electric_Power_Steering" 3 "TeTRSC_e_TRSCAbortReason_DID_No_Or_Transmission_Controller" 4 "TeTRSC_e_TRSCAbortReason_DID_No_Or_InvalidResp_ORC_Module" 5 "TeTRSC_e_TRSCAbortReason_DID_No_Or_InvalidResp_Radio" 6 "TeTRSC_e_TRSCAbortReason_DID_Speed_Above_25mph" 7 "TeTRSC_e_TRSCAbortReason_DID_Trailer_Lost_From_FoV" 8 "TeTRSC_e_TRSCAbortReason_DID_Ignition_Not_Run" 9 "TeTRSC_e_TRSCAbortReason_DID_Rear_Tailgate_Open" 10 "TeTRSC_e_TRSCAbortReason_DID_Engine_Off" 11 "TeTRSC_e_TRSCAbortReason_DID_Driver_Steering_Override" 12 "TeTRSC_e_TRSCAbortReason_DID_No_User_Feedback" 13 "TeTRSC_e_TRSCAbortReason_DID_TRSC_Btn_Pressed" 14 "TeTRSC_e_TRSCAbortReason_DID_Vehicle_Speed_exceeded" 15 "TeTRSC_e_TRSCAbortReason_DID_Driver_Door_Open" 16 "TeTRSC_e_TRSCAbortReason_DID_TRSKMKnob_Module_No_Response" 17 "TeTRSC_e_TRSCAbortReason_DID_Voltage_Low_Or_High_Than_OperatingRange" 18 "TeTRSC_e_TRSCAbortReason_DID_Trailer_Angle_Too_Steep" 19 "TeTRSC_e_TRSCAbortReason_DID_Fail_Not_Present" 20 "TeTRSC_e_TRSCAbortReason_DID_SNA" 2147483647 "TeTRSC_e_TRSCAbortReason_DID_Dummy" /end COMPU_VTAB
/begin COMPU_METHOD TRSC_SM_VC_Int_CM_TeTRSC_e_TADAngActSign "Enumerated data type: TeTRSC_e_TADAngActSign" TAB_VERB "%0.6" "" COMPU_TAB_REF VTAB_FOR_TRSC_SM_VC_Int_CM_TeTRSC_e_TADAngActSign /end COMPU_METHOD
/begin COMPU_VTAB VTAB_FOR_TRSC_SM_VC_Int_CM_TeTRSC_e_TADAngActSign "Enumerated data type: TeTRSC_e_TADAngActSign" TAB_VERB 5 0 "TeTRSC_e_TADAngActSign_None" 1 "TeTRSC_e_TADAngActSign_Positive" 2 "TeTRSC_e_TADAngActSign_Negative" 3 "TeTRSC_e_TADAngActSign_SNA" 2147483647 "TeTRSC_e_TADAngActSign_Dummy" /end COMPU_VTAB
/begin COMPU_METHOD TRSC_SM_VC_Int_CM_TeTRSC_e_SpdLmtReq "Enumerated data type: TeTRSC_e_SpdLmtReq" TAB_VERB "%0.6" "" COMPU_TAB_REF VTAB_FOR_TRSC_SM_VC_Int_CM_TeTRSC_e_SpdLmtReq /end COMPU_METHOD
/begin COMPU_VTAB VTAB_FOR_TRSC_SM_VC_Int_CM_TeTRSC_e_SpdLmtReq "Enumerated data type: TeTRSC_e_SpdLmtReq" TAB_VERB 10 0 "TeTRSC_e_SpdLmtReq_NotLim" 1 "TeTRSC_e_SpdLmtReq_Spd4" 2 "TeTRSC_e_SpdLmtReq_Spd5" 3 "TeTRSC_e_SpdLmtReq_Spd6" 4 "TeTRSC_e_SpdLmtReq_Spd7" 5 "TeTRSC_e_SpdLmtReq_Spd8" 6 "TeTRSC_e_SpdLmtReq_Spd9" 7 "TeTRSC_e_SpdLmtReq_Spd10" 15 "TeTRSC_e_SpdLmtReq_SNA" 2147483647 "TeTRSC_e_SpdLmtReq_Dummy" /end COMPU_VTAB
/begin COMPU_METHOD TRSC_SM_VC_Int_CM_TeTRSC_e_GraphicOverlay_Sts "Enumerated data type: TeTRSC_e_GraphicOverlay_Sts" TAB_VERB "%0.6" "" COMPU_TAB_REF VTAB_FOR_TRSC_SM_VC_Int_CM_TeTRSC_e_GraphicOverlay_Sts /end COMPU_METHOD
/begin COMPU_VTAB VTAB_FOR_TRSC_SM_VC_Int_CM_TeTRSC_e_GraphicOverlay_Sts "Enumerated data type: TeTRSC_e_GraphicOverlay_Sts" TAB_VERB 4 0 "TeTRSC_e_GraphicOverlay_Sts_Inactive" 1 "TeTRSC_e_GraphicOverlay_Sts_Active" 3 "TeTRSC_e_GraphicOverlay_Sts_SNA" 2147483647 "TeTRSC_e_GraphicOverlay_Sts_Dummy" /end COMPU_VTAB
/begin COMPU_METHOD TRSC_SM_VC_Int_CM_TeTRSC_e_GearShiftSts_DID "Enumerated data type: TeTRSC_e_GearShiftSts_DID" TAB_VERB "%0.6" "" COMPU_TAB_REF VTAB_FOR_TRSC_SM_VC_Int_CM_TeTRSC_e_GearShiftSts_DID /end COMPU_METHOD
/begin COMPU_VTAB VTAB_FOR_TRSC_SM_VC_Int_CM_TeTRSC_e_GearShiftSts_DID "Enumerated data type: TeTRSC_e_GearShiftSts_DID" TAB_VERB 9 0 "TeTRSC_e_GearShiftSts_DID_P" 1 "TeTRSC_e_GearShiftSts_DID_R" 2 "TeTRSC_e_GearShiftSts_DID_N" 3 "TeTRSC_e_GearShiftSts_DID_D" 4 "TeTRSC_e_GearShiftSts_DID_L" 5 "TeTRSC_e_GearShiftSts_DID_M" 6 "TeTRSC_e_GearShiftSts_DID_S" 7 "TeTRSC_e_GearShiftSts_DID_SNA" 2147483647 "TeTRSC_e_GearShiftSts_DID_Dummy" /end COMPU_VTAB
/begin COMPU_METHOD TRSC_SM_VC_Int_CM_TeTRSC_e_DispView2_DID "Enumerated data type: TeTRSC_e_DispView2_DID" TAB_VERB "%0.6" "" COMPU_TAB_REF VTAB_FOR_TRSC_SM_VC_Int_CM_TeTRSC_e_DispView2_DID /end COMPU_METHOD
/begin COMPU_VTAB VTAB_FOR_TRSC_SM_VC_Int_CM_TeTRSC_e_DispView2_DID "Enumerated data type: TeTRSC_e_DispView2_DID" TAB_VERB 17 0 "TeTRSC_e_DispView2_DID_Off" 1 "TeTRSC_e_DispView2_DID_View1" 2 "TeTRSC_e_DispView2_DID_View2" 3 "TeTRSC_e_DispView2_DID_View3" 4 "TeTRSC_e_DispView2_DID_View4" 5 "TeTRSC_e_DispView2_DID_View5" 6 "TeTRSC_e_DispView2_DID_View6" 7 "TeTRSC_e_DispView2_DID_View7" 8 "TeTRSC_e_DispView2_DID_View8" 9 "TeTRSC_e_DispView2_DID_View9" 10 "TeTRSC_e_DispView2_DID_View10" 11 "TeTRSC_e_DispView2_DID_View11" 12 "TeTRSC_e_DispView2_DID_View12" 13 "TeTRSC_e_DispView2_DID_View13" 14 "TeTRSC_e_DispView2_DID_View14" 15 "TeTRSC_e_DispView2_DID_View15" 2147483647 "TeTRSC_e_DispView2_DID_Dummy" /end COMPU_VTAB
/begin COMPU_METHOD TRSC_SM_VC_Int_CM_uint16_count "Q = V" RAT_FUNC "%5.0" "count" COEFFS 0 1 0 0 0 1 /end COMPU_METHOD
/begin GROUP TRSC_SM_VC_Int "TRSC_SM_VC_Int" /* Root */ ROOT
 /begin SUB_GROUP IbTRSC_InpBus mr_grp2link_TRSC_InputAdapter mr_grp2link_TRSC_OutputAdapter mr_grp2link_TRSC_SM_VC /end SUB_GROUP
 /begin REF_MEASUREMENT IeTRSC_M_TRSCStrTrq IeTRSC_b_MoreCamReqSts IeTRSC_cnt_KnobPos IeTRSC_deg_FrntWhlAng IeTRSC_deg_JackknifeThrAngle IeTRSC_deg_TADAngAct IeTRSC_deg_TrlrAngKnob IeTRSC_e_GearShiftSts IeTRSC_e_GearShiftSts_DID IeTRSC_e_GraphicOverlay_Sts IeTRSC_e_SpdLmtReq IeTRSC_e_TADAngActSign IeTRSC_e_TRSCAbortReas IeTRSC_e_TRSCAbortReas_DID IeTRSC_e_TRSCLedSts IeTRSC_e_TRSCPopupDispInfo IeTRSC_e_TRSCStrTrqActvReq IeTRSC_e_TRSCSts IeTRSC_e_TRSCUnavailReas IeTRSC_e_TRSCUnavailReas_DID IeTRSC_e_TRSKMBtnSts IeTRSC_e_TRSKMBtnSts_DID IeTRSC_e_TRSKMCenBtnSts IeTRSC_e_TRSKMCenBtnSts_DID IeTRSC_e_TRSKMSts IeTRSC_e_TRSKMSts_DID IeTRSC_e_TrlrCalInfo IeTRSC_e_TrlrHitchLightCtrl IeTRSC_e_VehStpReq IeTRSC_e_VehStpReq_DID IeTRSC_kph_SpdLmtReq_DID IeTRSC_kph_VehSpeedVSOSig IeTRSC_m_TrlrWhlBaseEff IeTRSC_pct_TRSCStrDmp MeSVS_e_DispView2Info_DID MeTRSC_b_MoreCamSoftButtEnbl MeTRSC_b_OTBLReset MeTRSC_b_TBLComputationDone MeTRSC_b_TRSCSwitchPressed MeTRSC_b_TrlrCalibPopInfo MeTRSC_b_TrlrRevSteeringStsInfo MeTRSC_deg_JackKnifeAngle MeTRSC_deg_JackknifeThrAngle MeTRSC_deg_KnobAngle MeTRSC_deg_MaxAllowedTADAngle MeTRSC_deg_StrCMD MeTRSC_deg_TADAngleSMVC MeTRSC_e_TRSCStat MeTRSC_e_TrlrCalInfoSMVC MeTRSC_e_TrlrPrsntInfoCAN MeTRSC_m_TrailerBeamLen /end REF_MEASUREMENT
/end GROUP
/begin GROUP IbTRSC_InpBus ""
 /begin SUB_GROUP IbTRSC_InpBus.IbDDC_DegMgrToTRSC IbTRSC_InpBus.IbTRSCSmVc_TunParam IbTRSC_InpBus.IbTRSC_MEProxiToIpc IbTRSC_InpBus.IbTRSC_SVStoTRSC IbTRSC_InpBus.IbTRSC_TrailerDetInp IbTRSC_InpBus.IbTRSC_VehInpFromCAN14 IbTRSC_InpBus.IbTRSC_VehInpFromCAN2 /end SUB_GROUP
 /begin REF_MEASUREMENT IbTRSC_InpBus.MeTRSC_b_InternalFault IbTRSC_InpBus.MeTRSC_e_CamBlockSts /end REF_MEASUREMENT
/end GROUP
/begin GROUP IbTRSC_InpBus.IbTRSC_VehInpFromCAN2 ""
 /begin REF_MEASUREMENT IbTRSC_InpBus.IbTRSC_VehInpFromCAN2.IeVBII_b_DriverDoorSts IbTRSC_InpBus.IbTRSC_VehInpFromCAN2.IeVBII_b_TrnkStatus IbTRSC_InpBus.IbTRSC_VehInpFromCAN2.IeVBII_b_VehAscmSysFail IbTRSC_InpBus.IbTRSC_VehInpFromCAN2.IeVBII_e_CamDispSts IbTRSC_InpBus.IbTRSC_VehInpFromCAN2.IeVBII_e_CenterBtnSts IbTRSC_InpBus.IbTRSC_VehInpFromCAN2.IeVBII_e_CmdIgnSts IbTRSC_InpBus.IbTRSC_VehInpFromCAN2.IeVBII_e_CustTrlrType IbTRSC_InpBus.IbTRSC_VehInpFromCAN2.IeVBII_e_EnblBtnSts IbTRSC_InpBus.IbTRSC_VehInpFromCAN2.IeVBII_e_GearEngagedForDsply IbTRSC_InpBus.IbTRSC_VehInpFromCAN2.IeVBII_e_GearRptState IbTRSC_InpBus.IbTRSC_VehInpFromCAN2.IeVBII_e_SBR1RowDriverSeatSts IbTRSC_InpBus.IbTRSC_VehInpFromCAN2.IeVBII_e_ShiftLvrPos IbTRSC_InpBus.IbTRSC_VehInpFromCAN2.IeVBII_e_TGWCamDispSts IbTRSC_InpBus.IbTRSC_VehInpFromCAN2.IeVBII_e_TchScrSts IbTRSC_InpBus.IbTRSC_VehInpFromCAN2.IeVBII_e_TrailerConnectionSts IbTRSC_InpBus.IbTRSC_VehInpFromCAN2.IeVBII_e_TrlrPrsntSts IbTRSC_InpBus.IbTRSC_VehInpFromCAN2.IeVBII_e_TrscEnblBtnSts IbTRSC_InpBus.IbTRSC_VehInpFromCAN2.IeVBII_e_VehAscmSts IbTRSC_InpBus.IbTRSC_VehInpFromCAN2.IeVBII_e_VehFlLvlAdj IbTRSC_InpBus.IbTRSC_VehInpFromCAN2.IeVBII_e_VehFrLvlAdj IbTRSC_InpBus.IbTRSC_VehInpFromCAN2.IeVBII_e_VehRlLvlAdj IbTRSC_InpBus.IbTRSC_VehInpFromCAN2.IeVBII_e_VehRrLvlAdj IbTRSC_InpBus.IbTRSC_VehInpFromCAN2.IeVBII_k_KnobAngl IbTRSC_InpBus.IbTRSC_VehInpFromCAN2.IeVBII_mm_VehFlLvl IbTRSC_InpBus.IbTRSC_VehInpFromCAN2.IeVBII_mm_VehFrLvl IbTRSC_InpBus.IbTRSC_VehInpFromCAN2.IeVBII_mm_VehRlLvl IbTRSC_InpBus.IbTRSC_VehInpFromCAN2.IeVBII_mm_VehRrLvl IbTRSC_InpBus.IbTRSC_VehInpFromCAN2.IeVBII_px_TchXCoord IbTRSC_InpBus.IbTRSC_VehInpFromCAN2.IeVBII_px_TchYCoord /end REF_MEASUREMENT
/end GROUP
/begin GROUP IbTRSC_InpBus.IbTRSC_VehInpFromCAN14 ""
 /begin REF_MEASUREMENT IbTRSC_InpBus.IbTRSC_VehInpFromCAN14.IeVBII_M_StrWhlTrq IbTRSC_InpBus.IbTRSC_VehInpFromCAN14.IeVBII_a_VehLatAcc IbTRSC_InpBus.IbTRSC_VehInpFromCAN14.IeVBII_a_VehLatAccOffset IbTRSC_InpBus.IbTRSC_VehInpFromCAN14.IeVBII_a_VehLongAcc IbTRSC_InpBus.IbTRSC_VehInpFromCAN14.IeVBII_a_VehLongAccOffset IbTRSC_InpBus.IbTRSC_VehInpFromCAN14.IeVBII_b_StrTchSts IbTRSC_InpBus.IbTRSC_VehInpFromCAN14.IeVBII_cnt_LhfPulseCtr IbTRSC_InpBus.IbTRSC_VehInpFromCAN14.IeVBII_cnt_LhrPulseCtr IbTRSC_InpBus.IbTRSC_VehInpFromCAN14.IeVBII_cnt_RhfPulseCtr IbTRSC_InpBus.IbTRSC_VehInpFromCAN14.IeVBII_cnt_RhrPulseCtr IbTRSC_InpBus.IbTRSC_VehInpFromCAN14.IeVBII_ddeg_StrWhlSpd IbTRSC_InpBus.IbTRSC_VehInpFromCAN14.IeVBII_ddeg_VehYawRate IbTRSC_InpBus.IbTRSC_VehInpFromCAN14.IeVBII_deg_StrWhlAng IbTRSC_InpBus.IbTRSC_VehInpFromCAN14.IeVBII_e_EcmTrscResp IbTRSC_InpBus.IbTRSC_VehInpFromCAN14.IeVBII_e_EngineSts IbTRSC_InpBus.IbTRSC_VehInpFromCAN14.IeVBII_e_EscTrscBrkResp IbTRSC_InpBus.IbTRSC_VehInpFromCAN14.IeVBII_e_LhfWhlSpnSts IbTRSC_InpBus.IbTRSC_VehInpFromCAN14.IeVBII_e_LhrWhlSpnSts IbTRSC_InpBus.IbTRSC_VehInpFromCAN14.IeVBII_e_RhfWhlSpnSts IbTRSC_InpBus.IbTRSC_VehInpFromCAN14.IeVBII_e_RhrWhlSpnSts IbTRSC_InpBus.IbTRSC_VehInpFromCAN14.IeVBII_e_SPMLatCtrlRespSts IbTRSC_InpBus.IbTRSC_VehInpFromCAN14.IeVBII_e_StrTrqResp IbTRSC_InpBus.IbTRSC_VehInpFromCAN14.IeVBII_e_StrWhlAngleType IbTRSC_InpBus.IbTRSC_VehInpFromCAN14.IeVBII_e_VehStandStillSts IbTRSC_InpBus.IbTRSC_VehInpFromCAN14.IeVBII_kph_LhfWhlSpd IbTRSC_InpBus.IbTRSC_VehInpFromCAN14.IeVBII_kph_LhrWhlSpd IbTRSC_InpBus.IbTRSC_VehInpFromCAN14.IeVBII_kph_RefVehSpd IbTRSC_InpBus.IbTRSC_VehInpFromCAN14.IeVBII_kph_RhfWhlSpd IbTRSC_InpBus.IbTRSC_VehInpFromCAN14.IeVBII_kph_RhrWhlSpd IbTRSC_InpBus.IbTRSC_VehInpFromCAN14.IeVBII_kph_VehSpeedVSOSig /end REF_MEASUREMENT
/end GROUP
/begin GROUP IbTRSC_InpBus.IbTRSC_TrailerDetInp ""
 /begin REF_MEASUREMENT IbTRSC_InpBus.IbTRSC_TrailerDetInp.MeTRSC_b_OBTLRecalibrate IbTRSC_InpBus.IbTRSC_TrailerDetInp.MeTRSC_b_TrlrCalibDelayInfo IbTRSC_InpBus.IbTRSC_TrailerDetInp.MeTRSC_cnt_TrlrCalibFailCntInfo IbTRSC_InpBus.IbTRSC_TrailerDetInp.MeTRSC_deg_DetJackKnifeAngle IbTRSC_InpBus.IbTRSC_TrailerDetInp.MeTRSC_deg_DetJackknifeThrAngle IbTRSC_InpBus.IbTRSC_TrailerDetInp.MeTRSC_deg_TADAngle IbTRSC_InpBus.IbTRSC_TrailerDetInp.MeTRSC_deg_TADAngleRate IbTRSC_InpBus.IbTRSC_TrailerDetInp.MeTRSC_e_TADCalibrationSubstate IbTRSC_InpBus.IbTRSC_TrailerDetInp.MeTRSC_e_TADState IbTRSC_InpBus.IbTRSC_TrailerDetInp.MeTRSC_e_TrlrCalInfo IbTRSC_InpBus.IbTRSC_TrailerDetInp.MeTRSC_e_TrlrPrsntInfo IbTRSC_InpBus.IbTRSC_TrailerDetInp.MeTRSC_e_TrlrRecogInfo IbTRSC_InpBus.IbTRSC_TrailerDetInp.MeTRSC_e_TurnAroundSubState IbTRSC_InpBus.IbTRSC_TrailerDetInp.MeTRSC_m_DetTrailerBeamLen IbTRSC_InpBus.IbTRSC_TrailerDetInp.MeTRSC_m_HitchLength /end REF_MEASUREMENT
/end GROUP
/begin GROUP IbTRSC_InpBus.IbTRSC_MEProxiToIpc ""
 /begin REF_MEASUREMENT IbTRSC_InpBus.IbTRSC_MEProxiToIpc.IePRX_b_AuxTrlrCam IbTRSC_InpBus.IbTRSC_MEProxiToIpc.IePRX_b_CanNode27AsmAscm IbTRSC_InpBus.IbTRSC_MEProxiToIpc.IePRX_b_CanNode63Ttm IbTRSC_InpBus.IbTRSC_MEProxiToIpc.IePRX_b_CanNode95ItbmItcm IbTRSC_InpBus.IbTRSC_MEProxiToIpc.IePRX_b_SRT IbTRSC_InpBus.IbTRSC_MEProxiToIpc.IePRX_b_SVSPresent IbTRSC_InpBus.IbTRSC_MEProxiToIpc.IePRX_b_TRSCPresent IbTRSC_InpBus.IbTRSC_MEProxiToIpc.IePRX_b_TrlrSurroundPresence IbTRSC_InpBus.IbTRSC_MEProxiToIpc.IePRX_e_BoxDelete IbTRSC_InpBus.IbTRSC_MEProxiToIpc.IePRX_e_RadDsplyTyp IbTRSC_InpBus.IbTRSC_MEProxiToIpc.IePRX_e_StrRackPinTyp IbTRSC_InpBus.IbTRSC_MEProxiToIpc.IePRX_e_VehWhlBase IbTRSC_InpBus.IbTRSC_MEProxiToIpc.IePRX_mm_VehTyreSize /end REF_MEASUREMENT
/end GROUP
/begin GROUP IbTRSC_InpBus.IbTRSC_SVStoTRSC ""
 /begin REF_MEASUREMENT IbTRSC_InpBus.IbTRSC_SVStoTRSC.IeHMI_b_MoreCamReq IbTRSC_InpBus.IbTRSC_SVStoTRSC.MeSVS_e_DispView2Info /end REF_MEASUREMENT
/end GROUP
/begin GROUP IbTRSC_InpBus.IbDDC_DegMgrToTRSC ""
 /begin REF_MEASUREMENT IbTRSC_InpBus.IbDDC_DegMgrToTRSC.IeDDC_b_TRSCDisabled IbTRSC_InpBus.IbDDC_DegMgrToTRSC.IeDDC_b_TRSCLimASCMDef IbTRSC_InpBus.IbDDC_DegMgrToTRSC.IeDDC_b_TRSCLimDefView IbTRSC_InpBus.IbDDC_DegMgrToTRSC.IeDDC_b_TRSCLimView /end REF_MEASUREMENT
/end GROUP
/begin GROUP IbTRSC_InpBus.IbTRSCSmVc_TunParam ""
 /begin REF_MEASUREMENT IbTRSC_InpBus.IbTRSCSmVc_TunParam.KaTRA_deg_TADLUTBrkPts IbTRSC_InpBus.IbTRSCSmVc_TunParam.KaTRA_deg_TADLUTTblData IbTRSC_InpBus.IbTRSCSmVc_TunParam.KaTRA_deg_TAD_IGainLUTBrkPts IbTRSC_InpBus.IbTRSCSmVc_TunParam.KaTRA_k_PGainLUTTblData IbTRSC_InpBus.IbTRSCSmVc_TunParam.KaTRA_k_TADLUTTblData IbTRSC_InpBus.IbTRSCSmVc_TunParam.KaTRA_k_TAD_IGainLUTTblData IbTRSC_InpBus.IbTRSCSmVc_TunParam.KaTRA_k_TravDistLUTTblData IbTRSC_InpBus.IbTRSCSmVc_TunParam.KaTRA_k_VehSpdLUTTblData IbTRSC_InpBus.IbTRSCSmVc_TunParam.KaTRA_k_VehSpd_HdgDeviatLUTTblData IbTRSC_InpBus.IbTRSCSmVc_TunParam.KaTRA_k_VehSpd_IGainLUTTblData IbTRSC_InpBus.IbTRSCSmVc_TunParam.KaTRA_m_PGainLUTYBrkPts IbTRSC_InpBus.IbTRSCSmVc_TunParam.KaTRA_m_TravDistLUTBrkPts IbTRSC_InpBus.IbTRSCSmVc_TunParam.KaTRA_rate_RateGuardXdat IbTRSC_InpBus.IbTRSCSmVc_TunParam.KaTRA_rate_RateGuardYdat IbTRSC_InpBus.IbTRSCSmVc_TunParam.KaTRA_v_PGainLUTXBrkPts IbTRSC_InpBus.IbTRSCSmVc_TunParam.KaTRA_v_VehSpdLUTBrkPts IbTRSC_InpBus.IbTRSCSmVc_TunParam.KaTRA_v_VehSpd_HdgDeviatLUTBrkPts IbTRSC_InpBus.IbTRSCSmVc_TunParam.KaTRA_v_VehSpd_IGainLUTBrkPts IbTRSC_InpBus.IbTRSCSmVc_TunParam.KaTRSC_deg_FtWhlAngPts IbTRSC_InpBus.IbTRSCSmVc_TunParam.KaTRSC_deg_PGainLUTYBrkPts IbTRSC_InpBus.IbTRSCSmVc_TunParam.KaTRSC_deg_StwAngPts IbTRSC_InpBus.IbTRSCSmVc_TunParam.KaTRSC_k_DampingGainTblData IbTRSC_InpBus.IbTRSCSmVc_TunParam.KaTRSC_k_DiffGainTblData IbTRSC_InpBus.IbTRSCSmVc_TunParam.KaTRSC_k_InputRateLimTblData IbTRSC_InpBus.IbTRSCSmVc_TunParam.KaTRSC_k_IntegratorExtSatTblData IbTRSC_InpBus.IbTRSCSmVc_TunParam.KaTRSC_k_IntegratorGainTblData IbTRSC_InpBus.IbTRSCSmVc_TunParam.KaTRSC_k_PGainLUTTblData IbTRSC_InpBus.IbTRSCSmVc_TunParam.KaTRSC_kph_DampingGainBrkPts IbTRSC_InpBus.IbTRSCSmVc_TunParam.KaTRSC_kph_DiffGainBrkPts IbTRSC_InpBus.IbTRSCSmVc_TunParam.KaTRSC_kph_InputRateLimBrkPts IbTRSC_InpBus.IbTRSCSmVc_TunParam.KaTRSC_kph_IntegratorExtSatBrkPts IbTRSC_InpBus.IbTRSCSmVc_TunParam.KaTRSC_kph_IntegratorGainBrkPts IbTRSC_InpBus.IbTRSCSmVc_TunParam.KaTRSC_kph_PGainLUTXBrkPts IbTRSC_InpBus.IbTRSCSmVc_TunParam.KeKM_deg_AngTh IbTRSC_InpBus.IbTRSCSmVc_TunParam.KeKM_k_GyroYawCov IbTRSC_InpBus.IbTRSCSmVc_TunParam.KeKM_k_KM_SF_RelAngCov IbTRSC_InpBus.IbTRSCSmVc_TunParam.KeKM_k_KM_SF_RelAngRateCov IbTRSC_InpBus.IbTRSCSmVc_TunParam.KeKM_k_KM_SF_YawRateCov IbTRSC_InpBus.IbTRSCSmVc_TunParam.KeKM_k_KM_YawRateGyroBiasInit IbTRSC_InpBus.IbTRSCSmVc_TunParam.KeKM_k_NumWheelPulses IbTRSC_InpBus.IbTRSCSmVc_TunParam.KeKM_k_SWA_Res IbTRSC_InpBus.IbTRSCSmVc_TunParam.KeKM_k_TADCov IbTRSC_InpBus.IbTRSCSmVc_TunParam.KeKM_k_UpdateIMU_H IbTRSC_InpBus.IbTRSCSmVc_TunParam.KeKM_k_UpdateRPM_H IbTRSC_InpBus.IbTRSCSmVc_TunParam.KeKM_k_UpdateTAD_H IbTRSC_InpBus.IbTRSCSmVc_TunParam.KeKM_k_WhlPlsCnt_high_lim IbTRSC_InpBus.IbTRSCSmVc_TunParam.KeKM_k_WhlPlsCnt_low_lim IbTRSC_InpBus.IbTRSCSmVc_TunParam.KeKM_k_WhlRPMYawCov IbTRSC_InpBus.IbTRSCSmVc_TunParam.KeKM_m_BeamLength IbTRSC_InpBus.IbTRSCSmVc_TunParam.KeKM_m_TrackWidth IbTRSC_InpBus.IbTRSCSmVc_TunParam.KeKM_m_WheelCircumference IbTRSC_InpBus.IbTRSCSmVc_TunParam.KeKM_s_SampleTime IbTRSC_InpBus.IbTRSCSmVc_TunParam.KeTRA_deg_TrailerBeamLenYBrkPts IbTRSC_InpBus.IbTRSCSmVc_TunParam.KeTRA_k_Kp IbTRSC_InpBus.IbTRSCSmVc_TunParam.KeTRA_k_SteerAngRateLmt IbTRSC_InpBus.IbTRSCSmVc_TunParam.KeTRA_m_K_beta IbTRSC_InpBus.IbTRSCSmVc_TunParam.KeTRA_m_TrailerBeamLenXBrkPts IbTRSC_InpBus.IbTRSCSmVc_TunParam.KeTRSC_Cnt_FailedCnt IbTRSC_InpBus.IbTRSCSmVc_TunParam.KeTRSC_TADdes_k_PIDKd IbTRSC_InpBus.IbTRSCSmVc_TunParam.KeTRSC_TADep_k_PIDKp IbTRSC_InpBus.IbTRSCSmVc_TunParam.KeTRSC_b_bValidFlag IbTRSC_InpBus.IbTRSCSmVc_TunParam.KeTRSC_deg_KnobHys IbTRSC_InpBus.IbTRSCSmVc_TunParam.KeTRSC_deg_MaxKnobAngle IbTRSC_InpBus.IbTRSCSmVc_TunParam.KeTRSC_deg_MaxStrAngle IbTRSC_InpBus.IbTRSCSmVc_TunParam.KeTRSC_deg_MaxStrAngle_Low_Limit IbTRSC_InpBus.IbTRSCSmVc_TunParam.KeTRSC_deg_MaxStrAngle_Up_Limit IbTRSC_InpBus.IbTRSCSmVc_TunParam.KeTRSC_deg_MaxTrlrAngl IbTRSC_InpBus.IbTRSCSmVc_TunParam.KeTRSC_deg_TAD_DesRateUpLim IbTRSC_InpBus.IbTRSCSmVc_TunParam.KeTRSC_deg_TGTADdesRateChange IbTRSC_InpBus.IbTRSCSmVc_TunParam.KeTRSC_deg_TrqCnt_LowLimit IbTRSC_InpBus.IbTRSCSmVc_TunParam.KeTRSC_deg_TrqCnt_UpLimit IbTRSC_InpBus.IbTRSCSmVc_TunParam.KeTRSC_e_CamBlockAcceptLvl IbTRSC_InpBus.IbTRSCSmVc_TunParam.KeTRSC_k_JKAngle_LowLimit IbTRSC_InpBus.IbTRSCSmVc_TunParam.KeTRSC_k_JKAngle_UpLimit IbTRSC_InpBus.IbTRSCSmVc_TunParam.KeTRSC_k_LogVecLength IbTRSC_InpBus.IbTRSCSmVc_TunParam.KeTRSC_k_TrqConstRateLim IbTRSC_InpBus.IbTRSCSmVc_TunParam.KeTRSC_k_TrqConstSatLim IbTRSC_InpBus.IbTRSCSmVc_TunParam.KeTRSC_k_VariantID IbTRSC_InpBus.IbTRSCSmVc_TunParam.KeTRSC_k_WhlAngCFBias IbTRSC_InpBus.IbTRSCSmVc_TunParam.KeTRSC_k_WhlAngCFWt IbTRSC_InpBus.IbTRSCSmVc_TunParam.KeTRSC_kph_DeactivationSpd IbTRSC_InpBus.IbTRSCSmVc_TunParam.KeTRSC_m_TBL_LowLimit IbTRSC_InpBus.IbTRSCSmVc_TunParam.KeTRSC_m_TBL_UpLimit IbTRSC_InpBus.IbTRSCSmVc_TunParam.KeTRSC_m_WheelBase IbTRSC_InpBus.IbTRSCSmVc_TunParam.KeTRSC_m_WheelBase_Low_Limit IbTRSC_InpBus.IbTRSCSmVc_TunParam.KeTRSC_m_WheelBase_Up_Limit IbTRSC_InpBus.IbTRSCSmVc_TunParam.KeTRSC_pct_JackKnifePerc IbTRSC_InpBus.IbTRSCSmVc_TunParam.KeTRSC_pct_TrlrJackKnifePerc IbTRSC_InpBus.IbTRSCSmVc_TunParam.KeTRSC_s_ActTransRevDbnc2 IbTRSC_InpBus.IbTRSCSmVc_TunParam.KeTRSC_s_CalibDlyTh IbTRSC_InpBus.IbTRSCSmVc_TunParam.KeTRSC_s_EpsRespTmOut IbTRSC_InpBus.IbTRSCSmVc_TunParam.KeTRSC_s_GearDbncTh IbTRSC_InpBus.IbTRSCSmVc_TunParam.KeTRSC_s_LEDTmrTh IbTRSC_InpBus.IbTRSCSmVc_TunParam.KeTRSC_s_RespNotRcvdTmOut IbTRSC_InpBus.IbTRSCSmVc_TunParam.KeTRSC_s_TrlrUnkwnSet /end REF_MEASUREMENT
/end GROUP
/end MODULE
/end PROJECT
/* (add any file trailer comments here) */
/* EOF TRSC_SM_VC_Int.a2l */
