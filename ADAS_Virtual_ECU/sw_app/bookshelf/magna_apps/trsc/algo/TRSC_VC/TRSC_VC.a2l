/******************************************************************************
* ASAP2 file: TRSC_VC.a2l
* Code generation for model "TRSC_VC".
* Model version : 1.7705
* Simulink Coder version : 9.2 (R2019b) 18-Jul-2019
* C source code generated on : Thu Nov 13 09:52:03 2025
* Target selection: ert.tlc
* Embedded hardware selection: ARM Compatible->ARM Cortex
* Code generation objectives:
* 1. MISRA C:2012 guidelines
* 2. RAM efficiency
* 3. ROM efficiency
* Validation result: Not run
* (add additional file header information here)
******************************************************************************/ ASAP2_VERSION 1 31
/* Version 1.31 */
/begin PROJECT ProjectName "Project Comment Goes Here"
/begin HEADER "Header Comments go here" /end HEADER
/begin MODULE ModuleName "Module Comment Goes Here"
/begin MOD_PAR "MOD PAR Comment Goes Here" /end MOD_PAR
/begin MOD_COMMON "Mod Common Comment Here" BYTE_ORDER MSB_LAST /end MOD_COMMON
/begin RECORD_LAYOUT Scalar_BOOLEAN FNC_VALUES 1 UBYTE COLUMN_DIR DIRECT /end RECORD_LAYOUT
/begin RECORD_LAYOUT Scalar_UBYTE FNC_VALUES 1 UBYTE COLUMN_DIR DIRECT /end RECORD_LAYOUT
/begin RECORD_LAYOUT Scalar_BYTE FNC_VALUES 1 SBYTE COLUMN_DIR DIRECT /end RECORD_LAYOUT
/begin RECORD_LAYOUT Scalar_UWORD FNC_VALUES 1 UWORD COLUMN_DIR DIRECT /end RECORD_LAYOUT
/begin RECORD_LAYOUT Scalar_SWORD FNC_VALUES 1 SWORD COLUMN_DIR DIRECT /end RECORD_LAYOUT
/begin RECORD_LAYOUT Scalar_ULONG FNC_VALUES 1 ULONG COLUMN_DIR DIRECT /end RECORD_LAYOUT
/begin RECORD_LAYOUT Scalar_LONG FNC_VALUES 1 SLONG COLUMN_DIR DIRECT /end RECORD_LAYOUT
/begin RECORD_LAYOUT Scalar_FLOAT32_IEEE FNC_VALUES 1 FLOAT32_IEEE COLUMN_DIR DIRECT /end RECORD_LAYOUT
/begin RECORD_LAYOUT Scalar_FLOAT64_IEEE FNC_VALUES 1 FLOAT64_IEEE COLUMN_DIR DIRECT /end RECORD_LAYOUT
/begin RECORD_LAYOUT Lookup1D_BOOLEAN FNC_VALUES 1 UBYTE COLUMN_DIR DIRECT /end RECORD_LAYOUT
/begin RECORD_LAYOUT Lookup1D_X_BOOLEAN AXIS_PTS_X 1 UBYTE INDEX_INCR DIRECT /end RECORD_LAYOUT
/begin RECORD_LAYOUT Lookup1D_BYTE FNC_VALUES 1 SBYTE COLUMN_DIR DIRECT /end RECORD_LAYOUT
/begin RECORD_LAYOUT Lookup1D_X_BYTE AXIS_PTS_X 1 SBYTE INDEX_INCR DIRECT /end RECORD_LAYOUT
/begin RECORD_LAYOUT Lookup1D_UBYTE FNC_VALUES 1 UBYTE COLUMN_DIR DIRECT /end RECORD_LAYOUT
/begin RECORD_LAYOUT Lookup1D_X_UBYTE AXIS_PTS_X 1 UBYTE INDEX_INCR DIRECT /end RECORD_LAYOUT
/begin RECORD_LAYOUT Lookup1D_UWORD FNC_VALUES 1 UWORD COLUMN_DIR DIRECT /end RECORD_LAYOUT
/begin RECORD_LAYOUT Lookup1D_X_UWORD AXIS_PTS_X 1 UWORD INDEX_INCR DIRECT /end RECORD_LAYOUT
/begin RECORD_LAYOUT Lookup1D_WORD FNC_VALUES 1 SWORD COLUMN_DIR DIRECT /end RECORD_LAYOUT
/begin RECORD_LAYOUT Lookup1D_X_WORD AXIS_PTS_X 1 SWORD INDEX_INCR DIRECT /end RECORD_LAYOUT
/begin RECORD_LAYOUT Lookup1D_ULONG FNC_VALUES 1 ULONG COLUMN_DIR DIRECT /end RECORD_LAYOUT
/begin RECORD_LAYOUT Lookup1D_X_ULONG AXIS_PTS_X 1 ULONG INDEX_INCR DIRECT /end RECORD_LAYOUT
/begin RECORD_LAYOUT Lookup1D_SLONG FNC_VALUES 1 SLONG COLUMN_DIR DIRECT /end RECORD_LAYOUT
/begin RECORD_LAYOUT Lookup1D_X_LONG AXIS_PTS_X 1 SLONG INDEX_INCR DIRECT /end RECORD_LAYOUT
/begin RECORD_LAYOUT Lookup1D_FLOAT32_IEEE FNC_VALUES 1 FLOAT32_IEEE COLUMN_DIR DIRECT /end RECORD_LAYOUT
/begin RECORD_LAYOUT Lookup1D_X_FLOAT32_IEEE AXIS_PTS_X 1 FLOAT32_IEEE INDEX_INCR DIRECT /end RECORD_LAYOUT
/begin RECORD_LAYOUT Lookup1D_FLOAT64_IEEE FNC_VALUES 1 FLOAT64_IEEE COLUMN_DIR DIRECT /end RECORD_LAYOUT
/begin RECORD_LAYOUT Lookup1D_X_FLOAT64_IEEE AXIS_PTS_X 1 FLOAT64_IEEE INDEX_INCR DIRECT /end RECORD_LAYOUT
/begin RECORD_LAYOUT Lookup2D_BOOLEAN FNC_VALUES 1 UBYTE COLUMN_DIR DIRECT /end RECORD_LAYOUT
/begin RECORD_LAYOUT Lookup2D_X_BOOLEAN AXIS_PTS_X 1 UBYTE INDEX_INCR DIRECT /end RECORD_LAYOUT
/begin RECORD_LAYOUT Lookup2D_UBYTE FNC_VALUES 1 UBYTE COLUMN_DIR DIRECT /end RECORD_LAYOUT
/begin RECORD_LAYOUT Lookup2D_X_UBYTE AXIS_PTS_X 1 UBYTE INDEX_INCR DIRECT /end RECORD_LAYOUT
/begin RECORD_LAYOUT Lookup2D_BYTE FNC_VALUES 1 SBYTE COLUMN_DIR DIRECT /end RECORD_LAYOUT
/begin RECORD_LAYOUT Lookup2D_X_BYTE AXIS_PTS_X 1 SBYTE INDEX_INCR DIRECT /end RECORD_LAYOUT
/begin RECORD_LAYOUT Lookup2D_UWORD FNC_VALUES 1 UWORD COLUMN_DIR DIRECT /end RECORD_LAYOUT
/begin RECORD_LAYOUT Lookup2D_X_UWORD AXIS_PTS_X 1 UWORD INDEX_INCR DIRECT /end RECORD_LAYOUT
/begin RECORD_LAYOUT Lookup2D_WORD FNC_VALUES 1 SWORD COLUMN_DIR DIRECT /end RECORD_LAYOUT
/begin RECORD_LAYOUT Lookup2D_X_WORD AXIS_PTS_X 1 SWORD INDEX_INCR DIRECT /end RECORD_LAYOUT
/begin RECORD_LAYOUT Lookup2D_ULONG FNC_VALUES 1 ULONG COLUMN_DIR DIRECT /end RECORD_LAYOUT
/begin RECORD_LAYOUT Lookup2D_X_ULONG AXIS_PTS_X 1 ULONG INDEX_INCR DIRECT /end RECORD_LAYOUT
/begin RECORD_LAYOUT Lookup2D_LONG FNC_VALUES 1 SLONG COLUMN_DIR DIRECT /end RECORD_LAYOUT
/begin RECORD_LAYOUT Lookup2D_X_LONG AXIS_PTS_X 1 SLONG INDEX_INCR DIRECT /end RECORD_LAYOUT
/begin RECORD_LAYOUT Lookup2D_FLOAT32_IEEE FNC_VALUES 1 FLOAT32_IEEE COLUMN_DIR DIRECT /end RECORD_LAYOUT
/begin RECORD_LAYOUT Lookup2D_X_FLOAT32_IEEE AXIS_PTS_X 1 FLOAT32_IEEE INDEX_INCR DIRECT /end RECORD_LAYOUT
/begin RECORD_LAYOUT Lookup2D_FLOAT64_IEEE FNC_VALUES 1 FLOAT64_IEEE COLUMN_DIR DIRECT /end RECORD_LAYOUT
/begin RECORD_LAYOUT Lookup2D_X_FLOAT64_IEEE AXIS_PTS_X 1 FLOAT64_IEEE INDEX_INCR DIRECT /end RECORD_LAYOUT
/begin CHARACTERISTIC KeTRSC_pct_TrlrAngScaleDwnPct "Percentage to scale down KnobAngle based on TBL" CURVE 0x0000 /* @ECU_Address@KeTRSC_pct_TrlrAngScaleDwnPct@ */ Lookup1D_FLOAT32_IEEE 0 TRSC_VC_CM_single -3.4E+38 3.4E+38
 /begin AXIS_DESCR COM_AXIS NO_INPUT_QUANTITY TRSC_VC_CM_single 4 -3.4E+38 3.4E+38 AXIS_PTS_REF KeTRSC_m_DesAnglScaleTBLThr /end AXIS_DESCR
/end CHARACTERISTIC
/begin AXIS_PTS KeTRSC_m_DesAnglScaleTBLThr "Desired Trlr Angle TBL Threshold" 0x0000 /* @ECU_Address@KeTRSC_m_DesAnglScaleTBLThr@ */ NO_INPUT_QUANTITY Lookup1D_X_FLOAT32_IEEE 0 TRSC_VC_CM_single 4 -3.4E+38 3.4E+38 /end AXIS_PTS
/begin CHARACTERISTIC KaTRA_k_PGainLUTTblData "Table Data for P-Gain LookUp Table " MAP 0x0000 /* @ECU_Address@KaTRA_k_PGainLUTTblData@ */ Lookup2D_FLOAT32_IEEE 0 TRSC_VC_CM_single -3.4E+38 3.4E+38
 /begin AXIS_DESCR COM_AXIS NO_INPUT_QUANTITY TRSC_VC_CM_single_m 2 -3.4E+38 3.4E+38 AXIS_PTS_REF KaTRA_m_PGainLUTYBrkPts /end AXIS_DESCR
 /begin AXIS_DESCR COM_AXIS NO_INPUT_QUANTITY TRSC_VC_CM_single_mps 2 -3.4E+38 3.4E+38 AXIS_PTS_REF KaTRA_v_PGainLUTXBrkPts /end AXIS_DESCR
/end CHARACTERISTIC
/begin AXIS_PTS KaTRA_v_PGainLUTXBrkPts "X-Breakpoints for P-Gain LookUp Table " 0x0000 /* @ECU_Address@KaTRA_v_PGainLUTXBrkPts@ */ NO_INPUT_QUANTITY Lookup2D_X_FLOAT32_IEEE 0 TRSC_VC_CM_single_mps 2 -3.4E+38 3.4E+38 /end AXIS_PTS
/begin AXIS_PTS KaTRA_m_PGainLUTYBrkPts "Y-Breakpoints for P-Gain LookUp Table " 0x0000 /* @ECU_Address@KaTRA_m_PGainLUTYBrkPts@ */ NO_INPUT_QUANTITY Lookup2D_X_FLOAT32_IEEE 0 TRSC_VC_CM_single_m 2 -3.4E+38 3.4E+38 /end AXIS_PTS
/begin CHARACTERISTIC KaTRSC_k_PGainLUTTDTyp1 "Table Data for P Gain LookUp Table " MAP 0x0000 /* @ECU_Address@KaTRSC_k_PGainLUTTDTyp1@ */ Lookup2D_FLOAT32_IEEE 0 TRSC_VC_CM_single -3.4E+38 3.4E+38
 /begin AXIS_DESCR COM_AXIS NO_INPUT_QUANTITY TRSC_VC_CM_single 5 -3.4E+38 3.4E+38 AXIS_PTS_REF KaTRSC_deg_PGainLUTYBPTyp1 /end AXIS_DESCR
 /begin AXIS_DESCR COM_AXIS NO_INPUT_QUANTITY TRSC_VC_CM_single 4 -3.4E+38 3.4E+38 AXIS_PTS_REF KaTRSC_kph_PGainLUTXBPTyp1 /end AXIS_DESCR
/end CHARACTERISTIC
/begin AXIS_PTS KaTRSC_kph_PGainLUTXBPTyp1 "X Breakpoints for P Gain LookUp Table " 0x0000 /* @ECU_Address@KaTRSC_kph_PGainLUTXBPTyp1@ */ NO_INPUT_QUANTITY Lookup2D_X_FLOAT32_IEEE 0 TRSC_VC_CM_single 4 -3.4E+38 3.4E+38 /end AXIS_PTS
/begin AXIS_PTS KaTRSC_deg_PGainLUTYBPTyp1 "Y Breakpoints for P Gain LookUp Table " 0x0000 /* @ECU_Address@KaTRSC_deg_PGainLUTYBPTyp1@ */ NO_INPUT_QUANTITY Lookup2D_X_FLOAT32_IEEE 0 TRSC_VC_CM_single 5 -3.4E+38 3.4E+38 /end AXIS_PTS
/begin CHARACTERISTIC KaTRSC_k_PGainLUTTDTyp2 "Table Data for P Gain LookUp Table " MAP 0x0000 /* @ECU_Address@KaTRSC_k_PGainLUTTDTyp2@ */ Lookup2D_FLOAT32_IEEE 0 TRSC_VC_CM_single -3.4E+38 3.4E+38
 /begin AXIS_DESCR COM_AXIS NO_INPUT_QUANTITY TRSC_VC_CM_single 5 -3.4E+38 3.4E+38 AXIS_PTS_REF KaTRSC_deg_PGainLUTYBPTyp2 /end AXIS_DESCR
 /begin AXIS_DESCR COM_AXIS NO_INPUT_QUANTITY TRSC_VC_CM_single 4 -3.4E+38 3.4E+38 AXIS_PTS_REF KaTRSC_kph_PGainLUTXBPTyp2 /end AXIS_DESCR
/end CHARACTERISTIC
/begin AXIS_PTS KaTRSC_kph_PGainLUTXBPTyp2 "X Breakpoints for P Gain LookUp Table " 0x0000 /* @ECU_Address@KaTRSC_kph_PGainLUTXBPTyp2@ */ NO_INPUT_QUANTITY Lookup2D_X_FLOAT32_IEEE 0 TRSC_VC_CM_single 4 -3.4E+38 3.4E+38 /end AXIS_PTS
/begin AXIS_PTS KaTRSC_deg_PGainLUTYBPTyp2 "Y Breakpoints for P Gain LookUp Table " 0x0000 /* @ECU_Address@KaTRSC_deg_PGainLUTYBPTyp2@ */ NO_INPUT_QUANTITY Lookup2D_X_FLOAT32_IEEE 0 TRSC_VC_CM_single 5 -3.4E+38 3.4E+38 /end AXIS_PTS
/begin CHARACTERISTIC KaTRSC_k_PGainLUTTDTyp3 "Table Data for P Gain LookUp Table " MAP 0x0000 /* @ECU_Address@KaTRSC_k_PGainLUTTDTyp3@ */ Lookup2D_FLOAT32_IEEE 0 TRSC_VC_CM_single -3.4E+38 3.4E+38
 /begin AXIS_DESCR COM_AXIS NO_INPUT_QUANTITY TRSC_VC_CM_single 5 -3.4E+38 3.4E+38 AXIS_PTS_REF KaTRSC_deg_PGainLUTYBPTyp3 /end AXIS_DESCR
 /begin AXIS_DESCR COM_AXIS NO_INPUT_QUANTITY TRSC_VC_CM_single 4 -3.4E+38 3.4E+38 AXIS_PTS_REF KaTRSC_kph_PGainLUTXBPTyp3 /end AXIS_DESCR
/end CHARACTERISTIC
/begin AXIS_PTS KaTRSC_kph_PGainLUTXBPTyp3 "X Breakpoints for P Gain LookUp Table " 0x0000 /* @ECU_Address@KaTRSC_kph_PGainLUTXBPTyp3@ */ NO_INPUT_QUANTITY Lookup2D_X_FLOAT32_IEEE 0 TRSC_VC_CM_single 4 -3.4E+38 3.4E+38 /end AXIS_PTS
/begin AXIS_PTS KaTRSC_deg_PGainLUTYBPTyp3 "Y Breakpoints for P Gain LookUp Table " 0x0000 /* @ECU_Address@KaTRSC_deg_PGainLUTYBPTyp3@ */ NO_INPUT_QUANTITY Lookup2D_X_FLOAT32_IEEE 0 TRSC_VC_CM_single 5 -3.4E+38 3.4E+38 /end AXIS_PTS
/begin CHARACTERISTIC CeConst_k_ConstOne "" VALUE 0x0000 /* @ECU_Address@CeConst_k_ConstOne@ */ Scalar_FLOAT32_IEEE 0 TRSC_VC_CM_single -3.4E+38 3.4E+38 /end CHARACTERISTIC
/begin CHARACTERISTIC CeConst_k_ConstTwo "" VALUE 0x0000 /* @ECU_Address@CeConst_k_ConstTwo@ */ Scalar_FLOAT32_IEEE 0 TRSC_VC_CM_single -3.4E+38 3.4E+38 /end CHARACTERISTIC
/begin CHARACTERISTIC CeConst_k_ConstZero "" VALUE 0x0000 /* @ECU_Address@CeConst_k_ConstZero@ */ Scalar_FLOAT32_IEEE 0 TRSC_VC_CM_single -3.4E+38 3.4E+38 /end CHARACTERISTIC
/begin CHARACTERISTIC CeConst_ku_deg2rad "" VALUE 0x0000 /* @ECU_Address@CeConst_ku_deg2rad@ */ Scalar_FLOAT32_IEEE 0 TRSC_VC_CM_single -3.4E+38 3.4E+38 /end CHARACTERISTIC
/begin CHARACTERISTIC CeKM_deg_180 "180 degree" VALUE 0x0000 /* @ECU_Address@CeKM_deg_180@ */ Scalar_FLOAT32_IEEE 0 TRSC_VC_CM_single_deg -3.4E+38 3.4E+38 /end CHARACTERISTIC
/begin CHARACTERISTIC CeKM_deg_360 "360 degree" VALUE 0x0000 /* @ECU_Address@CeKM_deg_360@ */ Scalar_FLOAT32_IEEE 0 TRSC_VC_CM_single_deg -3.4E+38 3.4E+38 /end CHARACTERISTIC
/begin CHARACTERISTIC CeKM_k_ArrayZeros "array of zeros for initialiation" VAL_BLK 0x0000 /* @ECU_Address@CeKM_k_ArrayZeros@ */ Scalar_FLOAT32_IEEE 0 TRSC_VC_CM_single -3.4E+38 3.4E+38 NUMBER 3 /end CHARACTERISTIC
/begin CHARACTERISTIC CeKM_k_pi "Pi Constant" VALUE 0x0000 /* @ECU_Address@CeKM_k_pi@ */ Scalar_FLOAT32_IEEE 0 TRSC_VC_CM_single -3.4E+38 3.4E+38 /end CHARACTERISTIC
/begin CHARACTERISTIC CeTRA_deg_AngleNinety "Angle 90 deg" VALUE 0x0000 /* @ECU_Address@CeTRA_deg_AngleNinety@ */ Scalar_FLOAT32_IEEE 0 TRSC_VC_CM_single_deg -3.4E+38 3.4E+38 /end CHARACTERISTIC
/begin CHARACTERISTIC CeTRA_deg_AngleOneEighty "Angle 180 degree" VALUE 0x0000 /* @ECU_Address@CeTRA_deg_AngleOneEighty@ */ Scalar_FLOAT32_IEEE 0 TRSC_VC_CM_single_deg -3.4E+38 3.4E+38 /end CHARACTERISTIC
/begin CHARACTERISTIC CeTRA_deg_AngleThreeSixty "Angle 360 degree" VALUE 0x0000 /* @ECU_Address@CeTRA_deg_AngleThreeSixty@ */ Scalar_FLOAT32_IEEE 0 TRSC_VC_CM_single_deg -3.4E+38 3.4E+38 /end CHARACTERISTIC
/begin CHARACTERISTIC CeTRA_k_ConstTen "Constant value Ten" VALUE 0x0000 /* @ECU_Address@CeTRA_k_ConstTen@ */ Scalar_FLOAT32_IEEE 0 TRSC_VC_CM_single -3.4E+38 3.4E+38 /end CHARACTERISTIC
/begin CHARACTERISTIC CeTRA_k_OnePerHundred "Constant value 0.01 used to calculate D-gain of PID controller" VALUE 0x0000 /* @ECU_Address@CeTRA_k_OnePerHundred@ */ Scalar_FLOAT32_IEEE 0 TRSC_VC_CM_single -3.4E+38 3.4E+38 /end CHARACTERISTIC
/begin CHARACTERISTIC CeTRA_k_fifteen "Constant Value Fifteen" VALUE 0x0000 /* @ECU_Address@CeTRA_k_fifteen@ */ Scalar_FLOAT32_IEEE 0 TRSC_VC_CM_single -3.4E+38 3.4E+38 /end CHARACTERISTIC
/begin CHARACTERISTIC CeTRA_sec_SampleTime "sampling time" VALUE 0x0000 /* @ECU_Address@CeTRA_sec_SampleTime@ */ Scalar_FLOAT32_IEEE 0 TRSC_VC_CM_single_sec -3.4E+38 3.4E+38 /end CHARACTERISTIC
/begin CHARACTERISTIC CeTRSC_s_TRSCLpTm "TRSC Loop time" VALUE 0x0000 /* @ECU_Address@CeTRSC_s_TRSCLpTm@ */ Scalar_FLOAT32_IEEE 0 TRSC_VC_CM_single_sec -3.4E+38 3.4E+38 /end CHARACTERISTIC
/begin CHARACTERISTIC KM_SamplingTime "" VALUE 0x0000 /* @ECU_Address@KM_SamplingTime@ */ Scalar_FLOAT32_IEEE 0 TRSC_VC_CM_single -3.4E+38 3.4E+38 /end CHARACTERISTIC
/begin CHARACTERISTIC KaTRSC_k_IntGainTDTyp1 "Table Data for Integrator Gain LookUp Table " VAL_BLK 0x0000 /* @ECU_Address@KaTRSC_k_IntGainTDTyp1@ */ Scalar_FLOAT32_IEEE 0 TRSC_VC_CM_single -3.4E+38 3.4E+38 NUMBER 16 /end CHARACTERISTIC
/begin CHARACTERISTIC KaTRSC_k_IntGainTDTyp2or3 "Table Data for Integrator Gain LookUp Table " VAL_BLK 0x0000 /* @ECU_Address@KaTRSC_k_IntGainTDTyp2or3@ */ Scalar_FLOAT32_IEEE 0 TRSC_VC_CM_single -3.4E+38 3.4E+38 NUMBER 16 /end CHARACTERISTIC
/begin CHARACTERISTIC KeKM_k_KM_YawRateGyroBiasInit "Yaw rate Gyro bias initialization" VALUE 0x0000 /* @ECU_Address@KeKM_k_KM_YawRateGyroBiasInit@ */ Scalar_FLOAT32_IEEE 0 TRSC_VC_CM_single -3.4E+38 3.4E+38 /end CHARACTERISTIC
/begin CHARACTERISTIC KeTRSC_Nm_MaxTrqLim "KeTRSC_Nm_MaxTrqLim" VALUE 0x0000 /* @ECU_Address@KeTRSC_Nm_MaxTrqLim@ */ Scalar_FLOAT32_IEEE 0 TRSC_VC_CM_single_nm -3.4E+38 3.4E+38 /end CHARACTERISTIC
/begin CHARACTERISTIC KeTRSC_ddeg_TadDesRateLim "Desired Trailer Angle rate limit for TAD Error computation" VALUE 0x0000 /* @ECU_Address@KeTRSC_ddeg_TadDesRateLim@ */ Scalar_FLOAT32_IEEE 0 TRSC_VC_CM_single_ddeg_s -3.4E+38 3.4E+38 /end CHARACTERISTIC
/begin CHARACTERISTIC KeTRSC_deg_TADErrSpdLmtLowThr "TADErrSpdLmtLowThr" VALUE 0x0000 /* @ECU_Address@KeTRSC_deg_TADErrSpdLmtLowThr@ */ Scalar_FLOAT32_IEEE 0 TRSC_VC_CM_single_deg -3.4E+38 3.4E+38 /end CHARACTERISTIC
/begin CHARACTERISTIC KeTRSC_deg_TADErrSpdLmtMidThr "TADErrSpdLmtMidThr" VALUE 0x0000 /* @ECU_Address@KeTRSC_deg_TADErrSpdLmtMidThr@ */ Scalar_FLOAT32_IEEE 0 TRSC_VC_CM_single_deg -3.4E+38 3.4E+38 /end CHARACTERISTIC
/begin CHARACTERISTIC KeTRSC_deg_TadCornerCaseThr "TAD angle threshold for corner case" VALUE 0x0000 /* @ECU_Address@KeTRSC_deg_TadCornerCaseThr@ */ Scalar_FLOAT32_IEEE 0 TRSC_VC_CM_single -3.4E+38 3.4E+38 /end CHARACTERISTIC
/begin CHARACTERISTIC KeTRSC_deg_TadErrSatLim "Saturation Limit for TAD error" VALUE 0x0000 /* @ECU_Address@KeTRSC_deg_TadErrSatLim@ */ Scalar_FLOAT32_IEEE 0 TRSC_VC_CM_single -3.4E+38 3.4E+38 /end CHARACTERISTIC
/begin CHARACTERISTIC KeTRSC_deg_TwitchTrqRateLim "trq rate limit for twitch" VALUE 0x0000 /* @ECU_Address@KeTRSC_deg_TwitchTrqRateLim@ */ Scalar_FLOAT32_IEEE 0 TRSC_VC_CM_single_deg_sec -3.4E+38 3.4E+38 /end CHARACTERISTIC
/begin CHARACTERISTIC KeTRSC_deg_Zero "lower saturation value for Trailer Protection Angle " VALUE 0x0000 /* @ECU_Address@KeTRSC_deg_Zero@ */ Scalar_FLOAT32_IEEE 0 TRSC_VC_CM_single -3.4E+38 3.4E+38 /end CHARACTERISTIC
/begin CHARACTERISTIC KeTRSC_k_EnblJKPrevention "flag to Enable JK Prevention logic in TAD PID" VALUE 0x0000 /* @ECU_Address@KeTRSC_k_EnblJKPrevention@ */ Scalar_FLOAT32_IEEE 0 TRSC_VC_CM_single -3.4E+38 3.4E+38 /end CHARACTERISTIC
/begin CHARACTERISTIC KeTRSC_k_ErrSatLim "steering Error saturation limit
      " VAL_BLK 0x0000 /* @ECU_Address@KeTRSC_k_ErrSatLim@ */ Scalar_FLOAT32_IEEE 0 TRSC_VC_CM_single -3.4E+38 3.4E+38 NUMBER 4 /end CHARACTERISTIC
/begin CHARACTERISTIC KeTRSC_k_IntExtSat "Integrator Saturation Limit" VALUE 0x0000 /* @ECU_Address@KeTRSC_k_IntExtSat@ */ Scalar_FLOAT32_IEEE 0 TRSC_VC_CM_single -3.4E+38 3.4E+38 /end CHARACTERISTIC
/begin CHARACTERISTIC KeTRSC_k_NumTwitchPulse "Number of PWM pulses for twitch" VALUE 0x0000 /* @ECU_Address@KeTRSC_k_NumTwitchPulse@ */ Scalar_FLOAT32_IEEE 0 TRSC_VC_CM_single -3.4E+38 3.4E+38 /end CHARACTERISTIC
/begin CHARACTERISTIC KeTRSC_k_PIDKdPathDeviation "Path Deviation PID control D gain" VALUE 0x0000 /* @ECU_Address@KeTRSC_k_PIDKdPathDeviation@ */ Scalar_FLOAT32_IEEE 0 TRSC_VC_CM_single -3.4E+38 3.4E+38 /end CHARACTERISTIC
/begin CHARACTERISTIC KeTRSC_k_StrCtrlLPFFrequency "Steering_controller_low_pass_filter_frequency
      " VALUE 0x0000 /* @ECU_Address@KeTRSC_k_StrCtrlLPFFrequency@ */ Scalar_FLOAT32_IEEE 0 TRSC_VC_CM_single -3.4E+38 3.4E+38 /end CHARACTERISTIC
/begin CHARACTERISTIC KeTRSC_k_StrRptLPFFrequency "Steering_controller_low_pass_filter_frequency
      " VALUE 0x0000 /* @ECU_Address@KeTRSC_k_StrRptLPFFrequency@ */ Scalar_FLOAT32_IEEE 0 TRSC_VC_CM_single -3.4E+38 3.4E+38 /end CHARACTERISTIC
/begin CHARACTERISTIC KeTRSC_k_TadPidPGainMult "TAD PID P gain multiplier for non-zero Knob angle" VALUE 0x0000 /* @ECU_Address@KeTRSC_k_TadPidPGainMult@ */ Scalar_FLOAT32_IEEE 0 TRSC_VC_CM_single 1.0 100.0 /end CHARACTERISTIC
/begin CHARACTERISTIC KeTRSC_k_TrqConstRateLim "Constant Rate Limit for Torque " VALUE 0x0000 /* @ECU_Address@KeTRSC_k_TrqConstRateLim@ */ Scalar_FLOAT32_IEEE 0 TRSC_VC_CM_single -3.4E+38 3.4E+38 /end CHARACTERISTIC
/begin CHARACTERISTIC KeTRSC_k_TrqConstSatLim "Constant Saturation Limit for Torque " VALUE 0x0000 /* @ECU_Address@KeTRSC_k_TrqConstSatLim@ */ Scalar_FLOAT32_IEEE 0 TRSC_VC_CM_single -3.4E+38 3.4E+38 /end CHARACTERISTIC
/begin CHARACTERISTIC KeTRSC_k_TrqCtrlDMultiplier "Torque controller D multiplier" VAL_BLK 0x0000 /* @ECU_Address@KeTRSC_k_TrqCtrlDMultiplier@ */ Scalar_FLOAT32_IEEE 0 TRSC_VC_CM_single -3.4E+38 3.4E+38 NUMBER 4 /end CHARACTERISTIC
/begin CHARACTERISTIC KeTRSC_k_TrqCtrlIMultiplier "Torque controller I multiplier" VAL_BLK 0x0000 /* @ECU_Address@KeTRSC_k_TrqCtrlIMultiplier@ */ Scalar_FLOAT32_IEEE 0 TRSC_VC_CM_single -3.4E+38 3.4E+38 NUMBER 4 /end CHARACTERISTIC
/begin CHARACTERISTIC KeTRSC_k_TrqCtrlPMultiplierT1 "Torque controller P multiplier" VAL_BLK 0x0000 /* @ECU_Address@KeTRSC_k_TrqCtrlPMultiplierT1@ */ Scalar_FLOAT32_IEEE 0 TRSC_VC_CM_single -3.4E+38 3.4E+38 NUMBER 4 /end CHARACTERISTIC
/begin CHARACTERISTIC KeTRSC_k_TrqCtrlPMultiplierT2or3 "Torque controller P multiplier" VAL_BLK 0x0000 /* @ECU_Address@KeTRSC_k_TrqCtrlPMultiplierT2or3@ */ Scalar_FLOAT32_IEEE 0 TRSC_VC_CM_single -3.4E+38 3.4E+38 NUMBER 4 /end CHARACTERISTIC
/begin CHARACTERISTIC KeTRSC_m_HardcodedTBL "Hardcoded TBL value" VALUE 0x0000 /* @ECU_Address@KeTRSC_m_HardcodedTBL@ */ Scalar_FLOAT32_IEEE 0 TRSC_VC_CM_single -3.4E+38 3.4E+38 /end CHARACTERISTIC
/begin CHARACTERISTIC KeTRSC_m_SprLimitTBLThr "Trailer Beam Length Upper Limit" VALUE 0x0000 /* @ECU_Address@KeTRSC_m_SprLimitTBLThr@ */ Scalar_FLOAT32_IEEE 0 TRSC_VC_CM_single -3.4E+38 3.4E+38 /end CHARACTERISTIC
/begin CHARACTERISTIC KeTRSC_m_SprLimitTBLThr1 "Trailer Beam Length Upper Limit" VALUE 0x0000 /* @ECU_Address@KeTRSC_m_SprLimitTBLThr1@ */ Scalar_FLOAT32_IEEE 0 TRSC_VC_CM_single -3.4E+38 3.4E+38 /end CHARACTERISTIC
/begin CHARACTERISTIC KeTRSC_pct_4kphSpdThr "Percentage Threshold for 4 kph Speed Limit Req" VALUE 0x0000 /* @ECU_Address@KeTRSC_pct_4kphSpdThr@ */ Scalar_FLOAT32_IEEE 0 TRSC_VC_CM_single -3.4E+38 3.4E+38 /end CHARACTERISTIC
/begin CHARACTERISTIC KeTRSC_pct_5kphSpdThr "Percentage Threshold for 5 kph Speed Limit Req" VALUE 0x0000 /* @ECU_Address@KeTRSC_pct_5kphSpdThr@ */ Scalar_FLOAT32_IEEE 0 TRSC_VC_CM_single -3.4E+38 3.4E+38 /end CHARACTERISTIC
/begin CHARACTERISTIC KeTRSC_pct_6kphSpdThr "Percentage Threshold for 6 kph Speed Limit Req" VALUE 0x0000 /* @ECU_Address@KeTRSC_pct_6kphSpdThr@ */ Scalar_FLOAT32_IEEE 0 TRSC_VC_CM_single -3.4E+38 3.4E+38 /end CHARACTERISTIC
/begin CHARACTERISTIC KeTRSC_pct_7kphSpdThr "Percentage Threshold for 7 kph Speed Limit Req" VALUE 0x0000 /* @ECU_Address@KeTRSC_pct_7kphSpdThr@ */ Scalar_FLOAT32_IEEE 0 TRSC_VC_CM_single -3.4E+38 3.4E+38 /end CHARACTERISTIC
/begin CHARACTERISTIC KeTRSC_pct_8kphSpdThr "Percentage Threshold for 8 kph Speed Limit Req" VALUE 0x0000 /* @ECU_Address@KeTRSC_pct_8kphSpdThr@ */ Scalar_FLOAT32_IEEE 0 TRSC_VC_CM_single -3.4E+38 3.4E+38 /end CHARACTERISTIC
/begin CHARACTERISTIC KeTRSC_pct_9kphSpdThr "Percentage Threshold for 8 kph Speed Limit Req" VALUE 0x0000 /* @ECU_Address@KeTRSC_pct_9kphSpdThr@ */ Scalar_FLOAT32_IEEE 0 TRSC_VC_CM_single -3.4E+38 3.4E+38 /end CHARACTERISTIC
/begin CHARACTERISTIC KeTRSC_pct_JackKnifePerc "JackKnife Angle Percentage" VALUE 0x0000 /* @ECU_Address@KeTRSC_pct_JackKnifePerc@ */ Scalar_FLOAT32_IEEE 0 TRSC_VC_CM_single 0.0 95.0 /end CHARACTERISTIC
/begin CHARACTERISTIC KeTRSC_pct_StrCornerCaseThr "Percentage Max Steering wheel angle threshold for corner case" VALUE 0x0000 /* @ECU_Address@KeTRSC_pct_StrCornerCaseThr@ */ Scalar_FLOAT32_IEEE 0 TRSC_VC_CM_single -3.4E+38 3.4E+38 /end CHARACTERISTIC
/begin CHARACTERISTIC KeTRSC_s_HeldThreshold "Time threshold to ensure user is actually requesting knob zero
      " VALUE 0x0000 /* @ECU_Address@KeTRSC_s_HeldThreshold@ */ Scalar_FLOAT32_IEEE 0 TRSC_VC_CM_single -3.4E+38 3.4E+38 /end CHARACTERISTIC
/begin CHARACTERISTIC KeTRSC_s_TblKmDelay "Systemic delay for KM signal i.e. speed and yaw specified in seconds" VALUE 0x0000 /* @ECU_Address@KeTRSC_s_TblKmDelay@ */ Scalar_FLOAT32_IEEE 0 TRSC_VC_CM_single -3.4E+38 3.4E+38 /end CHARACTERISTIC
/begin CHARACTERISTIC KeTRSC_s_TwitchTime "KeTRSC_s_TwitchTime" VALUE 0x0000 /* @ECU_Address@KeTRSC_s_TwitchTime@ */ Scalar_FLOAT32_IEEE 0 TRSC_VC_CM_single_sec -3.4E+38 3.4E+38 /end CHARACTERISTIC
/begin CHARACTERISTIC KeTRSC_sec_CornerCaseLatchLimit "Corner case latch limit
      " VALUE 0x0000 /* @ECU_Address@KeTRSC_sec_CornerCaseLatchLimit@ */ Scalar_FLOAT32_IEEE 0 TRSC_VC_CM_single -3.4E+38 3.4E+38 /end CHARACTERISTIC
/begin CHARACTERISTIC KeTRSC_sec_CornerCaseTimeLimit "Corner case identification limit
      " VALUE 0x0000 /* @ECU_Address@KeTRSC_sec_CornerCaseTimeLimit@ */ Scalar_FLOAT32_IEEE 0 TRSC_VC_CM_single -3.4E+38 3.4E+38 /end CHARACTERISTIC
/begin CHARACTERISTIC CeConst_k_ConstOneInt16 "" VALUE 0x0000 /* @ECU_Address@CeConst_k_ConstOneInt16@ */ Scalar_SWORD 0 TRSC_VC_CM_int16 -32768 32767 /end CHARACTERISTIC
/begin CHARACTERISTIC CeTRSC_deg_KnobHysLowLim " Lower Limit of Threshold value for Knob Hysteresis" VALUE 0x0000 /* @ECU_Address@CeTRSC_deg_KnobHysLowLim@ */ Scalar_SWORD 0 TRSC_VC_CM_int16 -32768 32767 /end CHARACTERISTIC
/begin CHARACTERISTIC CeTRSC_deg_KnobHysUpLim "Upper Limit of Threshold value for Knob Hysteresis" VALUE 0x0000 /* @ECU_Address@CeTRSC_deg_KnobHysUpLim@ */ Scalar_SWORD 0 TRSC_VC_CM_int16 -32768 32767 /end CHARACTERISTIC
/begin CHARACTERISTIC KeTRSC_deg_ZeroInt16 "lower saturation value for Trailer Protection Angle " VALUE 0x0000 /* @ECU_Address@KeTRSC_deg_ZeroInt16@ */ Scalar_SWORD 0 TRSC_VC_CM_int16 -32768 32767 /end CHARACTERISTIC
/begin CHARACTERISTIC KeTRSC_deg_ZeroPadUpThr "" VALUE 0x0000 /* @ECU_Address@KeTRSC_deg_ZeroPadUpThr@ */ Scalar_SWORD 0 TRSC_VC_CM_int16_deg 0.0 10.0 /end CHARACTERISTIC
/begin CHARACTERISTIC CeTRSC_deg_MaxKnobAngleLowLim "Maximum Knob Angle Lower Limit" VALUE 0x0000 /* @ECU_Address@CeTRSC_deg_MaxKnobAngleLowLim@ */ Scalar_UWORD 0 TRSC_VC_CM_uint16 0.0 360.0 /end CHARACTERISTIC
/begin CHARACTERISTIC CeTRSC_deg_MaxKnobAngleUpLim "Maximum Knob Angle Upper Limit" VALUE 0x0000 /* @ECU_Address@CeTRSC_deg_MaxKnobAngleUpLim@ */ Scalar_UWORD 0 TRSC_VC_CM_uint16 0.0 360.0 /end CHARACTERISTIC
/begin CHARACTERISTIC CeTRSC_k_MaxJumpSizeLowLim "Lower limit of Max Jump Size for Raw Knob Count" VALUE 0x0000 /* @ECU_Address@CeTRSC_k_MaxJumpSizeLowLim@ */ Scalar_UWORD 0 TRSC_VC_CM_uint16 0 65535 /end CHARACTERISTIC
/begin CHARACTERISTIC CeTRSC_k_MaxJumpSizeUpLim "Upper limit of Max Jump Size for Raw Knob Count" VALUE 0x0000 /* @ECU_Address@CeTRSC_k_MaxJumpSizeUpLim@ */ Scalar_UWORD 0 TRSC_VC_CM_uint16 0 65535 /end CHARACTERISTIC
/begin CHARACTERISTIC KeTRSC_k_MaxJumpSize "Max Jump Size for Raw Knob Count" VALUE 0x0000 /* @ECU_Address@KeTRSC_k_MaxJumpSize@ */ Scalar_UWORD 0 TRSC_VC_CM_uint16 0 65535 /end CHARACTERISTIC
/begin CHARACTERISTIC CeKM_b_False "Relative angle Covariance" VALUE 0x0000 /* @ECU_Address@CeKM_b_False@ */ Scalar_BOOLEAN 0 TRSC_VC_CM_boolean 0 1 /end CHARACTERISTIC
/begin CHARACTERISTIC CeKM_b_True "array of zeros for initialiation" VALUE 0x0000 /* @ECU_Address@CeKM_b_True@ */ Scalar_BOOLEAN 0 TRSC_VC_CM_boolean 0 1 /end CHARACTERISTIC
/begin CHARACTERISTIC KeTRSC_b_ForceJKCalc "Force JK calculation" VALUE 0x0000 /* @ECU_Address@KeTRSC_b_ForceJKCalc@ */ Scalar_BOOLEAN 0 TRSC_VC_CM_boolean 0 1 /end CHARACTERISTIC
/begin CHARACTERISTIC KeTRSC_b_HardcodeTBLflag "Flag to enable/disable TBL hardcoding" VALUE 0x0000 /* @ECU_Address@KeTRSC_b_HardcodeTBLflag@ */ Scalar_BOOLEAN 0 TRSC_VC_CM_boolean 0 1 /end CHARACTERISTIC
/begin CHARACTERISTIC OTBL_EN "" VALUE 0x0000 /* @ECU_Address@OTBL_EN@ */ Scalar_BOOLEAN 0 TRSC_VC_CM_boolean 0 1 /end CHARACTERISTIC
/begin CHARACTERISTIC CeConst_k_ConstThreeUint8 "" VALUE 0x0000 /* @ECU_Address@CeConst_k_ConstThreeUint8@ */ Scalar_UBYTE 0 TRSC_VC_CM_uint8 0 255 /end CHARACTERISTIC
/begin CHARACTERISTIC CeConst_k_ConstTwoUint8 "" VALUE 0x0000 /* @ECU_Address@CeConst_k_ConstTwoUint8@ */ Scalar_UBYTE 0 TRSC_VC_CM_uint8 0 255 /end CHARACTERISTIC
/begin CHARACTERISTIC CeKM_k_ConstFour "Gear number four" VALUE 0x0000 /* @ECU_Address@CeKM_k_ConstFour@ */ Scalar_UBYTE 0 TRSC_VC_CM_uint8 0 255 /end CHARACTERISTIC
/begin MEASUREMENT KM_MABx.IeLSCAN_m_HV_X "" FLOAT32_IEEE TRSC_VC_CM_single 0 0 -3.4E+38 3.4E+38 ECU_ADDRESS 0x0000 /* @ECU_Address@KM_MABx.IeLSCAN_m_HV_X@ */ /end MEASUREMENT
/begin MEASUREMENT KM_MABx.IeLSCAN_m_HV_Y "" FLOAT32_IEEE TRSC_VC_CM_single 0 0 -3.4E+38 3.4E+38 ECU_ADDRESS 0x0000 /* @ECU_Address@KM_MABx.IeLSCAN_m_HV_Y@ */ /end MEASUREMENT
/begin MEASUREMENT KM_MABx.IeLSCAN_deg_HV_H "" FLOAT32_IEEE TRSC_VC_CM_single 0 0 -3.4E+38 3.4E+38 ECU_ADDRESS 0x0000 /* @ECU_Address@KM_MABx.IeLSCAN_deg_HV_H@ */ /end MEASUREMENT
/begin MEASUREMENT KM_MABx.IeLSCAN_m_TX "" FLOAT32_IEEE TRSC_VC_CM_single 0 0 -3.4E+38 3.4E+38 ECU_ADDRESS 0x0000 /* @ECU_Address@KM_MABx.IeLSCAN_m_TX@ */ /end MEASUREMENT
/begin MEASUREMENT KM_MABx.IeLSCAN_m_TY "" FLOAT32_IEEE TRSC_VC_CM_single 0 0 -3.4E+38 3.4E+38 ECU_ADDRESS 0x0000 /* @ECU_Address@KM_MABx.IeLSCAN_m_TY@ */ /end MEASUREMENT
/begin MEASUREMENT KM_MABx.IeLSCAN_deg_TH "" FLOAT32_IEEE TRSC_VC_CM_single 0 0 -3.4E+38 3.4E+38 ECU_ADDRESS 0x0000 /* @ECU_Address@KM_MABx.IeLSCAN_deg_TH@ */ /end MEASUREMENT
/begin MEASUREMENT IeLSCAN_m_TrailerBeamLen "IeLSCAN_m_TrailerBeamLen" FLOAT32_IEEE TRSC_VC_CM_single 0 0 -3.4E+38 3.4E+38 ECU_ADDRESS 0x0000 /* @ECU_Address@IeLSCAN_m_TrailerBeamLen@ */ /end MEASUREMENT
/begin MEASUREMENT MeCtrl_deg_THInit "MeCtrl_deg_THInit" FLOAT32_IEEE TRSC_VC_CM_single 0 0 -3.4E+38 3.4E+38 ECU_ADDRESS 0x0000 /* @ECU_Address@MeCtrl_deg_THInit@ */ /end MEASUREMENT
/begin MEASUREMENT MeCtrl_deg_HdgDevLookup "MeCtrl_deg_HdgDevLookup" FLOAT32_IEEE TRSC_VC_CM_single 0 0 -3.4E+38 3.4E+38 ECU_ADDRESS 0x0000 /* @ECU_Address@MeCtrl_deg_HdgDevLookup@ */ /end MEASUREMENT
/begin MEASUREMENT MeCtrl_deg_TAD_des "MeCtrl_deg_TAD_des" FLOAT32_IEEE TRSC_VC_CM_single 0 0 -3.4E+38 3.4E+38 ECU_ADDRESS 0x0000 /* @ECU_Address@MeCtrl_deg_TAD_des@ */ /end MEASUREMENT
/begin MEASUREMENT MeCtrl_deg_TAD_error "MeCtrl_deg_TAD_error" FLOAT32_IEEE TRSC_VC_CM_single 0 0 -3.4E+38 3.4E+38 ECU_ADDRESS 0x0000 /* @ECU_Address@MeCtrl_deg_TAD_error@ */ /end MEASUREMENT
/begin MEASUREMENT MeTRSC_deg_TrlrAngKnob "MeTRSC_deg_TrlrAngKnob" FLOAT32_IEEE TRSC_VC_CM_single 0 0 -3.4E+38 3.4E+38 ECU_ADDRESS 0x0000 /* @ECU_Address@MeTRSC_deg_TrlrAngKnob@ */ /end MEASUREMENT
/begin MEASUREMENT MeCtrl_deg_TAD_PID "Intermediate signal for Trailer Angle Detect for PID" FLOAT32_IEEE TRSC_VC_CM_single_deg 0 0 -3.4E+38 3.4E+38 ECU_ADDRESS 0x0000 /* @ECU_Address@MeCtrl_deg_TAD_PID@ */ /end MEASUREMENT
/begin MEASUREMENT MeCtrl_deg_SteerAngIn "MeCtrl_deg_SteerAngIn" FLOAT32_IEEE TRSC_VC_CM_single 0 0 -3.4E+38 3.4E+38 ECU_ADDRESS 0x0000 /* @ECU_Address@MeCtrl_deg_SteerAngIn@ */ /end MEASUREMENT
/begin MEASUREMENT MeCtrl_deg_SteerCMD "MeCtrl_deg_SteerCMD" FLOAT32_IEEE TRSC_VC_CM_single 0 0 -3.4E+38 3.4E+38 ECU_ADDRESS 0x0000 /* @ECU_Address@MeCtrl_deg_SteerCMD@ */ /end MEASUREMENT
/begin MEASUREMENT StrCmd "StrCmd" FLOAT32_IEEE TRSC_VC_CM_single 0 0 -3.4E+38 3.4E+38 ECU_ADDRESS 0x0000 /* @ECU_Address@StrCmd@ */ /end MEASUREMENT
/begin MEASUREMENT StrRpt "StrRpt" FLOAT32_IEEE TRSC_VC_CM_single 0 0 -3.4E+38 3.4E+38 ECU_ADDRESS 0x0000 /* @ECU_Address@StrRpt@ */ /end MEASUREMENT
/begin MEASUREMENT MeTRSC_s_TwitchTmr "MeTRSC_s_TwitchTmr" FLOAT32_IEEE TRSC_VC_CM_single 0 0 -3.4E+38 3.4E+38 ECU_ADDRESS 0x0000 /* @ECU_Address@MeTRSC_s_TwitchTmr@ */ /end MEASUREMENT
/begin MEASUREMENT MeTRSC_e_IdentifiedCase "MeTRSC_e_IdentifiedCase" FLOAT32_IEEE TRSC_VC_CM_single 0 0 -3.4E+38 3.4E+38 ECU_ADDRESS 0x0000 /* @ECU_Address@MeTRSC_e_IdentifiedCase@ */ /end MEASUREMENT
/begin MEASUREMENT MeCtrl_m_TravelDist "MeCtrl_m_TravelDist" FLOAT32_IEEE TRSC_VC_CM_single 0 0 -3.4E+38 3.4E+38 ECU_ADDRESS 0x0000 /* @ECU_Address@MeCtrl_m_TravelDist@ */ /end MEASUREMENT
/begin MEASUREMENT MeCtrl_deg_PIDe_p "MeCtrl_deg_PIDe_p" FLOAT32_IEEE TRSC_VC_CM_single 0 0 -3.4E+38 3.4E+38 ECU_ADDRESS 0x0000 /* @ECU_Address@MeCtrl_deg_PIDe_p@ */ /end MEASUREMENT
/begin MEASUREMENT MeTRA_deg_PathDeviation "MeTRA_deg_PathDeviation" FLOAT32_IEEE TRSC_VC_CM_single 0 0 -3.4E+38 3.4E+38 ECU_ADDRESS 0x0000 /* @ECU_Address@MeTRA_deg_PathDeviation@ */ /end MEASUREMENT
/begin MEASUREMENT MeCtrl_deg_HeadingOut "Intermediate signal for Heading Output" FLOAT32_IEEE TRSC_VC_CM_single_deg 0 0 -3.4E+38 3.4E+38 ECU_ADDRESS 0x0000 /* @ECU_Address@MeCtrl_deg_HeadingOut@ */ /end MEASUREMENT
/begin MEASUREMENT MeCtrl_deg_e_p "Intermediate signal for error" FLOAT32_IEEE TRSC_VC_CM_single_deg 0 0 -3.4E+38 3.4E+38 ECU_ADDRESS 0x0000 /* @ECU_Address@MeCtrl_deg_e_p@ */ /end MEASUREMENT
/begin MEASUREMENT MeCtrl_deg_HeadingDeviation "Intermediate signal for Heading Deviation" FLOAT32_IEEE TRSC_VC_CM_single_deg 0 0 -3.4E+38 3.4E+38 ECU_ADDRESS 0x0000 /* @ECU_Address@MeCtrl_deg_HeadingDeviation@ */ /end MEASUREMENT
/begin MEASUREMENT MeTRSC_deg_RawDesTrlrAng "Intermediate signal for Raw value of desired trailer angle" FLOAT32_IEEE TRSC_VC_CM_single 0 0 -3.4E+38 3.4E+38 ECU_ADDRESS 0x0000 /* @ECU_Address@MeTRSC_deg_RawDesTrlrAng@ */ /end MEASUREMENT
/begin MEASUREMENT IeLSCAN_v_VehSp_pulse "IeLSCAN_v_VehSp_pulse" FLOAT32_IEEE TRSC_VC_CM_single 0 0 -3.4E+38 3.4E+38 ECU_ADDRESS 0x0000 /* @ECU_Address@IeLSCAN_v_VehSp_pulse@ */ /end MEASUREMENT
/begin MEASUREMENT MeKM_deg_GyroYawRate "MeKM_deg_GyroYawRate" FLOAT32_IEEE TRSC_VC_CM_single 0 0 -3.4E+38 3.4E+38 ECU_ADDRESS 0x0000 /* @ECU_Address@MeKM_deg_GyroYawRate@ */ /end MEASUREMENT
/begin MEASUREMENT JackKnifeAngle_deg "JackKnifeAngle_deg" FLOAT32_IEEE TRSC_VC_CM_single 0 0 -3.4E+38 3.4E+38 ECU_ADDRESS 0x0000 /* @ECU_Address@JackKnifeAngle_deg@ */ /end MEASUREMENT
/begin MEASUREMENT MeTRSC_deg_KnobAngHys "Intermediate signal for Knob Angle (Output of knob hysteresis logic)" SWORD TRSC_VC_CM_int16_deg 0 0 -32768 32767 ECU_ADDRESS 0x0000 /* @ECU_Address@MeTRSC_deg_KnobAngHys@ */ /end MEASUREMENT
/begin MEASUREMENT MeTRSC_b_TRAAct "TRA ACT" UBYTE TRSC_VC_CM_boolean_inherit 0 0 0.0 0.0 ECU_ADDRESS 0x0000 /* @ECU_Address@MeTRSC_b_TRAAct@ */ /end MEASUREMENT
/begin MEASUREMENT MeOTBL_b_Enable_1 "MeOTBL_b_Enable_1" UBYTE TRSC_VC_CM_boolean 0 0 0 1 ECU_ADDRESS 0x0000 /* @ECU_Address@MeOTBL_b_Enable_1@ */ /end MEASUREMENT
/begin MEASUREMENT MeOTBL_b_Enable "MeOTBL_b_Enable" UBYTE TRSC_VC_CM_boolean 0 0 0 1 ECU_ADDRESS 0x0000 /* @ECU_Address@MeOTBL_b_Enable@ */ /end MEASUREMENT
/begin MEASUREMENT MeTRSC_b_TwitchCompleted "MeTRSC_b_TwitchCompleted" UBYTE TRSC_VC_CM_boolean 0 0 0 1 ECU_ADDRESS 0x0000 /* @ECU_Address@MeTRSC_b_TwitchCompleted@ */ /end MEASUREMENT
/begin COMPU_METHOD TRSC_VC_CM_single "Q = V" RAT_FUNC "%8.6" "" COEFFS 0 1 0 0 0 1 /end COMPU_METHOD
/begin COMPU_METHOD TRSC_VC_CM_single_m "Q = V" RAT_FUNC "%8.6" "m" COEFFS 0 1 0 0 0 1 /end COMPU_METHOD
/begin COMPU_METHOD TRSC_VC_CM_single_mps "Q = V" RAT_FUNC "%8.6" "mps" COEFFS 0 1 0 0 0 1 /end COMPU_METHOD
/begin COMPU_METHOD TRSC_VC_CM_single_deg "Q = V" RAT_FUNC "%8.6" "deg" COEFFS 0 1 0 0 0 1 /end COMPU_METHOD
/begin COMPU_METHOD TRSC_VC_CM_single_sec "Q = V" RAT_FUNC "%8.6" "sec" COEFFS 0 1 0 0 0 1 /end COMPU_METHOD
/begin COMPU_METHOD TRSC_VC_CM_single_nm "Q = V" RAT_FUNC "%8.6" "nm" COEFFS 0 1 0 0 0 1 /end COMPU_METHOD
/begin COMPU_METHOD TRSC_VC_CM_single_ddeg_s "Q = V" RAT_FUNC "%8.6" "ddeg/s" COEFFS 0 1 0 0 0 1 /end COMPU_METHOD
/begin COMPU_METHOD TRSC_VC_CM_single_deg_sec "Q = V" RAT_FUNC "%8.6" "deg/sec" COEFFS 0 1 0 0 0 1 /end COMPU_METHOD
/begin COMPU_METHOD TRSC_VC_CM_int16 "Q = V" RAT_FUNC "%5.0" "" COEFFS 0 1 0 0 0 1 /end COMPU_METHOD
/begin COMPU_METHOD TRSC_VC_CM_int16_deg "Q = V" RAT_FUNC "%5.0" "deg" COEFFS 0 1 0 0 0 1 /end COMPU_METHOD
/begin COMPU_METHOD TRSC_VC_CM_uint16 "Q = V" RAT_FUNC "%5.0" "" COEFFS 0 1 0 0 0 1 /end COMPU_METHOD
/begin COMPU_METHOD TRSC_VC_CM_boolean "Q = V" RAT_FUNC "%1.0" "" COEFFS 0 1 0 0 0 1 /end COMPU_METHOD
/begin COMPU_METHOD TRSC_VC_CM_uint8 "Q = V" RAT_FUNC "%3.0" "" COEFFS 0 1 0 0 0 1 /end COMPU_METHOD
/begin COMPU_METHOD TRSC_VC_CM_boolean_inherit "Q = V" RAT_FUNC "%1.0" "inherit" COEFFS 0 1 0 0 0 1 /end COMPU_METHOD
/begin GROUP TRSC_VC "TRSC_VC" /* Root */ ROOT /begin SUB_GROUP Root_TRSC_VC2 /end SUB_GROUP /end GROUP
/begin GROUP Root_TRSC_VC2 "TRSC_VC/TRSC_VC2"
 /begin SUB_GROUP S1_JackKnife_Angle_ S1_Kinematic_Model S1_Knob_Sensing S1_Torque_Control S1_Trailer_Beam_Length1 S1_VehicleActivation /end SUB_GROUP
 /begin REF_CHARACTERISTIC KeTRSC_b_ForceJKCalc KeTRSC_b_HardcodeTBLflag KeTRSC_deg_Zero KeTRSC_m_HardcodedTBL /end REF_CHARACTERISTIC
/end GROUP
/begin GROUP S1_JackKnife_Angle_ "TRSC_VC/TRSC_VC2/JackKnife Angle " /begin REF_MEASUREMENT JackKnifeAngle_deg /end REF_MEASUREMENT /end GROUP
/begin GROUP S1_Kinematic_Model "TRSC_VC/TRSC_VC2/Kinematic Model" /begin SUB_GROUP KM_MABx S8_Kinematic_model /end SUB_GROUP /begin REF_CHARACTERISTIC KeTRSC_deg_Zero /end REF_CHARACTERISTIC /end GROUP
/begin GROUP S1_Knob_Sensing "TRSC_VC/TRSC_VC2/Knob_Sensing" /begin SUB_GROUP S9_DesiredTrailerAngleComp S9_KnobHysteresis /end SUB_GROUP
 /begin REF_CHARACTERISTIC CeTRSC_deg_MaxKnobAngleLowLim CeTRSC_deg_MaxKnobAngleUpLim CeTRSC_k_MaxJumpSizeLowLim CeTRSC_k_MaxJumpSizeUpLim KeTRSC_deg_Zero KeTRSC_k_MaxJumpSize /end REF_CHARACTERISTIC
/end GROUP
/begin GROUP S1_Torque_Control "TRSC_VC/TRSC_VC2/Torque Control" /begin SUB_GROUP S17_VehicleControl /end SUB_GROUP /end GROUP
/begin GROUP S1_Trailer_Beam_Length1 "TRSC_VC/TRSC_VC2/Trailer Beam Length1" /begin SUB_GROUP S18_Subsystem /end SUB_GROUP /end GROUP
/begin GROUP S1_VehicleActivation "TRSC_VC/TRSC_VC2/VehicleActivation" /begin REF_MEASUREMENT MeTRSC_b_TRAAct /end REF_MEASUREMENT /end GROUP
/begin GROUP S8_Kinematic_model "TRSC_VC/TRSC_VC2/Kinematic Model/Kinematic_model"
 /begin SUB_GROUP S24_KM_Gyro_YawRate S24_KM_Integrator_Trapazoidal S24_KM_Integrator_Trapazoidal1 S24_KM_Integrator_Trapazoidal2 S24_KM_Rear_Axle_ds S24_KM_Reset S24_KM_Wheel_Angle S24_KM_heading_angle S24_ME_EWMA_Float S24_Predict S24_TrailerPositionAndHeadingCalculation S24_YawRate S24_YawRateEnableCriteria S24_YawRateWhlRPMEn S24_YawRate_RPM S24_YawRate_RPM_Bias S24_x_Out /end SUB_GROUP
/end GROUP
/begin GROUP S9_DesiredTrailerAngleComp "TRSC_VC/TRSC_VC2/Knob_Sensing/DesiredTrailerAngleComp" /begin REF_MEASUREMENT MeTRSC_deg_RawDesTrlrAng /end REF_MEASUREMENT /end GROUP
/begin GROUP S9_KnobHysteresis "TRSC_VC/TRSC_VC2/Knob_Sensing/KnobHysteresis"
 /begin REF_CHARACTERISTIC CeConst_k_ConstOneInt16 CeTRSC_deg_KnobHysLowLim CeTRSC_deg_KnobHysUpLim KeTRSC_deg_ZeroInt16 KeTRSC_deg_ZeroPadUpThr /end REF_CHARACTERISTIC
 /begin REF_MEASUREMENT MeTRSC_deg_KnobAngHys /end REF_MEASUREMENT
/end GROUP
/begin GROUP S17_VehicleControl "TRSC_VC/TRSC_VC2/Torque Control/VehicleControl" /begin SUB_GROUP S108_Controller_Main2 S108_Controller_T_h_init /end SUB_GROUP /end GROUP
/begin GROUP S18_Subsystem "TRSC_VC/TRSC_VC2/Trailer Beam Length1/Subsystem"
 /begin SUB_GROUP S170_OTBL_Enable S170_OTBL_Enable1 S170_OnlineTrailerBeamLengthEstimation /end SUB_GROUP
 /begin REF_CHARACTERISTIC OTBL_EN /end REF_CHARACTERISTIC
 /begin REF_MEASUREMENT IeLSCAN_m_TrailerBeamLen /end REF_MEASUREMENT
/end GROUP
/begin GROUP S24_KM_Gyro_YawRate "TRSC_VC/TRSC_VC2/Kinematic Model/Kinematic_model/KM_Gyro_YawRate"
 /begin SUB_GROUP S28_Bias_Calculation_Enable_Criteria S28_Gyro_Measurement_Signal_Processing S28_Gyro_YawRate_Bias /end SUB_GROUP
 /begin REF_CHARACTERISTIC KeKM_k_KM_YawRateGyroBiasInit /end REF_CHARACTERISTIC
/end GROUP
/begin GROUP S24_KM_Integrator_Trapazoidal "TRSC_VC/TRSC_VC2/Kinematic Model/Kinematic_model/KM_Integrator_Trapazoidal" /begin REF_CHARACTERISTIC CeConst_k_ConstTwo /end REF_CHARACTERISTIC /end GROUP
/begin GROUP S24_KM_Integrator_Trapazoidal1 "TRSC_VC/TRSC_VC2/Kinematic Model/Kinematic_model/KM_Integrator_Trapazoidal1" /begin REF_CHARACTERISTIC CeConst_k_ConstTwo /end REF_CHARACTERISTIC /end GROUP
/begin GROUP S24_KM_Integrator_Trapazoidal2 "TRSC_VC/TRSC_VC2/Kinematic Model/Kinematic_model/KM_Integrator_Trapazoidal2" /begin REF_CHARACTERISTIC CeConst_k_ConstTwo /end REF_CHARACTERISTIC /end GROUP
/begin GROUP S24_KM_Rear_Axle_ds "TRSC_VC/TRSC_VC2/Kinematic Model/Kinematic_model/KM_Rear_Axle_ds" /begin REF_CHARACTERISTIC CeConst_k_ConstZero /end REF_CHARACTERISTIC /end GROUP
/begin GROUP S24_KM_Reset "TRSC_VC/TRSC_VC2/Kinematic Model/Kinematic_model/KM_Reset" /begin SUB_GROUP S33_reset_KM /end SUB_GROUP /begin REF_CHARACTERISTIC CeConst_k_ConstZero /end REF_CHARACTERISTIC /end GROUP
/begin GROUP S24_KM_Wheel_Angle "TRSC_VC/TRSC_VC2/Kinematic Model/Kinematic_model/KM_Wheel_Angle" /begin REF_CHARACTERISTIC CeConst_k_ConstOne CeConst_k_ConstZero /end REF_CHARACTERISTIC /end GROUP
/begin GROUP S24_KM_heading_angle "TRSC_VC/TRSC_VC2/Kinematic Model/Kinematic_model/KM_heading_angle"
 /begin REF_CHARACTERISTIC CeConst_k_ConstOne CeConst_k_ConstZero CeKM_deg_180 CeKM_deg_360 /end REF_CHARACTERISTIC
/end GROUP
/begin GROUP S24_ME_EWMA_Float "TRSC_VC/TRSC_VC2/Kinematic Model/Kinematic_model/ME_EWMA_Float" /begin REF_MEASUREMENT IeLSCAN_v_VehSp_pulse /end REF_MEASUREMENT /end GROUP
/begin GROUP S24_Predict "TRSC_VC/TRSC_VC2/Kinematic Model/Kinematic_model/Predict"
 /begin SUB_GROUP S38_StateTransitionFunction_Avg_tanAngle S38_StateTransitionFunction_x_next /end SUB_GROUP
/end GROUP
/begin GROUP S24_TrailerPositionAndHeadingCalculation "TRSC_VC/TRSC_VC2/Kinematic Model/Kinematic_model/TrailerPositionAndHeadingCalculation" /begin SUB_GROUP S39_Calc_T_H /end SUB_GROUP /end GROUP
/begin GROUP S24_YawRate "TRSC_VC/TRSC_VC2/Kinematic Model/Kinematic_model/YawRate" /begin REF_CHARACTERISTIC CeKM_deg_180 CeKM_k_pi /end REF_CHARACTERISTIC /end GROUP
/begin GROUP S24_YawRateEnableCriteria "TRSC_VC/TRSC_VC2/Kinematic Model/Kinematic_model/YawRateEnableCriteria" /begin REF_CHARACTERISTIC CeConst_k_ConstZero /end REF_CHARACTERISTIC /end GROUP
/begin GROUP S24_YawRateWhlRPMEn "TRSC_VC/TRSC_VC2/Kinematic Model/Kinematic_model/YawRateWhlRPMEn" /begin REF_CHARACTERISTIC CeConst_k_ConstOne CeConst_k_ConstZero /end REF_CHARACTERISTIC /end GROUP
/begin GROUP S24_YawRate_RPM "TRSC_VC/TRSC_VC2/Kinematic Model/Kinematic_model/YawRate_RPM"
 /begin REF_CHARACTERISTIC CeConst_k_ConstZero CeKM_b_False CeKM_b_True CeKM_deg_180 CeKM_k_pi /end REF_CHARACTERISTIC
/end GROUP
/begin GROUP S24_YawRate_RPM_Bias "TRSC_VC/TRSC_VC2/Kinematic Model/Kinematic_model/YawRate_RPM_Bias" /begin SUB_GROUP S47_Accumulator /end SUB_GROUP /begin REF_CHARACTERISTIC CeConst_k_ConstOne /end REF_CHARACTERISTIC /end GROUP
/begin GROUP S24_x_Out "TRSC_VC/TRSC_VC2/Kinematic Model/Kinematic_model/x_Out" /begin REF_CHARACTERISTIC CeConst_k_ConstTwo CeConst_k_ConstZero /end REF_CHARACTERISTIC /end GROUP
/begin GROUP S108_Controller_Main2 "TRSC_VC/TRSC_VC2/Torque Control/VehicleControl/Controller_Main2"
 /begin SUB_GROUP S109_Desired_angle_controller S109_FrontWheel_to_Steering1 S109_Heading_Deviation1 S109_Path_Deviation S109_Speed_Limit_Req S109_TAD_Error S109_TAD_PID1 S109_TAD_des1 S109_TAD_ep1 S109_TravDist_TrapIntegrator S109_TrqControl2 /end SUB_GROUP
 /begin REF_CHARACTERISTIC KeTRSC_deg_Zero /end REF_CHARACTERISTIC
/end GROUP
/begin GROUP S108_Controller_T_h_init "TRSC_VC/TRSC_VC2/Torque Control/VehicleControl/Controller_T_h_init" /begin SUB_GROUP S110_Calc_T_H_init /end SUB_GROUP /end GROUP
/begin GROUP S170_OTBL_Enable "TRSC_VC/TRSC_VC2/Trailer Beam Length1/Subsystem/OTBL_Enable" /begin REF_MEASUREMENT MeOTBL_b_Enable /end REF_MEASUREMENT /end GROUP
/begin GROUP S170_OTBL_Enable1 "TRSC_VC/TRSC_VC2/Trailer Beam Length1/Subsystem/OTBL_Enable1" /begin REF_MEASUREMENT MeOTBL_b_Enable_1 /end REF_MEASUREMENT /end GROUP
/begin GROUP S170_OnlineTrailerBeamLengthEstimation "TRSC_VC/TRSC_VC2/Trailer Beam Length1/Subsystem/OnlineTrailerBeamLengthEstimation" /begin SUB_GROUP S177_TrailerBeamLengthCalculation /end SUB_GROUP /end GROUP
/begin GROUP S28_Bias_Calculation_Enable_Criteria "TRSC_VC/TRSC_VC2/Kinematic Model/Kinematic_model/KM_Gyro_YawRate/Bias_Calculation_Enable_Criteria" /begin REF_CHARACTERISTIC CeConst_k_ConstOne CeConst_k_ConstZero /end REF_CHARACTERISTIC /end GROUP
/begin GROUP S28_Gyro_Measurement_Signal_Processing "TRSC_VC/TRSC_VC2/Kinematic Model/Kinematic_model/KM_Gyro_YawRate/Gyro_Measurement_Signal_Processing" /begin REF_CHARACTERISTIC CeConst_k_ConstZero /end REF_CHARACTERISTIC /begin REF_MEASUREMENT MeKM_deg_GyroYawRate /end REF_MEASUREMENT /end GROUP
/begin GROUP S28_Gyro_YawRate_Bias "TRSC_VC/TRSC_VC2/Kinematic Model/Kinematic_model/KM_Gyro_YawRate/Gyro_YawRate_Bias" /begin REF_CHARACTERISTIC CeConst_k_ConstOne /end REF_CHARACTERISTIC /end GROUP
/begin GROUP S33_reset_KM "TRSC_VC/TRSC_VC2/Kinematic Model/Kinematic_model/KM_Reset/reset_KM" /begin REF_CHARACTERISTIC CeKM_b_False /end REF_CHARACTERISTIC /end GROUP
/begin GROUP S38_StateTransitionFunction_Avg_tanAngle "TRSC_VC/TRSC_VC2/Kinematic Model/Kinematic_model/Predict/StateTransitionFunction_Avg_tanAngle"
 /begin SUB_GROUP S57_Enable_Average_Wheel_Angle_Calculation S57_ResettableSubsystem /end SUB_GROUP
/end GROUP
/begin GROUP S38_StateTransitionFunction_x_next "TRSC_VC/TRSC_VC2/Kinematic Model/Kinematic_model/Predict/StateTransitionFunction_x_next" /begin SUB_GROUP S58_X_next_2_ S58_X_next_2_1 S58_x_next_1_ S58_x_next_3_ /end SUB_GROUP /begin REF_CHARACTERISTIC CeKM_k_ArrayZeros /end REF_CHARACTERISTIC /end GROUP
/begin GROUP S39_Calc_T_H "TRSC_VC/TRSC_VC2/Kinematic Model/Kinematic_model/TrailerPositionAndHeadingCalculation/Calc_T_H" /begin SUB_GROUP S82_heading_angle /end SUB_GROUP /end GROUP
/begin GROUP S47_Accumulator "TRSC_VC/TRSC_VC2/Kinematic Model/Kinematic_model/YawRate_RPM_Bias/Accumulator" /begin REF_CHARACTERISTIC CeConst_k_ConstOne /end REF_CHARACTERISTIC /end GROUP
/begin GROUP S109_Desired_angle_controller "TRSC_VC/TRSC_VC2/Torque Control/VehicleControl/Controller_Main2/Desired_angle_controller" /begin REF_CHARACTERISTIC CeConst_k_ConstOne CeConst_ku_deg2rad /end REF_CHARACTERISTIC /end GROUP
/begin GROUP S109_FrontWheel_to_Steering1 "TRSC_VC/TRSC_VC2/Torque Control/VehicleControl/Controller_Main2/FrontWheel_to_Steering1" /begin SUB_GROUP S113_Dynamic_rate_limiter2 /end SUB_GROUP /begin REF_CHARACTERISTIC CeConst_k_ConstOne CeConst_k_ConstZero /end REF_CHARACTERISTIC /begin REF_MEASUREMENT MeCtrl_deg_SteerAngIn /end REF_MEASUREMENT /end GROUP
/begin GROUP S109_Heading_Deviation1 "TRSC_VC/TRSC_VC2/Torque Control/VehicleControl/Controller_Main2/Heading_Deviation1" /begin SUB_GROUP S114_heading_angle /end SUB_GROUP /begin REF_CHARACTERISTIC CeConst_k_ConstOne CeConst_k_ConstZero /end REF_CHARACTERISTIC /begin REF_MEASUREMENT MeCtrl_deg_HeadingDeviation MeCtrl_deg_e_p /end REF_MEASUREMENT /end GROUP
/begin GROUP S109_Path_Deviation "TRSC_VC/TRSC_VC2/Torque Control/VehicleControl/Controller_Main2/Path_Deviation" /begin REF_CHARACTERISTIC CeTRA_deg_AngleNinety /end REF_CHARACTERISTIC /begin REF_MEASUREMENT MeTRA_deg_PathDeviation /end REF_MEASUREMENT /end GROUP
/begin GROUP S109_Speed_Limit_Req "TRSC_VC/TRSC_VC2/Torque Control/VehicleControl/Controller_Main2/Speed Limit Req"
 /begin REF_CHARACTERISTIC CeConst_k_ConstThreeUint8 CeConst_k_ConstTwoUint8 KeTRSC_deg_TADErrSpdLmtLowThr KeTRSC_deg_TADErrSpdLmtMidThr KeTRSC_m_SprLimitTBLThr KeTRSC_m_SprLimitTBLThr1 KeTRSC_pct_4kphSpdThr KeTRSC_pct_5kphSpdThr KeTRSC_pct_6kphSpdThr KeTRSC_pct_7kphSpdThr KeTRSC_pct_8kphSpdThr KeTRSC_pct_9kphSpdThr /end REF_CHARACTERISTIC
/end GROUP
/begin GROUP S109_TAD_Error "TRSC_VC/TRSC_VC2/Torque Control/VehicleControl/Controller_Main2/TAD_Error" /begin SUB_GROUP S117_Dynamic_rate_limiter1 S117_Dynamic_rate_limiter2 /end SUB_GROUP
 /begin REF_CHARACTERISTIC KeTRSC_ddeg_TadDesRateLim KeTRSC_deg_TadErrSatLim KeTRSC_pct_JackKnifePerc KeTRSC_pct_TrlrAngScaleDwnPct /end REF_CHARACTERISTIC
 /begin REF_MEASUREMENT MeCtrl_deg_TAD_error MeTRSC_deg_TrlrAngKnob /end REF_MEASUREMENT
/end GROUP
/begin GROUP S109_TAD_PID1 "TRSC_VC/TRSC_VC2/Torque Control/VehicleControl/Controller_Main2/TAD_PID1" /begin SUB_GROUP S118_Discrete_PID_Controller /end SUB_GROUP
 /begin REF_CHARACTERISTIC CeConst_k_ConstOne CeTRA_k_ConstTen CeTRA_k_OnePerHundred CeTRA_sec_SampleTime KaTRA_k_PGainLUTTblData KeTRSC_k_TadPidPGainMult /end REF_CHARACTERISTIC
/end GROUP
/begin GROUP S109_TAD_des1 "TRSC_VC/TRSC_VC2/Torque Control/VehicleControl/Controller_Main2/TAD_des1" /begin SUB_GROUP S119_TAD_PID /end SUB_GROUP /begin REF_MEASUREMENT MeCtrl_deg_HdgDevLookup /end REF_MEASUREMENT /end GROUP
/begin GROUP S109_TAD_ep1 "TRSC_VC/TRSC_VC2/Torque Control/VehicleControl/Controller_Main2/TAD_ep1"
 /begin REF_CHARACTERISTIC CeTRA_k_ConstTen CeTRA_k_fifteen CeTRA_sec_SampleTime KeTRSC_k_PIDKdPathDeviation /end REF_CHARACTERISTIC
 /begin REF_MEASUREMENT MeCtrl_deg_PIDe_p /end REF_MEASUREMENT
/end GROUP
/begin GROUP S109_TravDist_TrapIntegrator "TRSC_VC/TRSC_VC2/Torque Control/VehicleControl/Controller_Main2/TravDist_TrapIntegrator" /begin REF_CHARACTERISTIC CeConst_k_ConstTwo CeTRA_sec_SampleTime /end REF_CHARACTERISTIC /begin REF_MEASUREMENT MeCtrl_m_TravelDist /end REF_MEASUREMENT /end GROUP
/begin GROUP S109_TrqControl2 "TRSC_VC/TRSC_VC2/Torque Control/VehicleControl/Controller_Main2/TrqControl2"
 /begin SUB_GROUP S122_THA_SteerTweakProfile_Processing2 S122_TrqControl1 S122_low_pass_filter /end SUB_GROUP
 /begin REF_CHARACTERISTIC KeTRSC_Nm_MaxTrqLim KeTRSC_deg_TadCornerCaseThr KeTRSC_deg_TwitchTrqRateLim KeTRSC_k_StrCtrlLPFFrequency KeTRSC_pct_StrCornerCaseThr KeTRSC_s_TwitchTime KeTRSC_sec_CornerCaseLatchLimit KeTRSC_sec_CornerCaseTimeLimit /end REF_CHARACTERISTIC
 /begin REF_MEASUREMENT MeTRSC_b_TwitchCompleted MeTRSC_e_IdentifiedCase MeTRSC_s_TwitchTmr StrRpt /end REF_MEASUREMENT
/end GROUP
/begin GROUP S110_Calc_T_H_init "TRSC_VC/TRSC_VC2/Torque Control/VehicleControl/Controller_T_h_init/Calc_T_H_init" /begin REF_CHARACTERISTIC CeConst_k_ConstZero /end REF_CHARACTERISTIC /begin REF_MEASUREMENT MeCtrl_deg_THInit /end REF_MEASUREMENT /end GROUP
/begin GROUP S177_TrailerBeamLengthCalculation "TRSC_VC/TRSC_VC2/Trailer Beam Length1/Subsystem/OnlineTrailerBeamLengthEstimation/TrailerBeamLengthCalculation" /begin SUB_GROUP S184_TBL_DataLog /end SUB_GROUP /end GROUP
/begin GROUP S57_Enable_Average_Wheel_Angle_Calculation "TRSC_VC/TRSC_VC2/Kinematic Model/Kinematic_model/Predict/StateTransitionFunction_Avg_tanAngle/Enable_Average_Wheel_Angle_Calculation"
 /begin REF_CHARACTERISTIC CeConst_k_ConstOne CeConst_k_ConstTwo CeConst_k_ConstZero CeKM_k_ConstFour /end REF_CHARACTERISTIC
/end GROUP
/begin GROUP S57_ResettableSubsystem "TRSC_VC/TRSC_VC2/Kinematic Model/Kinematic_model/Predict/StateTransitionFunction_Avg_tanAngle/ResettableSubsystem" /begin SUB_GROUP S60_AvgTanAngleCal /end SUB_GROUP /begin REF_CHARACTERISTIC CeConst_k_ConstOne /end REF_CHARACTERISTIC /end GROUP
/begin GROUP S58_X_next_2_ "TRSC_VC/TRSC_VC2/Kinematic Model/Kinematic_model/Predict/StateTransitionFunction_x_next/X_next(2)"
 /begin REF_CHARACTERISTIC CeConst_k_ConstOne CeConst_k_ConstTwo CeKM_deg_180 CeKM_k_pi /end REF_CHARACTERISTIC
/end GROUP
/begin GROUP S58_X_next_2_1 "TRSC_VC/TRSC_VC2/Kinematic Model/Kinematic_model/Predict/StateTransitionFunction_x_next/X_next(2)1"
 /begin REF_CHARACTERISTIC CeConst_k_ConstOne CeConst_k_ConstTwo CeKM_deg_180 CeKM_k_pi /end REF_CHARACTERISTIC
/end GROUP
/begin GROUP S58_x_next_1_ "TRSC_VC/TRSC_VC2/Kinematic Model/Kinematic_model/Predict/StateTransitionFunction_x_next/x_next(1)" /begin REF_CHARACTERISTIC CeKM_deg_180 CeKM_k_pi /end REF_CHARACTERISTIC /end GROUP
/begin GROUP S58_x_next_3_ "TRSC_VC/TRSC_VC2/Kinematic Model/Kinematic_model/Predict/StateTransitionFunction_x_next/x_next(3)" /begin REF_CHARACTERISTIC CeConst_k_ConstOne CeConst_k_ConstTwo /end REF_CHARACTERISTIC /end GROUP
/begin GROUP S82_heading_angle "TRSC_VC/TRSC_VC2/Kinematic Model/Kinematic_model/TrailerPositionAndHeadingCalculation/Calc_T_H/heading_angle"
 /begin REF_CHARACTERISTIC CeConst_k_ConstOne CeConst_k_ConstZero CeKM_deg_180 CeKM_deg_360 /end REF_CHARACTERISTIC
/end GROUP
/begin GROUP S113_Dynamic_rate_limiter2 "TRSC_VC/TRSC_VC2/Torque Control/VehicleControl/Controller_Main2/FrontWheel_to_Steering1/Dynamic_rate_limiter2" /begin REF_CHARACTERISTIC KM_SamplingTime /end REF_CHARACTERISTIC /begin REF_MEASUREMENT MeCtrl_deg_SteerCMD /end REF_MEASUREMENT /end GROUP
/begin GROUP S114_heading_angle "TRSC_VC/TRSC_VC2/Torque Control/VehicleControl/Controller_Main2/Heading_Deviation1/heading_angle"
 /begin REF_CHARACTERISTIC CeConst_k_ConstOne CeConst_k_ConstZero CeTRA_deg_AngleOneEighty CeTRA_deg_AngleThreeSixty /end REF_CHARACTERISTIC
 /begin REF_MEASUREMENT MeCtrl_deg_HeadingOut /end REF_MEASUREMENT
/end GROUP
/begin GROUP S117_Dynamic_rate_limiter1 "TRSC_VC/TRSC_VC2/Torque Control/VehicleControl/Controller_Main2/TAD_Error/Dynamic_rate_limiter1" /begin REF_CHARACTERISTIC KM_SamplingTime /end REF_CHARACTERISTIC /end GROUP
/begin GROUP S117_Dynamic_rate_limiter2 "TRSC_VC/TRSC_VC2/Torque Control/VehicleControl/Controller_Main2/TAD_Error/Dynamic_rate_limiter2" /begin REF_CHARACTERISTIC KM_SamplingTime /end REF_CHARACTERISTIC /end GROUP
/begin GROUP S118_Discrete_PID_Controller "TRSC_VC/TRSC_VC2/Torque Control/VehicleControl/Controller_Main2/TAD_PID1/Discrete_PID_Controller"
 /begin REF_CHARACTERISTIC CeConst_k_ConstOne CeConst_k_ConstZero KeTRSC_k_EnblJKPrevention /end REF_CHARACTERISTIC
 /begin REF_MEASUREMENT MeCtrl_deg_TAD_PID /end REF_MEASUREMENT
/end GROUP
/begin GROUP S119_TAD_PID "TRSC_VC/TRSC_VC2/Torque Control/VehicleControl/Controller_Main2/TAD_des1/TAD_PID" /begin REF_CHARACTERISTIC CeTRA_k_ConstTen CeTRA_sec_SampleTime /end REF_CHARACTERISTIC /begin REF_MEASUREMENT MeCtrl_deg_TAD_des /end REF_MEASUREMENT /end GROUP
/begin GROUP S122_THA_SteerTweakProfile_Processing2 "TRSC_VC/TRSC_VC2/Torque Control/VehicleControl/Controller_Main2/TrqControl2/THA_SteerTweakProfile_Processing2" /begin REF_CHARACTERISTIC KeTRSC_k_NumTwitchPulse /end REF_CHARACTERISTIC /end GROUP
/begin GROUP S122_TrqControl1 "TRSC_VC/TRSC_VC2/Torque Control/VehicleControl/Controller_Main2/TrqControl2/TrqControl1"
 /begin REF_CHARACTERISTIC CeTRA_sec_SampleTime KaTRSC_k_IntGainTDTyp1 KaTRSC_k_IntGainTDTyp2or3 KaTRSC_k_PGainLUTTDTyp1 KaTRSC_k_PGainLUTTDTyp2 KaTRSC_k_PGainLUTTDTyp3 KeTRSC_k_ErrSatLim KeTRSC_k_IntExtSat KeTRSC_k_StrRptLPFFrequency KeTRSC_k_TrqConstRateLim KeTRSC_k_TrqConstSatLim KeTRSC_k_TrqCtrlDMultiplier KeTRSC_k_TrqCtrlIMultiplier KeTRSC_k_TrqCtrlPMultiplierT1 KeTRSC_k_TrqCtrlPMultiplierT2or3 KeTRSC_s_HeldThreshold /end REF_CHARACTERISTIC
/end GROUP
/begin GROUP S122_low_pass_filter "TRSC_VC/TRSC_VC2/Torque Control/VehicleControl/Controller_Main2/TrqControl2/low_pass_filter" /begin REF_MEASUREMENT StrCmd /end REF_MEASUREMENT /end GROUP
/begin GROUP S184_TBL_DataLog "TRSC_VC/TRSC_VC2/Trailer Beam Length1/Subsystem/OnlineTrailerBeamLengthEstimation/TrailerBeamLengthCalculation/TBL_DataLog" /begin REF_CHARACTERISTIC CeTRSC_s_TRSCLpTm KeTRSC_s_TblKmDelay /end REF_CHARACTERISTIC /end GROUP
/begin GROUP S60_AvgTanAngleCal "TRSC_VC/TRSC_VC2/Kinematic Model/Kinematic_model/Predict/StateTransitionFunction_Avg_tanAngle/ResettableSubsystem/AvgTanAngleCal" /begin REF_CHARACTERISTIC CeConst_k_ConstZero /end REF_CHARACTERISTIC /end GROUP
/begin GROUP KM_MABx ""
 /begin REF_MEASUREMENT KM_MABx.IeLSCAN_deg_HV_H KM_MABx.IeLSCAN_deg_TH KM_MABx.IeLSCAN_m_HV_X KM_MABx.IeLSCAN_m_HV_Y KM_MABx.IeLSCAN_m_TX KM_MABx.IeLSCAN_m_TY /end REF_MEASUREMENT
/end GROUP
/end MODULE
/end PROJECT
/* (add any file trailer comments here) */
/* EOF TRSC_VC.a2l */
