/******************************************************************************
* ASAP2 file: TRSC_InputAdapter.a2l
* Code generation for model "TRSC_InputAdapter".
* Model version : 1.125
* Simulink Coder version : 9.2 (R2019b) 18-Jul-2019
* C source code generated on : Thu Nov 13 09:50:30 2025
* Target selection: ert.tlc
* Embedded hardware selection: ARM Compatible->ARM Cortex
* Code generation objectives:
* 1. MISRA C:2012 guidelines
* 2. RAM efficiency
* 3. ROM efficiency
* Validation result: Not run
* (add additional file header information here)
******************************************************************************/ ASAP2_VERSION 1 31
/* Version 1.31 */
/begin PROJECT ProjectName "Project Comment Goes Here"
/begin HEADER "Header Comments go here" /end HEADER
/begin MODULE ModuleName "Module Comment Goes Here"
/begin MOD_PAR "MOD PAR Comment Goes Here" /end MOD_PAR
/begin MOD_COMMON "Mod Common Comment Here" BYTE_ORDER MSB_LAST /end MOD_COMMON
/begin RECORD_LAYOUT Scalar_BOOLEAN FNC_VALUES 1 UBYTE COLUMN_DIR DIRECT /end RECORD_LAYOUT
/begin RECORD_LAYOUT Scalar_UBYTE FNC_VALUES 1 UBYTE COLUMN_DIR DIRECT /end RECORD_LAYOUT
/begin RECORD_LAYOUT Scalar_BYTE FNC_VALUES 1 SBYTE COLUMN_DIR DIRECT /end RECORD_LAYOUT
/begin RECORD_LAYOUT Scalar_UWORD FNC_VALUES 1 UWORD COLUMN_DIR DIRECT /end RECORD_LAYOUT
/begin RECORD_LAYOUT Scalar_SWORD FNC_VALUES 1 SWORD COLUMN_DIR DIRECT /end RECORD_LAYOUT
/begin RECORD_LAYOUT Scalar_ULONG FNC_VALUES 1 ULONG COLUMN_DIR DIRECT /end RECORD_LAYOUT
/begin RECORD_LAYOUT Scalar_LONG FNC_VALUES 1 SLONG COLUMN_DIR DIRECT /end RECORD_LAYOUT
/begin RECORD_LAYOUT Scalar_FLOAT32_IEEE FNC_VALUES 1 FLOAT32_IEEE COLUMN_DIR DIRECT /end RECORD_LAYOUT
/begin RECORD_LAYOUT Scalar_FLOAT64_IEEE FNC_VALUES 1 FLOAT64_IEEE COLUMN_DIR DIRECT /end RECORD_LAYOUT
/begin RECORD_LAYOUT Lookup1D_BOOLEAN FNC_VALUES 1 UBYTE COLUMN_DIR DIRECT /end RECORD_LAYOUT
/begin RECORD_LAYOUT Lookup1D_X_BOOLEAN AXIS_PTS_X 1 UBYTE INDEX_INCR DIRECT /end RECORD_LAYOUT
/begin RECORD_LAYOUT Lookup1D_BYTE FNC_VALUES 1 SBYTE COLUMN_DIR DIRECT /end RECORD_LAYOUT
/begin RECORD_LAYOUT Lookup1D_X_BYTE AXIS_PTS_X 1 SBYTE INDEX_INCR DIRECT /end RECORD_LAYOUT
/begin RECORD_LAYOUT Lookup1D_UBYTE FNC_VALUES 1 UBYTE COLUMN_DIR DIRECT /end RECORD_LAYOUT
/begin RECORD_LAYOUT Lookup1D_X_UBYTE AXIS_PTS_X 1 UBYTE INDEX_INCR DIRECT /end RECORD_LAYOUT
/begin RECORD_LAYOUT Lookup1D_UWORD FNC_VALUES 1 UWORD COLUMN_DIR DIRECT /end RECORD_LAYOUT
/begin RECORD_LAYOUT Lookup1D_X_UWORD AXIS_PTS_X 1 UWORD INDEX_INCR DIRECT /end RECORD_LAYOUT
/begin RECORD_LAYOUT Lookup1D_WORD FNC_VALUES 1 SWORD COLUMN_DIR DIRECT /end RECORD_LAYOUT
/begin RECORD_LAYOUT Lookup1D_X_WORD AXIS_PTS_X 1 SWORD INDEX_INCR DIRECT /end RECORD_LAYOUT
/begin RECORD_LAYOUT Lookup1D_ULONG FNC_VALUES 1 ULONG COLUMN_DIR DIRECT /end RECORD_LAYOUT
/begin RECORD_LAYOUT Lookup1D_X_ULONG AXIS_PTS_X 1 ULONG INDEX_INCR DIRECT /end RECORD_LAYOUT
/begin RECORD_LAYOUT Lookup1D_SLONG FNC_VALUES 1 SLONG COLUMN_DIR DIRECT /end RECORD_LAYOUT
/begin RECORD_LAYOUT Lookup1D_X_LONG AXIS_PTS_X 1 SLONG INDEX_INCR DIRECT /end RECORD_LAYOUT
/begin RECORD_LAYOUT Lookup1D_FLOAT32_IEEE FNC_VALUES 1 FLOAT32_IEEE COLUMN_DIR DIRECT /end RECORD_LAYOUT
/begin RECORD_LAYOUT Lookup1D_X_FLOAT32_IEEE AXIS_PTS_X 1 FLOAT32_IEEE INDEX_INCR DIRECT /end RECORD_LAYOUT
/begin RECORD_LAYOUT Lookup1D_FLOAT64_IEEE FNC_VALUES 1 FLOAT64_IEEE COLUMN_DIR DIRECT /end RECORD_LAYOUT
/begin RECORD_LAYOUT Lookup1D_X_FLOAT64_IEEE AXIS_PTS_X 1 FLOAT64_IEEE INDEX_INCR DIRECT /end RECORD_LAYOUT
/begin RECORD_LAYOUT Lookup2D_BOOLEAN FNC_VALUES 1 UBYTE COLUMN_DIR DIRECT /end RECORD_LAYOUT
/begin RECORD_LAYOUT Lookup2D_X_BOOLEAN AXIS_PTS_X 1 UBYTE INDEX_INCR DIRECT /end RECORD_LAYOUT
/begin RECORD_LAYOUT Lookup2D_UBYTE FNC_VALUES 1 UBYTE COLUMN_DIR DIRECT /end RECORD_LAYOUT
/begin RECORD_LAYOUT Lookup2D_X_UBYTE AXIS_PTS_X 1 UBYTE INDEX_INCR DIRECT /end RECORD_LAYOUT
/begin RECORD_LAYOUT Lookup2D_BYTE FNC_VALUES 1 SBYTE COLUMN_DIR DIRECT /end RECORD_LAYOUT
/begin RECORD_LAYOUT Lookup2D_X_BYTE AXIS_PTS_X 1 SBYTE INDEX_INCR DIRECT /end RECORD_LAYOUT
/begin RECORD_LAYOUT Lookup2D_UWORD FNC_VALUES 1 UWORD COLUMN_DIR DIRECT /end RECORD_LAYOUT
/begin RECORD_LAYOUT Lookup2D_X_UWORD AXIS_PTS_X 1 UWORD INDEX_INCR DIRECT /end RECORD_LAYOUT
/begin RECORD_LAYOUT Lookup2D_WORD FNC_VALUES 1 SWORD COLUMN_DIR DIRECT /end RECORD_LAYOUT
/begin RECORD_LAYOUT Lookup2D_X_WORD AXIS_PTS_X 1 SWORD INDEX_INCR DIRECT /end RECORD_LAYOUT
/begin RECORD_LAYOUT Lookup2D_ULONG FNC_VALUES 1 ULONG COLUMN_DIR DIRECT /end RECORD_LAYOUT
/begin RECORD_LAYOUT Lookup2D_X_ULONG AXIS_PTS_X 1 ULONG INDEX_INCR DIRECT /end RECORD_LAYOUT
/begin RECORD_LAYOUT Lookup2D_LONG FNC_VALUES 1 SLONG COLUMN_DIR DIRECT /end RECORD_LAYOUT
/begin RECORD_LAYOUT Lookup2D_X_LONG AXIS_PTS_X 1 SLONG INDEX_INCR DIRECT /end RECORD_LAYOUT
/begin RECORD_LAYOUT Lookup2D_FLOAT32_IEEE FNC_VALUES 1 FLOAT32_IEEE COLUMN_DIR DIRECT /end RECORD_LAYOUT
/begin RECORD_LAYOUT Lookup2D_X_FLOAT32_IEEE AXIS_PTS_X 1 FLOAT32_IEEE INDEX_INCR DIRECT /end RECORD_LAYOUT
/begin RECORD_LAYOUT Lookup2D_FLOAT64_IEEE FNC_VALUES 1 FLOAT64_IEEE COLUMN_DIR DIRECT /end RECORD_LAYOUT
/begin RECORD_LAYOUT Lookup2D_X_FLOAT64_IEEE AXIS_PTS_X 1 FLOAT64_IEEE INDEX_INCR DIRECT /end RECORD_LAYOUT
/begin CHARACTERISTIC KaTRA_deg_TADLUTBrkPts "Breakpoints for TAD LookUp Table " VAL_BLK 0x0000 /* @ECU_Address@KaTRA_deg_TADLUTBrkPts@ */ Scalar_FLOAT32_IEEE 0 TRSC_InputAdapter_CM_single_deg -3.4E+38 3.4E+38 NUMBER 3 /end CHARACTERISTIC
/begin CHARACTERISTIC KaTRA_deg_TADLUTTblData "TAD Lookup Table Data" VAL_BLK 0x0000 /* @ECU_Address@KaTRA_deg_TADLUTTblData@ */ Scalar_FLOAT32_IEEE 0 TRSC_InputAdapter_CM_single_deg -3.4E+38 3.4E+38 NUMBER 3 /end CHARACTERISTIC
/begin CHARACTERISTIC KaTRA_deg_TAD_IGainLUTBrkPts "Breakpoints for I-Gain LookUp Table for TAD" VAL_BLK 0x0000 /* @ECU_Address@KaTRA_deg_TAD_IGainLUTBrkPts@ */ Scalar_FLOAT32_IEEE 0 TRSC_InputAdapter_CM_single_deg -3.4E+38 3.4E+38 NUMBER 2 /end CHARACTERISTIC
/begin CHARACTERISTIC KaTRA_k_PGainLUTTblData "Table Data for P-Gain LookUp Table " VAL_BLK 0x0000 /* @ECU_Address@KaTRA_k_PGainLUTTblData@ */ Scalar_FLOAT32_IEEE 0 TRSC_InputAdapter_CM_single -3.4E+38 3.4E+38 NUMBER 4 /end CHARACTERISTIC
/begin CHARACTERISTIC KaTRA_k_TADLUTTblData "Table Data for TAD LookUp Table " VAL_BLK 0x0000 /* @ECU_Address@KaTRA_k_TADLUTTblData@ */ Scalar_FLOAT32_IEEE 0 TRSC_InputAdapter_CM_single -3.4E+38 3.4E+38 NUMBER 3 /end CHARACTERISTIC
/begin CHARACTERISTIC KaTRA_k_TAD_IGainLUTTblData "Table data for I-Gain LookUp Table for TAD" VAL_BLK 0x0000 /* @ECU_Address@KaTRA_k_TAD_IGainLUTTblData@ */ Scalar_FLOAT32_IEEE 0 TRSC_InputAdapter_CM_single -3.4E+38 3.4E+38 NUMBER 2 /end CHARACTERISTIC
/begin CHARACTERISTIC KaTRA_k_TravDistLUTTblData "Table data for Travel Distance LookUp Table" VAL_BLK 0x0000 /* @ECU_Address@KaTRA_k_TravDistLUTTblData@ */ Scalar_FLOAT32_IEEE 0 TRSC_InputAdapter_CM_single -3.4E+38 3.4E+38 NUMBER 2 /end CHARACTERISTIC
/begin CHARACTERISTIC KaTRA_k_VehSpdLUTTblData "Table data for Vehicle Speed LookUp Table " VAL_BLK 0x0000 /* @ECU_Address@KaTRA_k_VehSpdLUTTblData@ */ Scalar_FLOAT32_IEEE 0 TRSC_InputAdapter_CM_single -3.4E+38 3.4E+38 NUMBER 2 /end CHARACTERISTIC
/begin CHARACTERISTIC KaTRA_k_VehSpd_HdgDeviatLUTTblData "Table data for Heading Deviation LookUp Table " VAL_BLK 0x0000 /* @ECU_Address@KaTRA_k_VehSpd_HdgDeviatLUTTblData@ */ Scalar_FLOAT32_IEEE 0 TRSC_InputAdapter_CM_single -3.4E+38 3.4E+38 NUMBER 3 /end CHARACTERISTIC
/begin CHARACTERISTIC KaTRA_k_VehSpd_IGainLUTTblData "Table data for I-Gain LookUp Table for vehicle speed" VAL_BLK 0x0000 /* @ECU_Address@KaTRA_k_VehSpd_IGainLUTTblData@ */ Scalar_FLOAT32_IEEE 0 TRSC_InputAdapter_CM_single -3.4E+38 3.4E+38 NUMBER 2 /end CHARACTERISTIC
/begin CHARACTERISTIC KaTRA_m_PGainLUTYBrkPts "Y-Breakpoints for P-Gain LookUp Table " VAL_BLK 0x0000 /* @ECU_Address@KaTRA_m_PGainLUTYBrkPts@ */ Scalar_FLOAT32_IEEE 0 TRSC_InputAdapter_CM_single_m -3.4E+38 3.4E+38 NUMBER 2 /end CHARACTERISTIC
/begin CHARACTERISTIC KaTRA_m_TravDistLUTBrkPts "Breakpoints for Travel Distance LookUp Table" VAL_BLK 0x0000 /* @ECU_Address@KaTRA_m_TravDistLUTBrkPts@ */ Scalar_FLOAT32_IEEE 0 TRSC_InputAdapter_CM_single_m -3.4E+38 3.4E+38 NUMBER 2 /end CHARACTERISTIC
/begin CHARACTERISTIC KaTRA_rate_RateGuardXdat "Front Wheel to Steering Rate Guard X data" VAL_BLK 0x0000 /* @ECU_Address@KaTRA_rate_RateGuardXdat@ */ Scalar_FLOAT32_IEEE 0 TRSC_InputAdapter_CM_single -3.4E+38 3.4E+38 NUMBER 8 /end CHARACTERISTIC
/begin CHARACTERISTIC KaTRA_rate_RateGuardYdat "Front Wheel to Steering Rate Guard Y data" VAL_BLK 0x0000 /* @ECU_Address@KaTRA_rate_RateGuardYdat@ */ Scalar_FLOAT32_IEEE 0 TRSC_InputAdapter_CM_single -3.4E+38 3.4E+38 NUMBER 8 /end CHARACTERISTIC
/begin CHARACTERISTIC KaTRA_v_PGainLUTXBrkPts "X-Breakpoints for P-Gain LookUp Table " VAL_BLK 0x0000 /* @ECU_Address@KaTRA_v_PGainLUTXBrkPts@ */ Scalar_FLOAT32_IEEE 0 TRSC_InputAdapter_CM_single_mps -3.4E+38 3.4E+38 NUMBER 2 /end CHARACTERISTIC
/begin CHARACTERISTIC KaTRA_v_VehSpdLUTBrkPts "Breakpoints for Vehicle Speed LookUp Table " VAL_BLK 0x0000 /* @ECU_Address@KaTRA_v_VehSpdLUTBrkPts@ */ Scalar_FLOAT32_IEEE 0 TRSC_InputAdapter_CM_single_mps -3.4E+38 3.4E+38 NUMBER 2 /end CHARACTERISTIC
/begin CHARACTERISTIC KaTRA_v_VehSpd_HdgDeviatLUTBrkPts "Breakpoints for Heading Deviation LookUp Table" VAL_BLK 0x0000 /* @ECU_Address@KaTRA_v_VehSpd_HdgDeviatLUTBrkPts@ */ Scalar_FLOAT32_IEEE 0 TRSC_InputAdapter_CM_single_mps -3.4E+38 3.4E+38 NUMBER 3 /end CHARACTERISTIC
/begin CHARACTERISTIC KaTRA_v_VehSpd_IGainLUTBrkPts "Breakpoints for I-Gain LookUp Table " VAL_BLK 0x0000 /* @ECU_Address@KaTRA_v_VehSpd_IGainLUTBrkPts@ */ Scalar_FLOAT32_IEEE 0 TRSC_InputAdapter_CM_single_mps -3.4E+38 3.4E+38 NUMBER 2 /end CHARACTERISTIC
/begin CHARACTERISTIC KaTRSC_deg_FtWhlAngPts "Maximum combined road wheel angle" VAL_BLK 0x0000 /* @ECU_Address@KaTRSC_deg_FtWhlAngPts@ */ Scalar_FLOAT32_IEEE 0 TRSC_InputAdapter_CM_single -3.4E+38 3.4E+38 NUMBER 37 /end CHARACTERISTIC
/begin CHARACTERISTIC KaTRSC_deg_PGainLUTYBrkPts "Y Breakpoints for P Gain LookUp Table " VAL_BLK 0x0000 /* @ECU_Address@KaTRSC_deg_PGainLUTYBrkPts@ */ Scalar_FLOAT32_IEEE 0 TRSC_InputAdapter_CM_single -3.4E+38 3.4E+38 NUMBER 5 /end CHARACTERISTIC
/begin CHARACTERISTIC KaTRSC_deg_StwAngPts "Steering road wheel Angle" VAL_BLK 0x0000 /* @ECU_Address@KaTRSC_deg_StwAngPts@ */ Scalar_FLOAT32_IEEE 0 TRSC_InputAdapter_CM_single -3.4E+38 3.4E+38 NUMBER 37 /end CHARACTERISTIC
/begin CHARACTERISTIC KaTRSC_k_DampingGainTblData "Table Data for Damping Gain LookUp Table " VAL_BLK 0x0000 /* @ECU_Address@KaTRSC_k_DampingGainTblData@ */ Scalar_FLOAT32_IEEE 0 TRSC_InputAdapter_CM_single -3.4E+38 3.4E+38 NUMBER 4 /end CHARACTERISTIC
/begin CHARACTERISTIC KaTRSC_k_DiffGainTblData "Table Data for Differential Gain LookUp Table " VAL_BLK 0x0000 /* @ECU_Address@KaTRSC_k_DiffGainTblData@ */ Scalar_FLOAT32_IEEE 0 TRSC_InputAdapter_CM_single -3.4E+38 3.4E+38 NUMBER 4 /end CHARACTERISTIC
/begin CHARACTERISTIC KaTRSC_k_InputRateLimTblData "Table Data for Input Rate Limit LookUp Table " VAL_BLK 0x0000 /* @ECU_Address@KaTRSC_k_InputRateLimTblData@ */ Scalar_FLOAT32_IEEE 0 TRSC_InputAdapter_CM_single -3.4E+38 3.4E+38 NUMBER 4 /end CHARACTERISTIC
/begin CHARACTERISTIC KaTRSC_k_IntegratorExtSatTblData "Table Data for Integrator External Saturation LookUp Table " VAL_BLK 0x0000 /* @ECU_Address@KaTRSC_k_IntegratorExtSatTblData@ */ Scalar_FLOAT32_IEEE 0 TRSC_InputAdapter_CM_single -3.4E+38 3.4E+38 NUMBER 4 /end CHARACTERISTIC
/begin CHARACTERISTIC KaTRSC_k_IntegratorGainTblData "Table Data for Integrator Gain LookUp Table " VAL_BLK 0x0000 /* @ECU_Address@KaTRSC_k_IntegratorGainTblData@ */ Scalar_FLOAT32_IEEE 0 TRSC_InputAdapter_CM_single -3.4E+38 3.4E+38 NUMBER 4 /end CHARACTERISTIC
/begin CHARACTERISTIC KaTRSC_k_PGainLUTTblData "Table Data for P Gain LookUp Table " VAL_BLK 0x0000 /* @ECU_Address@KaTRSC_k_PGainLUTTblData@ */ Scalar_FLOAT32_IEEE 0 TRSC_InputAdapter_CM_single -3.4E+38 3.4E+38 NUMBER 20 /end CHARACTERISTIC
/begin CHARACTERISTIC KaTRSC_kph_DampingGainBrkPts "Breakpoints for Damping Gain LookUp Table " VAL_BLK 0x0000 /* @ECU_Address@KaTRSC_kph_DampingGainBrkPts@ */ Scalar_FLOAT32_IEEE 0 TRSC_InputAdapter_CM_single -3.4E+38 3.4E+38 NUMBER 4 /end CHARACTERISTIC
/begin CHARACTERISTIC KaTRSC_kph_DiffGainBrkPts "Breakpoints for Differential Gain LookUp Table " VAL_BLK 0x0000 /* @ECU_Address@KaTRSC_kph_DiffGainBrkPts@ */ Scalar_FLOAT32_IEEE 0 TRSC_InputAdapter_CM_single -3.4E+38 3.4E+38 NUMBER 4 /end CHARACTERISTIC
/begin CHARACTERISTIC KaTRSC_kph_InputRateLimBrkPts "Breakpoints for Input Rate Limit LookUp Table " VAL_BLK 0x0000 /* @ECU_Address@KaTRSC_kph_InputRateLimBrkPts@ */ Scalar_FLOAT32_IEEE 0 TRSC_InputAdapter_CM_single -3.4E+38 3.4E+38 NUMBER 4 /end CHARACTERISTIC
/begin CHARACTERISTIC KaTRSC_kph_IntegratorExtSatBrkPts "Breakpoints for Integrator External Saturation LookUp Table " VAL_BLK 0x0000 /* @ECU_Address@KaTRSC_kph_IntegratorExtSatBrkPts@ */ Scalar_FLOAT32_IEEE 0 TRSC_InputAdapter_CM_single -3.4E+38 3.4E+38 NUMBER 4 /end CHARACTERISTIC
/begin CHARACTERISTIC KaTRSC_kph_IntegratorGainBrkPts "Breakpoints for Integrator Gain LookUp Table " VAL_BLK 0x0000 /* @ECU_Address@KaTRSC_kph_IntegratorGainBrkPts@ */ Scalar_FLOAT32_IEEE 0 TRSC_InputAdapter_CM_single -3.4E+38 3.4E+38 NUMBER 4 /end CHARACTERISTIC
/begin CHARACTERISTIC KaTRSC_kph_PGainLUTXBrkPts "X Breakpoints for P Gain LookUp Table " VAL_BLK 0x0000 /* @ECU_Address@KaTRSC_kph_PGainLUTXBrkPts@ */ Scalar_FLOAT32_IEEE 0 TRSC_InputAdapter_CM_single -3.4E+38 3.4E+38 NUMBER 4 /end CHARACTERISTIC
/begin CHARACTERISTIC KeKM_deg_AngTh "steering wheel threshold value to compare steering wheel angle." VALUE 0x0000 /* @ECU_Address@KeKM_deg_AngTh@ */ Scalar_FLOAT32_IEEE 0 TRSC_InputAdapter_CM_single_deg -3.4E+38 3.4E+38 /end CHARACTERISTIC
/begin CHARACTERISTIC KeKM_k_GyroYawCov "Gyro Yaw Covariance  " VALUE 0x0000 /* @ECU_Address@KeKM_k_GyroYawCov@ */ Scalar_FLOAT32_IEEE 0 TRSC_InputAdapter_CM_single -3.4E+38 3.4E+38 /end CHARACTERISTIC
/begin CHARACTERISTIC KeKM_k_KM_SF_RelAngCov "Relative angle Covariance" VALUE 0x0000 /* @ECU_Address@KeKM_k_KM_SF_RelAngCov@ */ Scalar_FLOAT32_IEEE 0 TRSC_InputAdapter_CM_single -3.4E+38 3.4E+38 /end CHARACTERISTIC
/begin CHARACTERISTIC KeKM_k_KM_SF_RelAngRateCov "Relative angle rate covariance  " VALUE 0x0000 /* @ECU_Address@KeKM_k_KM_SF_RelAngRateCov@ */ Scalar_FLOAT32_IEEE 0 TRSC_InputAdapter_CM_single -3.4E+38 3.4E+38 /end CHARACTERISTIC
/begin CHARACTERISTIC KeKM_k_KM_SF_YawRateCov "Yaw Rate Covariance" VALUE 0x0000 /* @ECU_Address@KeKM_k_KM_SF_YawRateCov@ */ Scalar_FLOAT32_IEEE 0 TRSC_InputAdapter_CM_single -3.4E+38 3.4E+38 /end CHARACTERISTIC
/begin CHARACTERISTIC KeKM_k_KM_YawRateGyroBiasInit "Yaw rate Gyro bias initialization" VALUE 0x0000 /* @ECU_Address@KeKM_k_KM_YawRateGyroBiasInit@ */ Scalar_FLOAT32_IEEE 0 TRSC_InputAdapter_CM_single -3.4E+38 3.4E+38 /end CHARACTERISTIC
/begin CHARACTERISTIC KeKM_k_NumWheelPulses "Number of wheel pulses" VALUE 0x0000 /* @ECU_Address@KeKM_k_NumWheelPulses@ */ Scalar_FLOAT32_IEEE 0 TRSC_InputAdapter_CM_single -3.4E+38 3.4E+38 /end CHARACTERISTIC
/begin CHARACTERISTIC KeKM_k_SWA_Res "Steering Wheel Angle Resolution" VALUE 0x0000 /* @ECU_Address@KeKM_k_SWA_Res@ */ Scalar_FLOAT32_IEEE 0 TRSC_InputAdapter_CM_single -3.4E+38 3.4E+38 /end CHARACTERISTIC
/begin CHARACTERISTIC KeKM_k_TADCov "Trailer Angle Detection Covariance  " VALUE 0x0000 /* @ECU_Address@KeKM_k_TADCov@ */ Scalar_FLOAT32_IEEE 0 TRSC_InputAdapter_CM_single -3.4E+38 3.4E+38 /end CHARACTERISTIC
/begin CHARACTERISTIC KeKM_k_UpdateIMU_H "Update IMU measurement matrix" VAL_BLK 0x0000 /* @ECU_Address@KeKM_k_UpdateIMU_H@ */ Scalar_FLOAT32_IEEE 0 TRSC_InputAdapter_CM_single -3.4E+38 3.4E+38 NUMBER 3 /end CHARACTERISTIC
/begin CHARACTERISTIC KeKM_k_UpdateRPM_H "Update RPM measurement matrix" VAL_BLK 0x0000 /* @ECU_Address@KeKM_k_UpdateRPM_H@ */ Scalar_FLOAT32_IEEE 0 TRSC_InputAdapter_CM_single -3.4E+38 3.4E+38 NUMBER 3 /end CHARACTERISTIC
/begin CHARACTERISTIC KeKM_k_UpdateTAD_H "Update TAD measurement matrix" VAL_BLK 0x0000 /* @ECU_Address@KeKM_k_UpdateTAD_H@ */ Scalar_FLOAT32_IEEE 0 TRSC_InputAdapter_CM_single -3.4E+38 3.4E+38 NUMBER 3 /end CHARACTERISTIC
/begin CHARACTERISTIC KeKM_k_WhlPlsCnt_high_lim "Wheel Pulse count high limit" VALUE 0x0000 /* @ECU_Address@KeKM_k_WhlPlsCnt_high_lim@ */ Scalar_FLOAT32_IEEE 0 TRSC_InputAdapter_CM_single -3.4E+38 3.4E+38 /end CHARACTERISTIC
/begin CHARACTERISTIC KeKM_k_WhlPlsCnt_low_lim "Wheel Pulse count low limit" VALUE 0x0000 /* @ECU_Address@KeKM_k_WhlPlsCnt_low_lim@ */ Scalar_FLOAT32_IEEE 0 TRSC_InputAdapter_CM_single -3.4E+38 3.4E+38 /end CHARACTERISTIC
/begin CHARACTERISTIC KeKM_k_WhlRPMYawCov "Wheel RPM Yaw Covariance  " VALUE 0x0000 /* @ECU_Address@KeKM_k_WhlRPMYawCov@ */ Scalar_FLOAT32_IEEE 0 TRSC_InputAdapter_CM_single -3.4E+38 3.4E+38 /end CHARACTERISTIC
/begin CHARACTERISTIC KeKM_m_BeamLength "Beam Length" VALUE 0x0000 /* @ECU_Address@KeKM_m_BeamLength@ */ Scalar_FLOAT32_IEEE 0 TRSC_InputAdapter_CM_single -3.4E+38 3.4E+38 /end CHARACTERISTIC
/begin CHARACTERISTIC KeKM_m_TrackWidth "Track Width" VALUE 0x0000 /* @ECU_Address@KeKM_m_TrackWidth@ */ Scalar_FLOAT32_IEEE 0 TRSC_InputAdapter_CM_single_m -3.4E+38 3.4E+38 /end CHARACTERISTIC
/begin CHARACTERISTIC KeKM_m_WheelCircumference "Wheel circumference" VALUE 0x0000 /* @ECU_Address@KeKM_m_WheelCircumference@ */ Scalar_FLOAT32_IEEE 0 TRSC_InputAdapter_CM_single_m -3.4E+38 3.4E+38 /end CHARACTERISTIC
/begin CHARACTERISTIC KeKM_s_SampleTime "sampling time" VALUE 0x0000 /* @ECU_Address@KeKM_s_SampleTime@ */ Scalar_FLOAT32_IEEE 0 TRSC_InputAdapter_CM_single_sec -3.4E+38 3.4E+38 /end CHARACTERISTIC
/begin CHARACTERISTIC KeTRA_deg_TrailerBeamLenYBrkPts "Trailer Beam Length Y Data Break Point" VAL_BLK 0x0000 /* @ECU_Address@KeTRA_deg_TrailerBeamLenYBrkPts@ */ Scalar_FLOAT32_IEEE 0 TRSC_InputAdapter_CM_single_m -3.4E+38 3.4E+38 NUMBER 3 /end CHARACTERISTIC
/begin CHARACTERISTIC KeTRA_k_Kp "Kp value(5) used to calculate P-gain of PID controller" VALUE 0x0000 /* @ECU_Address@KeTRA_k_Kp@ */ Scalar_FLOAT32_IEEE 0 TRSC_InputAdapter_CM_single -3.4E+38 3.4E+38 /end CHARACTERISTIC
/begin CHARACTERISTIC KeTRA_k_SteerAngRateLmt "Control Steering Angle Rate Upper Limit" VALUE 0x0000 /* @ECU_Address@KeTRA_k_SteerAngRateLmt@ */ Scalar_FLOAT32_IEEE 0 TRSC_InputAdapter_CM_single -3.4E+38 3.4E+38 /end CHARACTERISTIC
/begin CHARACTERISTIC KeTRA_m_K_beta "Calibration Value Beta used for P-Gain in PID" VALUE 0x0000 /* @ECU_Address@KeTRA_m_K_beta@ */ Scalar_FLOAT32_IEEE 0 TRSC_InputAdapter_CM_single_m -3.4E+38 3.4E+38 /end CHARACTERISTIC
/begin CHARACTERISTIC KeTRA_m_TrailerBeamLenXBrkPts "X-Breakpoints for Trailer Beam Length" VAL_BLK 0x0000 /* @ECU_Address@KeTRA_m_TrailerBeamLenXBrkPts@ */ Scalar_FLOAT32_IEEE 0 TRSC_InputAdapter_CM_single_m -3.4E+38 3.4E+38 NUMBER 3 /end CHARACTERISTIC
/begin CHARACTERISTIC KeTRSC_TADdes_k_PIDKd "TAD Des PID Derevative Gain" VALUE 0x0000 /* @ECU_Address@KeTRSC_TADdes_k_PIDKd@ */ Scalar_FLOAT32_IEEE 0 TRSC_InputAdapter_CM_single -3.4E+38 3.4E+38 /end CHARACTERISTIC
/begin CHARACTERISTIC KeTRSC_TADep_k_PIDKp "TAD Dep PID Propotional Gain" VALUE 0x0000 /* @ECU_Address@KeTRSC_TADep_k_PIDKp@ */ Scalar_FLOAT32_IEEE 0 TRSC_InputAdapter_CM_single -3.4E+38 3.4E+38 /end CHARACTERISTIC
/begin CHARACTERISTIC KeTRSC_deg_MaxStrAngle "Maximum Steering Angle threshold" VALUE 0x0000 /* @ECU_Address@KeTRSC_deg_MaxStrAngle@ */ Scalar_FLOAT32_IEEE 0 TRSC_InputAdapter_CM_single -800.0 800.0 /end CHARACTERISTIC
/begin CHARACTERISTIC KeTRSC_deg_MaxStrAngle_Low_Limit "Maximum Steering Angle threshold Low Limit" VALUE 0x0000 /* @ECU_Address@KeTRSC_deg_MaxStrAngle_Low_Limit@ */ Scalar_FLOAT32_IEEE 0 TRSC_InputAdapter_CM_single -3.4E+38 3.4E+38 /end CHARACTERISTIC
/begin CHARACTERISTIC KeTRSC_deg_MaxStrAngle_Up_Limit "Maximum Steering Angle threshold Up Limit" VALUE 0x0000 /* @ECU_Address@KeTRSC_deg_MaxStrAngle_Up_Limit@ */ Scalar_FLOAT32_IEEE 0 TRSC_InputAdapter_CM_single -3.4E+38 3.4E+38 /end CHARACTERISTIC
/begin CHARACTERISTIC KeTRSC_deg_MaxTrlrAngl "Maximum Trailer Angle" VALUE 0x0000 /* @ECU_Address@KeTRSC_deg_MaxTrlrAngl@ */ Scalar_FLOAT32_IEEE 0 TRSC_InputAdapter_CM_single 0.0 53.0 /end CHARACTERISTIC
/begin CHARACTERISTIC KeTRSC_deg_TAD_DesRateUpLim "TAD des Rate change Up Limit" VALUE 0x0000 /* @ECU_Address@KeTRSC_deg_TAD_DesRateUpLim@ */ Scalar_FLOAT32_IEEE 0 TRSC_InputAdapter_CM_single_deg -3.4E+38 3.4E+38 /end CHARACTERISTIC
/begin CHARACTERISTIC KeTRSC_deg_TGTADdesRateChange "TAD des Rate change" VALUE 0x0000 /* @ECU_Address@KeTRSC_deg_TGTADdesRateChange@ */ Scalar_FLOAT32_IEEE 0 TRSC_InputAdapter_CM_single_deg -3.4E+38 3.4E+38 /end CHARACTERISTIC
/begin CHARACTERISTIC KeTRSC_deg_TrqCnt_LowLimit "Torque Control Lowe Limit" VALUE 0x0000 /* @ECU_Address@KeTRSC_deg_TrqCnt_LowLimit@ */ Scalar_FLOAT32_IEEE 0 TRSC_InputAdapter_CM_single -3.4E+38 3.4E+38 /end CHARACTERISTIC
/begin CHARACTERISTIC KeTRSC_deg_TrqCnt_UpLimit "Torque Control Upper Limit" VALUE 0x0000 /* @ECU_Address@KeTRSC_deg_TrqCnt_UpLimit@ */ Scalar_FLOAT32_IEEE 0 TRSC_InputAdapter_CM_single -3.4E+38 3.4E+38 /end CHARACTERISTIC
/begin CHARACTERISTIC KeTRSC_k_JKAngle_LowLimit "Jack Knife Angle Lower Limit" VALUE 0x0000 /* @ECU_Address@KeTRSC_k_JKAngle_LowLimit@ */ Scalar_FLOAT32_IEEE 0 TRSC_InputAdapter_CM_single -3.4E+38 3.4E+38 /end CHARACTERISTIC
/begin CHARACTERISTIC KeTRSC_k_JKAngle_UpLimit "Jack Knife Angle Upper Limit" VALUE 0x0000 /* @ECU_Address@KeTRSC_k_JKAngle_UpLimit@ */ Scalar_FLOAT32_IEEE 0 TRSC_InputAdapter_CM_single -3.4E+38 3.4E+38 /end CHARACTERISTIC
/begin CHARACTERISTIC KeTRSC_k_LogVecLength "Log Vehicle Length" VALUE 0x0000 /* @ECU_Address@KeTRSC_k_LogVecLength@ */ Scalar_FLOAT32_IEEE 0 TRSC_InputAdapter_CM_single -3.4E+38 3.4E+38 /end CHARACTERISTIC
/begin CHARACTERISTIC KeTRSC_k_TrqConstRateLim "Constant Rate Limit for Torque " VALUE 0x0000 /* @ECU_Address@KeTRSC_k_TrqConstRateLim@ */ Scalar_FLOAT32_IEEE 0 TRSC_InputAdapter_CM_single -3.4E+38 3.4E+38 /end CHARACTERISTIC
/begin CHARACTERISTIC KeTRSC_k_TrqConstSatLim "Constant Saturation Limit for Torque " VALUE 0x0000 /* @ECU_Address@KeTRSC_k_TrqConstSatLim@ */ Scalar_FLOAT32_IEEE 0 TRSC_InputAdapter_CM_single -3.4E+38 3.4E+38 /end CHARACTERISTIC
/begin CHARACTERISTIC KeTRSC_k_WhlAngCFBias "KeTRSC_k_WhlAngCFBias" VALUE 0x0000 /* @ECU_Address@KeTRSC_k_WhlAngCFBias@ */ Scalar_FLOAT32_IEEE 0 TRSC_InputAdapter_CM_single -3.4E+38 3.4E+38 /end CHARACTERISTIC
/begin CHARACTERISTIC KeTRSC_k_WhlAngCFWt "KeTRSC_k_WhlAngCFWt" VALUE 0x0000 /* @ECU_Address@KeTRSC_k_WhlAngCFWt@ */ Scalar_FLOAT32_IEEE 0 TRSC_InputAdapter_CM_single -3.4E+38 3.4E+38 /end CHARACTERISTIC
/begin CHARACTERISTIC KeTRSC_kph_DeactivationSpd "DEACTIVATION_SPD" VALUE 0x0000 /* @ECU_Address@KeTRSC_kph_DeactivationSpd@ */ Scalar_FLOAT32_IEEE 0 TRSC_InputAdapter_CM_single_km_h -3.4E+38 3.4E+38 /end CHARACTERISTIC
/begin CHARACTERISTIC KeTRSC_m_TBL_LowLimit "Trailer Beam Length Lower Limit" VALUE 0x0000 /* @ECU_Address@KeTRSC_m_TBL_LowLimit@ */ Scalar_FLOAT32_IEEE 0 TRSC_InputAdapter_CM_single -3.4E+38 3.4E+38 /end CHARACTERISTIC
/begin CHARACTERISTIC KeTRSC_m_TBL_UpLimit "Trailer Beam Length Upper Limit" VALUE 0x0000 /* @ECU_Address@KeTRSC_m_TBL_UpLimit@ */ Scalar_FLOAT32_IEEE 0 TRSC_InputAdapter_CM_single -3.4E+38 3.4E+38 /end CHARACTERISTIC
/begin CHARACTERISTIC KeTRSC_m_WheelBase "Wheel base of the host vehicle" VALUE 0x0000 /* @ECU_Address@KeTRSC_m_WheelBase@ */ Scalar_FLOAT32_IEEE 0 TRSC_InputAdapter_CM_single 0.0 10.0 /end CHARACTERISTIC
/begin CHARACTERISTIC KeTRSC_m_WheelBase_Low_Limit "Wheel base of the host vehicle Low Limit" VALUE 0x0000 /* @ECU_Address@KeTRSC_m_WheelBase_Low_Limit@ */ Scalar_FLOAT32_IEEE 0 TRSC_InputAdapter_CM_single -3.4E+38 3.4E+38 /end CHARACTERISTIC
/begin CHARACTERISTIC KeTRSC_m_WheelBase_Up_Limit "Wheel base of the host vehicle Up Limit" VALUE 0x0000 /* @ECU_Address@KeTRSC_m_WheelBase_Up_Limit@ */ Scalar_FLOAT32_IEEE 0 TRSC_InputAdapter_CM_single -3.4E+38 3.4E+38 /end CHARACTERISTIC
/begin CHARACTERISTIC KeTRSC_pct_JackKnifePerc "JackKnife Angle Percentage" VALUE 0x0000 /* @ECU_Address@KeTRSC_pct_JackKnifePerc@ */ Scalar_FLOAT32_IEEE 0 TRSC_InputAdapter_CM_single 0.0 95.0 /end CHARACTERISTIC
/begin CHARACTERISTIC KeTRSC_pct_TrlrJackKnifePerc "TRAILER_JACKNIFE_PERCENT" VALUE 0x0000 /* @ECU_Address@KeTRSC_pct_TrlrJackKnifePerc@ */ Scalar_FLOAT32_IEEE 0 TRSC_InputAdapter_CM_single__ 0.0 100.0 /end CHARACTERISTIC
/begin CHARACTERISTIC KeTRSC_s_ActTransRevDbnc2 "ACTUAL_TRANS_REVERSE_DEBOUNCE_2" VALUE 0x0000 /* @ECU_Address@KeTRSC_s_ActTransRevDbnc2@ */ Scalar_FLOAT32_IEEE 0 TRSC_InputAdapter_CM_single_sec 0.5 2.0 /end CHARACTERISTIC
/begin CHARACTERISTIC KeTRSC_s_CalibDlyTh "Calibration Delay (1000 ms)" VALUE 0x0000 /* @ECU_Address@KeTRSC_s_CalibDlyTh@ */ Scalar_FLOAT32_IEEE 0 TRSC_InputAdapter_CM_single_sec -3.4E+38 3.4E+38 /end CHARACTERISTIC
/begin CHARACTERISTIC KeTRSC_s_EpsRespTmOut "EPS_RESPONSE_TIME_OUT" VALUE 0x0000 /* @ECU_Address@KeTRSC_s_EpsRespTmOut@ */ Scalar_FLOAT32_IEEE 0 TRSC_InputAdapter_CM_single_sec 1.0 5.0 /end CHARACTERISTIC
/begin CHARACTERISTIC KeTRSC_s_GearDbncTh "Gear Debounce timer threshold = 350 msec" VALUE 0x0000 /* @ECU_Address@KeTRSC_s_GearDbncTh@ */ Scalar_FLOAT32_IEEE 0 TRSC_InputAdapter_CM_single_sec -3.4E+38 3.4E+38 /end CHARACTERISTIC
/begin CHARACTERISTIC KeTRSC_s_LEDTmrTh "LED timer threshold (5 Sec) used for blinking" VALUE 0x0000 /* @ECU_Address@KeTRSC_s_LEDTmrTh@ */ Scalar_FLOAT32_IEEE 0 TRSC_InputAdapter_CM_single_sec -3.4E+38 3.4E+38 /end CHARACTERISTIC
/begin CHARACTERISTIC KeTRSC_s_RespNotRcvdTmOut "RESPONSE_NOT_RECEIVED_TIME_OUT (300 msec)" VALUE 0x0000 /* @ECU_Address@KeTRSC_s_RespNotRcvdTmOut@ */ Scalar_FLOAT32_IEEE 0 TRSC_InputAdapter_CM_single_sec 0.1 0.8 /end CHARACTERISTIC
/begin CHARACTERISTIC KeTRSC_s_TrlrUnkwnSet "TRAILER_UNKNOWN_SET = 10 sec" VALUE 0x0000 /* @ECU_Address@KeTRSC_s_TrlrUnkwnSet@ */ Scalar_FLOAT32_IEEE 0 TRSC_InputAdapter_CM_single_sec 5.0 120.0 /end CHARACTERISTIC
/begin CHARACTERISTIC KeTRSC_deg_KnobHys "Threshold value for Knob Hysteresis" VALUE 0x0000 /* @ECU_Address@KeTRSC_deg_KnobHys@ */ Scalar_SWORD 0 TRSC_InputAdapter_CM_int16 -32768 32767 /end CHARACTERISTIC
/begin CHARACTERISTIC KeTRSC_deg_MaxKnobAngle "Maximum Knob Angle" VALUE 0x0000 /* @ECU_Address@KeTRSC_deg_MaxKnobAngle@ */ Scalar_UWORD 0 TRSC_InputAdapter_CM_uint16 0.0 120.0 /end CHARACTERISTIC
/begin CHARACTERISTIC KeTRSC_b_BypTunParam "Calibration to Bypass Tunable Params from BSW" VALUE 0x0000 /* @ECU_Address@KeTRSC_b_BypTunParam@ */ Scalar_BOOLEAN 0 TRSC_InputAdapter_CM_boolean 0.0 1.0 /end CHARACTERISTIC
/begin CHARACTERISTIC CeConst_k_ConstZeroUint8 "" VALUE 0x0000 /* @ECU_Address@CeConst_k_ConstZeroUint8@ */ Scalar_UBYTE 0 TRSC_InputAdapter_CM_uint8 0 255 /end CHARACTERISTIC
/begin CHARACTERISTIC KeTRSC_Cnt_FailedCnt "Failed Count" VALUE 0x0000 /* @ECU_Address@KeTRSC_Cnt_FailedCnt@ */ Scalar_UBYTE 0 TRSC_InputAdapter_CM_uint8_count 0.0 10.0 /end CHARACTERISTIC
/begin CHARACTERISTIC KeTRSC_e_CamBlockAcceptLvl "acceptance value" VALUE 0x0000 /* @ECU_Address@KeTRSC_e_CamBlockAcceptLvl@ */ Scalar_UBYTE 0 TRSC_InputAdapter_CM_uint8 0.0 255.0 /end CHARACTERISTIC
/begin CHARACTERISTIC KeTRSC_k_VariantID "Variant ID " VALUE 0x0000 /* @ECU_Address@KeTRSC_k_VariantID@ */ Scalar_UBYTE 0 TRSC_InputAdapter_CM_uint8 0 255 /end CHARACTERISTIC
/begin COMPU_METHOD TRSC_InputAdapter_CM_single_deg "Q = V" RAT_FUNC "%8.6" "deg" COEFFS 0 1 0 0 0 1 /end COMPU_METHOD
/begin COMPU_METHOD TRSC_InputAdapter_CM_single "Q = V" RAT_FUNC "%8.6" "" COEFFS 0 1 0 0 0 1 /end COMPU_METHOD
/begin COMPU_METHOD TRSC_InputAdapter_CM_single_m "Q = V" RAT_FUNC "%8.6" "m" COEFFS 0 1 0 0 0 1 /end COMPU_METHOD
/begin COMPU_METHOD TRSC_InputAdapter_CM_single_mps "Q = V" RAT_FUNC "%8.6" "mps" COEFFS 0 1 0 0 0 1 /end COMPU_METHOD
/begin COMPU_METHOD TRSC_InputAdapter_CM_single_sec "Q = V" RAT_FUNC "%8.6" "sec" COEFFS 0 1 0 0 0 1 /end COMPU_METHOD
/begin COMPU_METHOD TRSC_InputAdapter_CM_single_km_h "Q = V" RAT_FUNC "%8.6" "km/h" COEFFS 0 1 0 0 0 1 /end COMPU_METHOD
/begin COMPU_METHOD TRSC_InputAdapter_CM_single__ "Q = V" RAT_FUNC "%8.6" "%" COEFFS 0 1 0 0 0 1 /end COMPU_METHOD
/begin COMPU_METHOD TRSC_InputAdapter_CM_int16 "Q = V" RAT_FUNC "%5.0" "" COEFFS 0 1 0 0 0 1 /end COMPU_METHOD
/begin COMPU_METHOD TRSC_InputAdapter_CM_uint16 "Q = V" RAT_FUNC "%5.0" "" COEFFS 0 1 0 0 0 1 /end COMPU_METHOD
/begin COMPU_METHOD TRSC_InputAdapter_CM_boolean "Q = V" RAT_FUNC "%1.0" "" COEFFS 0 1 0 0 0 1 /end COMPU_METHOD
/begin COMPU_METHOD TRSC_InputAdapter_CM_uint8 "Q = V" RAT_FUNC "%3.0" "" COEFFS 0 1 0 0 0 1 /end COMPU_METHOD
/begin COMPU_METHOD TRSC_InputAdapter_CM_uint8_count "Q = V" RAT_FUNC "%3.0" "count" COEFFS 0 1 0 0 0 1 /end COMPU_METHOD
/begin GROUP TRSC_InputAdapter "TRSC_InputAdapter" /* Root */ ROOT /begin SUB_GROUP Root_Subsystem2 /end SUB_GROUP /begin REF_CHARACTERISTIC CeConst_k_ConstZeroUint8 KeTRSC_b_BypTunParam /end REF_CHARACTERISTIC /end GROUP
/begin GROUP Root_Subsystem2 "TRSC_InputAdapter/Subsystem2"
 /begin REF_CHARACTERISTIC KaTRA_deg_TADLUTBrkPts KaTRA_deg_TADLUTTblData KaTRA_deg_TAD_IGainLUTBrkPts KaTRA_k_PGainLUTTblData KaTRA_k_TADLUTTblData KaTRA_k_TAD_IGainLUTTblData KaTRA_k_TravDistLUTTblData KaTRA_k_VehSpdLUTTblData KaTRA_k_VehSpd_HdgDeviatLUTTblData KaTRA_k_VehSpd_IGainLUTTblData KaTRA_m_PGainLUTYBrkPts KaTRA_m_TravDistLUTBrkPts KaTRA_rate_RateGuardXdat KaTRA_rate_RateGuardYdat KaTRA_v_PGainLUTXBrkPts KaTRA_v_VehSpdLUTBrkPts KaTRA_v_VehSpd_HdgDeviatLUTBrkPts KaTRA_v_VehSpd_IGainLUTBrkPts KaTRSC_deg_FtWhlAngPts KaTRSC_deg_PGainLUTYBrkPts KaTRSC_deg_StwAngPts KaTRSC_k_DampingGainTblData KaTRSC_k_DiffGainTblData KaTRSC_k_InputRateLimTblData KaTRSC_k_IntegratorExtSatTblData KaTRSC_k_IntegratorGainTblData KaTRSC_k_PGainLUTTblData KaTRSC_kph_DampingGainBrkPts KaTRSC_kph_DiffGainBrkPts KaTRSC_kph_InputRateLimBrkPts KaTRSC_kph_IntegratorExtSatBrkPts KaTRSC_kph_IntegratorGainBrkPts KaTRSC_kph_PGainLUTXBrkPts KeKM_deg_AngTh KeKM_k_GyroYawCov KeKM_k_KM_SF_RelAngCov KeKM_k_KM_SF_RelAngRateCov KeKM_k_KM_SF_YawRateCov KeKM_k_KM_YawRateGyroBiasInit KeKM_k_NumWheelPulses KeKM_k_SWA_Res KeKM_k_TADCov KeKM_k_UpdateIMU_H KeKM_k_UpdateRPM_H KeKM_k_UpdateTAD_H KeKM_k_WhlPlsCnt_high_lim KeKM_k_WhlPlsCnt_low_lim KeKM_k_WhlRPMYawCov KeKM_m_BeamLength KeKM_m_TrackWidth KeKM_m_WheelCircumference KeKM_s_SampleTime KeTRA_deg_TrailerBeamLenYBrkPts KeTRA_k_Kp KeTRA_k_SteerAngRateLmt KeTRA_m_K_beta KeTRA_m_TrailerBeamLenXBrkPts KeTRSC_Cnt_FailedCnt KeTRSC_TADdes_k_PIDKd KeTRSC_TADep_k_PIDKp KeTRSC_deg_KnobHys KeTRSC_deg_MaxKnobAngle KeTRSC_deg_MaxStrAngle KeTRSC_deg_MaxStrAngle_Low_Limit KeTRSC_deg_MaxStrAngle_Up_Limit KeTRSC_deg_MaxTrlrAngl KeTRSC_deg_TAD_DesRateUpLim KeTRSC_deg_TGTADdesRateChange KeTRSC_deg_TrqCnt_LowLimit KeTRSC_deg_TrqCnt_UpLimit KeTRSC_e_CamBlockAcceptLvl KeTRSC_k_JKAngle_LowLimit KeTRSC_k_JKAngle_UpLimit KeTRSC_k_LogVecLength KeTRSC_k_TrqConstRateLim KeTRSC_k_TrqConstSatLim KeTRSC_k_VariantID KeTRSC_k_WhlAngCFBias KeTRSC_k_WhlAngCFWt KeTRSC_kph_DeactivationSpd KeTRSC_m_TBL_LowLimit KeTRSC_m_TBL_UpLimit KeTRSC_m_WheelBase KeTRSC_m_WheelBase_Low_Limit KeTRSC_m_WheelBase_Up_Limit KeTRSC_pct_JackKnifePerc KeTRSC_pct_TrlrJackKnifePerc KeTRSC_s_ActTransRevDbnc2 KeTRSC_s_CalibDlyTh KeTRSC_s_EpsRespTmOut KeTRSC_s_GearDbncTh KeTRSC_s_LEDTmrTh KeTRSC_s_RespNotRcvdTmOut KeTRSC_s_TrlrUnkwnSet /end REF_CHARACTERISTIC
/end GROUP
/end MODULE
/end PROJECT
/* (add any file trailer comments here) */
/* EOF TRSC_InputAdapter.a2l */
