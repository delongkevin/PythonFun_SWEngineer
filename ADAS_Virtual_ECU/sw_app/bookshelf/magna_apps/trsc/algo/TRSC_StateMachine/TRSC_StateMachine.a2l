/******************************************************************************
* ASAP2 file: TRSC_StateMachine.a2l
* Code generation for model "TRSC_StateMachine".
* Model version : 1.1744
* Simulink Coder version : 9.2 (R2019b) 18-Jul-2019
* C source code generated on : Thu Nov 13 09:51:14 2025
* Target selection: ert.tlc
* Embedded hardware selection: ARM Compatible->ARM Cortex
* Code generation objectives:
* 1. MISRA C:2012 guidelines
* 2. RAM efficiency
* 3. ROM efficiency
* Validation result: Not run
* (add additional file header information here)
******************************************************************************/ ASAP2_VERSION 1 31
/* Version 1.31 */
/begin PROJECT ProjectName "Project Comment Goes Here"
/begin HEADER "Header Comments go here" /end HEADER
/begin MODULE ModuleName "Module Comment Goes Here"
/begin MOD_PAR "MOD PAR Comment Goes Here" /end MOD_PAR
/begin MOD_COMMON "Mod Common Comment Here" BYTE_ORDER MSB_LAST /end MOD_COMMON
/begin RECORD_LAYOUT Scalar_BOOLEAN FNC_VALUES 1 UBYTE COLUMN_DIR DIRECT /end RECORD_LAYOUT
/begin RECORD_LAYOUT Scalar_UBYTE FNC_VALUES 1 UBYTE COLUMN_DIR DIRECT /end RECORD_LAYOUT
/begin RECORD_LAYOUT Scalar_BYTE FNC_VALUES 1 SBYTE COLUMN_DIR DIRECT /end RECORD_LAYOUT
/begin RECORD_LAYOUT Scalar_UWORD FNC_VALUES 1 UWORD COLUMN_DIR DIRECT /end RECORD_LAYOUT
/begin RECORD_LAYOUT Scalar_SWORD FNC_VALUES 1 SWORD COLUMN_DIR DIRECT /end RECORD_LAYOUT
/begin RECORD_LAYOUT Scalar_ULONG FNC_VALUES 1 ULONG COLUMN_DIR DIRECT /end RECORD_LAYOUT
/begin RECORD_LAYOUT Scalar_LONG FNC_VALUES 1 SLONG COLUMN_DIR DIRECT /end RECORD_LAYOUT
/begin RECORD_LAYOUT Scalar_FLOAT32_IEEE FNC_VALUES 1 FLOAT32_IEEE COLUMN_DIR DIRECT /end RECORD_LAYOUT
/begin RECORD_LAYOUT Scalar_FLOAT64_IEEE FNC_VALUES 1 FLOAT64_IEEE COLUMN_DIR DIRECT /end RECORD_LAYOUT
/begin RECORD_LAYOUT Lookup1D_BOOLEAN FNC_VALUES 1 UBYTE COLUMN_DIR DIRECT /end RECORD_LAYOUT
/begin RECORD_LAYOUT Lookup1D_X_BOOLEAN AXIS_PTS_X 1 UBYTE INDEX_INCR DIRECT /end RECORD_LAYOUT
/begin RECORD_LAYOUT Lookup1D_BYTE FNC_VALUES 1 SBYTE COLUMN_DIR DIRECT /end RECORD_LAYOUT
/begin RECORD_LAYOUT Lookup1D_X_BYTE AXIS_PTS_X 1 SBYTE INDEX_INCR DIRECT /end RECORD_LAYOUT
/begin RECORD_LAYOUT Lookup1D_UBYTE FNC_VALUES 1 UBYTE COLUMN_DIR DIRECT /end RECORD_LAYOUT
/begin RECORD_LAYOUT Lookup1D_X_UBYTE AXIS_PTS_X 1 UBYTE INDEX_INCR DIRECT /end RECORD_LAYOUT
/begin RECORD_LAYOUT Lookup1D_UWORD FNC_VALUES 1 UWORD COLUMN_DIR DIRECT /end RECORD_LAYOUT
/begin RECORD_LAYOUT Lookup1D_X_UWORD AXIS_PTS_X 1 UWORD INDEX_INCR DIRECT /end RECORD_LAYOUT
/begin RECORD_LAYOUT Lookup1D_WORD FNC_VALUES 1 SWORD COLUMN_DIR DIRECT /end RECORD_LAYOUT
/begin RECORD_LAYOUT Lookup1D_X_WORD AXIS_PTS_X 1 SWORD INDEX_INCR DIRECT /end RECORD_LAYOUT
/begin RECORD_LAYOUT Lookup1D_ULONG FNC_VALUES 1 ULONG COLUMN_DIR DIRECT /end RECORD_LAYOUT
/begin RECORD_LAYOUT Lookup1D_X_ULONG AXIS_PTS_X 1 ULONG INDEX_INCR DIRECT /end RECORD_LAYOUT
/begin RECORD_LAYOUT Lookup1D_SLONG FNC_VALUES 1 SLONG COLUMN_DIR DIRECT /end RECORD_LAYOUT
/begin RECORD_LAYOUT Lookup1D_X_LONG AXIS_PTS_X 1 SLONG INDEX_INCR DIRECT /end RECORD_LAYOUT
/begin RECORD_LAYOUT Lookup1D_FLOAT32_IEEE FNC_VALUES 1 FLOAT32_IEEE COLUMN_DIR DIRECT /end RECORD_LAYOUT
/begin RECORD_LAYOUT Lookup1D_X_FLOAT32_IEEE AXIS_PTS_X 1 FLOAT32_IEEE INDEX_INCR DIRECT /end RECORD_LAYOUT
/begin RECORD_LAYOUT Lookup1D_FLOAT64_IEEE FNC_VALUES 1 FLOAT64_IEEE COLUMN_DIR DIRECT /end RECORD_LAYOUT
/begin RECORD_LAYOUT Lookup1D_X_FLOAT64_IEEE AXIS_PTS_X 1 FLOAT64_IEEE INDEX_INCR DIRECT /end RECORD_LAYOUT
/begin RECORD_LAYOUT Lookup2D_BOOLEAN FNC_VALUES 1 UBYTE COLUMN_DIR DIRECT /end RECORD_LAYOUT
/begin RECORD_LAYOUT Lookup2D_X_BOOLEAN AXIS_PTS_X 1 UBYTE INDEX_INCR DIRECT /end RECORD_LAYOUT
/begin RECORD_LAYOUT Lookup2D_UBYTE FNC_VALUES 1 UBYTE COLUMN_DIR DIRECT /end RECORD_LAYOUT
/begin RECORD_LAYOUT Lookup2D_X_UBYTE AXIS_PTS_X 1 UBYTE INDEX_INCR DIRECT /end RECORD_LAYOUT
/begin RECORD_LAYOUT Lookup2D_BYTE FNC_VALUES 1 SBYTE COLUMN_DIR DIRECT /end RECORD_LAYOUT
/begin RECORD_LAYOUT Lookup2D_X_BYTE AXIS_PTS_X 1 SBYTE INDEX_INCR DIRECT /end RECORD_LAYOUT
/begin RECORD_LAYOUT Lookup2D_UWORD FNC_VALUES 1 UWORD COLUMN_DIR DIRECT /end RECORD_LAYOUT
/begin RECORD_LAYOUT Lookup2D_X_UWORD AXIS_PTS_X 1 UWORD INDEX_INCR DIRECT /end RECORD_LAYOUT
/begin RECORD_LAYOUT Lookup2D_WORD FNC_VALUES 1 SWORD COLUMN_DIR DIRECT /end RECORD_LAYOUT
/begin RECORD_LAYOUT Lookup2D_X_WORD AXIS_PTS_X 1 SWORD INDEX_INCR DIRECT /end RECORD_LAYOUT
/begin RECORD_LAYOUT Lookup2D_ULONG FNC_VALUES 1 ULONG COLUMN_DIR DIRECT /end RECORD_LAYOUT
/begin RECORD_LAYOUT Lookup2D_X_ULONG AXIS_PTS_X 1 ULONG INDEX_INCR DIRECT /end RECORD_LAYOUT
/begin RECORD_LAYOUT Lookup2D_LONG FNC_VALUES 1 SLONG COLUMN_DIR DIRECT /end RECORD_LAYOUT
/begin RECORD_LAYOUT Lookup2D_X_LONG AXIS_PTS_X 1 SLONG INDEX_INCR DIRECT /end RECORD_LAYOUT
/begin RECORD_LAYOUT Lookup2D_FLOAT32_IEEE FNC_VALUES 1 FLOAT32_IEEE COLUMN_DIR DIRECT /end RECORD_LAYOUT
/begin RECORD_LAYOUT Lookup2D_X_FLOAT32_IEEE AXIS_PTS_X 1 FLOAT32_IEEE INDEX_INCR DIRECT /end RECORD_LAYOUT
/begin RECORD_LAYOUT Lookup2D_FLOAT64_IEEE FNC_VALUES 1 FLOAT64_IEEE COLUMN_DIR DIRECT /end RECORD_LAYOUT
/begin RECORD_LAYOUT Lookup2D_X_FLOAT64_IEEE AXIS_PTS_X 1 FLOAT64_IEEE INDEX_INCR DIRECT /end RECORD_LAYOUT
/begin CHARACTERISTIC CeConst_k_ConstOne "" VALUE 0x0000 /* @ECU_Address@CeConst_k_ConstOne@ */ Scalar_FLOAT32_IEEE 0 TRSC_StateMachine_CM_single -3.4E+38 3.4E+38 /end CHARACTERISTIC
/begin CHARACTERISTIC CeConst_k_ConstThree "" VALUE 0x0000 /* @ECU_Address@CeConst_k_ConstThree@ */ Scalar_FLOAT32_IEEE 0 TRSC_StateMachine_CM_single -3.4E+38 3.4E+38 /end CHARACTERISTIC
/begin CHARACTERISTIC CeConst_k_ConstZero "" VALUE 0x0000 /* @ECU_Address@CeConst_k_ConstZero@ */ Scalar_FLOAT32_IEEE 0 TRSC_StateMachine_CM_single -3.4E+38 3.4E+38 /end CHARACTERISTIC
/begin CHARACTERISTIC CeConst_k_SnglTen "Constant Ten" VALUE 0x0000 /* @ECU_Address@CeConst_k_SnglTen@ */ Scalar_FLOAT32_IEEE 0 TRSC_StateMachine_CM_single_inherit -3.4E+38 3.4E+38 /end CHARACTERISTIC
/begin CHARACTERISTIC CeConst_k_SnglTwentyFive "Constant TwentyFive" VALUE 0x0000 /* @ECU_Address@CeConst_k_SnglTwentyFive@ */ Scalar_FLOAT32_IEEE 0 TRSC_StateMachine_CM_single_inherit -3.4E+38 3.4E+38 /end CHARACTERISTIC
/begin CHARACTERISTIC CeConst_k_SnglZero "Constant Zero" VALUE 0x0000 /* @ECU_Address@CeConst_k_SnglZero@ */ Scalar_FLOAT32_IEEE 0 TRSC_StateMachine_CM_single_inherit -3.4E+38 3.4E+38 /end CHARACTERISTIC
/begin CHARACTERISTIC CeConst_mph_VehSpeedThr "Vehicle speed Threshold" VALUE 0x0000 /* @ECU_Address@CeConst_mph_VehSpeedThr@ */ Scalar_FLOAT32_IEEE 0 TRSC_StateMachine_CM_single_inherit -3.4E+38 3.4E+38 /end CHARACTERISTIC
/begin CHARACTERISTIC CeTRA_sec_SampleTime "sampling time" VALUE 0x0000 /* @ECU_Address@CeTRA_sec_SampleTime@ */ Scalar_FLOAT32_IEEE 0 TRSC_StateMachine_CM_single_sec -3.4E+38 3.4E+38 /end CHARACTERISTIC
/begin CHARACTERISTIC CeTRSC_k_SnglEight "Constant 8" VALUE 0x0000 /* @ECU_Address@CeTRSC_k_SnglEight@ */ Scalar_FLOAT32_IEEE 0 TRSC_StateMachine_CM_single -3.4E+38 3.4E+38 /end CHARACTERISTIC
/begin CHARACTERISTIC CeTRSC_s_TRSCLpTm "TRSC Loop time" VALUE 0x0000 /* @ECU_Address@CeTRSC_s_TRSCLpTm@ */ Scalar_FLOAT32_IEEE 0 TRSC_StateMachine_CM_single_sec -3.4E+38 3.4E+38 /end CHARACTERISTIC
/begin CHARACTERISTIC KeTRSC_cnt_DrvOvrdTurnOnDlyTime "" VALUE 0x0000 /* @ECU_Address@KeTRSC_cnt_DrvOvrdTurnOnDlyTime@ */ Scalar_FLOAT32_IEEE 0 TRSC_StateMachine_CM_single -3.4E+38 3.4E+38 /end CHARACTERISTIC
/begin CHARACTERISTIC KeTRSC_cnt_OvrSpdThr "Over speed counter based on Maximum speed limit request " VALUE 0x0000 /* @ECU_Address@KeTRSC_cnt_OvrSpdThr@ */ Scalar_FLOAT32_IEEE 0 TRSC_StateMachine_CM_single -3.4E+38 3.4E+38 /end CHARACTERISTIC
/begin CHARACTERISTIC KeTRSC_cnt_ResetOvrSpdThr "Over speed counter based on Maximum speed limit request " VALUE 0x0000 /* @ECU_Address@KeTRSC_cnt_ResetOvrSpdThr@ */ Scalar_FLOAT32_IEEE 0 TRSC_StateMachine_CM_single -3.4E+38 3.4E+38 /end CHARACTERISTIC
/begin CHARACTERISTIC KeTRSC_dM_StrTrqCmdRateLmtForDrvOvrd "" VALUE 0x0000 /* @ECU_Address@KeTRSC_dM_StrTrqCmdRateLmtForDrvOvrd@ */ Scalar_FLOAT32_IEEE 0 TRSC_StateMachine_CM_single -3.4E+38 3.4E+38 /end CHARACTERISTIC
/begin CHARACTERISTIC KeTRSC_ddeg_SmTrqRateLimNonActv "State Machine TrqRateLim NonActv State" VALUE 0x0000 /* @ECU_Address@KeTRSC_ddeg_SmTrqRateLimNonActv@ */ Scalar_FLOAT32_IEEE 0 TRSC_StateMachine_CM_single_deg_sec -3.4E+38 3.4E+38 /end CHARACTERISTIC
/begin CHARACTERISTIC KeTRSC_deg_MaxStrAngTyp1 "Maximum Steering Angle threshold" VALUE 0x0000 /* @ECU_Address@KeTRSC_deg_MaxStrAngTyp1@ */ Scalar_FLOAT32_IEEE 0 TRSC_StateMachine_CM_single -1000.0 1000.0 /end CHARACTERISTIC
/begin CHARACTERISTIC KeTRSC_deg_MaxStrAngTyp2 "Maximum Steering Angle threshold" VALUE 0x0000 /* @ECU_Address@KeTRSC_deg_MaxStrAngTyp2@ */ Scalar_FLOAT32_IEEE 0 TRSC_StateMachine_CM_single -1000.0 1000.0 /end CHARACTERISTIC
/begin CHARACTERISTIC KeTRSC_k_NegSteerWheelThreshold "Negative Steering angle threshold for TRSC activation for corner case1" VALUE 0x0000 /* @ECU_Address@KeTRSC_k_NegSteerWheelThreshold@ */ Scalar_FLOAT32_IEEE 0 TRSC_StateMachine_CM_single -3.4E+38 3.4E+38 /end CHARACTERISTIC
/begin CHARACTERISTIC KeTRSC_k_NegativeTadAngleThreshold "Negative TAD angle threshold for TRSC activation for corner case1" VALUE 0x0000 /* @ECU_Address@KeTRSC_k_NegativeTadAngleThreshold@ */ Scalar_FLOAT32_IEEE 0 TRSC_StateMachine_CM_single -3.4E+38 3.4E+38 /end CHARACTERISTIC
/begin CHARACTERISTIC KeTRSC_k_PosSteerWheelThreshold "Positive Steering angle threshold for TRSC activation for corner case1" VALUE 0x0000 /* @ECU_Address@KeTRSC_k_PosSteerWheelThreshold@ */ Scalar_FLOAT32_IEEE 0 TRSC_StateMachine_CM_single -3.4E+38 3.4E+38 /end CHARACTERISTIC
/begin CHARACTERISTIC KeTRSC_k_PositiveTadAngleThreshold "Positive TAD angle threshold for TRSC activation for corner case1" VALUE 0x0000 /* @ECU_Address@KeTRSC_k_PositiveTadAngleThreshold@ */ Scalar_FLOAT32_IEEE 0 TRSC_StateMachine_CM_single -3.4E+38 3.4E+38 /end CHARACTERISTIC
/begin CHARACTERISTIC KeTRSC_k_StrTrqPercThresholdForDrvOvrd "Percentage value to enable false driver override prevention code" VALUE 0x0000 /* @ECU_Address@KeTRSC_k_StrTrqPercThresholdForDrvOvrd@ */ Scalar_FLOAT32_IEEE 0 TRSC_StateMachine_CM_single -3.4E+38 3.4E+38 /end CHARACTERISTIC
/begin CHARACTERISTIC KeTRSC_k_TrqConstRateLim "Constant Rate Limit for Torque " VALUE 0x0000 /* @ECU_Address@KeTRSC_k_TrqConstRateLim@ */ Scalar_FLOAT32_IEEE 0 TRSC_StateMachine_CM_single -3.4E+38 3.4E+38 /end CHARACTERISTIC
/begin CHARACTERISTIC KeTRSC_kph_MaxSpdLimThr "Vehicle speed threshold based on Maximum speed limit request" VALUE 0x0000 /* @ECU_Address@KeTRSC_kph_MaxSpdLimThr@ */ Scalar_FLOAT32_IEEE 0 TRSC_StateMachine_CM_single -3.4E+38 3.4E+38 /end CHARACTERISTIC
/begin CHARACTERISTIC KeTRSC_m_DesAnglScaleTBLThrSM "TBL Threshold for TAD angle limit for activation" VALUE 0x0000 /* @ECU_Address@KeTRSC_m_DesAnglScaleTBLThrSM@ */ Scalar_FLOAT32_IEEE 0 TRSC_StateMachine_CM_single -3.4E+38 3.4E+38 /end CHARACTERISTIC
/begin CHARACTERISTIC KeTRSC_mph_SpdThrActivation "Vehicle Speed Threshold for TRSC activation" VALUE 0x0000 /* @ECU_Address@KeTRSC_mph_SpdThrActivation@ */ Scalar_FLOAT32_IEEE 0 TRSC_StateMachine_CM_single -3.4E+38 3.4E+38 /end CHARACTERISTIC
/begin CHARACTERISTIC KeTRSC_pct_JackKnifePerc "JackKnife Angle Percentage" VALUE 0x0000 /* @ECU_Address@KeTRSC_pct_JackKnifePerc@ */ Scalar_FLOAT32_IEEE 0 TRSC_StateMachine_CM_single 0.0 95.0 /end CHARACTERISTIC
/begin CHARACTERISTIC KeTRSC_pct_TrlrAngScaleDwnPctSM "Desired Trlr Angle TBL Threshold" VALUE 0x0000 /* @ECU_Address@KeTRSC_pct_TrlrAngScaleDwnPctSM@ */ Scalar_FLOAT32_IEEE 0 TRSC_StateMachine_CM_single -3.4E+38 3.4E+38 /end CHARACTERISTIC
/begin CHARACTERISTIC KeTRSC_s_CalibDlyTh "Calibration Delay (1000 ms)" VALUE 0x0000 /* @ECU_Address@KeTRSC_s_CalibDlyTh@ */ Scalar_FLOAT32_IEEE 0 TRSC_StateMachine_CM_single_sec -3.4E+38 3.4E+38 /end CHARACTERISTIC
/begin CHARACTERISTIC KeTRSC_s_DeactSpdTime "DEACTIVATON_SPD_TIME" VALUE 0x0000 /* @ECU_Address@KeTRSC_s_DeactSpdTime@ */ Scalar_FLOAT32_IEEE 0 TRSC_StateMachine_CM_single_sec -3.4E+38 3.4E+38 /end CHARACTERISTIC
/begin CHARACTERISTIC KeTRSC_s_EightSecTh "Display timer threshold (8 Sec) used for Disply popup" VALUE 0x0000 /* @ECU_Address@KeTRSC_s_EightSecTh@ */ Scalar_FLOAT32_IEEE 0 TRSC_StateMachine_CM_single_sec -3.4E+38 3.4E+38 /end CHARACTERISTIC
/begin CHARACTERISTIC KeTRSC_s_FifteenSecTh "15 sec" VALUE 0x0000 /* @ECU_Address@KeTRSC_s_FifteenSecTh@ */ Scalar_FLOAT32_IEEE 0 TRSC_StateMachine_CM_single_sec -3.4E+38 3.4E+38 /end CHARACTERISTIC
/begin CHARACTERISTIC KeTRSC_s_FiveSecTh "LED timer threshold (5 Sec) used for blinking" VALUE 0x0000 /* @ECU_Address@KeTRSC_s_FiveSecTh@ */ Scalar_FLOAT32_IEEE 0 TRSC_StateMachine_CM_single_sec -3.4E+38 3.4E+38 /end CHARACTERISTIC
/begin CHARACTERISTIC KeTRSC_s_TRSCCornerCasAtc "Time limit for TRSCCornerCasAtc" VALUE 0x0000 /* @ECU_Address@KeTRSC_s_TRSCCornerCasAtc@ */ Scalar_FLOAT32_IEEE 0 TRSC_StateMachine_CM_single -3.4E+38 3.4E+38 /end CHARACTERISTIC
/begin CHARACTERISTIC KeTRSC_s_TenMinTh "10 Min = 600 seconds timer threshold" VALUE 0x0000 /* @ECU_Address@KeTRSC_s_TenMinTh@ */ Scalar_FLOAT32_IEEE 0 TRSC_StateMachine_CM_single_sec -3.4E+38 3.4E+38 /end CHARACTERISTIC
/begin CHARACTERISTIC KeTRSC_s_ThirtySecTh "30 sec" VALUE 0x0000 /* @ECU_Address@KeTRSC_s_ThirtySecTh@ */ Scalar_FLOAT32_IEEE 0 TRSC_StateMachine_CM_single_sec -3.4E+38 3.4E+38 /end CHARACTERISTIC
/begin CHARACTERISTIC KeTRSC_s_TwoSecTh "LED timer threshold (2 Sec) used for blinking" VALUE 0x0000 /* @ECU_Address@KeTRSC_s_TwoSecTh@ */ Scalar_FLOAT32_IEEE 0 TRSC_StateMachine_CM_single_sec -3.4E+38 3.4E+38 /end CHARACTERISTIC
/begin CHARACTERISTIC KeTRSC_b_BypassRadDsplyTyp "Bypass RadDsplyTyp check for TRSC Enable Button Sts" VALUE 0x0000 /* @ECU_Address@KeTRSC_b_BypassRadDsplyTyp@ */ Scalar_BOOLEAN 0 TRSC_StateMachine_CM_boolean 0 1 /end CHARACTERISTIC
/begin CHARACTERISTIC KeTRSC_b_EnblDrvDctcOvrd "" VALUE 0x0000 /* @ECU_Address@KeTRSC_b_EnblDrvDctcOvrd@ */ Scalar_BOOLEAN 0 TRSC_StateMachine_CM_boolean 0 1 /end CHARACTERISTIC
/begin CHARACTERISTIC KeTRSC_b_EnblExtFault "Enable External Faults" VALUE 0x0000 /* @ECU_Address@KeTRSC_b_EnblExtFault@ */ Scalar_BOOLEAN 0 TRSC_StateMachine_CM_boolean 0.0 1.0 /end CHARACTERISTIC
/begin CHARACTERISTIC CeConst_k_ConstOneUint8 "" VALUE 0x0000 /* @ECU_Address@CeConst_k_ConstOneUint8@ */ Scalar_UBYTE 0 TRSC_StateMachine_CM_uint8 0 255 /end CHARACTERISTIC
/begin CHARACTERISTIC CeConst_k_ConstZeroUint8 "" VALUE 0x0000 /* @ECU_Address@CeConst_k_ConstZeroUint8@ */ Scalar_UBYTE 0 TRSC_StateMachine_CM_uint8 0 255 /end CHARACTERISTIC
/begin CHARACTERISTIC KeTRSC_cnt_AvgSampleCnt "" VALUE 0x0000 /* @ECU_Address@KeTRSC_cnt_AvgSampleCnt@ */ Scalar_UBYTE 0 TRSC_StateMachine_CM_uint8 0 255 /end CHARACTERISTIC
/begin MEASUREMENT MeTRSC_b_ExternalFault "TRSC External Fault signal comprising following CAN  signals:
      
      1. m_QM_FID_TRSC_DISABLED 
      2. m_QM_FID_TRSC_CAM_CAL_ABORT 
      " /* Data type */ UBYTE /* Conversion method */ TRSC_StateMachine_CM_boolean /* Resolution (Not used) */ 0 /* Accuracy (Not used) */ 0 /* Lower limit */ 0 /* Upper limit */ 1 ECU_ADDRESS 0x0000 /* @ECU_Address@MeTRSC_b_ExternalFault@ */ /end MEASUREMENT
/begin COMPU_METHOD TRSC_StateMachine_CM_single "Q = V" RAT_FUNC "%8.6" "" COEFFS 0 1 0 0 0 1 /end COMPU_METHOD
/begin COMPU_METHOD TRSC_StateMachine_CM_single_inherit "Q = V" RAT_FUNC "%8.6" "inherit" COEFFS 0 1 0 0 0 1 /end COMPU_METHOD
/begin COMPU_METHOD TRSC_StateMachine_CM_single_sec "Q = V" RAT_FUNC "%8.6" "sec" COEFFS 0 1 0 0 0 1 /end COMPU_METHOD
/begin COMPU_METHOD TRSC_StateMachine_CM_single_deg_sec "Q = V" RAT_FUNC "%8.6" "deg/sec" COEFFS 0 1 0 0 0 1 /end COMPU_METHOD
/begin COMPU_METHOD TRSC_StateMachine_CM_boolean "Q = V" RAT_FUNC "%1.0" "" COEFFS 0 1 0 0 0 1 /end COMPU_METHOD
/begin COMPU_METHOD TRSC_StateMachine_CM_uint8 "Q = V" RAT_FUNC "%3.0" "" COEFFS 0 1 0 0 0 1 /end COMPU_METHOD
/begin GROUP TRSC_StateMachine "TRSC_StateMachine" /* Root */ ROOT /begin SUB_GROUP Root_TRSC_StateLogic /end SUB_GROUP /end GROUP
/begin GROUP Root_TRSC_StateLogic "TRSC_StateMachine/TRSC_StateLogic"
 /begin SUB_GROUP S2_MaxStrAngle_Selection S2_OverSpeed_Check S2_Subsystem1 S2_TADAngAct_TADAngActSign S2_TRSCAbortReas_DID S2_TRSC_ExternalFault /end SUB_GROUP
 /begin REF_CHARACTERISTIC CeConst_k_ConstOne CeConst_k_ConstOneUint8 CeConst_k_ConstThree CeConst_k_ConstZero CeConst_k_ConstZeroUint8 CeConst_k_SnglTen CeConst_k_SnglTwentyFive CeConst_k_SnglZero CeConst_mph_VehSpeedThr CeTRA_sec_SampleTime CeTRSC_k_SnglEight CeTRSC_s_TRSCLpTm KeTRSC_b_EnblDrvDctcOvrd KeTRSC_cnt_AvgSampleCnt KeTRSC_cnt_DrvOvrdTurnOnDlyTime KeTRSC_dM_StrTrqCmdRateLmtForDrvOvrd KeTRSC_ddeg_SmTrqRateLimNonActv KeTRSC_k_NegSteerWheelThreshold KeTRSC_k_NegativeTadAngleThreshold KeTRSC_k_PosSteerWheelThreshold KeTRSC_k_PositiveTadAngleThreshold KeTRSC_k_StrTrqPercThresholdForDrvOvrd KeTRSC_k_TrqConstRateLim KeTRSC_m_DesAnglScaleTBLThrSM KeTRSC_mph_SpdThrActivation KeTRSC_pct_JackKnifePerc KeTRSC_pct_TrlrAngScaleDwnPctSM KeTRSC_s_CalibDlyTh KeTRSC_s_DeactSpdTime KeTRSC_s_EightSecTh KeTRSC_s_FifteenSecTh KeTRSC_s_FiveSecTh KeTRSC_s_TRSCCornerCasAtc KeTRSC_s_TenMinTh KeTRSC_s_ThirtySecTh KeTRSC_s_TwoSecTh /end REF_CHARACTERISTIC
/end GROUP
/begin GROUP S2_MaxStrAngle_Selection "TRSC_StateMachine/TRSC_StateLogic/MaxStrAngle_Selection" /begin REF_CHARACTERISTIC KeTRSC_deg_MaxStrAngTyp1 KeTRSC_deg_MaxStrAngTyp2 /end REF_CHARACTERISTIC /end GROUP
/begin GROUP S2_OverSpeed_Check "TRSC_StateMachine/TRSC_StateLogic/OverSpeed_Check"
 /begin REF_CHARACTERISTIC CeTRSC_s_TRSCLpTm KeTRSC_cnt_OvrSpdThr KeTRSC_cnt_ResetOvrSpdThr KeTRSC_kph_MaxSpdLimThr /end REF_CHARACTERISTIC
/end GROUP
/begin GROUP S2_Subsystem1 "TRSC_StateMachine/TRSC_StateLogic/Subsystem1" /begin REF_CHARACTERISTIC KeTRSC_b_BypassRadDsplyTyp /end REF_CHARACTERISTIC /end GROUP
/begin GROUP S2_TADAngAct_TADAngActSign "TRSC_StateMachine/TRSC_StateLogic/TADAngAct_TADAngActSign" /begin REF_CHARACTERISTIC CeConst_k_SnglZero /end REF_CHARACTERISTIC /end GROUP
/begin GROUP S2_TRSCAbortReas_DID "TRSC_StateMachine/TRSC_StateLogic/TRSCAbortReas_DID"
 /begin REF_CHARACTERISTIC CeConst_k_SnglTwentyFive CeTRSC_s_TRSCLpTm KeTRSC_s_TenMinTh /end REF_CHARACTERISTIC
/end GROUP
/begin GROUP S2_TRSC_ExternalFault "TRSC_StateMachine/TRSC_StateLogic/TRSC_ExternalFault" /begin REF_CHARACTERISTIC KeTRSC_b_EnblExtFault /end REF_CHARACTERISTIC /begin REF_MEASUREMENT MeTRSC_b_ExternalFault /end REF_MEASUREMENT /end GROUP
/end MODULE
/end PROJECT
/* (add any file trailer comments here) */
/* EOF TRSC_StateMachine.a2l */
