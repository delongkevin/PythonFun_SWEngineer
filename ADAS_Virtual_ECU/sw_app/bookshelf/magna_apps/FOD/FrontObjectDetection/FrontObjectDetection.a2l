/******************************************************************************
* ASAP2 file: FrontObjectDetection.a2l
* Code generation for model "FrontObjectDetection".
* Model version : 1.61
* Simulink Coder version : 9.2 (R2019b) 18-Jul-2019
* C source code generated on : Thu Sep 26 17:23:17 2024
* Target selection: ert.tlc
* Embedded hardware selection: ARM Compatible->ARM Cortex
* Code generation objectives:
* 1. MISRA C:2012 guidelines
* 2. RAM efficiency
* 3. ROM efficiency
* Validation result: Not run
* (add additional file header information here)
******************************************************************************/ ASAP2_VERSION 1 31
/* Version 1.31 */
/begin PROJECT ProjectName "Project Comment Goes Here"
/begin HEADER "Header Comments go here" /end HEADER
/begin MODULE ModuleName "Module Comment Goes Here"
/begin MOD_PAR "MOD PAR Comment Goes Here" /end MOD_PAR
/begin MOD_COMMON "Mod Common Comment Here" BYTE_ORDER MSB_LAST /end MOD_COMMON
/begin RECORD_LAYOUT Scalar_BOOLEAN FNC_VALUES 1 UBYTE COLUMN_DIR DIRECT /end RECORD_LAYOUT
/begin RECORD_LAYOUT Scalar_UBYTE FNC_VALUES 1 UBYTE COLUMN_DIR DIRECT /end RECORD_LAYOUT
/begin RECORD_LAYOUT Scalar_BYTE FNC_VALUES 1 SBYTE COLUMN_DIR DIRECT /end RECORD_LAYOUT
/begin RECORD_LAYOUT Scalar_UWORD FNC_VALUES 1 UWORD COLUMN_DIR DIRECT /end RECORD_LAYOUT
/begin RECORD_LAYOUT Scalar_SWORD FNC_VALUES 1 SWORD COLUMN_DIR DIRECT /end RECORD_LAYOUT
/begin RECORD_LAYOUT Scalar_ULONG FNC_VALUES 1 ULONG COLUMN_DIR DIRECT /end RECORD_LAYOUT
/begin RECORD_LAYOUT Scalar_LONG FNC_VALUES 1 SLONG COLUMN_DIR DIRECT /end RECORD_LAYOUT
/begin RECORD_LAYOUT Scalar_FLOAT32_IEEE FNC_VALUES 1 FLOAT32_IEEE COLUMN_DIR DIRECT /end RECORD_LAYOUT
/begin RECORD_LAYOUT Scalar_FLOAT64_IEEE FNC_VALUES 1 FLOAT64_IEEE COLUMN_DIR DIRECT /end RECORD_LAYOUT
/begin RECORD_LAYOUT Lookup1D_BOOLEAN FNC_VALUES 1 UBYTE COLUMN_DIR DIRECT /end RECORD_LAYOUT
/begin RECORD_LAYOUT Lookup1D_X_BOOLEAN AXIS_PTS_X 1 UBYTE INDEX_INCR DIRECT /end RECORD_LAYOUT
/begin RECORD_LAYOUT Lookup1D_BYTE FNC_VALUES 1 SBYTE COLUMN_DIR DIRECT /end RECORD_LAYOUT
/begin RECORD_LAYOUT Lookup1D_X_BYTE AXIS_PTS_X 1 SBYTE INDEX_INCR DIRECT /end RECORD_LAYOUT
/begin RECORD_LAYOUT Lookup1D_UBYTE FNC_VALUES 1 UBYTE COLUMN_DIR DIRECT /end RECORD_LAYOUT
/begin RECORD_LAYOUT Lookup1D_X_UBYTE AXIS_PTS_X 1 UBYTE INDEX_INCR DIRECT /end RECORD_LAYOUT
/begin RECORD_LAYOUT Lookup1D_UWORD FNC_VALUES 1 UWORD COLUMN_DIR DIRECT /end RECORD_LAYOUT
/begin RECORD_LAYOUT Lookup1D_X_UWORD AXIS_PTS_X 1 UWORD INDEX_INCR DIRECT /end RECORD_LAYOUT
/begin RECORD_LAYOUT Lookup1D_WORD FNC_VALUES 1 SWORD COLUMN_DIR DIRECT /end RECORD_LAYOUT
/begin RECORD_LAYOUT Lookup1D_X_WORD AXIS_PTS_X 1 SWORD INDEX_INCR DIRECT /end RECORD_LAYOUT
/begin RECORD_LAYOUT Lookup1D_ULONG FNC_VALUES 1 ULONG COLUMN_DIR DIRECT /end RECORD_LAYOUT
/begin RECORD_LAYOUT Lookup1D_X_ULONG AXIS_PTS_X 1 ULONG INDEX_INCR DIRECT /end RECORD_LAYOUT
/begin RECORD_LAYOUT Lookup1D_SLONG FNC_VALUES 1 SLONG COLUMN_DIR DIRECT /end RECORD_LAYOUT
/begin RECORD_LAYOUT Lookup1D_X_LONG AXIS_PTS_X 1 SLONG INDEX_INCR DIRECT /end RECORD_LAYOUT
/begin RECORD_LAYOUT Lookup1D_FLOAT32_IEEE FNC_VALUES 1 FLOAT32_IEEE COLUMN_DIR DIRECT /end RECORD_LAYOUT
/begin RECORD_LAYOUT Lookup1D_X_FLOAT32_IEEE AXIS_PTS_X 1 FLOAT32_IEEE INDEX_INCR DIRECT /end RECORD_LAYOUT
/begin RECORD_LAYOUT Lookup1D_FLOAT64_IEEE FNC_VALUES 1 FLOAT64_IEEE COLUMN_DIR DIRECT /end RECORD_LAYOUT
/begin RECORD_LAYOUT Lookup1D_X_FLOAT64_IEEE AXIS_PTS_X 1 FLOAT64_IEEE INDEX_INCR DIRECT /end RECORD_LAYOUT
/begin RECORD_LAYOUT Lookup2D_BOOLEAN FNC_VALUES 1 UBYTE COLUMN_DIR DIRECT /end RECORD_LAYOUT
/begin RECORD_LAYOUT Lookup2D_X_BOOLEAN AXIS_PTS_X 1 UBYTE INDEX_INCR DIRECT /end RECORD_LAYOUT
/begin RECORD_LAYOUT Lookup2D_UBYTE FNC_VALUES 1 UBYTE COLUMN_DIR DIRECT /end RECORD_LAYOUT
/begin RECORD_LAYOUT Lookup2D_X_UBYTE AXIS_PTS_X 1 UBYTE INDEX_INCR DIRECT /end RECORD_LAYOUT
/begin RECORD_LAYOUT Lookup2D_BYTE FNC_VALUES 1 SBYTE COLUMN_DIR DIRECT /end RECORD_LAYOUT
/begin RECORD_LAYOUT Lookup2D_X_BYTE AXIS_PTS_X 1 SBYTE INDEX_INCR DIRECT /end RECORD_LAYOUT
/begin RECORD_LAYOUT Lookup2D_UWORD FNC_VALUES 1 UWORD COLUMN_DIR DIRECT /end RECORD_LAYOUT
/begin RECORD_LAYOUT Lookup2D_X_UWORD AXIS_PTS_X 1 UWORD INDEX_INCR DIRECT /end RECORD_LAYOUT
/begin RECORD_LAYOUT Lookup2D_WORD FNC_VALUES 1 SWORD COLUMN_DIR DIRECT /end RECORD_LAYOUT
/begin RECORD_LAYOUT Lookup2D_X_WORD AXIS_PTS_X 1 SWORD INDEX_INCR DIRECT /end RECORD_LAYOUT
/begin RECORD_LAYOUT Lookup2D_ULONG FNC_VALUES 1 ULONG COLUMN_DIR DIRECT /end RECORD_LAYOUT
/begin RECORD_LAYOUT Lookup2D_X_ULONG AXIS_PTS_X 1 ULONG INDEX_INCR DIRECT /end RECORD_LAYOUT
/begin RECORD_LAYOUT Lookup2D_LONG FNC_VALUES 1 SLONG COLUMN_DIR DIRECT /end RECORD_LAYOUT
/begin RECORD_LAYOUT Lookup2D_X_LONG AXIS_PTS_X 1 SLONG INDEX_INCR DIRECT /end RECORD_LAYOUT
/begin RECORD_LAYOUT Lookup2D_FLOAT32_IEEE FNC_VALUES 1 FLOAT32_IEEE COLUMN_DIR DIRECT /end RECORD_LAYOUT
/begin RECORD_LAYOUT Lookup2D_X_FLOAT32_IEEE AXIS_PTS_X 1 FLOAT32_IEEE INDEX_INCR DIRECT /end RECORD_LAYOUT
/begin RECORD_LAYOUT Lookup2D_FLOAT64_IEEE FNC_VALUES 1 FLOAT64_IEEE COLUMN_DIR DIRECT /end RECORD_LAYOUT
/begin RECORD_LAYOUT Lookup2D_X_FLOAT64_IEEE AXIS_PTS_X 1 FLOAT64_IEEE INDEX_INCR DIRECT /end RECORD_LAYOUT
/begin CHARACTERISTIC KeFOD_cm_CenterWarnLatThreshold "Parameter to decide center region" VALUE 0x0000 /* @ECU_Address@KeFOD_cm_CenterWarnLatThreshold@ */ Scalar_SWORD 0 FrontObjectDetection_CM_int16 -32768 32767 /end CHARACTERISTIC
/begin CHARACTERISTIC KeFOD_cm_DistZone1 "Warning Zone 1 Dist" VALUE 0x0000 /* @ECU_Address@KeFOD_cm_DistZone1@ */ Scalar_SWORD 0 FrontObjectDetection_CM_int16_cm 0.0 32767 /end CHARACTERISTIC
/begin CHARACTERISTIC KeFOD_cm_DistZone2 "Warning Zone 2 Dist" VALUE 0x0000 /* @ECU_Address@KeFOD_cm_DistZone2@ */ Scalar_SWORD 0 FrontObjectDetection_CM_int16_cm 0.0 32767 /end CHARACTERISTIC
/begin CHARACTERISTIC KeFOD_cm_DistZone3 "Warning Zone 3 Dist" VALUE 0x0000 /* @ECU_Address@KeFOD_cm_DistZone3@ */ Scalar_SWORD 0 FrontObjectDetection_CM_int16_cm 0.0 32767 /end CHARACTERISTIC
/begin CHARACTERISTIC KeFOD_cm_DistZone4 "Warning Zone 4 Dist" VALUE 0x0000 /* @ECU_Address@KeFOD_cm_DistZone4@ */ Scalar_SWORD 0 FrontObjectDetection_CM_int16_cm 0.0 32767 /end CHARACTERISTIC
/begin CHARACTERISTIC KeFOD_cm_DistZone5 "Warning Zone 5 Dist" VALUE 0x0000 /* @ECU_Address@KeFOD_cm_DistZone5@ */ Scalar_SWORD 0 FrontObjectDetection_CM_int16_cm 0.0 32767 /end CHARACTERISTIC
/begin CHARACTERISTIC KeFOD_cm_DistZone6 "Warning Zone 6 Dist" VALUE 0x0000 /* @ECU_Address@KeFOD_cm_DistZone6@ */ Scalar_SWORD 0 FrontObjectDetection_CM_int16_cm 0.0 32767 /end CHARACTERISTIC
/begin CHARACTERISTIC KeFOD_cm_HalfVehicleWidth "Ego Vehicle Car Half Width" VALUE 0x0000 /* @ECU_Address@KeFOD_cm_HalfVehicleWidth@ */ Scalar_SWORD 0 FrontObjectDetection_CM_int16_sec -32768 32767 /end CHARACTERISTIC
/begin CHARACTERISTIC KeFOD_cm_SideDetectionRange "FOD Lateral Detection range" VALUE 0x0000 /* @ECU_Address@KeFOD_cm_SideDetectionRange@ */ Scalar_SWORD 0 FrontObjectDetection_CM_int16 -32768 32767 /end CHARACTERISTIC
/begin CHARACTERISTIC KeFOD_cm_VehContour_FIL_x "X-coordinate for FIL Edge" VALUE 0x0000 /* @ECU_Address@KeFOD_cm_VehContour_FIL_x@ */ Scalar_SWORD 0 FrontObjectDetection_CM_int16_cm -32768 32767 /end CHARACTERISTIC
/begin CHARACTERISTIC KeFOD_cm_VehContour_FIL_y "Y-coordinate for FIL Edge" VALUE 0x0000 /* @ECU_Address@KeFOD_cm_VehContour_FIL_y@ */ Scalar_SWORD 0 FrontObjectDetection_CM_int16_cm -32768 32767 /end CHARACTERISTIC
/begin CHARACTERISTIC KeFOD_cm_VehContour_FIR_x "X-coordinate for FIR Edge" VALUE 0x0000 /* @ECU_Address@KeFOD_cm_VehContour_FIR_x@ */ Scalar_SWORD 0 FrontObjectDetection_CM_int16_cm -32768 32767 /end CHARACTERISTIC
/begin CHARACTERISTIC KeFOD_cm_VehContour_FIR_y "Y-coordinate for FIR Edge" VALUE 0x0000 /* @ECU_Address@KeFOD_cm_VehContour_FIR_y@ */ Scalar_SWORD 0 FrontObjectDetection_CM_int16_cm -32768 32767 /end CHARACTERISTIC
/begin CHARACTERISTIC KeFOD_cm_VehContour_FOL_x "X-coordinate for FOL Edge" VALUE 0x0000 /* @ECU_Address@KeFOD_cm_VehContour_FOL_x@ */ Scalar_SWORD 0 FrontObjectDetection_CM_int16_cm -32768 32767 /end CHARACTERISTIC
/begin CHARACTERISTIC KeFOD_cm_VehContour_FOL_y "Y-coordinate for FOL Edge" VALUE 0x0000 /* @ECU_Address@KeFOD_cm_VehContour_FOL_y@ */ Scalar_SWORD 0 FrontObjectDetection_CM_int16_cm -32768 32767 /end CHARACTERISTIC
/begin CHARACTERISTIC KeFOD_cm_VehContour_FOR_x "X-coordinate for FOR Edge" VALUE 0x0000 /* @ECU_Address@KeFOD_cm_VehContour_FOR_x@ */ Scalar_SWORD 0 FrontObjectDetection_CM_int16_cm -32768 32767 /end CHARACTERISTIC
/begin CHARACTERISTIC KeFOD_cm_VehContour_FOR_y "Y-coordinate for FOR Edge" VALUE 0x0000 /* @ECU_Address@KeFOD_cm_VehContour_FOR_y@ */ Scalar_SWORD 0 FrontObjectDetection_CM_int16_cm -32768 32767 /end CHARACTERISTIC
/begin CHARACTERISTIC KeFOD_cm_VehContour_FSL_x "X-coordinate for FSL Edge" VALUE 0x0000 /* @ECU_Address@KeFOD_cm_VehContour_FSL_x@ */ Scalar_SWORD 0 FrontObjectDetection_CM_int16_cm -32768 32767 /end CHARACTERISTIC
/begin CHARACTERISTIC KeFOD_cm_VehContour_FSL_y "Y-coordinate for FSL Edge" VALUE 0x0000 /* @ECU_Address@KeFOD_cm_VehContour_FSL_y@ */ Scalar_SWORD 0 FrontObjectDetection_CM_int16_cm -32768 32767 /end CHARACTERISTIC
/begin CHARACTERISTIC KeFOD_cm_VehContour_FSR_x "X-coordinate for FSR Edge" VALUE 0x0000 /* @ECU_Address@KeFOD_cm_VehContour_FSR_x@ */ Scalar_SWORD 0 FrontObjectDetection_CM_int16_cm -32768 32767 /end CHARACTERISTIC
/begin CHARACTERISTIC KeFOD_cm_VehContour_FSR_y "Y-coordinate for FSR Edge" VALUE 0x0000 /* @ECU_Address@KeFOD_cm_VehContour_FSR_y@ */ Scalar_SWORD 0 FrontObjectDetection_CM_int16_cm -32768 32767 /end CHARACTERISTIC
/begin CHARACTERISTIC KeFOD_cm_VehContour_RIL_x "X-coordinate for RIL Edge" VALUE 0x0000 /* @ECU_Address@KeFOD_cm_VehContour_RIL_x@ */ Scalar_SWORD 0 FrontObjectDetection_CM_int16_cm -32768 32767 /end CHARACTERISTIC
/begin CHARACTERISTIC KeFOD_cm_VehContour_RIL_y "Y-coordinate for RIL Edge" VALUE 0x0000 /* @ECU_Address@KeFOD_cm_VehContour_RIL_y@ */ Scalar_SWORD 0 FrontObjectDetection_CM_int16_cm -32768 32767 /end CHARACTERISTIC
/begin CHARACTERISTIC KeFOD_cm_VehContour_RIR_x "X-coordinate for RIR Edge" VALUE 0x0000 /* @ECU_Address@KeFOD_cm_VehContour_RIR_x@ */ Scalar_SWORD 0 FrontObjectDetection_CM_int16_cm -32768 32767 /end CHARACTERISTIC
/begin CHARACTERISTIC KeFOD_cm_VehContour_RIR_y "Y-coordinate for RIR Edge" VALUE 0x0000 /* @ECU_Address@KeFOD_cm_VehContour_RIR_y@ */ Scalar_SWORD 0 FrontObjectDetection_CM_int16_cm -32768 32767 /end CHARACTERISTIC
/begin CHARACTERISTIC KeFOD_cm_VehContour_ROL_x "X-coordinate for ROL Edge" VALUE 0x0000 /* @ECU_Address@KeFOD_cm_VehContour_ROL_x@ */ Scalar_SWORD 0 FrontObjectDetection_CM_int16_cm -32768 32767 /end CHARACTERISTIC
/begin CHARACTERISTIC KeFOD_cm_VehContour_ROL_y "Y-coordinate for ROL Edge" VALUE 0x0000 /* @ECU_Address@KeFOD_cm_VehContour_ROL_y@ */ Scalar_SWORD 0 FrontObjectDetection_CM_int16_cm -32768 32767 /end CHARACTERISTIC
/begin CHARACTERISTIC KeFOD_cm_VehContour_ROR_x "X-coordinate for ROR Edge" VALUE 0x0000 /* @ECU_Address@KeFOD_cm_VehContour_ROR_x@ */ Scalar_SWORD 0 FrontObjectDetection_CM_int16_cm -32768 32767 /end CHARACTERISTIC
/begin CHARACTERISTIC KeFOD_cm_VehContour_ROR_y "Y-coordinate for ROR Edge" VALUE 0x0000 /* @ECU_Address@KeFOD_cm_VehContour_ROR_y@ */ Scalar_SWORD 0 FrontObjectDetection_CM_int16_cm -32768 32767 /end CHARACTERISTIC
/begin CHARACTERISTIC KeFOD_cm_VehContour_RSL_x "X-coordinate for RSL Edge" VALUE 0x0000 /* @ECU_Address@KeFOD_cm_VehContour_RSL_x@ */ Scalar_SWORD 0 FrontObjectDetection_CM_int16_cm -32768 32767 /end CHARACTERISTIC
/begin CHARACTERISTIC KeFOD_cm_VehContour_RSL_y "Y-coordinate for RSL Edge" VALUE 0x0000 /* @ECU_Address@KeFOD_cm_VehContour_RSL_y@ */ Scalar_SWORD 0 FrontObjectDetection_CM_int16_cm -32768 32767 /end CHARACTERISTIC
/begin CHARACTERISTIC KeFOD_cm_VehContour_RSR_x "X-coordinate for RSR Edge" VALUE 0x0000 /* @ECU_Address@KeFOD_cm_VehContour_RSR_x@ */ Scalar_SWORD 0 FrontObjectDetection_CM_int16_cm -32768 32767 /end CHARACTERISTIC
/begin CHARACTERISTIC KeFOD_cm_VehContour_RSR_y "Y-coordinate for RSR Edge" VALUE 0x0000 /* @ECU_Address@KeFOD_cm_VehContour_RSR_y@ */ Scalar_SWORD 0 FrontObjectDetection_CM_int16_cm -32768 32767 /end CHARACTERISTIC
/begin CHARACTERISTIC KeFOD_cm_WarnOffset "Warn Offset Distance " VALUE 0x0000 /* @ECU_Address@KeFOD_cm_WarnOffset@ */ Scalar_SWORD 0 FrontObjectDetection_CM_int16_cm -32768 32767 /end CHARACTERISTIC
/begin CHARACTERISTIC KeFOD_ms_DbncTimeThsd "Debounce time for detected object" VALUE 0x0000 /* @ECU_Address@KeFOD_ms_DbncTimeThsd@ */ Scalar_UWORD 0 FrontObjectDetection_CM_uint16_msec 0 65535 /end CHARACTERISTIC
/begin CHARACTERISTIC KeFOD_b_DbncEnabld "Debounce for FOD Distance enabled" VALUE 0x0000 /* @ECU_Address@KeFOD_b_DbncEnabld@ */ Scalar_BOOLEAN 0 FrontObjectDetection_CM_boolean 0 1 /end CHARACTERISTIC
/begin CHARACTERISTIC KeFOD_pct_ObjConfidenceThd "Detected Object Confidence threshold" VALUE 0x0000 /* @ECU_Address@KeFOD_pct_ObjConfidenceThd@ */ Scalar_UBYTE 0 FrontObjectDetection_CM_uint8_pct 0 255 /end CHARACTERISTIC
/begin CHARACTERISTIC KeFOD_pct_ObjConfidenceThd_Closer "Detected Object Confidence threshold closer objects" VALUE 0x0000 /* @ECU_Address@KeFOD_pct_ObjConfidenceThd_Closer@ */ Scalar_UBYTE 0 FrontObjectDetection_CM_uint8_pct 0 255 /end CHARACTERISTIC
/begin CHARACTERISTIC KeFOD_pct_ObjConfidenceThd_Far "Detected Object Confidence threshold for farther objects" VALUE 0x0000 /* @ECU_Address@KeFOD_pct_ObjConfidenceThd_Far@ */ Scalar_UBYTE 0 FrontObjectDetection_CM_uint8_pct 0 255 /end CHARACTERISTIC
/begin CHARACTERISTIC KeFOD_pct_ObjConfidenceThd_Nearest "Detected Object Confidence threshold for nearest objects" VALUE 0x0000 /* @ECU_Address@KeFOD_pct_ObjConfidenceThd_Nearest@ */ Scalar_UBYTE 0 FrontObjectDetection_CM_uint8_pct 0 255 /end CHARACTERISTIC
/begin MEASUREMENT MeFOD_cm_FrntSideMinXDist "" /* Data type */ SWORD /* Conversion method */ FrontObjectDetection_CM_int16 /* Resolution (Not used) */ 0 /* Accuracy (Not used) */ 0 /* Lower limit */ -32768 /* Upper limit */ 32767 ECU_ADDRESS 0x0000 /* @ECU_Address@MeFOD_cm_FrntSideMinXDist@ */ /end MEASUREMENT
/begin MEASUREMENT MeFOD_cm_FrntCenterMinXDist "" /* Data type */ SWORD /* Conversion method */ FrontObjectDetection_CM_int16 /* Resolution (Not used) */ 0 /* Accuracy (Not used) */ 0 /* Lower limit */ -32768 /* Upper limit */ 32767 ECU_ADDRESS 0x0000 /* @ECU_Address@MeFOD_cm_FrntCenterMinXDist@ */ /end MEASUREMENT
/begin COMPU_METHOD FrontObjectDetection_CM_int16 "Q = V" RAT_FUNC "%5.0" "" COEFFS 0 1 0 0 0 1 /end COMPU_METHOD
/begin COMPU_METHOD FrontObjectDetection_CM_int16_cm "Q = V" RAT_FUNC "%5.0" "cm" COEFFS 0 1 0 0 0 1 /end COMPU_METHOD
/begin COMPU_METHOD FrontObjectDetection_CM_int16_sec "Q = V" RAT_FUNC "%5.0" "sec" COEFFS 0 1 0 0 0 1 /end COMPU_METHOD
/begin COMPU_METHOD FrontObjectDetection_CM_uint16_msec "Q = V" RAT_FUNC "%5.0" "msec" COEFFS 0 1 0 0 0 1 /end COMPU_METHOD
/begin COMPU_METHOD FrontObjectDetection_CM_boolean "Q = V" RAT_FUNC "%1.0" "" COEFFS 0 1 0 0 0 1 /end COMPU_METHOD
/begin COMPU_METHOD FrontObjectDetection_CM_uint8_pct "Q = V" RAT_FUNC "%3.0" "pct" COEFFS 0 1 0 0 0 1 /end COMPU_METHOD
/begin GROUP FrontObjectDetection "FrontObjectDetection" /* Root */ ROOT /begin SUB_GROUP Root_InputProcessing Root_ObjectMinDistanceCalculator /end SUB_GROUP /end GROUP
/begin GROUP Root_InputProcessing "FrontObjectDetection/InputProcessing" /begin SUB_GROUP S1_VrntTunParam /end SUB_GROUP /end GROUP
/begin GROUP Root_ObjectMinDistanceCalculator "FrontObjectDetection/ObjectMinDistanceCalculator" /begin SUB_GROUP S3_CalcMinDistance /end SUB_GROUP /end GROUP
/begin GROUP S1_VrntTunParam "FrontObjectDetection/InputProcessing/VrntTunParam"
 /begin REF_CHARACTERISTIC KeFOD_cm_DistZone1 KeFOD_cm_DistZone2 KeFOD_cm_DistZone3 KeFOD_cm_DistZone4 KeFOD_cm_DistZone5 KeFOD_cm_DistZone6 KeFOD_cm_HalfVehicleWidth KeFOD_cm_VehContour_FIL_x KeFOD_cm_VehContour_FIL_y KeFOD_cm_VehContour_FIR_x KeFOD_cm_VehContour_FIR_y KeFOD_cm_VehContour_FOL_x KeFOD_cm_VehContour_FOL_y KeFOD_cm_VehContour_FOR_x KeFOD_cm_VehContour_FOR_y KeFOD_cm_VehContour_FSL_x KeFOD_cm_VehContour_FSL_y KeFOD_cm_VehContour_FSR_x KeFOD_cm_VehContour_FSR_y KeFOD_cm_VehContour_RIL_x KeFOD_cm_VehContour_RIL_y KeFOD_cm_VehContour_RIR_x KeFOD_cm_VehContour_RIR_y KeFOD_cm_VehContour_ROL_x KeFOD_cm_VehContour_ROL_y KeFOD_cm_VehContour_ROR_x KeFOD_cm_VehContour_ROR_y KeFOD_cm_VehContour_RSL_x KeFOD_cm_VehContour_RSL_y KeFOD_cm_VehContour_RSR_x KeFOD_cm_VehContour_RSR_y /end REF_CHARACTERISTIC
/end GROUP
/begin GROUP S3_CalcMinDistance "FrontObjectDetection/ObjectMinDistanceCalculator/CalcMinDistance" /begin SUB_GROUP S6_CalculateMinDistances S6_FromtMinDist /end SUB_GROUP
 /begin REF_CHARACTERISTIC KeFOD_cm_CenterWarnLatThreshold KeFOD_cm_DistZone2 KeFOD_cm_DistZone4 KeFOD_cm_DistZone6 KeFOD_cm_SideDetectionRange KeFOD_cm_WarnOffset KeFOD_pct_ObjConfidenceThd KeFOD_pct_ObjConfidenceThd_Closer KeFOD_pct_ObjConfidenceThd_Far KeFOD_pct_ObjConfidenceThd_Nearest /end REF_CHARACTERISTIC
/end GROUP
/begin GROUP S6_FromtMinDist "FrontObjectDetection/ObjectMinDistanceCalculator/CalcMinDistance/FromtMinDist" /begin SUB_GROUP S9_FrontCenterDistAvg S9_FrontLeftDistAvg /end SUB_GROUP /begin REF_CHARACTERISTIC KeFOD_b_DbncEnabld KeFOD_ms_DbncTimeThsd /end REF_CHARACTERISTIC /end GROUP
/begin GROUP S6_CalculateMinDistances "FrontObjectDetection/ObjectMinDistanceCalculator/CalcMinDistance/CalculateMinDistances" /begin SUB_GROUP S8_UpdateDistNoDetection /end SUB_GROUP /end GROUP
/begin GROUP S9_FrontCenterDistAvg "FrontObjectDetection/ObjectMinDistanceCalculator/CalcMinDistance/FromtMinDist/FrontCenterDistAvg" /begin REF_MEASUREMENT MeFOD_cm_FrntCenterMinXDist /end REF_MEASUREMENT /end GROUP
/begin GROUP S9_FrontLeftDistAvg "FrontObjectDetection/ObjectMinDistanceCalculator/CalcMinDistance/FromtMinDist/FrontLeftDistAvg" /begin REF_MEASUREMENT MeFOD_cm_FrntSideMinXDist /end REF_MEASUREMENT /end GROUP
/begin GROUP S8_UpdateDistNoDetection "FrontObjectDetection/ObjectMinDistanceCalculator/CalcMinDistance/CalculateMinDistances/UpdateDistNoDetection" /begin REF_CHARACTERISTIC KeFOD_cm_DistZone2 /end REF_CHARACTERISTIC /end GROUP
/end MODULE
/end PROJECT
/* (add any file trailer comments here) */
/* EOF FrontObjectDetection.a2l */
