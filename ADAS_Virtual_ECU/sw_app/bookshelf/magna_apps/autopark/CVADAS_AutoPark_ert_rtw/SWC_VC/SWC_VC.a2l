/******************************************************************************
* ASAP2 file: SWC_VC.a2l
* Code generation for model "SWC_VC".
* Model version : 1.2255
* Simulink Coder version : 9.2 (R2019b) 18-Jul-2019
* C source code generated on : Tue Nov 11 20:51:59 2025
* Target selection: ert.tlc
* Embedded hardware selection: ARM Compatible->ARM Cortex
* Code generation objectives:
* 1. MISRA C:2012 guidelines
* 2. RAM efficiency
* 3. ROM efficiency
* Validation result: Not run
* (add additional file header information here)
******************************************************************************/ ASAP2_VERSION 1 31
/* Version 1.31 */
/begin PROJECT ProjectName "Project Comment Goes Here"
/begin HEADER "Header Comments go here" /end HEADER
/begin MODULE ModuleName "Module Comment Goes Here"
/begin MOD_PAR "MOD PAR Comment Goes Here" /end MOD_PAR
/begin MOD_COMMON "Mod Common Comment Here" BYTE_ORDER MSB_LAST /end MOD_COMMON
/begin RECORD_LAYOUT Scalar_BOOLEAN FNC_VALUES 1 UBYTE COLUMN_DIR DIRECT /end RECORD_LAYOUT
/begin RECORD_LAYOUT Scalar_UBYTE FNC_VALUES 1 UBYTE COLUMN_DIR DIRECT /end RECORD_LAYOUT
/begin RECORD_LAYOUT Scalar_BYTE FNC_VALUES 1 SBYTE COLUMN_DIR DIRECT /end RECORD_LAYOUT
/begin RECORD_LAYOUT Scalar_UWORD FNC_VALUES 1 UWORD COLUMN_DIR DIRECT /end RECORD_LAYOUT
/begin RECORD_LAYOUT Scalar_SWORD FNC_VALUES 1 SWORD COLUMN_DIR DIRECT /end RECORD_LAYOUT
/begin RECORD_LAYOUT Scalar_ULONG FNC_VALUES 1 ULONG COLUMN_DIR DIRECT /end RECORD_LAYOUT
/begin RECORD_LAYOUT Scalar_LONG FNC_VALUES 1 SLONG COLUMN_DIR DIRECT /end RECORD_LAYOUT
/begin RECORD_LAYOUT Scalar_FLOAT32_IEEE FNC_VALUES 1 FLOAT32_IEEE COLUMN_DIR DIRECT /end RECORD_LAYOUT
/begin RECORD_LAYOUT Scalar_FLOAT64_IEEE FNC_VALUES 1 FLOAT64_IEEE COLUMN_DIR DIRECT /end RECORD_LAYOUT
/begin RECORD_LAYOUT Lookup1D_BOOLEAN FNC_VALUES 1 UBYTE COLUMN_DIR DIRECT /end RECORD_LAYOUT
/begin RECORD_LAYOUT Lookup1D_X_BOOLEAN AXIS_PTS_X 1 UBYTE INDEX_INCR DIRECT /end RECORD_LAYOUT
/begin RECORD_LAYOUT Lookup1D_BYTE FNC_VALUES 1 SBYTE COLUMN_DIR DIRECT /end RECORD_LAYOUT
/begin RECORD_LAYOUT Lookup1D_X_BYTE AXIS_PTS_X 1 SBYTE INDEX_INCR DIRECT /end RECORD_LAYOUT
/begin RECORD_LAYOUT Lookup1D_UBYTE FNC_VALUES 1 UBYTE COLUMN_DIR DIRECT /end RECORD_LAYOUT
/begin RECORD_LAYOUT Lookup1D_X_UBYTE AXIS_PTS_X 1 UBYTE INDEX_INCR DIRECT /end RECORD_LAYOUT
/begin RECORD_LAYOUT Lookup1D_UWORD FNC_VALUES 1 UWORD COLUMN_DIR DIRECT /end RECORD_LAYOUT
/begin RECORD_LAYOUT Lookup1D_X_UWORD AXIS_PTS_X 1 UWORD INDEX_INCR DIRECT /end RECORD_LAYOUT
/begin RECORD_LAYOUT Lookup1D_WORD FNC_VALUES 1 SWORD COLUMN_DIR DIRECT /end RECORD_LAYOUT
/begin RECORD_LAYOUT Lookup1D_X_WORD AXIS_PTS_X 1 SWORD INDEX_INCR DIRECT /end RECORD_LAYOUT
/begin RECORD_LAYOUT Lookup1D_ULONG FNC_VALUES 1 ULONG COLUMN_DIR DIRECT /end RECORD_LAYOUT
/begin RECORD_LAYOUT Lookup1D_X_ULONG AXIS_PTS_X 1 ULONG INDEX_INCR DIRECT /end RECORD_LAYOUT
/begin RECORD_LAYOUT Lookup1D_SLONG FNC_VALUES 1 SLONG COLUMN_DIR DIRECT /end RECORD_LAYOUT
/begin RECORD_LAYOUT Lookup1D_X_LONG AXIS_PTS_X 1 SLONG INDEX_INCR DIRECT /end RECORD_LAYOUT
/begin RECORD_LAYOUT Lookup1D_FLOAT32_IEEE FNC_VALUES 1 FLOAT32_IEEE COLUMN_DIR DIRECT /end RECORD_LAYOUT
/begin RECORD_LAYOUT Lookup1D_X_FLOAT32_IEEE AXIS_PTS_X 1 FLOAT32_IEEE INDEX_INCR DIRECT /end RECORD_LAYOUT
/begin RECORD_LAYOUT Lookup1D_FLOAT64_IEEE FNC_VALUES 1 FLOAT64_IEEE COLUMN_DIR DIRECT /end RECORD_LAYOUT
/begin RECORD_LAYOUT Lookup1D_X_FLOAT64_IEEE AXIS_PTS_X 1 FLOAT64_IEEE INDEX_INCR DIRECT /end RECORD_LAYOUT
/begin RECORD_LAYOUT Lookup2D_BOOLEAN FNC_VALUES 1 UBYTE COLUMN_DIR DIRECT /end RECORD_LAYOUT
/begin RECORD_LAYOUT Lookup2D_X_BOOLEAN AXIS_PTS_X 1 UBYTE INDEX_INCR DIRECT /end RECORD_LAYOUT
/begin RECORD_LAYOUT Lookup2D_UBYTE FNC_VALUES 1 UBYTE COLUMN_DIR DIRECT /end RECORD_LAYOUT
/begin RECORD_LAYOUT Lookup2D_X_UBYTE AXIS_PTS_X 1 UBYTE INDEX_INCR DIRECT /end RECORD_LAYOUT
/begin RECORD_LAYOUT Lookup2D_BYTE FNC_VALUES 1 SBYTE COLUMN_DIR DIRECT /end RECORD_LAYOUT
/begin RECORD_LAYOUT Lookup2D_X_BYTE AXIS_PTS_X 1 SBYTE INDEX_INCR DIRECT /end RECORD_LAYOUT
/begin RECORD_LAYOUT Lookup2D_UWORD FNC_VALUES 1 UWORD COLUMN_DIR DIRECT /end RECORD_LAYOUT
/begin RECORD_LAYOUT Lookup2D_X_UWORD AXIS_PTS_X 1 UWORD INDEX_INCR DIRECT /end RECORD_LAYOUT
/begin RECORD_LAYOUT Lookup2D_WORD FNC_VALUES 1 SWORD COLUMN_DIR DIRECT /end RECORD_LAYOUT
/begin RECORD_LAYOUT Lookup2D_X_WORD AXIS_PTS_X 1 SWORD INDEX_INCR DIRECT /end RECORD_LAYOUT
/begin RECORD_LAYOUT Lookup2D_ULONG FNC_VALUES 1 ULONG COLUMN_DIR DIRECT /end RECORD_LAYOUT
/begin RECORD_LAYOUT Lookup2D_X_ULONG AXIS_PTS_X 1 ULONG INDEX_INCR DIRECT /end RECORD_LAYOUT
/begin RECORD_LAYOUT Lookup2D_LONG FNC_VALUES 1 SLONG COLUMN_DIR DIRECT /end RECORD_LAYOUT
/begin RECORD_LAYOUT Lookup2D_X_LONG AXIS_PTS_X 1 SLONG INDEX_INCR DIRECT /end RECORD_LAYOUT
/begin RECORD_LAYOUT Lookup2D_FLOAT32_IEEE FNC_VALUES 1 FLOAT32_IEEE COLUMN_DIR DIRECT /end RECORD_LAYOUT
/begin RECORD_LAYOUT Lookup2D_X_FLOAT32_IEEE AXIS_PTS_X 1 FLOAT32_IEEE INDEX_INCR DIRECT /end RECORD_LAYOUT
/begin RECORD_LAYOUT Lookup2D_FLOAT64_IEEE FNC_VALUES 1 FLOAT64_IEEE COLUMN_DIR DIRECT /end RECORD_LAYOUT
/begin RECORD_LAYOUT Lookup2D_X_FLOAT64_IEEE AXIS_PTS_X 1 FLOAT64_IEEE INDEX_INCR DIRECT /end RECORD_LAYOUT
/begin CHARACTERISTIC KeAP_CurbLim_para "" VAL_BLK 0x0000 /* @ECU_Address@KeAP_CurbLim_para@ */ Scalar_FLOAT32_IEEE 0 SWC_VC_CM_single 0.0 5.0 NUMBER 3 /end CHARACTERISTIC
/begin CHARACTERISTIC KeAP_M_StrTrqValLimit "" VALUE 0x0000 /* @ECU_Address@KeAP_M_StrTrqValLimit@ */ Scalar_FLOAT32_IEEE 0 SWC_VC_CM_single -3.4E+38 3.4E+38 /end CHARACTERISTIC
/begin CHARACTERISTIC KeAP_break_point_para "" VAL_BLK 0x0000 /* @ECU_Address@KeAP_break_point_para@ */ Scalar_FLOAT32_IEEE 0 SWC_VC_CM_single -10.0 10.0 NUMBER 2 /end CHARACTERISTIC
/begin CHARACTERISTIC KeAP_break_point_perp "" VAL_BLK 0x0000 /* @ECU_Address@KeAP_break_point_perp@ */ Scalar_FLOAT32_IEEE 0 SWC_VC_CM_single -10.0 10.0 NUMBER 2 /end CHARACTERISTIC
/begin CHARACTERISTIC KeAP_deg_SteerAngelDiffThd "" VALUE 0x0000 /* @ECU_Address@KeAP_deg_SteerAngelDiffThd@ */ Scalar_FLOAT32_IEEE 0 SWC_VC_CM_single -3.4E+38 3.4E+38 /end CHARACTERISTIC
/begin CHARACTERISTIC KeAP_fin_loc_para_out "" VAL_BLK 0x0000 /* @ECU_Address@KeAP_fin_loc_para_out@ */ Scalar_FLOAT32_IEEE 0 SWC_VC_CM_single -5.0 0.0 NUMBER 2 /end CHARACTERISTIC
/begin CHARACTERISTIC KeAP_nm_TrqCmdRateLimThd "" VALUE 0x0000 /* @ECU_Address@KeAP_nm_TrqCmdRateLimThd@ */ Scalar_FLOAT32_IEEE 0 SWC_VC_CM_single -3.4E+38 3.4E+38 /end CHARACTERISTIC
/begin CHARACTERISTIC KeAP_p3_adj_perp "" VAL_BLK 0x0000 /* @ECU_Address@KeAP_p3_adj_perp@ */ Scalar_FLOAT32_IEEE 0 SWC_VC_CM_single -5.0 5.0 NUMBER 2 /end CHARACTERISTIC
/begin CHARACTERISTIC KeAP_str_profile_bigPS "" VAL_BLK 0x0000 /* @ECU_Address@KeAP_str_profile_bigPS@ */ Scalar_FLOAT32_IEEE 0 SWC_VC_CM_single 0.0 60.0 NUMBER 34 /end CHARACTERISTIC
/begin CHARACTERISTIC KsAP_k_DGainLUT_TD_55C "" VAL_BLK 0x0000 /* @ECU_Address@KsAP_k_DGainLUT_TD_55C@ */ Scalar_FLOAT32_IEEE 0 SWC_VC_CM_single -3.4E+38 3.4E+38 NUMBER 4 /end CHARACTERISTIC
/begin CHARACTERISTIC KsAP_k_DGainLUT_TD_63C "" VAL_BLK 0x0000 /* @ECU_Address@KsAP_k_DGainLUT_TD_63C@ */ Scalar_FLOAT32_IEEE 0 SWC_VC_CM_single -3.4E+38 3.4E+38 NUMBER 4 /end CHARACTERISTIC
/begin CHARACTERISTIC KsAP_k_DampingGainTD "" VAL_BLK 0x0000 /* @ECU_Address@KsAP_k_DampingGainTD@ */ Scalar_FLOAT32_IEEE 0 SWC_VC_CM_single -3.4E+38 3.4E+38 NUMBER 4 /end CHARACTERISTIC
/begin CHARACTERISTIC KsAP_k_IGainLUT_TD_55C "" VAL_BLK 0x0000 /* @ECU_Address@KsAP_k_IGainLUT_TD_55C@ */ Scalar_FLOAT32_IEEE 0 SWC_VC_CM_single -3.4E+38 3.4E+38 NUMBER 4 /end CHARACTERISTIC
/begin CHARACTERISTIC KsAP_k_IGainLUT_TD_63C "" VAL_BLK 0x0000 /* @ECU_Address@KsAP_k_IGainLUT_TD_63C@ */ Scalar_FLOAT32_IEEE 0 SWC_VC_CM_single -3.4E+38 3.4E+38 NUMBER 4 /end CHARACTERISTIC
/begin CHARACTERISTIC KsAP_k_IntegratorExtSatTD "" VAL_BLK 0x0000 /* @ECU_Address@KsAP_k_IntegratorExtSatTD@ */ Scalar_FLOAT32_IEEE 0 SWC_VC_CM_single -3.4E+38 3.4E+38 NUMBER 4 /end CHARACTERISTIC
/begin CHARACTERISTIC KsAP_k_PGainLUT_TD_55C "" VAL_BLK 0x0000 /* @ECU_Address@KsAP_k_PGainLUT_TD_55C@ */ Scalar_FLOAT32_IEEE 0 SWC_VC_CM_single -3.4E+38 3.4E+38 NUMBER 20 /end CHARACTERISTIC
/begin CHARACTERISTIC KsAP_k_PGainLUT_TD_60C "" VAL_BLK 0x0000 /* @ECU_Address@KsAP_k_PGainLUT_TD_60C@ */ Scalar_FLOAT32_IEEE 0 SWC_VC_CM_single -3.4E+38 3.4E+38 NUMBER 20 /end CHARACTERISTIC
/begin CHARACTERISTIC step_size_coeff "" VAL_BLK 0x0000 /* @ECU_Address@step_size_coeff@ */ Scalar_FLOAT32_IEEE 0 SWC_VC_CM_single 0.0 5.0 NUMBER 6 /end CHARACTERISTIC
/begin CHARACTERISTIC str_whl_ang_park_out "" VALUE 0x0000 /* @ECU_Address@str_whl_ang_park_out@ */ Scalar_FLOAT32_IEEE 0 SWC_VC_CM_single -60.0 60.0 /end CHARACTERISTIC
/begin MEASUREMENT X_MABx "" FLOAT32_IEEE SWC_VC_CM_single 0 0 -3.4E+38 3.4E+38 ECU_ADDRESS 0x0000 /* @ECU_Address@X_MABx@ */ /end MEASUREMENT
/begin MEASUREMENT Y_MABx "" FLOAT32_IEEE SWC_VC_CM_single 0 0 -3.4E+38 3.4E+38 ECU_ADDRESS 0x0000 /* @ECU_Address@Y_MABx@ */ /end MEASUREMENT
/begin MEASUREMENT heading_MABx "" FLOAT32_IEEE SWC_VC_CM_single 0 0 -3.4E+38 3.4E+38 ECU_ADDRESS 0x0000 /* @ECU_Address@heading_MABx@ */ /end MEASUREMENT
/begin MEASUREMENT Ma_AP_I_PSLimFSX "" FLOAT32_IEEE SWC_VC_CM_single 0 0 -3.4E+38 3.4E+38 ECU_ADDRESS 0x0000 /* @ECU_Address@Ma_AP_I_PSLimFSX@ */ /end MEASUREMENT
/begin MEASUREMENT Ma_AP_I_PSLimFSY "" FLOAT32_IEEE SWC_VC_CM_single 0 0 -3.4E+38 3.4E+38 ECU_ADDRESS 0x0000 /* @ECU_Address@Ma_AP_I_PSLimFSY@ */ /end MEASUREMENT
/begin MEASUREMENT Ma_AP_I_PSLimFBX "" FLOAT32_IEEE SWC_VC_CM_single 0 0 -3.4E+38 3.4E+38 ECU_ADDRESS 0x0000 /* @ECU_Address@Ma_AP_I_PSLimFBX@ */ /end MEASUREMENT
/begin MEASUREMENT Ma_AP_I_PSLimFBY "" FLOAT32_IEEE SWC_VC_CM_single 0 0 -3.4E+38 3.4E+38 ECU_ADDRESS 0x0000 /* @ECU_Address@Ma_AP_I_PSLimFBY@ */ /end MEASUREMENT
/begin MEASUREMENT Ma_AP_I_PSLimRBX "" FLOAT32_IEEE SWC_VC_CM_single 0 0 -3.4E+38 3.4E+38 ECU_ADDRESS 0x0000 /* @ECU_Address@Ma_AP_I_PSLimRBX@ */ /end MEASUREMENT
/begin MEASUREMENT Ma_AP_I_PSLimRBY "" FLOAT32_IEEE SWC_VC_CM_single 0 0 -3.4E+38 3.4E+38 ECU_ADDRESS 0x0000 /* @ECU_Address@Ma_AP_I_PSLimRBY@ */ /end MEASUREMENT
/begin MEASUREMENT Ma_AP_I_PSLimRSX "" FLOAT32_IEEE SWC_VC_CM_single 0 0 -3.4E+38 3.4E+38 ECU_ADDRESS 0x0000 /* @ECU_Address@Ma_AP_I_PSLimRSX@ */ /end MEASUREMENT
/begin MEASUREMENT Ma_AP_I_PSLimRSY "" FLOAT32_IEEE SWC_VC_CM_single 0 0 -3.4E+38 3.4E+38 ECU_ADDRESS 0x0000 /* @ECU_Address@Ma_AP_I_PSLimRSY@ */ /end MEASUREMENT
/begin MEASUREMENT MeAP_m_VehWheelbase "" FLOAT32_IEEE SWC_VC_CM_single 0 0 -3.4E+38 3.4E+38 ECU_ADDRESS 0x0000 /* @ECU_Address@MeAP_m_VehWheelbase@ */ /end MEASUREMENT
/begin MEASUREMENT MeAP_m_VehFrontOverhang "" FLOAT32_IEEE SWC_VC_CM_single 0 0 -3.4E+38 3.4E+38 ECU_ADDRESS 0x0000 /* @ECU_Address@MeAP_m_VehFrontOverhang@ */ /end MEASUREMENT
/begin MEASUREMENT MeAP_m_VehRearOverhang "" FLOAT32_IEEE SWC_VC_CM_single 0 0 -3.4E+38 3.4E+38 ECU_ADDRESS 0x0000 /* @ECU_Address@MeAP_m_VehRearOverhang@ */ /end MEASUREMENT
/begin MEASUREMENT MeAP_m_VehWidth "" FLOAT32_IEEE SWC_VC_CM_single 0 0 -3.4E+38 3.4E+38 ECU_ADDRESS 0x0000 /* @ECU_Address@MeAP_m_VehWidth@ */ /end MEASUREMENT
/begin MEASUREMENT MeAP_m_PlanminRadius "" FLOAT32_IEEE SWC_VC_CM_single 0 0 -3.4E+38 3.4E+38 ECU_ADDRESS 0x0000 /* @ECU_Address@MeAP_m_PlanminRadius@ */ /end MEASUREMENT
/begin MEASUREMENT MeAP_pm_maxCurvature "" FLOAT32_IEEE SWC_VC_CM_single 0 0 -3.4E+38 3.4E+38 ECU_ADDRESS 0x0000 /* @ECU_Address@MeAP_pm_maxCurvature@ */ /end MEASUREMENT
/begin MEASUREMENT PP_H "" FLOAT32_IEEE SWC_VC_CM_single 0 0 -3.4E+38 3.4E+38 ARRAY_SIZE 250 ECU_ADDRESS 0x0000 /* @ECU_Address@PP_H@ */ /end MEASUREMENT
/begin MEASUREMENT PP_x "" FLOAT32_IEEE SWC_VC_CM_single 0 0 -3.4E+38 3.4E+38 ARRAY_SIZE 250 ECU_ADDRESS 0x0000 /* @ECU_Address@PP_x@ */ /end MEASUREMENT
/begin MEASUREMENT PP_y "" FLOAT32_IEEE SWC_VC_CM_single 0 0 -3.4E+38 3.4E+38 ARRAY_SIZE 250 ECU_ADDRESS 0x0000 /* @ECU_Address@PP_y@ */ /end MEASUREMENT
/begin MEASUREMENT MeAP_m_WhlCircum "" FLOAT32_IEEE SWC_VC_CM_single 0 0 -3.4E+38 3.4E+38 ECU_ADDRESS 0x0000 /* @ECU_Address@MeAP_m_WhlCircum@ */ /end MEASUREMENT
/begin MEASUREMENT MeAP_deg_strAngtoWhlAng "" FLOAT32_IEEE SWC_VC_CM_single 0 0 -3.4E+38 3.4E+38 ECU_ADDRESS 0x0000 /* @ECU_Address@MeAP_deg_strAngtoWhlAng@ */ /end MEASUREMENT
/begin MEASUREMENT MeAP_m_WhlBase "" FLOAT32_IEEE SWC_VC_CM_single 0 0 -3.4E+38 3.4E+38 ECU_ADDRESS 0x0000 /* @ECU_Address@MeAP_m_WhlBase@ */ /end MEASUREMENT
/begin MEASUREMENT VC_RemainingDist "" FLOAT32_IEEE SWC_VC_CM_single 0 0 -3.4E+38 3.4E+38 ECU_ADDRESS 0x0000 /* @ECU_Address@VC_RemainingDist@ */ /end MEASUREMENT
/begin MEASUREMENT VC_Head_Dev "" FLOAT32_IEEE SWC_VC_CM_single 0 0 -3.4E+38 3.4E+38 ECU_ADDRESS 0x0000 /* @ECU_Address@VC_Head_Dev@ */ /end MEASUREMENT
/begin MEASUREMENT VC_PathDev "" FLOAT32_IEEE SWC_VC_CM_single 0 0 -3.4E+38 3.4E+38 ECU_ADDRESS 0x0000 /* @ECU_Address@VC_PathDev@ */ /end MEASUREMENT
/begin MEASUREMENT VC_Steer_CMD "" FLOAT32_IEEE SWC_VC_CM_single 0 0 -3.4E+38 3.4E+38 ECU_ADDRESS 0x0000 /* @ECU_Address@VC_Steer_CMD@ */ /end MEASUREMENT
/begin MEASUREMENT MeAP_e_GearCmd "" SLONG SWC_VC_CM_TeAutoPark_e_GearCmd 0 0 0 2147483647 ECU_ADDRESS 0x0000 /* @ECU_Address@MeAP_e_GearCmd@ */ /end MEASUREMENT
/begin MEASUREMENT Ap_App_ID "" UBYTE SWC_VC_CM_uint8 0 0 0 255 ECU_ADDRESS 0x0000 /* @ECU_Address@Ap_App_ID@ */ /end MEASUREMENT
/begin MEASUREMENT PM_CurrentSweep "" UBYTE SWC_VC_CM_uint8 0 0 0 255 ECU_ADDRESS 0x0000 /* @ECU_Address@PM_CurrentSweep@ */ /end MEASUREMENT
/begin MEASUREMENT PP_state "" SBYTE SWC_VC_CM_int8 0 0 -128 127 ECU_ADDRESS 0x0000 /* @ECU_Address@PP_state@ */ /end MEASUREMENT
/begin MEASUREMENT MeAP_b_SteerActionReq "" UBYTE SWC_VC_CM_boolean 0 0 0 1 ECU_ADDRESS 0x0000 /* @ECU_Address@MeAP_b_SteerActionReq@ */ /end MEASUREMENT
/begin MEASUREMENT MeAP_b_PosMet "" UBYTE SWC_VC_CM_boolean 0 0 0 1 ECU_ADDRESS 0x0000 /* @ECU_Address@MeAP_b_PosMet@ */ /end MEASUREMENT
/begin MEASUREMENT PP_Abort "" UBYTE SWC_VC_CM_boolean 0 0 0 1 ECU_ADDRESS 0x0000 /* @ECU_Address@PP_Abort@ */ /end MEASUREMENT
/begin MEASUREMENT ACT_ACTIVE "" UBYTE SWC_VC_CM_boolean 0 0 0 1 ECU_ADDRESS 0x0000 /* @ECU_Address@ACT_ACTIVE@ */ /end MEASUREMENT
/begin MEASUREMENT PM_RegenPath "" UBYTE SWC_VC_CM_boolean 0 0 0 1 ECU_ADDRESS 0x0000 /* @ECU_Address@PM_RegenPath@ */ /end MEASUREMENT
/begin MEASUREMENT SWC_VC_DW.tp_APX_Park_State_Inactive_ST1 "" UBYTE SWC_VC_CM_uint8 0 0 0 255 ECU_ADDRESS 0x0000 /* @ECU_Address@SWC_VC_DW.tp_APX_Park_State_Inactive_ST1@ */ /end MEASUREMENT
/begin MEASUREMENT SWC_VC_DW.tp_APX_Park_State_Inactive_ST "" UBYTE SWC_VC_CM_uint8 0 0 0 255 ECU_ADDRESS 0x0000 /* @ECU_Address@SWC_VC_DW.tp_APX_Park_State_Inactive_ST@ */ /end MEASUREMENT
/begin MEASUREMENT SWC_VC_DW.tp_APX_Park_State_Active_ST "" UBYTE SWC_VC_CM_uint8 0 0 0 255 ECU_ADDRESS 0x0000 /* @ECU_Address@SWC_VC_DW.tp_APX_Park_State_Active_ST@ */ /end MEASUREMENT
/begin MEASUREMENT SWC_VC_DW.tp_APX_Park_State_R_gear "" UBYTE SWC_VC_CM_uint8 0 0 0 255 ECU_ADDRESS 0x0000 /* @ECU_Address@SWC_VC_DW.tp_APX_Park_State_R_gear@ */ /end MEASUREMENT
/begin MEASUREMENT SWC_VC_DW.tp_APX_Park_State_End_ST "" UBYTE SWC_VC_CM_uint8 0 0 0 255 ECU_ADDRESS 0x0000 /* @ECU_Address@SWC_VC_DW.tp_APX_Park_State_End_ST@ */ /end MEASUREMENT
/begin MEASUREMENT SWC_VC_DW.tp_APX_Park_State_AllStrokes_ST "" UBYTE SWC_VC_CM_uint8 0 0 0 255 ECU_ADDRESS 0x0000 /* @ECU_Address@SWC_VC_DW.tp_APX_Park_State_AllStrokes_ST@ */ /end MEASUREMENT
/begin MEASUREMENT SWC_VC_DW.tp_APX_Park_State_Backw_DispForw "" UBYTE SWC_VC_CM_uint8 0 0 0 255 ECU_ADDRESS 0x0000 /* @ECU_Address@SWC_VC_DW.tp_APX_Park_State_Backw_DispForw@ */ /end MEASUREMENT
/begin MEASUREMENT SWC_VC_DW.tp_APX_Park_State_R_gear_o "" UBYTE SWC_VC_CM_uint8 0 0 0 255 ECU_ADDRESS 0x0000 /* @ECU_Address@SWC_VC_DW.tp_APX_Park_State_R_gear_o@ */ /end MEASUREMENT
/begin MEASUREMENT SWC_VC_DW.tp_APX_Park_State_Backward "" UBYTE SWC_VC_CM_uint8 0 0 0 255 ECU_ADDRESS 0x0000 /* @ECU_Address@SWC_VC_DW.tp_APX_Park_State_Backward@ */ /end MEASUREMENT
/begin MEASUREMENT SWC_VC_DW.tp_APX_Park_State_Backw_DeviationExceeded "" UBYTE SWC_VC_CM_uint8 0 0 0 255 ECU_ADDRESS 0x0000 /* @ECU_Address@SWC_VC_DW.tp_APX_Park_State_Backw_DeviationExceeded@ */ /end MEASUREMENT
/begin MEASUREMENT SWC_VC_DW.tp_APX_Park_State_Forw_DispBackw1 "" UBYTE SWC_VC_CM_uint8 0 0 0 255 ECU_ADDRESS 0x0000 /* @ECU_Address@SWC_VC_DW.tp_APX_Park_State_Forw_DispBackw1@ */ /end MEASUREMENT
/begin MEASUREMENT SWC_VC_DW.tp_APX_Park_State_Backw_RegenPathStarted "" UBYTE SWC_VC_CM_uint8 0 0 0 255 ECU_ADDRESS 0x0000 /* @ECU_Address@SWC_VC_DW.tp_APX_Park_State_Backw_RegenPathStarted@ */ /end MEASUREMENT
/begin MEASUREMENT SWC_VC_DW.tp_APX_Park_State_Forw_PathAccepted "" UBYTE SWC_VC_CM_uint8 0 0 0 255 ECU_ADDRESS 0x0000 /* @ECU_Address@SWC_VC_DW.tp_APX_Park_State_Forw_PathAccepted@ */ /end MEASUREMENT
/begin MEASUREMENT SWC_VC_DW.tp_APX_Park_State_Backw_PathAccepted "" UBYTE SWC_VC_CM_uint8 0 0 0 255 ECU_ADDRESS 0x0000 /* @ECU_Address@SWC_VC_DW.tp_APX_Park_State_Backw_PathAccepted@ */ /end MEASUREMENT
/begin MEASUREMENT SWC_VC_DW.tp_APX_Park_State_Forw_RegenPathStarted "" UBYTE SWC_VC_CM_uint8 0 0 0 255 ECU_ADDRESS 0x0000 /* @ECU_Address@SWC_VC_DW.tp_APX_Park_State_Forw_RegenPathStarted@ */ /end MEASUREMENT
/begin MEASUREMENT SWC_VC_DW.tp_APX_Park_State_Backw_DispForw1 "" UBYTE SWC_VC_CM_uint8 0 0 0 255 ECU_ADDRESS 0x0000 /* @ECU_Address@SWC_VC_DW.tp_APX_Park_State_Backw_DispForw1@ */ /end MEASUREMENT
/begin MEASUREMENT SWC_VC_DW.tp_APX_Park_State_Forw_DeviationExceeded "" UBYTE SWC_VC_CM_uint8 0 0 0 255 ECU_ADDRESS 0x0000 /* @ECU_Address@SWC_VC_DW.tp_APX_Park_State_Forw_DeviationExceeded@ */ /end MEASUREMENT
/begin MEASUREMENT SWC_VC_DW.tp_APX_Park_State_Forward "" UBYTE SWC_VC_CM_uint8 0 0 0 255 ECU_ADDRESS 0x0000 /* @ECU_Address@SWC_VC_DW.tp_APX_Park_State_Forward@ */ /end MEASUREMENT
/begin MEASUREMENT SWC_VC_DW.tp_APX_Park_State_Forw_DispBackw "" UBYTE SWC_VC_CM_uint8 0 0 0 255 ECU_ADDRESS 0x0000 /* @ECU_Address@SWC_VC_DW.tp_APX_Park_State_Forw_DispBackw@ */ /end MEASUREMENT
/begin MEASUREMENT SWC_VC_DW.tp_APX_Park_State_D_gear "" UBYTE SWC_VC_CM_uint8 0 0 0 255 ECU_ADDRESS 0x0000 /* @ECU_Address@SWC_VC_DW.tp_APX_Park_State_D_gear@ */ /end MEASUREMENT
/begin COMPU_METHOD SWC_VC_CM_single "Q = V" RAT_FUNC "%8.6" "" COEFFS 0 1 0 0 0 1 /end COMPU_METHOD
/begin COMPU_METHOD SWC_VC_CM_TeAutoPark_e_GearCmd "Enumerated data type: TeAutoPark_e_GearCmd" TAB_VERB "%0.6" "" /* Conversion Table */ COMPU_TAB_REF VTAB_FOR_SWC_VC_CM_TeAutoPark_e_GearCmd /end COMPU_METHOD
/begin COMPU_VTAB /* Name of Table */ VTAB_FOR_SWC_VC_CM_TeAutoPark_e_GearCmd "Enumerated data type: TeAutoPark_e_GearCmd" TAB_VERB /* Number of Elements */ 6 0 "TeAutoPark_e_GearCmd_None" 1 "TeAutoPark_e_GearCmd_Park" 2 "TeAutoPark_e_GearCmd_Reverse" 3 "TeAutoPark_e_GearCmd_Neutral" 4 "TeAutoPark_e_GearCmd_Drive" 2147483647 "TeAutoPark_e_GearCmd_MAX" /end COMPU_VTAB
/begin COMPU_METHOD SWC_VC_CM_uint8 "Q = V" RAT_FUNC "%3.0" "" COEFFS 0 1 0 0 0 1 /end COMPU_METHOD
/begin COMPU_METHOD SWC_VC_CM_int8 "Q = V" RAT_FUNC "%3.0" "" COEFFS 0 1 0 0 0 1 /end COMPU_METHOD
/begin COMPU_METHOD SWC_VC_CM_boolean "Q = V" RAT_FUNC "%1.0" "" COEFFS 0 1 0 0 0 1 /end COMPU_METHOD
/begin GROUP SWC_VC "SWC_VC" /* Root */ ROOT /begin SUB_GROUP Root_FCA_AutoPark_VC2 /end SUB_GROUP /begin REF_MEASUREMENT MeAP_e_GearCmd /end REF_MEASUREMENT /end GROUP
/begin GROUP Root_FCA_AutoPark_VC2 "SWC_VC/FCA_AutoPark_VC2"
 /begin SUB_GROUP S1_ADASManeuverManager S1_Kinematic_Model1 S1_PathPlanner S1_TrqControl S1_VehicleControl1 /end SUB_GROUP
 /begin REF_CHARACTERISTIC KeAP_deg_SteerAngelDiffThd KeAP_nm_TrqCmdRateLimThd /end REF_CHARACTERISTIC
 /begin REF_MEASUREMENT ACT_ACTIVE Ap_App_ID Ma_AP_I_PSLimFBX Ma_AP_I_PSLimFBY Ma_AP_I_PSLimFSX Ma_AP_I_PSLimFSY Ma_AP_I_PSLimRBX Ma_AP_I_PSLimRBY Ma_AP_I_PSLimRSX Ma_AP_I_PSLimRSY MeAP_b_PosMet MeAP_b_SteerActionReq X_MABx Y_MABx heading_MABx /end REF_MEASUREMENT
/end GROUP
/begin GROUP S1_ADASManeuverManager "SWC_VC/FCA_AutoPark_VC2/ADASManeuverManager" /begin SUB_GROUP S4_ParkingManeucerManager_SM /end SUB_GROUP /end GROUP
/begin GROUP S1_Kinematic_Model1 "SWC_VC/FCA_AutoPark_VC2/Kinematic Model1" /begin SUB_GROUP S12_StrTypeSel S12_VCWhlBaseSel /end SUB_GROUP /begin REF_MEASUREMENT MeAP_m_WhlCircum /end REF_MEASUREMENT /end GROUP
/begin GROUP S1_PathPlanner "SWC_VC/FCA_AutoPark_VC2/PathPlanner" /begin SUB_GROUP S13_Pathplanner_AP /end SUB_GROUP /begin REF_MEASUREMENT PP_H PP_x PP_y /end REF_MEASUREMENT /end GROUP
/begin GROUP S1_TrqControl "SWC_VC/FCA_AutoPark_VC2/TrqControl"
 /begin REF_CHARACTERISTIC KeAP_M_StrTrqValLimit KsAP_k_DGainLUT_TD_55C KsAP_k_DGainLUT_TD_63C KsAP_k_DampingGainTD KsAP_k_IGainLUT_TD_55C KsAP_k_IGainLUT_TD_63C KsAP_k_IntegratorExtSatTD KsAP_k_PGainLUT_TD_55C KsAP_k_PGainLUT_TD_60C /end REF_CHARACTERISTIC
/end GROUP
/begin GROUP S1_VehicleControl1 "SWC_VC/FCA_AutoPark_VC2/VehicleControl1" /begin SUB_GROUP S21_Control S21_ControllerOutput /end SUB_GROUP /end GROUP
/begin GROUP S4_ParkingManeucerManager_SM "SWC_VC/FCA_AutoPark_VC2/ADASManeuverManager/ParkingManeucerManager_SM"
 /begin REF_MEASUREMENT PM_CurrentSweep PM_RegenPath SWC_VC_DW.tp_APX_Park_State_Active_ST SWC_VC_DW.tp_APX_Park_State_AllStrokes_ST SWC_VC_DW.tp_APX_Park_State_Backw_DeviationExceeded SWC_VC_DW.tp_APX_Park_State_Backw_DispForw SWC_VC_DW.tp_APX_Park_State_Backw_DispForw1 SWC_VC_DW.tp_APX_Park_State_Backw_PathAccepted SWC_VC_DW.tp_APX_Park_State_Backw_RegenPathStarted SWC_VC_DW.tp_APX_Park_State_Backward SWC_VC_DW.tp_APX_Park_State_D_gear SWC_VC_DW.tp_APX_Park_State_End_ST SWC_VC_DW.tp_APX_Park_State_Forw_DeviationExceeded SWC_VC_DW.tp_APX_Park_State_Forw_DispBackw SWC_VC_DW.tp_APX_Park_State_Forw_DispBackw1 SWC_VC_DW.tp_APX_Park_State_Forw_PathAccepted SWC_VC_DW.tp_APX_Park_State_Forw_RegenPathStarted SWC_VC_DW.tp_APX_Park_State_Forward SWC_VC_DW.tp_APX_Park_State_Inactive_ST SWC_VC_DW.tp_APX_Park_State_Inactive_ST1 SWC_VC_DW.tp_APX_Park_State_R_gear SWC_VC_DW.tp_APX_Park_State_R_gear_o /end REF_MEASUREMENT
/end GROUP
/begin GROUP S12_StrTypeSel "SWC_VC/FCA_AutoPark_VC2/Kinematic Model1/StrTypeSel" /begin REF_MEASUREMENT MeAP_deg_strAngtoWhlAng /end REF_MEASUREMENT /end GROUP
/begin GROUP S12_VCWhlBaseSel "SWC_VC/FCA_AutoPark_VC2/Kinematic Model1/VCWhlBaseSel" /begin REF_MEASUREMENT MeAP_m_WhlBase /end REF_MEASUREMENT /end GROUP
/begin GROUP S13_Pathplanner_AP "SWC_VC/FCA_AutoPark_VC2/PathPlanner/Pathplanner_AP" /begin SUB_GROUP S57_PathPlanner1 /end SUB_GROUP /end GROUP
/begin GROUP S21_Control "SWC_VC/FCA_AutoPark_VC2/VehicleControl1/Control" /begin REF_MEASUREMENT VC_Head_Dev VC_PathDev VC_Steer_CMD /end REF_MEASUREMENT /end GROUP
/begin GROUP S21_ControllerOutput "SWC_VC/FCA_AutoPark_VC2/VehicleControl1/ControllerOutput" /begin SUB_GROUP S81_remainingDist1 /end SUB_GROUP /end GROUP
/begin GROUP S57_PathPlanner1 "SWC_VC/FCA_AutoPark_VC2/PathPlanner/Pathplanner_AP/PathPlanner1" /begin SUB_GROUP S59_Subsystem /end SUB_GROUP
 /begin REF_CHARACTERISTIC KeAP_CurbLim_para KeAP_break_point_para KeAP_break_point_perp KeAP_fin_loc_para_out KeAP_p3_adj_perp KeAP_str_profile_bigPS step_size_coeff str_whl_ang_park_out /end REF_CHARACTERISTIC
 /begin REF_MEASUREMENT PP_Abort PP_state /end REF_MEASUREMENT
/end GROUP
/begin GROUP S81_remainingDist1 "SWC_VC/FCA_AutoPark_VC2/VehicleControl1/ControllerOutput/remainingDist1" /begin REF_MEASUREMENT VC_RemainingDist /end REF_MEASUREMENT /end GROUP
/begin GROUP S59_Subsystem "SWC_VC/FCA_AutoPark_VC2/PathPlanner/Pathplanner_AP/PathPlanner1/Subsystem"
 /begin SUB_GROUP S61_Whl_baseMaxCurvature S61_Whl_baseSelect S61_Whl_baseSelectMinRadious /end SUB_GROUP
 /begin REF_MEASUREMENT MeAP_m_VehFrontOverhang MeAP_m_VehRearOverhang MeAP_m_VehWidth /end REF_MEASUREMENT
/end GROUP
/begin GROUP S61_Whl_baseMaxCurvature "SWC_VC/FCA_AutoPark_VC2/PathPlanner/Pathplanner_AP/PathPlanner1/Subsystem/Whl_baseMaxCurvature" /begin REF_MEASUREMENT MeAP_pm_maxCurvature /end REF_MEASUREMENT /end GROUP
/begin GROUP S61_Whl_baseSelect "SWC_VC/FCA_AutoPark_VC2/PathPlanner/Pathplanner_AP/PathPlanner1/Subsystem/Whl_baseSelect" /begin REF_MEASUREMENT MeAP_m_VehWheelbase /end REF_MEASUREMENT /end GROUP
/begin GROUP S61_Whl_baseSelectMinRadious "SWC_VC/FCA_AutoPark_VC2/PathPlanner/Pathplanner_AP/PathPlanner1/Subsystem/Whl_baseSelectMinRadious" /begin REF_MEASUREMENT MeAP_m_PlanminRadius /end REF_MEASUREMENT /end GROUP
/end MODULE
/end PROJECT
/* (add any file trailer comments here) */
/* EOF SWC_VC.a2l */
