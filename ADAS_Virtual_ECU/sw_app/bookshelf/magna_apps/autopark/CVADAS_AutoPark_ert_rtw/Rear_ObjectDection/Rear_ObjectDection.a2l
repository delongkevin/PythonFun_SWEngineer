/******************************************************************************
* ASAP2 file: Rear_ObjectDection.a2l
* Code generation for model "Rear_ObjectDection".
* Model version : 1.200
* Simulink Coder version : 9.2 (R2019b) 18-Jul-2019
* C source code generated on : Tue Nov 11 20:48:47 2025
* Target selection: ert.tlc
* Embedded hardware selection: ARM Compatible->ARM Cortex
* Code generation objectives:
* 1. MISRA C:2012 guidelines
* 2. RAM efficiency
* 3. ROM efficiency
* Validation result: Not run
* (add additional file header information here)
******************************************************************************/ ASAP2_VERSION 1 31
/* Version 1.31 */
/begin PROJECT ProjectName "Project Comment Goes Here"
/begin HEADER "Header Comments go here" /end HEADER
/begin MODULE ModuleName "Module Comment Goes Here"
/begin MOD_PAR "MOD PAR Comment Goes Here" /end MOD_PAR
/begin MOD_COMMON "Mod Common Comment Here" BYTE_ORDER MSB_LAST /end MOD_COMMON
/begin RECORD_LAYOUT Scalar_BOOLEAN FNC_VALUES 1 UBYTE COLUMN_DIR DIRECT /end RECORD_LAYOUT
/begin RECORD_LAYOUT Scalar_UBYTE FNC_VALUES 1 UBYTE COLUMN_DIR DIRECT /end RECORD_LAYOUT
/begin RECORD_LAYOUT Scalar_BYTE FNC_VALUES 1 SBYTE COLUMN_DIR DIRECT /end RECORD_LAYOUT
/begin RECORD_LAYOUT Scalar_UWORD FNC_VALUES 1 UWORD COLUMN_DIR DIRECT /end RECORD_LAYOUT
/begin RECORD_LAYOUT Scalar_SWORD FNC_VALUES 1 SWORD COLUMN_DIR DIRECT /end RECORD_LAYOUT
/begin RECORD_LAYOUT Scalar_ULONG FNC_VALUES 1 ULONG COLUMN_DIR DIRECT /end RECORD_LAYOUT
/begin RECORD_LAYOUT Scalar_LONG FNC_VALUES 1 SLONG COLUMN_DIR DIRECT /end RECORD_LAYOUT
/begin RECORD_LAYOUT Scalar_FLOAT32_IEEE FNC_VALUES 1 FLOAT32_IEEE COLUMN_DIR DIRECT /end RECORD_LAYOUT
/begin RECORD_LAYOUT Scalar_FLOAT64_IEEE FNC_VALUES 1 FLOAT64_IEEE COLUMN_DIR DIRECT /end RECORD_LAYOUT
/begin RECORD_LAYOUT Lookup1D_BOOLEAN FNC_VALUES 1 UBYTE COLUMN_DIR DIRECT /end RECORD_LAYOUT
/begin RECORD_LAYOUT Lookup1D_X_BOOLEAN AXIS_PTS_X 1 UBYTE INDEX_INCR DIRECT /end RECORD_LAYOUT
/begin RECORD_LAYOUT Lookup1D_BYTE FNC_VALUES 1 SBYTE COLUMN_DIR DIRECT /end RECORD_LAYOUT
/begin RECORD_LAYOUT Lookup1D_X_BYTE AXIS_PTS_X 1 SBYTE INDEX_INCR DIRECT /end RECORD_LAYOUT
/begin RECORD_LAYOUT Lookup1D_UBYTE FNC_VALUES 1 UBYTE COLUMN_DIR DIRECT /end RECORD_LAYOUT
/begin RECORD_LAYOUT Lookup1D_X_UBYTE AXIS_PTS_X 1 UBYTE INDEX_INCR DIRECT /end RECORD_LAYOUT
/begin RECORD_LAYOUT Lookup1D_UWORD FNC_VALUES 1 UWORD COLUMN_DIR DIRECT /end RECORD_LAYOUT
/begin RECORD_LAYOUT Lookup1D_X_UWORD AXIS_PTS_X 1 UWORD INDEX_INCR DIRECT /end RECORD_LAYOUT
/begin RECORD_LAYOUT Lookup1D_WORD FNC_VALUES 1 SWORD COLUMN_DIR DIRECT /end RECORD_LAYOUT
/begin RECORD_LAYOUT Lookup1D_X_WORD AXIS_PTS_X 1 SWORD INDEX_INCR DIRECT /end RECORD_LAYOUT
/begin RECORD_LAYOUT Lookup1D_ULONG FNC_VALUES 1 ULONG COLUMN_DIR DIRECT /end RECORD_LAYOUT
/begin RECORD_LAYOUT Lookup1D_X_ULONG AXIS_PTS_X 1 ULONG INDEX_INCR DIRECT /end RECORD_LAYOUT
/begin RECORD_LAYOUT Lookup1D_SLONG FNC_VALUES 1 SLONG COLUMN_DIR DIRECT /end RECORD_LAYOUT
/begin RECORD_LAYOUT Lookup1D_X_LONG AXIS_PTS_X 1 SLONG INDEX_INCR DIRECT /end RECORD_LAYOUT
/begin RECORD_LAYOUT Lookup1D_FLOAT32_IEEE FNC_VALUES 1 FLOAT32_IEEE COLUMN_DIR DIRECT /end RECORD_LAYOUT
/begin RECORD_LAYOUT Lookup1D_X_FLOAT32_IEEE AXIS_PTS_X 1 FLOAT32_IEEE INDEX_INCR DIRECT /end RECORD_LAYOUT
/begin RECORD_LAYOUT Lookup1D_FLOAT64_IEEE FNC_VALUES 1 FLOAT64_IEEE COLUMN_DIR DIRECT /end RECORD_LAYOUT
/begin RECORD_LAYOUT Lookup1D_X_FLOAT64_IEEE AXIS_PTS_X 1 FLOAT64_IEEE INDEX_INCR DIRECT /end RECORD_LAYOUT
/begin RECORD_LAYOUT Lookup2D_BOOLEAN FNC_VALUES 1 UBYTE COLUMN_DIR DIRECT /end RECORD_LAYOUT
/begin RECORD_LAYOUT Lookup2D_X_BOOLEAN AXIS_PTS_X 1 UBYTE INDEX_INCR DIRECT /end RECORD_LAYOUT
/begin RECORD_LAYOUT Lookup2D_UBYTE FNC_VALUES 1 UBYTE COLUMN_DIR DIRECT /end RECORD_LAYOUT
/begin RECORD_LAYOUT Lookup2D_X_UBYTE AXIS_PTS_X 1 UBYTE INDEX_INCR DIRECT /end RECORD_LAYOUT
/begin RECORD_LAYOUT Lookup2D_BYTE FNC_VALUES 1 SBYTE COLUMN_DIR DIRECT /end RECORD_LAYOUT
/begin RECORD_LAYOUT Lookup2D_X_BYTE AXIS_PTS_X 1 SBYTE INDEX_INCR DIRECT /end RECORD_LAYOUT
/begin RECORD_LAYOUT Lookup2D_UWORD FNC_VALUES 1 UWORD COLUMN_DIR DIRECT /end RECORD_LAYOUT
/begin RECORD_LAYOUT Lookup2D_X_UWORD AXIS_PTS_X 1 UWORD INDEX_INCR DIRECT /end RECORD_LAYOUT
/begin RECORD_LAYOUT Lookup2D_WORD FNC_VALUES 1 SWORD COLUMN_DIR DIRECT /end RECORD_LAYOUT
/begin RECORD_LAYOUT Lookup2D_X_WORD AXIS_PTS_X 1 SWORD INDEX_INCR DIRECT /end RECORD_LAYOUT
/begin RECORD_LAYOUT Lookup2D_ULONG FNC_VALUES 1 ULONG COLUMN_DIR DIRECT /end RECORD_LAYOUT
/begin RECORD_LAYOUT Lookup2D_X_ULONG AXIS_PTS_X 1 ULONG INDEX_INCR DIRECT /end RECORD_LAYOUT
/begin RECORD_LAYOUT Lookup2D_LONG FNC_VALUES 1 SLONG COLUMN_DIR DIRECT /end RECORD_LAYOUT
/begin RECORD_LAYOUT Lookup2D_X_LONG AXIS_PTS_X 1 SLONG INDEX_INCR DIRECT /end RECORD_LAYOUT
/begin RECORD_LAYOUT Lookup2D_FLOAT32_IEEE FNC_VALUES 1 FLOAT32_IEEE COLUMN_DIR DIRECT /end RECORD_LAYOUT
/begin RECORD_LAYOUT Lookup2D_X_FLOAT32_IEEE AXIS_PTS_X 1 FLOAT32_IEEE INDEX_INCR DIRECT /end RECORD_LAYOUT
/begin RECORD_LAYOUT Lookup2D_FLOAT64_IEEE FNC_VALUES 1 FLOAT64_IEEE COLUMN_DIR DIRECT /end RECORD_LAYOUT
/begin RECORD_LAYOUT Lookup2D_X_FLOAT64_IEEE AXIS_PTS_X 1 FLOAT64_IEEE INDEX_INCR DIRECT /end RECORD_LAYOUT
/begin CHARACTERISTIC CONST_DPS2RPS "conversion parameter from degree/s to rad/s" VALUE 0x0000 /* @ECU_Address@CONST_DPS2RPS@ */ Scalar_FLOAT32_IEEE 0 Rear_ObjectDection_CM_single -3.4E+38 3.4E+38 /end CHARACTERISTIC
/begin CHARACTERISTIC K_e_RAEB_DrawingTubeOffset "To feed mobileye obj type into AdCam instead of hard coded value" VALUE 0x0000 /* @ECU_Address@K_e_RAEB_DrawingTubeOffset@ */ Scalar_FLOAT32_IEEE 0 Rear_ObjectDection_CM_single -3.4E+38 3.4E+38 /end CHARACTERISTIC
/begin CHARACTERISTIC K_e_RAEB_VehicleWidth "To feed mobileye obj type into AdCam instead of hard coded value" VALUE 0x0000 /* @ECU_Address@K_e_RAEB_VehicleWidth@ */ Scalar_FLOAT32_IEEE 0 Rear_ObjectDection_CM_single -3.4E+38 3.4E+38 /end CHARACTERISTIC
/begin CHARACTERISTIC K_e_RAEB_WarnOffset "To feed lateral offset to issue warning" VALUE 0x0000 /* @ECU_Address@K_e_RAEB_WarnOffset@ */ Scalar_FLOAT32_IEEE 0 Rear_ObjectDection_CM_single -3.4E+38 3.4E+38 /end CHARACTERISTIC
/begin CHARACTERISTIC KeAP_cnt_NoiseModeRearDistComp "" VALUE 0x0000 /* @ECU_Address@KeAP_cnt_NoiseModeRearDistComp@ */ Scalar_FLOAT32_IEEE 0 Rear_ObjectDection_CM_single -3.4E+38 3.4E+38 /end CHARACTERISTIC
/begin CHARACTERISTIC KeAP_cnt_RearDistCompTimeThd "" VALUE 0x0000 /* @ECU_Address@KeAP_cnt_RearDistCompTimeThd@ */ Scalar_FLOAT32_IEEE 0 Rear_ObjectDection_CM_single -3.4E+38 3.4E+38 /end CHARACTERISTIC
/begin CHARACTERISTIC KeAP_cm_DistZone2 "Warning Zone 2 Dist" VALUE 0x0000 /* @ECU_Address@KeAP_cm_DistZone2@ */ Scalar_SWORD 0 Rear_ObjectDection_CM_int16_cm 0.0 32767 /end CHARACTERISTIC
/begin CHARACTERISTIC KeAP_cm_NhXmaxOffset "NeighboutHood Window" VALUE 0x0000 /* @ECU_Address@KeAP_cm_NhXmaxOffset@ */ Scalar_SWORD 0 Rear_ObjectDection_CM_int16_cm -100.0 100.0 /end CHARACTERISTIC
/begin CHARACTERISTIC KeAP_cm_NhXminOffset "NeighboutHood Window" VALUE 0x0000 /* @ECU_Address@KeAP_cm_NhXminOffset@ */ Scalar_SWORD 0 Rear_ObjectDection_CM_int16_cm -100.0 100.0 /end CHARACTERISTIC
/begin CHARACTERISTIC KeAP_cm_NhYmaxOffset "NeighboutHood Window" VALUE 0x0000 /* @ECU_Address@KeAP_cm_NhYmaxOffset@ */ Scalar_SWORD 0 Rear_ObjectDection_CM_int16_cm -100.0 100.0 /end CHARACTERISTIC
/begin CHARACTERISTIC KeAP_cm_NhYminOffset "NeighboutHood Window" VALUE 0x0000 /* @ECU_Address@KeAP_cm_NhYminOffset@ */ Scalar_SWORD 0 Rear_ObjectDection_CM_int16_cm -100.0 100.0 /end CHARACTERISTIC
/begin CHARACTERISTIC KeAP_cm_RearLongDistAdj "Longitudanl Distance from Rear Axle to Rear edge of vehicle" VALUE 0x0000 /* @ECU_Address@KeAP_cm_RearLongDistAdj@ */ Scalar_SWORD 0 Rear_ObjectDection_CM_int16_cm -32768 32767 /end CHARACTERISTIC
/begin CHARACTERISTIC KeAP_b_RearDistCorrBasedVehSpd "" VALUE 0x0000 /* @ECU_Address@KeAP_b_RearDistCorrBasedVehSpd@ */ Scalar_BOOLEAN 0 Rear_ObjectDection_CM_boolean 0 1 /end CHARACTERISTIC
/begin CHARACTERISTIC CeAP_k_CurbArrayInit "" VAL_BLK 0x0000 /* @ECU_Address@CeAP_k_CurbArrayInit@ */ Scalar_UBYTE 0 Rear_ObjectDection_CM_uint8 0 255 /* Array Size */ NUMBER 10 /end CHARACTERISTIC
/begin CHARACTERISTIC KeAP_b_SupprsUssGlblHght "" VALUE 0x0000 /* @ECU_Address@KeAP_b_SupprsUssGlblHght@ */ Scalar_UBYTE 0 Rear_ObjectDection_CM_uint8 0 255 /end CHARACTERISTIC
/begin CHARACTERISTIC KeAP_pct_ObjConfidenceThd "Detected Object Confidence threshold" VALUE 0x0000 /* @ECU_Address@KeAP_pct_ObjConfidenceThd@ */ Scalar_UBYTE 0 Rear_ObjectDection_CM_uint8_pct 0 255 /end CHARACTERISTIC
/begin CHARACTERISTIC KePA_b_EnFeatPointSplitImp "Enable NeighboutHood Window" VALUE 0x0000 /* @ECU_Address@KePA_b_EnFeatPointSplitImp@ */ Scalar_UBYTE 0 Rear_ObjectDection_CM_uint8 0.0 1.0 /end CHARACTERISTIC
/begin COMPU_METHOD Rear_ObjectDection_CM_single "Q = V" RAT_FUNC "%8.6" "" COEFFS 0 1 0 0 0 1 /end COMPU_METHOD
/begin COMPU_METHOD Rear_ObjectDection_CM_int16_cm "Q = V" RAT_FUNC "%5.0" "cm" COEFFS 0 1 0 0 0 1 /end COMPU_METHOD
/begin COMPU_METHOD Rear_ObjectDection_CM_boolean "Q = V" RAT_FUNC "%1.0" "" COEFFS 0 1 0 0 0 1 /end COMPU_METHOD
/begin COMPU_METHOD Rear_ObjectDection_CM_uint8 "Q = V" RAT_FUNC "%3.0" "" COEFFS 0 1 0 0 0 1 /end COMPU_METHOD
/begin COMPU_METHOD Rear_ObjectDection_CM_uint8_pct "Q = V" RAT_FUNC "%3.0" "pct" COEFFS 0 1 0 0 0 1 /end COMPU_METHOD
/begin GROUP Rear_ObjectDection "Rear_ObjectDection" /* Root */ ROOT
 /begin SUB_GROUP Root_CompensationValue Root_RearBrakingDistCalc Root_ValidObjectDist /end SUB_GROUP
 /begin REF_CHARACTERISTIC KeAP_b_RearDistCorrBasedVehSpd /end REF_CHARACTERISTIC
/end GROUP
/begin GROUP Root_CompensationValue "Rear_ObjectDection/CompensationValue"
 /begin REF_CHARACTERISTIC KeAP_cnt_NoiseModeRearDistComp KeAP_cnt_RearDistCompTimeThd /end REF_CHARACTERISTIC
/end GROUP
/begin GROUP Root_RearBrakingDistCalc "Rear_ObjectDection/RearBrakingDistCalc" /begin SUB_GROUP S2_CalcHeadingChange S2_CalculateRearBrakingDistance1 /end SUB_GROUP
 /begin REF_CHARACTERISTIC CeAP_k_CurbArrayInit KeAP_cm_DistZone2 KeAP_pct_ObjConfidenceThd KePA_b_EnFeatPointSplitImp /end REF_CHARACTERISTIC
/end GROUP
/begin GROUP Root_ValidObjectDist "Rear_ObjectDection/ValidObjectDist" /begin REF_CHARACTERISTIC KeAP_b_SupprsUssGlblHght /end REF_CHARACTERISTIC /end GROUP
/begin GROUP S2_CalcHeadingChange "Rear_ObjectDection/RearBrakingDistCalc/CalcHeadingChange"
 /begin REF_CHARACTERISTIC CONST_DPS2RPS K_e_RAEB_DrawingTubeOffset K_e_RAEB_WarnOffset KeAP_cm_RearLongDistAdj /end REF_CHARACTERISTIC
/end GROUP
/begin GROUP S2_CalculateRearBrakingDistance1 "Rear_ObjectDection/RearBrakingDistCalc/CalculateRearBrakingDistance1" /begin SUB_GROUP S7_CalcDistToObjStraight S7_NeighbourHoodCheck /end SUB_GROUP /end GROUP
/begin GROUP S7_CalcDistToObjStraight "Rear_ObjectDection/RearBrakingDistCalc/CalculateRearBrakingDistance1/CalcDistToObjStraight"
 /begin REF_CHARACTERISTIC K_e_RAEB_DrawingTubeOffset K_e_RAEB_VehicleWidth K_e_RAEB_WarnOffset /end REF_CHARACTERISTIC
/end GROUP
/begin GROUP S7_NeighbourHoodCheck "Rear_ObjectDection/RearBrakingDistCalc/CalculateRearBrakingDistance1/NeighbourHoodCheck"
 /begin REF_CHARACTERISTIC KeAP_cm_NhXmaxOffset KeAP_cm_NhXminOffset KeAP_cm_NhYmaxOffset KeAP_cm_NhYminOffset /end REF_CHARACTERISTIC
/end GROUP
/end MODULE
/end PROJECT
/* (add any file trailer comments here) */
/* EOF Rear_ObjectDection.a2l */
