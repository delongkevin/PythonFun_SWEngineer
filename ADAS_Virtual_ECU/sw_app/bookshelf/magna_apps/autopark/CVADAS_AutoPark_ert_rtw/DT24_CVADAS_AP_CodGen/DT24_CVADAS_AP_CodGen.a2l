/******************************************************************************
* ASAP2 file: DT24_CVADAS_AP_CodGen.a2l
* Code generation for model "DT24_CVADAS_AP_CodGen".
* Model version : 1.1280
* Simulink Coder version : 9.2 (R2019b) 18-Jul-2019
* C source code generated on : Wed Nov 12 18:15:18 2025
* Target selection: ert.tlc
* Embedded hardware selection: ARM Compatible->ARM Cortex
* Code generation objectives:
* 1. MISRA C:2012 guidelines
* 2. RAM efficiency
* 3. ROM efficiency
* Validation result: Not run
* (add additional file header information here)
******************************************************************************/ ASAP2_VERSION 1 31
/* Version 1.31 */
/begin PROJECT ProjectName "Project Comment Goes Here"
/begin HEADER "Header Comments go here" /end HEADER
/begin MODULE ModuleName "Module Comment Goes Here"
/begin MOD_PAR "MOD PAR Comment Goes Here" /end MOD_PAR
/begin MOD_COMMON "Mod Common Comment Here" BYTE_ORDER MSB_LAST /end MOD_COMMON
/begin RECORD_LAYOUT Scalar_BOOLEAN FNC_VALUES 1 UBYTE COLUMN_DIR DIRECT /end RECORD_LAYOUT
/begin RECORD_LAYOUT Scalar_UBYTE FNC_VALUES 1 UBYTE COLUMN_DIR DIRECT /end RECORD_LAYOUT
/begin RECORD_LAYOUT Scalar_BYTE FNC_VALUES 1 SBYTE COLUMN_DIR DIRECT /end RECORD_LAYOUT
/begin RECORD_LAYOUT Scalar_UWORD FNC_VALUES 1 UWORD COLUMN_DIR DIRECT /end RECORD_LAYOUT
/begin RECORD_LAYOUT Scalar_SWORD FNC_VALUES 1 SWORD COLUMN_DIR DIRECT /end RECORD_LAYOUT
/begin RECORD_LAYOUT Scalar_ULONG FNC_VALUES 1 ULONG COLUMN_DIR DIRECT /end RECORD_LAYOUT
/begin RECORD_LAYOUT Scalar_LONG FNC_VALUES 1 SLONG COLUMN_DIR DIRECT /end RECORD_LAYOUT
/begin RECORD_LAYOUT Scalar_FLOAT32_IEEE FNC_VALUES 1 FLOAT32_IEEE COLUMN_DIR DIRECT /end RECORD_LAYOUT
/begin RECORD_LAYOUT Scalar_FLOAT64_IEEE FNC_VALUES 1 FLOAT64_IEEE COLUMN_DIR DIRECT /end RECORD_LAYOUT
/begin RECORD_LAYOUT Lookup1D_BOOLEAN FNC_VALUES 1 UBYTE COLUMN_DIR DIRECT /end RECORD_LAYOUT
/begin RECORD_LAYOUT Lookup1D_X_BOOLEAN AXIS_PTS_X 1 UBYTE INDEX_INCR DIRECT /end RECORD_LAYOUT
/begin RECORD_LAYOUT Lookup1D_BYTE FNC_VALUES 1 SBYTE COLUMN_DIR DIRECT /end RECORD_LAYOUT
/begin RECORD_LAYOUT Lookup1D_X_BYTE AXIS_PTS_X 1 SBYTE INDEX_INCR DIRECT /end RECORD_LAYOUT
/begin RECORD_LAYOUT Lookup1D_UBYTE FNC_VALUES 1 UBYTE COLUMN_DIR DIRECT /end RECORD_LAYOUT
/begin RECORD_LAYOUT Lookup1D_X_UBYTE AXIS_PTS_X 1 UBYTE INDEX_INCR DIRECT /end RECORD_LAYOUT
/begin RECORD_LAYOUT Lookup1D_UWORD FNC_VALUES 1 UWORD COLUMN_DIR DIRECT /end RECORD_LAYOUT
/begin RECORD_LAYOUT Lookup1D_X_UWORD AXIS_PTS_X 1 UWORD INDEX_INCR DIRECT /end RECORD_LAYOUT
/begin RECORD_LAYOUT Lookup1D_WORD FNC_VALUES 1 SWORD COLUMN_DIR DIRECT /end RECORD_LAYOUT
/begin RECORD_LAYOUT Lookup1D_X_WORD AXIS_PTS_X 1 SWORD INDEX_INCR DIRECT /end RECORD_LAYOUT
/begin RECORD_LAYOUT Lookup1D_ULONG FNC_VALUES 1 ULONG COLUMN_DIR DIRECT /end RECORD_LAYOUT
/begin RECORD_LAYOUT Lookup1D_X_ULONG AXIS_PTS_X 1 ULONG INDEX_INCR DIRECT /end RECORD_LAYOUT
/begin RECORD_LAYOUT Lookup1D_SLONG FNC_VALUES 1 SLONG COLUMN_DIR DIRECT /end RECORD_LAYOUT
/begin RECORD_LAYOUT Lookup1D_X_LONG AXIS_PTS_X 1 SLONG INDEX_INCR DIRECT /end RECORD_LAYOUT
/begin RECORD_LAYOUT Lookup1D_FLOAT32_IEEE FNC_VALUES 1 FLOAT32_IEEE COLUMN_DIR DIRECT /end RECORD_LAYOUT
/begin RECORD_LAYOUT Lookup1D_X_FLOAT32_IEEE AXIS_PTS_X 1 FLOAT32_IEEE INDEX_INCR DIRECT /end RECORD_LAYOUT
/begin RECORD_LAYOUT Lookup1D_FLOAT64_IEEE FNC_VALUES 1 FLOAT64_IEEE COLUMN_DIR DIRECT /end RECORD_LAYOUT
/begin RECORD_LAYOUT Lookup1D_X_FLOAT64_IEEE AXIS_PTS_X 1 FLOAT64_IEEE INDEX_INCR DIRECT /end RECORD_LAYOUT
/begin RECORD_LAYOUT Lookup2D_BOOLEAN FNC_VALUES 1 UBYTE COLUMN_DIR DIRECT /end RECORD_LAYOUT
/begin RECORD_LAYOUT Lookup2D_X_BOOLEAN AXIS_PTS_X 1 UBYTE INDEX_INCR DIRECT /end RECORD_LAYOUT
/begin RECORD_LAYOUT Lookup2D_UBYTE FNC_VALUES 1 UBYTE COLUMN_DIR DIRECT /end RECORD_LAYOUT
/begin RECORD_LAYOUT Lookup2D_X_UBYTE AXIS_PTS_X 1 UBYTE INDEX_INCR DIRECT /end RECORD_LAYOUT
/begin RECORD_LAYOUT Lookup2D_BYTE FNC_VALUES 1 SBYTE COLUMN_DIR DIRECT /end RECORD_LAYOUT
/begin RECORD_LAYOUT Lookup2D_X_BYTE AXIS_PTS_X 1 SBYTE INDEX_INCR DIRECT /end RECORD_LAYOUT
/begin RECORD_LAYOUT Lookup2D_UWORD FNC_VALUES 1 UWORD COLUMN_DIR DIRECT /end RECORD_LAYOUT
/begin RECORD_LAYOUT Lookup2D_X_UWORD AXIS_PTS_X 1 UWORD INDEX_INCR DIRECT /end RECORD_LAYOUT
/begin RECORD_LAYOUT Lookup2D_WORD FNC_VALUES 1 SWORD COLUMN_DIR DIRECT /end RECORD_LAYOUT
/begin RECORD_LAYOUT Lookup2D_X_WORD AXIS_PTS_X 1 SWORD INDEX_INCR DIRECT /end RECORD_LAYOUT
/begin RECORD_LAYOUT Lookup2D_ULONG FNC_VALUES 1 ULONG COLUMN_DIR DIRECT /end RECORD_LAYOUT
/begin RECORD_LAYOUT Lookup2D_X_ULONG AXIS_PTS_X 1 ULONG INDEX_INCR DIRECT /end RECORD_LAYOUT
/begin RECORD_LAYOUT Lookup2D_LONG FNC_VALUES 1 SLONG COLUMN_DIR DIRECT /end RECORD_LAYOUT
/begin RECORD_LAYOUT Lookup2D_X_LONG AXIS_PTS_X 1 SLONG INDEX_INCR DIRECT /end RECORD_LAYOUT
/begin RECORD_LAYOUT Lookup2D_FLOAT32_IEEE FNC_VALUES 1 FLOAT32_IEEE COLUMN_DIR DIRECT /end RECORD_LAYOUT
/begin RECORD_LAYOUT Lookup2D_X_FLOAT32_IEEE AXIS_PTS_X 1 FLOAT32_IEEE INDEX_INCR DIRECT /end RECORD_LAYOUT
/begin RECORD_LAYOUT Lookup2D_FLOAT64_IEEE FNC_VALUES 1 FLOAT64_IEEE COLUMN_DIR DIRECT /end RECORD_LAYOUT
/begin RECORD_LAYOUT Lookup2D_X_FLOAT64_IEEE AXIS_PTS_X 1 FLOAT64_IEEE INDEX_INCR DIRECT /end RECORD_LAYOUT
/begin CHARACTERISTIC K_Overlap_Thrsld_RAEB "" VAL_BLK 0x0000 /* @ECU_Address@K_Overlap_Thrsld_RAEB@ */ Scalar_FLOAT32_IEEE 0 DT24_CVADAS_AP_CodGen_CM_single -3.4E+38 3.4E+38 NUMBER 5 /end CHARACTERISTIC
/begin CHARACTERISTIC K_e_RAEB_VehicleWidth "To feed mobileye obj type into AdCam instead of hard coded value" VALUE 0x0000 /* @ECU_Address@K_e_RAEB_VehicleWidth@ */ Scalar_FLOAT32_IEEE 0 DT24_CVADAS_AP_CodGen_CM_single -3.4E+38 3.4E+38 /end CHARACTERISTIC
/begin CHARACTERISTIC KeAP_degC_OperatingTempThd "Maximum operating Temprature threshold " VALUE 0x0000 /* @ECU_Address@KeAP_degC_OperatingTempThd@ */ Scalar_FLOAT32_IEEE 0 DT24_CVADAS_AP_CodGen_CM_single_degC -3.4E+38 3.4E+38 /end CHARACTERISTIC
/begin CHARACTERISTIC KeAP_k_BrakeIGain "" VALUE 0x0000 /* @ECU_Address@KeAP_k_BrakeIGain@ */ Scalar_FLOAT32_IEEE 0 DT24_CVADAS_AP_CodGen_CM_single -3.4E+38 3.4E+38 /end CHARACTERISTIC
/begin CHARACTERISTIC KeAP_k_BrakeLowerLimit "" VALUE 0x0000 /* @ECU_Address@KeAP_k_BrakeLowerLimit@ */ Scalar_FLOAT32_IEEE 0 DT24_CVADAS_AP_CodGen_CM_single -3.4E+38 3.4E+38 /end CHARACTERISTIC
/begin CHARACTERISTIC KeAP_k_BrakePGain "" VALUE 0x0000 /* @ECU_Address@KeAP_k_BrakePGain@ */ Scalar_FLOAT32_IEEE 0 DT24_CVADAS_AP_CodGen_CM_single -3.4E+38 3.4E+38 /end CHARACTERISTIC
/begin CHARACTERISTIC KeAP_k_BrakeUpperLimit "" VALUE 0x0000 /* @ECU_Address@KeAP_k_BrakeUpperLimit@ */ Scalar_FLOAT32_IEEE 0 DT24_CVADAS_AP_CodGen_CM_single -3.4E+38 3.4E+38 /end CHARACTERISTIC
/begin CHARACTERISTIC KeAP_k_CtrlOutCollDetActivate "" VALUE 0x0000 /* @ECU_Address@KeAP_k_CtrlOutCollDetActivate@ */ Scalar_FLOAT32_IEEE 0 DT24_CVADAS_AP_CodGen_CM_single -3.4E+38 3.4E+38 /end CHARACTERISTIC
/begin CHARACTERISTIC KeAP_k_CtrlOutCollDetCollDistLimit "" VALUE 0x0000 /* @ECU_Address@KeAP_k_CtrlOutCollDetCollDistLimit@ */ Scalar_FLOAT32_IEEE 0 DT24_CVADAS_AP_CodGen_CM_single -3.4E+38 3.4E+38 /end CHARACTERISTIC
/begin CHARACTERISTIC KeAP_k_CtrlOutCollDetRedStopVal "" VALUE 0x0000 /* @ECU_Address@KeAP_k_CtrlOutCollDetRedStopVal@ */ Scalar_FLOAT32_IEEE 0 DT24_CVADAS_AP_CodGen_CM_single -3.4E+38 3.4E+38 /end CHARACTERISTIC
/begin CHARACTERISTIC KeAP_k_CtrlOutGearDrive "" VALUE 0x0000 /* @ECU_Address@KeAP_k_CtrlOutGearDrive@ */ Scalar_FLOAT32_IEEE 0 DT24_CVADAS_AP_CodGen_CM_single -3.4E+38 3.4E+38 /end CHARACTERISTIC
/begin CHARACTERISTIC KeAP_k_CtrlOutGearPark "" VALUE 0x0000 /* @ECU_Address@KeAP_k_CtrlOutGearPark@ */ Scalar_FLOAT32_IEEE 0 DT24_CVADAS_AP_CodGen_CM_single -3.4E+38 3.4E+38 /end CHARACTERISTIC
/begin CHARACTERISTIC KeAP_k_CtrlOutGearReverse "" VALUE 0x0000 /* @ECU_Address@KeAP_k_CtrlOutGearReverse@ */ Scalar_FLOAT32_IEEE 0 DT24_CVADAS_AP_CodGen_CM_single -3.4E+38 3.4E+38 /end CHARACTERISTIC
/begin CHARACTERISTIC KeAP_k_CtrlOutRemainDistNA "" VALUE 0x0000 /* @ECU_Address@KeAP_k_CtrlOutRemainDistNA@ */ Scalar_FLOAT32_IEEE 0 DT24_CVADAS_AP_CodGen_CM_single -3.4E+38 3.4E+38 /end CHARACTERISTIC
/begin CHARACTERISTIC KeAP_k_CtrlOutVehSpdMaxSpotSteer "" VALUE 0x0000 /* @ECU_Address@KeAP_k_CtrlOutVehSpdMaxSpotSteer@ */ Scalar_FLOAT32_IEEE 0 DT24_CVADAS_AP_CodGen_CM_single -3.4E+38 3.4E+38 /end CHARACTERISTIC
/begin CHARACTERISTIC KeAP_k_CtrlOutVehSpdMaxSpotStrRackDevThd "" VALUE 0x0000 /* @ECU_Address@KeAP_k_CtrlOutVehSpdMaxSpotStrRackDevThd@ */ Scalar_FLOAT32_IEEE 0 DT24_CVADAS_AP_CodGen_CM_single -3.4E+38 3.4E+38 /end CHARACTERISTIC
/begin CHARACTERISTIC KeAP_k_CtrlOutVehSpdMaxSpotStrTime "" VALUE 0x0000 /* @ECU_Address@KeAP_k_CtrlOutVehSpdMaxSpotStrTime@ */ Scalar_FLOAT32_IEEE 0 DT24_CVADAS_AP_CodGen_CM_single -3.4E+38 3.4E+38 /end CHARACTERISTIC
/begin CHARACTERISTIC KeAP_k_DetWP_PreviewTime "" VALUE 0x0000 /* @ECU_Address@KeAP_k_DetWP_PreviewTime@ */ Scalar_FLOAT32_IEEE 0 DT24_CVADAS_AP_CodGen_CM_single -3.4E+38 3.4E+38 /end CHARACTERISTIC
/begin CHARACTERISTIC KeAP_k_LatHeadDevDGain "" VALUE 0x0000 /* @ECU_Address@KeAP_k_LatHeadDevDGain@ */ Scalar_FLOAT32_IEEE 0 DT24_CVADAS_AP_CodGen_CM_single -3.4E+38 3.4E+38 /end CHARACTERISTIC
/begin CHARACTERISTIC KeAP_k_LatHeadDevIGain "" VALUE 0x0000 /* @ECU_Address@KeAP_k_LatHeadDevIGain@ */ Scalar_FLOAT32_IEEE 0 DT24_CVADAS_AP_CodGen_CM_single -3.4E+38 3.4E+38 /end CHARACTERISTIC
/begin CHARACTERISTIC KeAP_k_LatHeadDevPGain "" VALUE 0x0000 /* @ECU_Address@KeAP_k_LatHeadDevPGain@ */ Scalar_FLOAT32_IEEE 0 DT24_CVADAS_AP_CodGen_CM_single -3.4E+38 3.4E+38 /end CHARACTERISTIC
/begin CHARACTERISTIC KeAP_k_LatPathDevDGain "" VALUE 0x0000 /* @ECU_Address@KeAP_k_LatPathDevDGain@ */ Scalar_FLOAT32_IEEE 0 DT24_CVADAS_AP_CodGen_CM_single -3.4E+38 3.4E+38 /end CHARACTERISTIC
/begin CHARACTERISTIC KeAP_k_LatPathDevIGain "" VALUE 0x0000 /* @ECU_Address@KeAP_k_LatPathDevIGain@ */ Scalar_FLOAT32_IEEE 0 DT24_CVADAS_AP_CodGen_CM_single -3.4E+38 3.4E+38 /end CHARACTERISTIC
/begin CHARACTERISTIC KeAP_k_LatPathDevPGain "" VALUE 0x0000 /* @ECU_Address@KeAP_k_LatPathDevPGain@ */ Scalar_FLOAT32_IEEE 0 DT24_CVADAS_AP_CodGen_CM_single -3.4E+38 3.4E+38 /end CHARACTERISTIC
/begin CHARACTERISTIC KeAP_k_PathSepaMinSpd "" VALUE 0x0000 /* @ECU_Address@KeAP_k_PathSepaMinSpd@ */ Scalar_FLOAT32_IEEE 0 DT24_CVADAS_AP_CodGen_CM_single -3.4E+38 3.4E+38 /end CHARACTERISTIC
/begin CHARACTERISTIC KeAP_k_PathSepaSpdRampGrd "" VALUE 0x0000 /* @ECU_Address@KeAP_k_PathSepaSpdRampGrd@ */ Scalar_FLOAT32_IEEE 0 DT24_CVADAS_AP_CodGen_CM_single -3.4E+38 3.4E+38 /end CHARACTERISTIC
/begin CHARACTERISTIC KeAP_k_SteerLowerLimit "" VALUE 0x0000 /* @ECU_Address@KeAP_k_SteerLowerLimit@ */ Scalar_FLOAT32_IEEE 0 DT24_CVADAS_AP_CodGen_CM_single -3.4E+38 3.4E+38 /end CHARACTERISTIC
/begin CHARACTERISTIC KeAP_k_SteerUpperLimit "" VALUE 0x0000 /* @ECU_Address@KeAP_k_SteerUpperLimit@ */ Scalar_FLOAT32_IEEE 0 DT24_CVADAS_AP_CodGen_CM_single -3.4E+38 3.4E+38 /end CHARACTERISTIC
/begin CHARACTERISTIC KeAP_k_WhlCircum "" VALUE 0x0000 /* @ECU_Address@KeAP_k_WhlCircum@ */ Scalar_FLOAT32_IEEE 0 DT24_CVADAS_AP_CodGen_CM_single -3.4E+38 3.4E+38 /end CHARACTERISTIC
/begin CHARACTERISTIC KeAP_kph_ConfThdSpdBrkPnts "" VAL_BLK 0x0000 /* @ECU_Address@KeAP_kph_ConfThdSpdBrkPnts@ */ Scalar_FLOAT32_IEEE 0 DT24_CVADAS_AP_CodGen_CM_single_kph 0.0 100.0 NUMBER 2 /end CHARACTERISTIC
/begin CHARACTERISTIC KeAP_kph_EnblHysThd "Hystere sis threshold to apply for all vehicle speed related threshold parameters" VALUE 0x0000 /* @ECU_Address@KeAP_kph_EnblHysThd@ */ Scalar_FLOAT32_IEEE 0 DT24_CVADAS_AP_CodGen_CM_single_kph 0.0 2.0 /end CHARACTERISTIC
/begin CHARACTERISTIC KeAP_kph_FrntWarnMaxSpdThd "Vehicle speed threshold during Front Park Assist feature" VALUE 0x0000 /* @ECU_Address@KeAP_kph_FrntWarnMaxSpdThd@ */ Scalar_FLOAT32_IEEE 0 DT24_CVADAS_AP_CodGen_CM_single_kph 0.0 11.0 /end CHARACTERISTIC
/begin CHARACTERISTIC KeAP_kph_PSDOffThd "Vehicle speed threshold during detection the parking slot" VALUE 0x0000 /* @ECU_Address@KeAP_kph_PSDOffThd@ */ Scalar_FLOAT32_IEEE 0 DT24_CVADAS_AP_CodGen_CM_single_kph 0.0 45.0 /end CHARACTERISTIC
/begin CHARACTERISTIC KeAP_kph_PSDOnThd "Vehicle speed threshold to warn driver about hight speed during parking slot detection" VALUE 0x0000 /* @ECU_Address@KeAP_kph_PSDOnThd@ */ Scalar_FLOAT32_IEEE 0 DT24_CVADAS_AP_CodGen_CM_single_kph 0.0 3.4E+38 /end CHARACTERISTIC
/begin CHARACTERISTIC KeAP_kph_ParkMnvThd "Ego Vehicle speed limit to continue parking maneuvering" VALUE 0x0000 /* @ECU_Address@KeAP_kph_ParkMnvThd@ */ Scalar_FLOAT32_IEEE 0 DT24_CVADAS_AP_CodGen_CM_single_kph 0.0 10.0 /end CHARACTERISTIC
/begin CHARACTERISTIC KeAP_kph_RearWarnMaxSpdThd "Vehicle speed threshold during Rear Park Assist feature" VALUE 0x0000 /* @ECU_Address@KeAP_kph_RearWarnMaxSpdThd@ */ Scalar_FLOAT32_IEEE 0 DT24_CVADAS_AP_CodGen_CM_single_kph 0.0 11.0 /end CHARACTERISTIC
/begin CHARACTERISTIC KeAP_sec_SampleTime "" VALUE 0x0000 /* @ECU_Address@KeAP_sec_SampleTime@ */ Scalar_FLOAT32_IEEE 0 DT24_CVADAS_AP_CodGen_CM_single_sec -3.4E+38 3.4E+38 /end CHARACTERISTIC
/begin CHARACTERISTIC KePA_cnt_FrntWallPntCntThd "" VALUE 0x0000 /* @ECU_Address@KePA_cnt_FrntWallPntCntThd@ */ Scalar_FLOAT32_IEEE 0 DT24_CVADAS_AP_CodGen_CM_single 0.0 100.0 /end CHARACTERISTIC
/begin CHARACTERISTIC KePA_cnt_RearWallPntCntThd "" VALUE 0x0000 /* @ECU_Address@KePA_cnt_RearWallPntCntThd@ */ Scalar_FLOAT32_IEEE 0 DT24_CVADAS_AP_CodGen_CM_single 0.0 100.0 /end CHARACTERISTIC
/begin CHARACTERISTIC KeTOS_s_InTurnDbncTm "" VALUE 0x0000 /* @ECU_Address@KeTOS_s_InTurnDbncTm@ */ Scalar_FLOAT32_IEEE 0 DT24_CVADAS_AP_CodGen_CM_single -3.4E+38 3.4E+38 /end CHARACTERISTIC
/begin CHARACTERISTIC KeTOS_s_StrDrvDbncTm "" VALUE 0x0000 /* @ECU_Address@KeTOS_s_StrDrvDbncTm@ */ Scalar_FLOAT32_IEEE 0 DT24_CVADAS_AP_CodGen_CM_single -3.4E+38 3.4E+38 /end CHARACTERISTIC
/begin CHARACTERISTIC KeTOS_s_TurnExitDbncTm "" VALUE 0x0000 /* @ECU_Address@KeTOS_s_TurnExitDbncTm@ */ Scalar_FLOAT32_IEEE 0 DT24_CVADAS_AP_CodGen_CM_single -3.4E+38 3.4E+38 /end CHARACTERISTIC
/begin CHARACTERISTIC KeTOS_x_InTurnThd "" VALUE 0x0000 /* @ECU_Address@KeTOS_x_InTurnThd@ */ Scalar_FLOAT32_IEEE 0 DT24_CVADAS_AP_CodGen_CM_single -3.4E+38 3.4E+38 /end CHARACTERISTIC
/begin CHARACTERISTIC KeTOS_x_TurnExitThd "" VALUE 0x0000 /* @ECU_Address@KeTOS_x_TurnExitThd@ */ Scalar_FLOAT32_IEEE 0 DT24_CVADAS_AP_CodGen_CM_single -3.4E+38 3.4E+38 /end CHARACTERISTIC
/begin CHARACTERISTIC Obj_DistTable "" VAL_BLK 0x0000 /* @ECU_Address@Obj_DistTable@ */ Scalar_FLOAT32_IEEE 0 DT24_CVADAS_AP_CodGen_CM_single -3.4E+38 3.4E+38 NUMBER 5 /end CHARACTERISTIC
/begin CHARACTERISTIC Overlap_Thrsld_Switch "" VALUE 0x0000 /* @ECU_Address@Overlap_Thrsld_Switch@ */ Scalar_FLOAT32_IEEE 0 DT24_CVADAS_AP_CodGen_CM_single -3.4E+38 3.4E+38 /end CHARACTERISTIC
/begin CHARACTERISTIC RAEB_Envelope_Offset "" VALUE 0x0000 /* @ECU_Address@RAEB_Envelope_Offset@ */ Scalar_FLOAT32_IEEE 0 DT24_CVADAS_AP_CodGen_CM_single -3.4E+38 3.4E+38 /end CHARACTERISTIC
/begin CHARACTERISTIC RAEB_Lateral_Distance_Notification "" VALUE 0x0000 /* @ECU_Address@RAEB_Lateral_Distance_Notification@ */ Scalar_FLOAT32_IEEE 0 DT24_CVADAS_AP_CodGen_CM_single -3.4E+38 3.4E+38 /end CHARACTERISTIC
/begin CHARACTERISTIC RAEB_Minimum_Object_Heigh "Minimum acceptable height of a object" VALUE 0x0000 /* @ECU_Address@RAEB_Minimum_Object_Heigh@ */ Scalar_FLOAT32_IEEE 0 DT24_CVADAS_AP_CodGen_CM_single_m -3.4E+38 3.4E+38 /end CHARACTERISTIC
/begin CHARACTERISTIC Steering_Angle_DeadZone_End "" VALUE 0x0000 /* @ECU_Address@Steering_Angle_DeadZone_End@ */ Scalar_FLOAT32_IEEE 0 DT24_CVADAS_AP_CodGen_CM_single -3.4E+38 3.4E+38 /end CHARACTERISTIC
/begin CHARACTERISTIC Steering_Angle_DeadZone_Start "" VALUE 0x0000 /* @ECU_Address@Steering_Angle_DeadZone_Start@ */ Scalar_FLOAT32_IEEE 0 DT24_CVADAS_AP_CodGen_CM_single -3.4E+38 3.4E+38 /end CHARACTERISTIC
/begin CHARACTERISTIC Straight_Driving_Thresold_rads2 "" VALUE 0x0000 /* @ECU_Address@Straight_Driving_Thresold_rads2@ */ Scalar_FLOAT32_IEEE 0 DT24_CVADAS_AP_CodGen_CM_single -3.4E+38 3.4E+38 /end CHARACTERISTIC
/begin CHARACTERISTIC keInpAdptr_e_StWhOffset "Wheel Offset" VALUE 0x0000 /* @ECU_Address@keInpAdptr_e_StWhOffset@ */ Scalar_FLOAT32_IEEE 0 DT24_CVADAS_AP_CodGen_CM_single -3.4E+38 3.4E+38 /end CHARACTERISTIC
/begin CHARACTERISTIC keVehParam_e_StrWhlRatioBrkPnts "Vehicle Steering Wheel Ratio Break Points " VAL_BLK 0x0000 /* @ECU_Address@keVehParam_e_StrWhlRatioBrkPnts@ */ Scalar_FLOAT32_IEEE 0 DT24_CVADAS_AP_CodGen_CM_single -3.4E+38 3.4E+38 NUMBER 19 /end CHARACTERISTIC
/begin CHARACTERISTIC keVehParam_e_VehSteerRatioTable "" VAL_BLK 0x0000 /* @ECU_Address@keVehParam_e_VehSteerRatioTable@ */ Scalar_FLOAT32_IEEE 0 DT24_CVADAS_AP_CodGen_CM_single -3.4E+38 3.4E+38 NUMBER 19 /end CHARACTERISTIC
/begin CHARACTERISTIC keVehParam_m_DistWhlBse "Reply Type In" VALUE 0x0000 /* @ECU_Address@keVehParam_m_DistWhlBse@ */ Scalar_FLOAT32_IEEE 0 DT24_CVADAS_AP_CodGen_CM_single_m -3.4E+38 3.4E+38 /end CHARACTERISTIC
/begin CHARACTERISTIC sampling_time "10ms sampling time" VALUE 0x0000 /* @ECU_Address@sampling_time@ */ Scalar_FLOAT32_IEEE 0 DT24_CVADAS_AP_CodGen_CM_single -3.4E+38 3.4E+38 /end CHARACTERISTIC
/begin CHARACTERISTIC KeAP_cm_CenterWarnLatThreshold "Parameter to decide center region" VALUE 0x0000 /* @ECU_Address@KeAP_cm_CenterWarnLatThreshold@ */ Scalar_SWORD 0 DT24_CVADAS_AP_CodGen_CM_int16 -32768 32767 /end CHARACTERISTIC
/begin CHARACTERISTIC KeAP_cm_DistZone1 "Warning Zone 1 Dist" VALUE 0x0000 /* @ECU_Address@KeAP_cm_DistZone1@ */ Scalar_SWORD 0 DT24_CVADAS_AP_CodGen_CM_int16_cm 0.0 32767 /end CHARACTERISTIC
/begin CHARACTERISTIC KeAP_cm_DistZone2 "Warning Zone 2 Dist" VALUE 0x0000 /* @ECU_Address@KeAP_cm_DistZone2@ */ Scalar_SWORD 0 DT24_CVADAS_AP_CodGen_CM_int16_cm 0.0 32767 /end CHARACTERISTIC
/begin CHARACTERISTIC KeAP_cm_DistZone3 "Warning Zone 3 Dist" VALUE 0x0000 /* @ECU_Address@KeAP_cm_DistZone3@ */ Scalar_SWORD 0 DT24_CVADAS_AP_CodGen_CM_int16_cm 0.0 32767 /end CHARACTERISTIC
/begin CHARACTERISTIC KeAP_cm_DistZone4 "Warning Zone 4 Dist" VALUE 0x0000 /* @ECU_Address@KeAP_cm_DistZone4@ */ Scalar_SWORD 0 DT24_CVADAS_AP_CodGen_CM_int16_cm 0.0 32767 /end CHARACTERISTIC
/begin CHARACTERISTIC KeAP_cm_DistZone5 "Warning Zone 5 Dist" VALUE 0x0000 /* @ECU_Address@KeAP_cm_DistZone5@ */ Scalar_SWORD 0 DT24_CVADAS_AP_CodGen_CM_int16_cm 0.0 32767 /end CHARACTERISTIC
/begin CHARACTERISTIC KeAP_cm_DistZone6 "Warning Zone 6 Dist" VALUE 0x0000 /* @ECU_Address@KeAP_cm_DistZone6@ */ Scalar_SWORD 0 DT24_CVADAS_AP_CodGen_CM_int16_cm 0.0 32767 /end CHARACTERISTIC
/begin CHARACTERISTIC KeAP_cm_FrntDistArcComp "Warning Zone 6 Dist" VALUE 0x0000 /* @ECU_Address@KeAP_cm_FrntDistArcComp@ */ Scalar_SWORD 0 DT24_CVADAS_AP_CodGen_CM_int16_cm 0.0 32767 /end CHARACTERISTIC
/begin CHARACTERISTIC KeAP_cm_FrntDistZone2 "Warning Zone 2 Dist" VALUE 0x0000 /* @ECU_Address@KeAP_cm_FrntDistZone2@ */ Scalar_SWORD 0 DT24_CVADAS_AP_CodGen_CM_int16_cm 0.0 32767 /end CHARACTERISTIC
/begin CHARACTERISTIC KeAP_cm_FrntDistZone4 "Warning Zone 4 Dist" VALUE 0x0000 /* @ECU_Address@KeAP_cm_FrntDistZone4@ */ Scalar_SWORD 0 DT24_CVADAS_AP_CodGen_CM_int16_cm 0.0 32767 /end CHARACTERISTIC
/begin CHARACTERISTIC KeAP_cm_FrntLongDistAdj "Longitudanl Distance from Rear Axle to Front edge of vehicle" VALUE 0x0000 /* @ECU_Address@KeAP_cm_FrntLongDistAdj@ */ Scalar_SWORD 0 DT24_CVADAS_AP_CodGen_CM_int16_cm -32768 32767 /end CHARACTERISTIC
/begin CHARACTERISTIC KeAP_cm_HalfVehicleWidth "Ego Vehicle Car Half Width" VALUE 0x0000 /* @ECU_Address@KeAP_cm_HalfVehicleWidth@ */ Scalar_SWORD 0 DT24_CVADAS_AP_CodGen_CM_int16_sec -32768 32767 /end CHARACTERISTIC
/begin CHARACTERISTIC KeAP_cm_HookDistOffset "Length of Permanant Hook attached at back side of Ego" VALUE 0x0000 /* @ECU_Address@KeAP_cm_HookDistOffset@ */ Scalar_SWORD 0 DT24_CVADAS_AP_CodGen_CM_int16_cm -32768 32767 /end CHARACTERISTIC
/begin CHARACTERISTIC KeAP_cm_MaxNoObjDetctDist "Max distance when no object detected" VALUE 0x0000 /* @ECU_Address@KeAP_cm_MaxNoObjDetctDist@ */ Scalar_SWORD 0 DT24_CVADAS_AP_CodGen_CM_int16_cm -32768 32767 /end CHARACTERISTIC
/begin CHARACTERISTIC KeAP_cm_NhXmaxOffset "NeighboutHood Window" VALUE 0x0000 /* @ECU_Address@KeAP_cm_NhXmaxOffset@ */ Scalar_SWORD 0 DT24_CVADAS_AP_CodGen_CM_int16_cm -100.0 100.0 /end CHARACTERISTIC
/begin CHARACTERISTIC KeAP_cm_NhXminOffset "NeighboutHood Window" VALUE 0x0000 /* @ECU_Address@KeAP_cm_NhXminOffset@ */ Scalar_SWORD 0 DT24_CVADAS_AP_CodGen_CM_int16_cm -100.0 100.0 /end CHARACTERISTIC
/begin CHARACTERISTIC KeAP_cm_NhYmaxOffset "NeighboutHood Window" VALUE 0x0000 /* @ECU_Address@KeAP_cm_NhYmaxOffset@ */ Scalar_SWORD 0 DT24_CVADAS_AP_CodGen_CM_int16_cm -100.0 100.0 /end CHARACTERISTIC
/begin CHARACTERISTIC KeAP_cm_NhYminOffset "NeighboutHood Window" VALUE 0x0000 /* @ECU_Address@KeAP_cm_NhYminOffset@ */ Scalar_SWORD 0 DT24_CVADAS_AP_CodGen_CM_int16_cm -100.0 100.0 /end CHARACTERISTIC
/begin CHARACTERISTIC KeAP_cm_RearDistArcComp "Warning Zone 6 Dist" VALUE 0x0000 /* @ECU_Address@KeAP_cm_RearDistArcComp@ */ Scalar_SWORD 0 DT24_CVADAS_AP_CodGen_CM_int16_cm 0.0 32767 /end CHARACTERISTIC
/begin CHARACTERISTIC KeAP_cm_RearLongDistAdj "Longitudanl Distance from Rear Axle to Rear edge of vehicle" VALUE 0x0000 /* @ECU_Address@KeAP_cm_RearLongDistAdj@ */ Scalar_SWORD 0 DT24_CVADAS_AP_CodGen_CM_int16_cm -32768 32767 /end CHARACTERISTIC
/begin CHARACTERISTIC KeAP_cm_StndStillObjMinDistThd "" VALUE 0x0000 /* @ECU_Address@KeAP_cm_StndStillObjMinDistThd@ */ Scalar_SWORD 0 DT24_CVADAS_AP_CodGen_CM_int16 -32768 32767 /end CHARACTERISTIC
/begin CHARACTERISTIC KeAP_cm_VIMGhstObjMinDistThd "" VALUE 0x0000 /* @ECU_Address@KeAP_cm_VIMGhstObjMinDistThd@ */ Scalar_SWORD 0 DT24_CVADAS_AP_CodGen_CM_int16 -32768 32767 /end CHARACTERISTIC
/begin CHARACTERISTIC KeAP_cm_VehContourFrntXAdj "X-coordinate for Adjustment for Front side" VALUE 0x0000 /* @ECU_Address@KeAP_cm_VehContourFrntXAdj@ */ Scalar_SWORD 0 DT24_CVADAS_AP_CodGen_CM_int16_cm -32768 32767 /end CHARACTERISTIC
/begin CHARACTERISTIC KeAP_cm_VehContourRearXAdj "X-coordinate for Adjustment for Front side" VALUE 0x0000 /* @ECU_Address@KeAP_cm_VehContourRearXAdj@ */ Scalar_SWORD 0 DT24_CVADAS_AP_CodGen_CM_int16_cm -32768 32767 /end CHARACTERISTIC
/begin CHARACTERISTIC KeAP_cm_VehContour_FIL_x "X-coordinate for FIL Edge" VALUE 0x0000 /* @ECU_Address@KeAP_cm_VehContour_FIL_x@ */ Scalar_SWORD 0 DT24_CVADAS_AP_CodGen_CM_int16_cm -32768 32767 /end CHARACTERISTIC
/begin CHARACTERISTIC KeAP_cm_VehContour_FIL_y "Y-coordinate for FIL Edge" VALUE 0x0000 /* @ECU_Address@KeAP_cm_VehContour_FIL_y@ */ Scalar_SWORD 0 DT24_CVADAS_AP_CodGen_CM_int16_cm -32768 32767 /end CHARACTERISTIC
/begin CHARACTERISTIC KeAP_cm_VehContour_FIR_x "X-coordinate for FIR Edge" VALUE 0x0000 /* @ECU_Address@KeAP_cm_VehContour_FIR_x@ */ Scalar_SWORD 0 DT24_CVADAS_AP_CodGen_CM_int16_cm -32768 32767 /end CHARACTERISTIC
/begin CHARACTERISTIC KeAP_cm_VehContour_FIR_y "Y-coordinate for FIR Edge" VALUE 0x0000 /* @ECU_Address@KeAP_cm_VehContour_FIR_y@ */ Scalar_SWORD 0 DT24_CVADAS_AP_CodGen_CM_int16_cm -32768 32767 /end CHARACTERISTIC
/begin CHARACTERISTIC KeAP_cm_VehContour_FOL_x "X-coordinate for FOL Edge" VALUE 0x0000 /* @ECU_Address@KeAP_cm_VehContour_FOL_x@ */ Scalar_SWORD 0 DT24_CVADAS_AP_CodGen_CM_int16_cm -32768 32767 /end CHARACTERISTIC
/begin CHARACTERISTIC KeAP_cm_VehContour_FOL_y "Y-coordinate for FOL Edge" VALUE 0x0000 /* @ECU_Address@KeAP_cm_VehContour_FOL_y@ */ Scalar_SWORD 0 DT24_CVADAS_AP_CodGen_CM_int16_cm -32768 32767 /end CHARACTERISTIC
/begin CHARACTERISTIC KeAP_cm_VehContour_FOR_x "X-coordinate for FOR Edge" VALUE 0x0000 /* @ECU_Address@KeAP_cm_VehContour_FOR_x@ */ Scalar_SWORD 0 DT24_CVADAS_AP_CodGen_CM_int16_cm -32768 32767 /end CHARACTERISTIC
/begin CHARACTERISTIC KeAP_cm_VehContour_FOR_y "Y-coordinate for FOR Edge" VALUE 0x0000 /* @ECU_Address@KeAP_cm_VehContour_FOR_y@ */ Scalar_SWORD 0 DT24_CVADAS_AP_CodGen_CM_int16_cm -32768 32767 /end CHARACTERISTIC
/begin CHARACTERISTIC KeAP_cm_VehContour_FSL_x "X-coordinate for FSL Edge" VALUE 0x0000 /* @ECU_Address@KeAP_cm_VehContour_FSL_x@ */ Scalar_SWORD 0 DT24_CVADAS_AP_CodGen_CM_int16_cm -32768 32767 /end CHARACTERISTIC
/begin CHARACTERISTIC KeAP_cm_VehContour_FSL_y "Y-coordinate for FSL Edge" VALUE 0x0000 /* @ECU_Address@KeAP_cm_VehContour_FSL_y@ */ Scalar_SWORD 0 DT24_CVADAS_AP_CodGen_CM_int16_cm -32768 32767 /end CHARACTERISTIC
/begin CHARACTERISTIC KeAP_cm_VehContour_FSR_x "X-coordinate for FSR Edge" VALUE 0x0000 /* @ECU_Address@KeAP_cm_VehContour_FSR_x@ */ Scalar_SWORD 0 DT24_CVADAS_AP_CodGen_CM_int16_cm -32768 32767 /end CHARACTERISTIC
/begin CHARACTERISTIC KeAP_cm_VehContour_FSR_y "Y-coordinate for FSR Edge" VALUE 0x0000 /* @ECU_Address@KeAP_cm_VehContour_FSR_y@ */ Scalar_SWORD 0 DT24_CVADAS_AP_CodGen_CM_int16_cm -32768 32767 /end CHARACTERISTIC
/begin CHARACTERISTIC KeAP_cm_VehContour_RIL_x "X-coordinate for RIL Edge" VALUE 0x0000 /* @ECU_Address@KeAP_cm_VehContour_RIL_x@ */ Scalar_SWORD 0 DT24_CVADAS_AP_CodGen_CM_int16_cm -32768 32767 /end CHARACTERISTIC
/begin CHARACTERISTIC KeAP_cm_VehContour_RIL_y "Y-coordinate for RIL Edge" VALUE 0x0000 /* @ECU_Address@KeAP_cm_VehContour_RIL_y@ */ Scalar_SWORD 0 DT24_CVADAS_AP_CodGen_CM_int16_cm -32768 32767 /end CHARACTERISTIC
/begin CHARACTERISTIC KeAP_cm_VehContour_RIR_x "X-coordinate for RIR Edge" VALUE 0x0000 /* @ECU_Address@KeAP_cm_VehContour_RIR_x@ */ Scalar_SWORD 0 DT24_CVADAS_AP_CodGen_CM_int16_cm -32768 32767 /end CHARACTERISTIC
/begin CHARACTERISTIC KeAP_cm_VehContour_RIR_y "Y-coordinate for RIR Edge" VALUE 0x0000 /* @ECU_Address@KeAP_cm_VehContour_RIR_y@ */ Scalar_SWORD 0 DT24_CVADAS_AP_CodGen_CM_int16_cm -32768 32767 /end CHARACTERISTIC
/begin CHARACTERISTIC KeAP_cm_VehContour_ROL_x "X-coordinate for ROL Edge" VALUE 0x0000 /* @ECU_Address@KeAP_cm_VehContour_ROL_x@ */ Scalar_SWORD 0 DT24_CVADAS_AP_CodGen_CM_int16_cm -32768 32767 /end CHARACTERISTIC
/begin CHARACTERISTIC KeAP_cm_VehContour_ROL_y "Y-coordinate for ROL Edge" VALUE 0x0000 /* @ECU_Address@KeAP_cm_VehContour_ROL_y@ */ Scalar_SWORD 0 DT24_CVADAS_AP_CodGen_CM_int16_cm -32768 32767 /end CHARACTERISTIC
/begin CHARACTERISTIC KeAP_cm_VehContour_ROR_x "X-coordinate for ROR Edge" VALUE 0x0000 /* @ECU_Address@KeAP_cm_VehContour_ROR_x@ */ Scalar_SWORD 0 DT24_CVADAS_AP_CodGen_CM_int16_cm -32768 32767 /end CHARACTERISTIC
/begin CHARACTERISTIC KeAP_cm_VehContour_ROR_y "Y-coordinate for ROR Edge" VALUE 0x0000 /* @ECU_Address@KeAP_cm_VehContour_ROR_y@ */ Scalar_SWORD 0 DT24_CVADAS_AP_CodGen_CM_int16_cm -32768 32767 /end CHARACTERISTIC
/begin CHARACTERISTIC KeAP_cm_VehContour_RSL_x "X-coordinate for RSL Edge" VALUE 0x0000 /* @ECU_Address@KeAP_cm_VehContour_RSL_x@ */ Scalar_SWORD 0 DT24_CVADAS_AP_CodGen_CM_int16_cm -32768 32767 /end CHARACTERISTIC
/begin CHARACTERISTIC KeAP_cm_VehContour_RSL_y "Y-coordinate for RSL Edge" VALUE 0x0000 /* @ECU_Address@KeAP_cm_VehContour_RSL_y@ */ Scalar_SWORD 0 DT24_CVADAS_AP_CodGen_CM_int16_cm -32768 32767 /end CHARACTERISTIC
/begin CHARACTERISTIC KeAP_cm_VehContour_RSR_x "X-coordinate for RSR Edge" VALUE 0x0000 /* @ECU_Address@KeAP_cm_VehContour_RSR_x@ */ Scalar_SWORD 0 DT24_CVADAS_AP_CodGen_CM_int16_cm -32768 32767 /end CHARACTERISTIC
/begin CHARACTERISTIC KeAP_cm_VehContour_RSR_y "Y-coordinate for RSR Edge" VALUE 0x0000 /* @ECU_Address@KeAP_cm_VehContour_RSR_y@ */ Scalar_SWORD 0 DT24_CVADAS_AP_CodGen_CM_int16_cm -32768 32767 /end CHARACTERISTIC
/begin CHARACTERISTIC KeAP_cm_WarnOffset "Warn Offset Distance " VALUE 0x0000 /* @ECU_Address@KeAP_cm_WarnOffset@ */ Scalar_SWORD 0 DT24_CVADAS_AP_CodGen_CM_int16_sec -32768 32767 /end CHARACTERISTIC
/begin CHARACTERISTIC KeAP_cnt_DebounceTimeThd "Debounce time threshold" VALUE 0x0000 /* @ECU_Address@KeAP_cnt_DebounceTimeThd@ */ Scalar_SWORD 0 DT24_CVADAS_AP_CodGen_CM_int16_cnt 0.0 32767 /end CHARACTERISTIC
/begin CHARACTERISTIC KePA_cm_FrntWallDetectLatThd "" VALUE 0x0000 /* @ECU_Address@KePA_cm_FrntWallDetectLatThd@ */ Scalar_SWORD 0 DT24_CVADAS_AP_CodGen_CM_int16 0.0 100.0 /end CHARACTERISTIC
/begin CHARACTERISTIC KePA_cm_FrntWallDetectLongThd "" VALUE 0x0000 /* @ECU_Address@KePA_cm_FrntWallDetectLongThd@ */ Scalar_SWORD 0 DT24_CVADAS_AP_CodGen_CM_int16 0.0 100.0 /end CHARACTERISTIC
/begin CHARACTERISTIC KePA_cm_RearWallDetectLatThd "" VALUE 0x0000 /* @ECU_Address@KePA_cm_RearWallDetectLatThd@ */ Scalar_SWORD 0 DT24_CVADAS_AP_CodGen_CM_int16 0.0 100.0 /end CHARACTERISTIC
/begin CHARACTERISTIC KePA_cm_RearWallDetectLongThd "" VALUE 0x0000 /* @ECU_Address@KePA_cm_RearWallDetectLongThd@ */ Scalar_SWORD 0 DT24_CVADAS_AP_CodGen_CM_int16 0.0 100.0 /end CHARACTERISTIC
/begin CHARACTERISTIC CeAP_ms_SampleTime "" VALUE 0x0000 /* @ECU_Address@CeAP_ms_SampleTime@ */ Scalar_UWORD 0 DT24_CVADAS_AP_CodGen_CM_uint16 0.0 65535 /end CHARACTERISTIC
/begin CHARACTERISTIC KeAP_Cnt_GearFiltTimeThd "Gear Filtering time threshold 400ms" VALUE 0x0000 /* @ECU_Address@KeAP_Cnt_GearFiltTimeThd@ */ Scalar_UWORD 0 DT24_CVADAS_AP_CodGen_CM_uint16_ms 0 65535 /end CHARACTERISTIC
/begin CHARACTERISTIC KeAP_Cnt_GearOverrideTimeThd "Gear override time threshold" VALUE 0x0000 /* @ECU_Address@KeAP_Cnt_GearOverrideTimeThd@ */ Scalar_UWORD 0 DT24_CVADAS_AP_CodGen_CM_uint16_ms 0 65535 /end CHARACTERISTIC
/begin CHARACTERISTIC KeAP_cm_ObjPrestFCDistThd "Distance threshold to detect object in Front Centre" VALUE 0x0000 /* @ECU_Address@KeAP_cm_ObjPrestFCDistThd@ */ Scalar_UWORD 0 DT24_CVADAS_AP_CodGen_CM_uint16_cm 0 65535 /end CHARACTERISTIC
/begin CHARACTERISTIC KeAP_cm_ObjPrestRCDistThd "Distance threshold to detect object in Rear Centre" VALUE 0x0000 /* @ECU_Address@KeAP_cm_ObjPrestRCDistThd@ */ Scalar_UWORD 0 DT24_CVADAS_AP_CodGen_CM_uint16_cm 0 65535 /end CHARACTERISTIC
/begin CHARACTERISTIC KeAP_cm_VehicleWidth "Ego Vehicle Car Width" VALUE 0x0000 /* @ECU_Address@KeAP_cm_VehicleWidth@ */ Scalar_UWORD 0 DT24_CVADAS_AP_CodGen_CM_uint16_sec 0 65535 /end CHARACTERISTIC
/begin CHARACTERISTIC KeAP_cnt_ChimeVolChgAlert "Chime Volume Change Alert time threshold - Half sec chime" VALUE 0x0000 /* @ECU_Address@KeAP_cnt_ChimeVolChgAlert@ */ Scalar_UWORD 0 DT24_CVADAS_AP_CodGen_CM_uint16_cnt 0.0 65535 /end CHARACTERISTIC
/begin CHARACTERISTIC KeAP_cnt_ForceNoiseModeTimeThd "" VALUE 0x0000 /* @ECU_Address@KeAP_cnt_ForceNoiseModeTimeThd@ */ Scalar_UWORD 0 DT24_CVADAS_AP_CodGen_CM_uint16 0 65535 /end CHARACTERISTIC
/begin CHARACTERISTIC KeAP_cnt_FrntChimeDisTimeThd "Front Chime Disable time threshold when Vehicle Standstill condition is true " VALUE 0x0000 /* @ECU_Address@KeAP_cnt_FrntChimeDisTimeThd@ */ Scalar_UWORD 0 DT24_CVADAS_AP_CodGen_CM_uint16_cnt 0.0 65535 /end CHARACTERISTIC
/begin CHARACTERISTIC KeAP_cnt_HalfSecChimeAlert "Half Sec Chime Alert Time Threshold" VALUE 0x0000 /* @ECU_Address@KeAP_cnt_HalfSecChimeAlert@ */ Scalar_UWORD 0 DT24_CVADAS_AP_CodGen_CM_uint16_cnt 0.0 65535 /end CHARACTERISTIC
/begin CHARACTERISTIC KeAP_cnt_LEDBlinkTimeThd "Time Step for LED blinking " VALUE 0x0000 /* @ECU_Address@KeAP_cnt_LEDBlinkTimeThd@ */ Scalar_UWORD 0 DT24_CVADAS_AP_CodGen_CM_uint16_cnt 0 65535 /end CHARACTERISTIC
/begin CHARACTERISTIC KeAP_cnt_SPMBlinkLEDDur "PPPA LED Blinking Time Threshold 5 sec" VALUE 0x0000 /* @ECU_Address@KeAP_cnt_SPMBlinkLEDDur@ */ Scalar_UWORD 0 DT24_CVADAS_AP_CodGen_CM_uint16_cm 0 65535 /end CHARACTERISTIC
/begin CHARACTERISTIC KeAP_cnt_SwtStuckTimeThd "Maximum time threshold for Switch to be presssed condition 60sec" VALUE 0x0000 /* @ECU_Address@KeAP_cnt_SwtStuckTimeThd@ */ Scalar_UWORD 0 DT24_CVADAS_AP_CodGen_CM_uint16_sec 0 65535 /end CHARACTERISTIC
/begin CHARACTERISTIC KeAP_cnt_TimeStep "Time Step for Counter " VALUE 0x0000 /* @ECU_Address@KeAP_cnt_TimeStep@ */ Scalar_UWORD 0 DT24_CVADAS_AP_CodGen_CM_uint16_sec 0 65535 /end CHARACTERISTIC
/begin CHARACTERISTIC KeAP_cnt_VehKeyOnTimeThd "Vehicle Key On Time Threshold" VALUE 0x0000 /* @ECU_Address@KeAP_cnt_VehKeyOnTimeThd@ */ Scalar_UWORD 0 DT24_CVADAS_AP_CodGen_CM_uint16_cnt 0.0 65535 /end CHARACTERISTIC
/begin CHARACTERISTIC KeAP_cnt_VehMovementCntThd "" VALUE 0x0000 /* @ECU_Address@KeAP_cnt_VehMovementCntThd@ */ Scalar_UWORD 0 DT24_CVADAS_AP_CodGen_CM_uint16 0 65535 /end CHARACTERISTIC
/begin CHARACTERISTIC KeAP_ms_DbncTimeThsd "" VALUE 0x0000 /* @ECU_Address@KeAP_ms_DbncTimeThsd@ */ Scalar_UWORD 0 DT24_CVADAS_AP_CodGen_CM_uint16_ms 0.0 65535 /end CHARACTERISTIC
/begin CHARACTERISTIC KeAP_s_BSMInterfaceCntTimeout "BSM Interface timeout threshold" VALUE 0x0000 /* @ECU_Address@KeAP_s_BSMInterfaceCntTimeout@ */ Scalar_UWORD 0 DT24_CVADAS_AP_CodGen_CM_uint16_ms 0 65535 /end CHARACTERISTIC
/begin CHARACTERISTIC KeAP_s_BSMInterfaceCntTimeoutTest "BSM Interface timeout threshold" VALUE 0x0000 /* @ECU_Address@KeAP_s_BSMInterfaceCntTimeoutTest@ */ Scalar_UWORD 0 DT24_CVADAS_AP_CodGen_CM_uint16_ms 0 65535 /end CHARACTERISTIC
/begin CHARACTERISTIC KeAP_s_CamHandshakeDur "Cam HMI Interface timeout threshold 100ms" VALUE 0x0000 /* @ECU_Address@KeAP_s_CamHandshakeDur@ */ Scalar_UWORD 0 DT24_CVADAS_AP_CodGen_CM_uint16_ms 0 65535 /end CHARACTERISTIC
/begin CHARACTERISTIC KeAP_s_CamHandshakeDurTest "Cam HMI Interface timeout threshold 100ms" VALUE 0x0000 /* @ECU_Address@KeAP_s_CamHandshakeDurTest@ */ Scalar_UWORD 0 DT24_CVADAS_AP_CodGen_CM_uint16_ms 0 65535 /end CHARACTERISTIC
/begin CHARACTERISTIC KeAP_s_EPSInterfaceCntTimeout "EPS Interface timeout threshold" VALUE 0x0000 /* @ECU_Address@KeAP_s_EPSInterfaceCntTimeout@ */ Scalar_UWORD 0 DT24_CVADAS_AP_CodGen_CM_uint16_ms 0 65535 /end CHARACTERISTIC
/begin CHARACTERISTIC KeAP_s_EPSInterfaceCntTimeoutTest "EPS Interface timeout threshold" VALUE 0x0000 /* @ECU_Address@KeAP_s_EPSInterfaceCntTimeoutTest@ */ Scalar_UWORD 0 DT24_CVADAS_AP_CodGen_CM_uint16_ms 0 65535 /end CHARACTERISTIC
/begin CHARACTERISTIC KeAP_s_GearShiftWaitCntTimeout "Gear Change/Shift request timeout threshold" VALUE 0x0000 /* @ECU_Address@KeAP_s_GearShiftWaitCntTimeout@ */ Scalar_UWORD 0 DT24_CVADAS_AP_CodGen_CM_uint16_ms 0 65535 /end CHARACTERISTIC
/begin CHARACTERISTIC KeAP_s_MaxStandstillTimeThd "Maximum time threshold for vehicle to be in stand still position" VALUE 0x0000 /* @ECU_Address@KeAP_s_MaxStandstillTimeThd@ */ Scalar_UWORD 0 DT24_CVADAS_AP_CodGen_CM_uint16_sec 0.0 65535.0 /end CHARACTERISTIC
/begin CHARACTERISTIC KeAP_s_ObjInPathTimeoutDur "EPS Interface timeout threshold" VALUE 0x0000 /* @ECU_Address@KeAP_s_ObjInPathTimeoutDur@ */ Scalar_UWORD 0 DT24_CVADAS_AP_CodGen_CM_uint16_ms 0 65535 /end CHARACTERISTIC
/begin CHARACTERISTIC KeAP_s_PausedPressBtnTimeoutDur "EPS Interface timeout threshold" VALUE 0x0000 /* @ECU_Address@KeAP_s_PausedPressBtnTimeoutDur@ */ Scalar_UWORD 0 DT24_CVADAS_AP_CodGen_CM_uint16_ms 0 65535 /end CHARACTERISTIC
/begin CHARACTERISTIC KeAP_b_AutoParkEn "Ego vehicle shall be equipped with Auto Park Assist feature" VALUE 0x0000 /* @ECU_Address@KeAP_b_AutoParkEn@ */ Scalar_BOOLEAN 0 DT24_CVADAS_AP_CodGen_CM_boolean 0.0 1.0 /end CHARACTERISTIC
/begin CHARACTERISTIC KeAP_b_CruisAgeBasedGhsObjDet "" VALUE 0x0000 /* @ECU_Address@KeAP_b_CruisAgeBasedGhsObjDet@ */ Scalar_BOOLEAN 0 DT24_CVADAS_AP_CodGen_CM_boolean 0 1 /end CHARACTERISTIC
/begin CHARACTERISTIC KeAP_b_DbncEnabld "" VALUE 0x0000 /* @ECU_Address@KeAP_b_DbncEnabld@ */ Scalar_BOOLEAN 0 DT24_CVADAS_AP_CodGen_CM_boolean 0.0 1 /end CHARACTERISTIC
/begin CHARACTERISTIC KeAP_b_DensityBasedGhstObjDet "" VALUE 0x0000 /* @ECU_Address@KeAP_b_DensityBasedGhstObjDet@ */ Scalar_BOOLEAN 0 DT24_CVADAS_AP_CodGen_CM_boolean 0 1 /end CHARACTERISTIC
/begin CHARACTERISTIC KeAP_b_DevlopmentTest "Test Parameter used to change value of Tunable parameter while Testing" VALUE 0x0000 /* @ECU_Address@KeAP_b_DevlopmentTest@ */ Scalar_BOOLEAN 0 DT24_CVADAS_AP_CodGen_CM_boolean 0 1 /end CHARACTERISTIC
/begin CHARACTERISTIC KeAP_b_EnFeatForceNoiseMode "" VALUE 0x0000 /* @ECU_Address@KeAP_b_EnFeatForceNoiseMode@ */ Scalar_BOOLEAN 0 DT24_CVADAS_AP_CodGen_CM_boolean 0 1 /end CHARACTERISTIC
/begin CHARACTERISTIC KeAP_b_FPAEn "Ego vehicle shall be equipped with Front Park Assist feature" VALUE 0x0000 /* @ECU_Address@KeAP_b_FPAEn@ */ Scalar_BOOLEAN 0 DT24_CVADAS_AP_CodGen_CM_boolean 0.0 1.0 /end CHARACTERISTIC
/begin CHARACTERISTIC KeAP_b_ForceEnArcTrack "" VALUE 0x0000 /* @ECU_Address@KeAP_b_ForceEnArcTrack@ */ Scalar_BOOLEAN 0 DT24_CVADAS_AP_CodGen_CM_boolean 0.0 1.0 /end CHARACTERISTIC
/begin CHARACTERISTIC KeAP_b_FullAutoPark "Ego vehicle shall be equipped with Fully Auto Park Assist feature" VALUE 0x0000 /* @ECU_Address@KeAP_b_FullAutoPark@ */ Scalar_BOOLEAN 0 DT24_CVADAS_AP_CodGen_CM_boolean 0.0 1.0 /end CHARACTERISTIC
/begin CHARACTERISTIC KeAP_b_HeightFlagEnabled "" VALUE 0x0000 /* @ECU_Address@KeAP_b_HeightFlagEnabled@ */ Scalar_BOOLEAN 0 DT24_CVADAS_AP_CodGen_CM_boolean 0 1 /end CHARACTERISTIC
/begin CHARACTERISTIC KeAP_b_HookConnected "Hook Connected 0= Not Connected 1=Connected" VALUE 0x0000 /* @ECU_Address@KeAP_b_HookConnected@ */ Scalar_BOOLEAN 0 DT24_CVADAS_AP_CodGen_CM_boolean 0 1 /end CHARACTERISTIC
/begin CHARACTERISTIC KeAP_b_RPAwithBrk "Ego vehicle shall be equipped with Rear Park Assist with Brake" VALUE 0x0000 /* @ECU_Address@KeAP_b_RPAwithBrk@ */ Scalar_BOOLEAN 0 DT24_CVADAS_AP_CodGen_CM_boolean 0.0 1.0 /end CHARACTERISTIC
/begin CHARACTERISTIC KeAP_b_RPAwithSurroundView "Ego vehicle shall be equipped with Rear Park Assist with Brake and Surround View Interaction" VALUE 0x0000 /* @ECU_Address@KeAP_b_RPAwithSurroundView@ */ Scalar_BOOLEAN 0 DT24_CVADAS_AP_CodGen_CM_boolean 0.0 1.0 /end CHARACTERISTIC
/begin CHARACTERISTIC KeAP_b_SteerOnlyAutoPark "Ego vehicle shall be equipped with Steer only Auto Park Assist feature" VALUE 0x0000 /* @ECU_Address@KeAP_b_SteerOnlyAutoPark@ */ Scalar_BOOLEAN 0 DT24_CVADAS_AP_CodGen_CM_boolean 0.0 1.0 /end CHARACTERISTIC
/begin CHARACTERISTIC KeAP_b_SuppArcInNoForceNoise "" VALUE 0x0000 /* @ECU_Address@KeAP_b_SuppArcInNoForceNoise@ */ Scalar_BOOLEAN 0 DT24_CVADAS_AP_CodGen_CM_boolean 0 1 /end CHARACTERISTIC
/begin CHARACTERISTIC KeCMbB_b_EnblOncObjDbnc "" VALUE 0x0000 /* @ECU_Address@KeCMbB_b_EnblOncObjDbnc@ */ Scalar_BOOLEAN 0 DT24_CVADAS_AP_CodGen_CM_boolean 0 1 /end CHARACTERISTIC
/begin CHARACTERISTIC KePA_b_EnbAppBlckg "" VALUE 0x0000 /* @ECU_Address@KePA_b_EnbAppBlckg@ */ Scalar_BOOLEAN 0 DT24_CVADAS_AP_CodGen_CM_boolean 0 1 /end CHARACTERISTIC
/begin CHARACTERISTIC KeAP_b_FeatDetectWall "" VALUE 0x0000 /* @ECU_Address@KeAP_b_FeatDetectWall@ */ Scalar_UBYTE 0 DT24_CVADAS_AP_CodGen_CM_uint8 0.0 1.0 /end CHARACTERISTIC
/begin CHARACTERISTIC KeAP_cnt_CruisAgeBasedDbncCount "" VALUE 0x0000 /* @ECU_Address@KeAP_cnt_CruisAgeBasedDbncCount@ */ Scalar_UBYTE 0 DT24_CVADAS_AP_CodGen_CM_uint8 0 255 /end CHARACTERISTIC
/begin CHARACTERISTIC KeAP_cnt_DensStdStlHighPntConfThd "" VALUE 0x0000 /* @ECU_Address@KeAP_cnt_DensStdStlHighPntConfThd@ */ Scalar_UBYTE 0 DT24_CVADAS_AP_CodGen_CM_uint8 0 255 /end CHARACTERISTIC
/begin CHARACTERISTIC KeAP_cnt_DensStdStlLowPntConfThd "" VALUE 0x0000 /* @ECU_Address@KeAP_cnt_DensStdStlLowPntConfThd@ */ Scalar_UBYTE 0 DT24_CVADAS_AP_CodGen_CM_uint8 0 255 /end CHARACTERISTIC
/begin CHARACTERISTIC KeAP_cnt_DensStdStlObjCruiseAgeThd "" VALUE 0x0000 /* @ECU_Address@KeAP_cnt_DensStdStlObjCruiseAgeThd@ */ Scalar_UBYTE 0 DT24_CVADAS_AP_CodGen_CM_uint8 0 255 /end CHARACTERISTIC
/begin CHARACTERISTIC KeAP_cnt_DensVIMHighPntConfThd "" VALUE 0x0000 /* @ECU_Address@KeAP_cnt_DensVIMHighPntConfThd@ */ Scalar_UBYTE 0 DT24_CVADAS_AP_CodGen_CM_uint8 0 255 /end CHARACTERISTIC
/begin CHARACTERISTIC KeAP_cnt_DensVIMLowPntConfThd "" VALUE 0x0000 /* @ECU_Address@KeAP_cnt_DensVIMLowPntConfThd@ */ Scalar_UBYTE 0 DT24_CVADAS_AP_CodGen_CM_uint8 0 255 /end CHARACTERISTIC
/begin CHARACTERISTIC KeAP_cnt_DensVIMObjCruiseAgeThd "" VALUE 0x0000 /* @ECU_Address@KeAP_cnt_DensVIMObjCruiseAgeThd@ */ Scalar_UBYTE 0 DT24_CVADAS_AP_CodGen_CM_uint8 0 255 /end CHARACTERISTIC
/begin CHARACTERISTIC KeAP_cnt_StndStSideCruiseAgeThd "" VALUE 0x0000 /* @ECU_Address@KeAP_cnt_StndStSideCruiseAgeThd@ */ Scalar_UBYTE 0 DT24_CVADAS_AP_CodGen_CM_uint8 0 255 /end CHARACTERISTIC
/begin CHARACTERISTIC KeAP_cnt_StndStSideLowCruiseAgeThd "" VALUE 0x0000 /* @ECU_Address@KeAP_cnt_StndStSideLowCruiseAgeThd@ */ Scalar_UBYTE 0 DT24_CVADAS_AP_CodGen_CM_uint8 0 255 /end CHARACTERISTIC
/begin CHARACTERISTIC KeAP_cnt_StndStillCruiseAgeThd "" VALUE 0x0000 /* @ECU_Address@KeAP_cnt_StndStillCruiseAgeThd@ */ Scalar_UBYTE 0 DT24_CVADAS_AP_CodGen_CM_uint8 0 255 /end CHARACTERISTIC
/begin CHARACTERISTIC KeAP_cnt_StndStillPntConfThd "" VALUE 0x0000 /* @ECU_Address@KeAP_cnt_StndStillPntConfThd@ */ Scalar_UBYTE 0 DT24_CVADAS_AP_CodGen_CM_uint8 0 255 /end CHARACTERISTIC
/begin CHARACTERISTIC KeAP_cnt_StndStillSideLowPntConfThd "" VALUE 0x0000 /* @ECU_Address@KeAP_cnt_StndStillSideLowPntConfThd@ */ Scalar_UBYTE 0 DT24_CVADAS_AP_CodGen_CM_uint8 0 255 /end CHARACTERISTIC
/begin CHARACTERISTIC KeAP_cnt_StndStillSidePntConfThd "" VALUE 0x0000 /* @ECU_Address@KeAP_cnt_StndStillSidePntConfThd@ */ Scalar_UBYTE 0 DT24_CVADAS_AP_CodGen_CM_uint8 0 255 /end CHARACTERISTIC
/begin CHARACTERISTIC KeAP_cnt_VIMGhstObjCruiseAgeThd "" VALUE 0x0000 /* @ECU_Address@KeAP_cnt_VIMGhstObjCruiseAgeThd@ */ Scalar_UBYTE 0 DT24_CVADAS_AP_CodGen_CM_uint8 0 255 /end CHARACTERISTIC
/begin CHARACTERISTIC KeAP_cnt_VIMGhstObjPntConfThd "" VALUE 0x0000 /* @ECU_Address@KeAP_cnt_VIMGhstObjPntConfThd@ */ Scalar_UBYTE 0 DT24_CVADAS_AP_CodGen_CM_uint8 0 255 /end CHARACTERISTIC
/begin CHARACTERISTIC KeAP_cnt_VIMSideLowPntConfThd "" VALUE 0x0000 /* @ECU_Address@KeAP_cnt_VIMSideLowPntConfThd@ */ Scalar_UBYTE 0 DT24_CVADAS_AP_CodGen_CM_uint8 0 255 /end CHARACTERISTIC
/begin CHARACTERISTIC KeAP_cnt_VIMSideObjCruiseAgeThd "" VALUE 0x0000 /* @ECU_Address@KeAP_cnt_VIMSideObjCruiseAgeThd@ */ Scalar_UBYTE 0 DT24_CVADAS_AP_CodGen_CM_uint8 0 255 /end CHARACTERISTIC
/begin CHARACTERISTIC KeAP_cnt_VIMSideObjLowCruiseAgeThd "" VALUE 0x0000 /* @ECU_Address@KeAP_cnt_VIMSideObjLowCruiseAgeThd@ */ Scalar_UBYTE 0 DT24_CVADAS_AP_CodGen_CM_uint8 0 255 /end CHARACTERISTIC
/begin CHARACTERISTIC KeAP_cnt_VIMSidePntConfThd "" VALUE 0x0000 /* @ECU_Address@KeAP_cnt_VIMSidePntConfThd@ */ Scalar_UBYTE 0 DT24_CVADAS_AP_CodGen_CM_uint8 0 255 /end CHARACTERISTIC
/begin CHARACTERISTIC KeAP_e_GbTypAT "ATX Gear_Box_Type" VALUE 0x0000 /* @ECU_Address@KeAP_e_GbTypAT@ */ Scalar_UBYTE 0 DT24_CVADAS_AP_CodGen_CM_uint8 0 255 /end CHARACTERISTIC
/begin CHARACTERISTIC KeAP_pct_ObjConfidenceThd "Detected Object Confidence threshold" VALUE 0x0000 /* @ECU_Address@KeAP_pct_ObjConfidenceThd@ */ Scalar_UBYTE 0 DT24_CVADAS_AP_CodGen_CM_uint8_pct 0 255 /end CHARACTERISTIC
/begin CHARACTERISTIC KeAP_pct_SpdBasedObjConfThd "" VAL_BLK 0x0000 /* @ECU_Address@KeAP_pct_SpdBasedObjConfThd@ */ Scalar_UBYTE 0 DT24_CVADAS_AP_CodGen_CM_uint8_pct 0.0 100.0 NUMBER 2 /end CHARACTERISTIC
/begin CHARACTERISTIC KeHMI_e_ParkStyleTest "Tunable parameter to change value of Park Style input while Testing 0=None, 1=Rear_In, 2=Front_In" VALUE 0x0000 /* @ECU_Address@KeHMI_e_ParkStyleTest@ */ Scalar_UBYTE 0 DT24_CVADAS_AP_CodGen_CM_uint8 0 255 /end CHARACTERISTIC
/begin CHARACTERISTIC KePA_b_EnFeatPointSplitImp "Enable NeighboutHood Window" VALUE 0x0000 /* @ECU_Address@KePA_b_EnFeatPointSplitImp@ */ Scalar_UBYTE 0 DT24_CVADAS_AP_CodGen_CM_uint8 0.0 1.0 /end CHARACTERISTIC
/begin CHARACTERISTIC Reverse_Gr_num "Reverse Gear Number" VALUE 0x0000 /* @ECU_Address@Reverse_Gr_num@ */ Scalar_UBYTE 0 DT24_CVADAS_AP_CodGen_CM_uint8 0 255 /end CHARACTERISTIC
/begin MEASUREMENT IbAP_InputVrntTunParam.KeAP_degC_OperatingTempThd "" FLOAT32_IEEE DT24_CVADAS_AP_CodGen_CM_single 0 0 -3.4E+38 3.4E+38 ECU_ADDRESS 0x0000 /* @ECU_Address@IbAP_InputVrntTunParam.KeAP_degC_OperatingTempThd@ */ /end MEASUREMENT
/begin MEASUREMENT IbAP_InputVrntTunParam.KeAP_kph_EnblHysThd "" FLOAT32_IEEE DT24_CVADAS_AP_CodGen_CM_single 0 0 -3.4E+38 3.4E+38 ECU_ADDRESS 0x0000 /* @ECU_Address@IbAP_InputVrntTunParam.KeAP_kph_EnblHysThd@ */ /end MEASUREMENT
/begin MEASUREMENT IbAP_InputVrntTunParam.KeAP_kph_FrntWarnMaxSpdThd "" FLOAT32_IEEE DT24_CVADAS_AP_CodGen_CM_single 0 0 -3.4E+38 3.4E+38 ECU_ADDRESS 0x0000 /* @ECU_Address@IbAP_InputVrntTunParam.KeAP_kph_FrntWarnMaxSpdThd@ */ /end MEASUREMENT
/begin MEASUREMENT IbAP_InputVrntTunParam.KeAP_kph_ParkMnvThd "" FLOAT32_IEEE DT24_CVADAS_AP_CodGen_CM_single 0 0 -3.4E+38 3.4E+38 ECU_ADDRESS 0x0000 /* @ECU_Address@IbAP_InputVrntTunParam.KeAP_kph_ParkMnvThd@ */ /end MEASUREMENT
/begin MEASUREMENT IbAP_InputVrntTunParam.KeAP_kph_PSDOffThd "" FLOAT32_IEEE DT24_CVADAS_AP_CodGen_CM_single 0 0 -3.4E+38 3.4E+38 ECU_ADDRESS 0x0000 /* @ECU_Address@IbAP_InputVrntTunParam.KeAP_kph_PSDOffThd@ */ /end MEASUREMENT
/begin MEASUREMENT IbAP_InputVrntTunParam.KeAP_kph_PSDOnThd "" FLOAT32_IEEE DT24_CVADAS_AP_CodGen_CM_single 0 0 -3.4E+38 3.4E+38 ECU_ADDRESS 0x0000 /* @ECU_Address@IbAP_InputVrntTunParam.KeAP_kph_PSDOnThd@ */ /end MEASUREMENT
/begin MEASUREMENT IbAP_InputVrntTunParam.KeAP_kph_RearWarnMaxSpdThd "" FLOAT32_IEEE DT24_CVADAS_AP_CodGen_CM_single 0 0 -3.4E+38 3.4E+38 ECU_ADDRESS 0x0000 /* @ECU_Address@IbAP_InputVrntTunParam.KeAP_kph_RearWarnMaxSpdThd@ */ /end MEASUREMENT
/begin MEASUREMENT IbAP_InputVrntTunParam.KeAP_kph_USSActiveSpdThd "" FLOAT32_IEEE DT24_CVADAS_AP_CodGen_CM_single 0 0 -3.4E+38 3.4E+38 ECU_ADDRESS 0x0000 /* @ECU_Address@IbAP_InputVrntTunParam.KeAP_kph_USSActiveSpdThd@ */ /end MEASUREMENT
/begin MEASUREMENT IbAP_InputVrntTunParam.K_e_RAEB_VehicleWidth "" FLOAT32_IEEE DT24_CVADAS_AP_CodGen_CM_single 0 0 -3.4E+38 3.4E+38 ECU_ADDRESS 0x0000 /* @ECU_Address@IbAP_InputVrntTunParam.K_e_RAEB_VehicleWidth@ */ /end MEASUREMENT
/begin MEASUREMENT IbAP_InputVrntTunParam.K_Overlap_Thrsld_RAEB "" FLOAT32_IEEE DT24_CVADAS_AP_CodGen_CM_single 0 0 -3.4E+38 3.4E+38 ARRAY_SIZE 5 ECU_ADDRESS 0x0000 /* @ECU_Address@IbAP_InputVrntTunParam.K_Overlap_Thrsld_RAEB@ */ /end MEASUREMENT
/begin MEASUREMENT IbAP_InputVrntTunParam.KeTOS_s_InTurnDbncTm "" FLOAT32_IEEE DT24_CVADAS_AP_CodGen_CM_single 0 0 -3.4E+38 3.4E+38 ECU_ADDRESS 0x0000 /* @ECU_Address@IbAP_InputVrntTunParam.KeTOS_s_InTurnDbncTm@ */ /end MEASUREMENT
/begin MEASUREMENT IbAP_InputVrntTunParam.KeTOS_s_StrDrvDbncTm "" FLOAT32_IEEE DT24_CVADAS_AP_CodGen_CM_single 0 0 -3.4E+38 3.4E+38 ECU_ADDRESS 0x0000 /* @ECU_Address@IbAP_InputVrntTunParam.KeTOS_s_StrDrvDbncTm@ */ /end MEASUREMENT
/begin MEASUREMENT IbAP_InputVrntTunParam.KeTOS_s_TurnExitDbncTm "" FLOAT32_IEEE DT24_CVADAS_AP_CodGen_CM_single 0 0 -3.4E+38 3.4E+38 ECU_ADDRESS 0x0000 /* @ECU_Address@IbAP_InputVrntTunParam.KeTOS_s_TurnExitDbncTm@ */ /end MEASUREMENT
/begin MEASUREMENT IbAP_InputVrntTunParam.KeTOS_x_InTurnThd "" FLOAT32_IEEE DT24_CVADAS_AP_CodGen_CM_single 0 0 -3.4E+38 3.4E+38 ECU_ADDRESS 0x0000 /* @ECU_Address@IbAP_InputVrntTunParam.KeTOS_x_InTurnThd@ */ /end MEASUREMENT
/begin MEASUREMENT IbAP_InputVrntTunParam.KeTOS_x_TurnExitThd "" FLOAT32_IEEE DT24_CVADAS_AP_CodGen_CM_single 0 0 -3.4E+38 3.4E+38 ECU_ADDRESS 0x0000 /* @ECU_Address@IbAP_InputVrntTunParam.KeTOS_x_TurnExitThd@ */ /end MEASUREMENT
/begin MEASUREMENT IbAP_InputVrntTunParam.keVehParam_m_DistWhlBse "" FLOAT32_IEEE DT24_CVADAS_AP_CodGen_CM_single 0 0 -3.4E+38 3.4E+38 ECU_ADDRESS 0x0000 /* @ECU_Address@IbAP_InputVrntTunParam.keVehParam_m_DistWhlBse@ */ /end MEASUREMENT
/begin MEASUREMENT IbAP_InputVrntTunParam.Obj_DistTable "" FLOAT32_IEEE DT24_CVADAS_AP_CodGen_CM_single 0 0 -3.4E+38 3.4E+38 ARRAY_SIZE 5 ECU_ADDRESS 0x0000 /* @ECU_Address@IbAP_InputVrntTunParam.Obj_DistTable@ */ /end MEASUREMENT
/begin MEASUREMENT IbAP_InputVrntTunParam.Overlap_Thrsld_Switch "" FLOAT32_IEEE DT24_CVADAS_AP_CodGen_CM_single 0 0 -3.4E+38 3.4E+38 ECU_ADDRESS 0x0000 /* @ECU_Address@IbAP_InputVrntTunParam.Overlap_Thrsld_Switch@ */ /end MEASUREMENT
/begin MEASUREMENT IbAP_InputVrntTunParam.RAEB_Envelope_Offset "" FLOAT32_IEEE DT24_CVADAS_AP_CodGen_CM_single 0 0 -3.4E+38 3.4E+38 ECU_ADDRESS 0x0000 /* @ECU_Address@IbAP_InputVrntTunParam.RAEB_Envelope_Offset@ */ /end MEASUREMENT
/begin MEASUREMENT IbAP_InputVrntTunParam.RAEB_Lateral_Distance_Notification "" FLOAT32_IEEE DT24_CVADAS_AP_CodGen_CM_single 0 0 -3.4E+38 3.4E+38 ECU_ADDRESS 0x0000 /* @ECU_Address@IbAP_InputVrntTunParam.RAEB_Lateral_Distance_Notification@ */ /end MEASUREMENT
/begin MEASUREMENT IbAP_InputVrntTunParam.RAEB_Minimum_Object_Heigh "" FLOAT32_IEEE DT24_CVADAS_AP_CodGen_CM_single 0 0 -3.4E+38 3.4E+38 ECU_ADDRESS 0x0000 /* @ECU_Address@IbAP_InputVrntTunParam.RAEB_Minimum_Object_Heigh@ */ /end MEASUREMENT
/begin MEASUREMENT IbAP_InputVrntTunParam.sampling_time "" FLOAT32_IEEE DT24_CVADAS_AP_CodGen_CM_single 0 0 -3.4E+38 3.4E+38 ECU_ADDRESS 0x0000 /* @ECU_Address@IbAP_InputVrntTunParam.sampling_time@ */ /end MEASUREMENT
/begin MEASUREMENT IbAP_InputVrntTunParam.keVehParam_e_VehSteerRatioTable "" FLOAT32_IEEE DT24_CVADAS_AP_CodGen_CM_single 0 0 -3.4E+38 3.4E+38 ARRAY_SIZE 19 ECU_ADDRESS 0x0000 /* @ECU_Address@IbAP_InputVrntTunParam.keVehParam_e_VehSteerRatioTable@ */ /end MEASUREMENT
/begin MEASUREMENT IbAP_InputVrntTunParam.keVehParam_e_StrWhlRatioBrkPnts "" FLOAT32_IEEE DT24_CVADAS_AP_CodGen_CM_single 0 0 -3.4E+38 3.4E+38 ARRAY_SIZE 19 ECU_ADDRESS 0x0000 /* @ECU_Address@IbAP_InputVrntTunParam.keVehParam_e_StrWhlRatioBrkPnts@ */ /end MEASUREMENT
/begin MEASUREMENT IbAP_InputVrntTunParam.keInpAdptr_e_StWhOffset "" FLOAT32_IEEE DT24_CVADAS_AP_CodGen_CM_single 0 0 -3.4E+38 3.4E+38 ECU_ADDRESS 0x0000 /* @ECU_Address@IbAP_InputVrntTunParam.keInpAdptr_e_StWhOffset@ */ /end MEASUREMENT
/begin MEASUREMENT IbAP_InputVrntTunParam.Straight_Driving_Thresold_rads2 "" FLOAT32_IEEE DT24_CVADAS_AP_CodGen_CM_single 0 0 -3.4E+38 3.4E+38 ECU_ADDRESS 0x0000 /* @ECU_Address@IbAP_InputVrntTunParam.Straight_Driving_Thresold_rads2@ */ /end MEASUREMENT
/begin MEASUREMENT IbAP_InputVrntTunParam.Steering_Angle_DeadZone_Start "" FLOAT32_IEEE DT24_CVADAS_AP_CodGen_CM_single 0 0 -3.4E+38 3.4E+38 ECU_ADDRESS 0x0000 /* @ECU_Address@IbAP_InputVrntTunParam.Steering_Angle_DeadZone_Start@ */ /end MEASUREMENT
/begin MEASUREMENT IbAP_InputVrntTunParam.Steering_Angle_DeadZone_End "" FLOAT32_IEEE DT24_CVADAS_AP_CodGen_CM_single 0 0 -3.4E+38 3.4E+38 ECU_ADDRESS 0x0000 /* @ECU_Address@IbAP_InputVrntTunParam.Steering_Angle_DeadZone_End@ */ /end MEASUREMENT
/begin MEASUREMENT IbAP_InputVrntTunParam.KeAP_k_PathSepaMinSpd "" FLOAT32_IEEE DT24_CVADAS_AP_CodGen_CM_single 0 0 -3.4E+38 3.4E+38 ECU_ADDRESS 0x0000 /* @ECU_Address@IbAP_InputVrntTunParam.KeAP_k_PathSepaMinSpd@ */ /end MEASUREMENT
/begin MEASUREMENT IbAP_InputVrntTunParam.KeAP_k_PathSepaSpdRampGrd "" FLOAT32_IEEE DT24_CVADAS_AP_CodGen_CM_single 0 0 -3.4E+38 3.4E+38 ECU_ADDRESS 0x0000 /* @ECU_Address@IbAP_InputVrntTunParam.KeAP_k_PathSepaSpdRampGrd@ */ /end MEASUREMENT
/begin MEASUREMENT IbAP_InputVrntTunParam.KeAP_k_DetWP_PreviewTime "" FLOAT32_IEEE DT24_CVADAS_AP_CodGen_CM_single 0 0 -3.4E+38 3.4E+38 ECU_ADDRESS 0x0000 /* @ECU_Address@IbAP_InputVrntTunParam.KeAP_k_DetWP_PreviewTime@ */ /end MEASUREMENT
/begin MEASUREMENT IbAP_InputVrntTunParam.KeAP_k_LatPathDevPGain "" FLOAT32_IEEE DT24_CVADAS_AP_CodGen_CM_single 0 0 -3.4E+38 3.4E+38 ECU_ADDRESS 0x0000 /* @ECU_Address@IbAP_InputVrntTunParam.KeAP_k_LatPathDevPGain@ */ /end MEASUREMENT
/begin MEASUREMENT IbAP_InputVrntTunParam.KeAP_k_LatPathDevIGain "" FLOAT32_IEEE DT24_CVADAS_AP_CodGen_CM_single 0 0 -3.4E+38 3.4E+38 ECU_ADDRESS 0x0000 /* @ECU_Address@IbAP_InputVrntTunParam.KeAP_k_LatPathDevIGain@ */ /end MEASUREMENT
/begin MEASUREMENT IbAP_InputVrntTunParam.KeAP_k_LatPathDevDGain "" FLOAT32_IEEE DT24_CVADAS_AP_CodGen_CM_single 0 0 -3.4E+38 3.4E+38 ECU_ADDRESS 0x0000 /* @ECU_Address@IbAP_InputVrntTunParam.KeAP_k_LatPathDevDGain@ */ /end MEASUREMENT
/begin MEASUREMENT IbAP_InputVrntTunParam.KeAP_k_LatHeadDevPGain "" FLOAT32_IEEE DT24_CVADAS_AP_CodGen_CM_single 0 0 -3.4E+38 3.4E+38 ECU_ADDRESS 0x0000 /* @ECU_Address@IbAP_InputVrntTunParam.KeAP_k_LatHeadDevPGain@ */ /end MEASUREMENT
/begin MEASUREMENT IbAP_InputVrntTunParam.KeAP_k_LatHeadDevIGain "" FLOAT32_IEEE DT24_CVADAS_AP_CodGen_CM_single 0 0 -3.4E+38 3.4E+38 ECU_ADDRESS 0x0000 /* @ECU_Address@IbAP_InputVrntTunParam.KeAP_k_LatHeadDevIGain@ */ /end MEASUREMENT
/begin MEASUREMENT IbAP_InputVrntTunParam.KeAP_k_LatHeadDevDGain "" FLOAT32_IEEE DT24_CVADAS_AP_CodGen_CM_single 0 0 -3.4E+38 3.4E+38 ECU_ADDRESS 0x0000 /* @ECU_Address@IbAP_InputVrntTunParam.KeAP_k_LatHeadDevDGain@ */ /end MEASUREMENT
/begin MEASUREMENT IbAP_InputVrntTunParam.KeAP_k_SteerUpperLimit "" FLOAT32_IEEE DT24_CVADAS_AP_CodGen_CM_single 0 0 -3.4E+38 3.4E+38 ECU_ADDRESS 0x0000 /* @ECU_Address@IbAP_InputVrntTunParam.KeAP_k_SteerUpperLimit@ */ /end MEASUREMENT
/begin MEASUREMENT IbAP_InputVrntTunParam.KeAP_k_SteerLowerLimit "" FLOAT32_IEEE DT24_CVADAS_AP_CodGen_CM_single 0 0 -3.4E+38 3.4E+38 ECU_ADDRESS 0x0000 /* @ECU_Address@IbAP_InputVrntTunParam.KeAP_k_SteerLowerLimit@ */ /end MEASUREMENT
/begin MEASUREMENT IbAP_InputVrntTunParam.KeAP_k_CtrlOutCollDetActivate "" FLOAT32_IEEE DT24_CVADAS_AP_CodGen_CM_single 0 0 -3.4E+38 3.4E+38 ECU_ADDRESS 0x0000 /* @ECU_Address@IbAP_InputVrntTunParam.KeAP_k_CtrlOutCollDetActivate@ */ /end MEASUREMENT
/begin MEASUREMENT IbAP_InputVrntTunParam.KeAP_k_CtrlOutRemainDistNA "" FLOAT32_IEEE DT24_CVADAS_AP_CodGen_CM_single 0 0 -3.4E+38 3.4E+38 ECU_ADDRESS 0x0000 /* @ECU_Address@IbAP_InputVrntTunParam.KeAP_k_CtrlOutRemainDistNA@ */ /end MEASUREMENT
/begin MEASUREMENT IbAP_InputVrntTunParam.KeAP_k_CtrlOutCollDetCollDistLimit "" FLOAT32_IEEE DT24_CVADAS_AP_CodGen_CM_single 0 0 -3.4E+38 3.4E+38 ECU_ADDRESS 0x0000 /* @ECU_Address@IbAP_InputVrntTunParam.KeAP_k_CtrlOutCollDetCollDistLimit@ */ /end MEASUREMENT
/begin MEASUREMENT IbAP_InputVrntTunParam.KeAP_k_CtrlOutCollDetRedStopVal "" FLOAT32_IEEE DT24_CVADAS_AP_CodGen_CM_single 0 0 -3.4E+38 3.4E+38 ECU_ADDRESS 0x0000 /* @ECU_Address@IbAP_InputVrntTunParam.KeAP_k_CtrlOutCollDetRedStopVal@ */ /end MEASUREMENT
/begin MEASUREMENT IbAP_InputVrntTunParam.KeAP_k_CtrlOutVehSpdMaxSpotStrTime "" FLOAT32_IEEE DT24_CVADAS_AP_CodGen_CM_single 0 0 -3.4E+38 3.4E+38 ECU_ADDRESS 0x0000 /* @ECU_Address@IbAP_InputVrntTunParam.KeAP_k_CtrlOutVehSpdMaxSpotStrTime@ */ /end MEASUREMENT
/begin MEASUREMENT IbAP_InputVrntTunParam.KeAP_k_CtrlOutVehSpdMaxSpotStrRackDevThd "" FLOAT32_IEEE DT24_CVADAS_AP_CodGen_CM_single 0 0 -3.4E+38 3.4E+38 ECU_ADDRESS 0x0000 /* @ECU_Address@IbAP_InputVrntTunParam.KeAP_k_CtrlOutVehSpdMaxSpotStrRackDevThd@ */ /end MEASUREMENT
/begin MEASUREMENT IbAP_InputVrntTunParam.KeAP_k_CtrlOutVehSpdMaxSpotSteer "" FLOAT32_IEEE DT24_CVADAS_AP_CodGen_CM_single 0 0 -3.4E+38 3.4E+38 ECU_ADDRESS 0x0000 /* @ECU_Address@IbAP_InputVrntTunParam.KeAP_k_CtrlOutVehSpdMaxSpotSteer@ */ /end MEASUREMENT
/begin MEASUREMENT IbAP_InputVrntTunParam.KeAP_k_BrakePGain "" FLOAT32_IEEE DT24_CVADAS_AP_CodGen_CM_single 0 0 -3.4E+38 3.4E+38 ECU_ADDRESS 0x0000 /* @ECU_Address@IbAP_InputVrntTunParam.KeAP_k_BrakePGain@ */ /end MEASUREMENT
/begin MEASUREMENT IbAP_InputVrntTunParam.KeAP_k_BrakeIGain "" FLOAT32_IEEE DT24_CVADAS_AP_CodGen_CM_single 0 0 -3.4E+38 3.4E+38 ECU_ADDRESS 0x0000 /* @ECU_Address@IbAP_InputVrntTunParam.KeAP_k_BrakeIGain@ */ /end MEASUREMENT
/begin MEASUREMENT IbAP_InputVrntTunParam.KeAP_k_BrakeUpperLimit "" FLOAT32_IEEE DT24_CVADAS_AP_CodGen_CM_single 0 0 -3.4E+38 3.4E+38 ECU_ADDRESS 0x0000 /* @ECU_Address@IbAP_InputVrntTunParam.KeAP_k_BrakeUpperLimit@ */ /end MEASUREMENT
/begin MEASUREMENT IbAP_InputVrntTunParam.KeAP_k_BrakeLowerLimit "" FLOAT32_IEEE DT24_CVADAS_AP_CodGen_CM_single 0 0 -3.4E+38 3.4E+38 ECU_ADDRESS 0x0000 /* @ECU_Address@IbAP_InputVrntTunParam.KeAP_k_BrakeLowerLimit@ */ /end MEASUREMENT
/begin MEASUREMENT IbAP_InputVrntTunParam.KeAP_k_CtrlOutGearDrive "" FLOAT32_IEEE DT24_CVADAS_AP_CodGen_CM_single 0 0 -3.4E+38 3.4E+38 ECU_ADDRESS 0x0000 /* @ECU_Address@IbAP_InputVrntTunParam.KeAP_k_CtrlOutGearDrive@ */ /end MEASUREMENT
/begin MEASUREMENT IbAP_InputVrntTunParam.KeAP_k_CtrlOutGearReverse "" FLOAT32_IEEE DT24_CVADAS_AP_CodGen_CM_single 0 0 -3.4E+38 3.4E+38 ECU_ADDRESS 0x0000 /* @ECU_Address@IbAP_InputVrntTunParam.KeAP_k_CtrlOutGearReverse@ */ /end MEASUREMENT
/begin MEASUREMENT IbAP_InputVrntTunParam.KeAP_k_CtrlOutGearPark "" FLOAT32_IEEE DT24_CVADAS_AP_CodGen_CM_single 0 0 -3.4E+38 3.4E+38 ECU_ADDRESS 0x0000 /* @ECU_Address@IbAP_InputVrntTunParam.KeAP_k_CtrlOutGearPark@ */ /end MEASUREMENT
/begin MEASUREMENT IbAP_InputVrntTunParam.KeAP_k_WhlCircum "" FLOAT32_IEEE DT24_CVADAS_AP_CodGen_CM_single 0 0 -3.4E+38 3.4E+38 ECU_ADDRESS 0x0000 /* @ECU_Address@IbAP_InputVrntTunParam.KeAP_k_WhlCircum@ */ /end MEASUREMENT
/begin MEASUREMENT IbAP_InputVrntTunParam.KeAP_cnt_ChimeVolChgAlert "" UWORD DT24_CVADAS_AP_CodGen_CM_uint16 0 0 0 65535 ECU_ADDRESS 0x0000 /* @ECU_Address@IbAP_InputVrntTunParam.KeAP_cnt_ChimeVolChgAlert@ */ /end MEASUREMENT
/begin MEASUREMENT IbAP_InputVrntTunParam.KeAP_cnt_FrntChimeDisTimeThd "" UWORD DT24_CVADAS_AP_CodGen_CM_uint16 0 0 0 65535 ECU_ADDRESS 0x0000 /* @ECU_Address@IbAP_InputVrntTunParam.KeAP_cnt_FrntChimeDisTimeThd@ */ /end MEASUREMENT
/begin MEASUREMENT IbAP_InputVrntTunParam.KeAP_cnt_HalfSecChimeAlert "" UWORD DT24_CVADAS_AP_CodGen_CM_uint16 0 0 0 65535 ECU_ADDRESS 0x0000 /* @ECU_Address@IbAP_InputVrntTunParam.KeAP_cnt_HalfSecChimeAlert@ */ /end MEASUREMENT
/begin MEASUREMENT IbAP_InputVrntTunParam.KeAP_cnt_LEDBlinkTimeThd "" UWORD DT24_CVADAS_AP_CodGen_CM_uint16 0 0 0 65535 ECU_ADDRESS 0x0000 /* @ECU_Address@IbAP_InputVrntTunParam.KeAP_cnt_LEDBlinkTimeThd@ */ /end MEASUREMENT
/begin MEASUREMENT IbAP_InputVrntTunParam.KeAP_cnt_VehKeyOnTimeThd "" UWORD DT24_CVADAS_AP_CodGen_CM_uint16 0 0 0 65535 ECU_ADDRESS 0x0000 /* @ECU_Address@IbAP_InputVrntTunParam.KeAP_cnt_VehKeyOnTimeThd@ */ /end MEASUREMENT
/begin MEASUREMENT IbAP_InputVrntTunParam.KeAP_Cnt_GearFiltTimeThd "" UWORD DT24_CVADAS_AP_CodGen_CM_uint16 0 0 0 65535 ECU_ADDRESS 0x0000 /* @ECU_Address@IbAP_InputVrntTunParam.KeAP_Cnt_GearFiltTimeThd@ */ /end MEASUREMENT
/begin MEASUREMENT IbAP_InputVrntTunParam.KeAP_cnt_TimeStep "" UWORD DT24_CVADAS_AP_CodGen_CM_uint16 0 0 0 65535 ECU_ADDRESS 0x0000 /* @ECU_Address@IbAP_InputVrntTunParam.KeAP_cnt_TimeStep@ */ /end MEASUREMENT
/begin MEASUREMENT IbAP_InputVrntTunParam.KeAP_cm_ObjPrestFCDistThd "" UWORD DT24_CVADAS_AP_CodGen_CM_uint16 0 0 0 65535 ECU_ADDRESS 0x0000 /* @ECU_Address@IbAP_InputVrntTunParam.KeAP_cm_ObjPrestFCDistThd@ */ /end MEASUREMENT
/begin MEASUREMENT IbAP_InputVrntTunParam.KeAP_cm_ObjPrestRCDistThd "" UWORD DT24_CVADAS_AP_CodGen_CM_uint16 0 0 0 65535 ECU_ADDRESS 0x0000 /* @ECU_Address@IbAP_InputVrntTunParam.KeAP_cm_ObjPrestRCDistThd@ */ /end MEASUREMENT
/begin MEASUREMENT IbAP_InputVrntTunParam.KeAP_cm_VehicleWidth "" UWORD DT24_CVADAS_AP_CodGen_CM_uint16 0 0 0 65535 ECU_ADDRESS 0x0000 /* @ECU_Address@IbAP_InputVrntTunParam.KeAP_cm_VehicleWidth@ */ /end MEASUREMENT
/begin MEASUREMENT IbAP_InputVrntTunParam.KeAP_Cnt_GearOverrideTimeThd "" UWORD DT24_CVADAS_AP_CodGen_CM_uint16 0 0 0 65535 ECU_ADDRESS 0x0000 /* @ECU_Address@IbAP_InputVrntTunParam.KeAP_Cnt_GearOverrideTimeThd@ */ /end MEASUREMENT
/begin MEASUREMENT IbAP_InputVrntTunParam.KeAP_cnt_SwtStuckTimeThd "" UWORD DT24_CVADAS_AP_CodGen_CM_uint16 0 0 0 65535 ECU_ADDRESS 0x0000 /* @ECU_Address@IbAP_InputVrntTunParam.KeAP_cnt_SwtStuckTimeThd@ */ /end MEASUREMENT
/begin MEASUREMENT IbAP_InputVrntTunParam.KeAP_s_BSMInterfaceCntTimeout "" UWORD DT24_CVADAS_AP_CodGen_CM_uint16 0 0 0 65535 ECU_ADDRESS 0x0000 /* @ECU_Address@IbAP_InputVrntTunParam.KeAP_s_BSMInterfaceCntTimeout@ */ /end MEASUREMENT
/begin MEASUREMENT IbAP_InputVrntTunParam.KeAP_s_CamHandshakeDur "" UWORD DT24_CVADAS_AP_CodGen_CM_uint16 0 0 0 65535 ECU_ADDRESS 0x0000 /* @ECU_Address@IbAP_InputVrntTunParam.KeAP_s_CamHandshakeDur@ */ /end MEASUREMENT
/begin MEASUREMENT IbAP_InputVrntTunParam.KeAP_s_EPSInterfaceCntTimeout "" UWORD DT24_CVADAS_AP_CodGen_CM_uint16 0 0 0 65535 ECU_ADDRESS 0x0000 /* @ECU_Address@IbAP_InputVrntTunParam.KeAP_s_EPSInterfaceCntTimeout@ */ /end MEASUREMENT
/begin MEASUREMENT IbAP_InputVrntTunParam.KeAP_s_GearShiftWaitCntTimeout "" UWORD DT24_CVADAS_AP_CodGen_CM_uint16 0 0 0 65535 ECU_ADDRESS 0x0000 /* @ECU_Address@IbAP_InputVrntTunParam.KeAP_s_GearShiftWaitCntTimeout@ */ /end MEASUREMENT
/begin MEASUREMENT IbAP_InputVrntTunParam.KeAP_s_MaxStandstillTimeThd "" UWORD DT24_CVADAS_AP_CodGen_CM_uint16 0 0 0 65535 ECU_ADDRESS 0x0000 /* @ECU_Address@IbAP_InputVrntTunParam.KeAP_s_MaxStandstillTimeThd@ */ /end MEASUREMENT
/begin MEASUREMENT IbAP_InputVrntTunParam.KeAP_s_ObjInPathTimeoutDur "" UWORD DT24_CVADAS_AP_CodGen_CM_uint16 0 0 0 65535 ECU_ADDRESS 0x0000 /* @ECU_Address@IbAP_InputVrntTunParam.KeAP_s_ObjInPathTimeoutDur@ */ /end MEASUREMENT
/begin MEASUREMENT IbAP_InputVrntTunParam.KeAP_s_PausedPressBtnTimeoutDur "" UWORD DT24_CVADAS_AP_CodGen_CM_uint16 0 0 0 65535 ECU_ADDRESS 0x0000 /* @ECU_Address@IbAP_InputVrntTunParam.KeAP_s_PausedPressBtnTimeoutDur@ */ /end MEASUREMENT
/begin MEASUREMENT IbAP_InputVrntTunParam.KeAP_s_SeekPhaseTimeoutDur "" UWORD DT24_CVADAS_AP_CodGen_CM_uint16 0 0 0 65535 ECU_ADDRESS 0x0000 /* @ECU_Address@IbAP_InputVrntTunParam.KeAP_s_SeekPhaseTimeoutDur@ */ /end MEASUREMENT
/begin MEASUREMENT IbAP_InputVrntTunParam.KeAP_s_SpdExceedDur "" UWORD DT24_CVADAS_AP_CodGen_CM_uint16 0 0 0 65535 ECU_ADDRESS 0x0000 /* @ECU_Address@IbAP_InputVrntTunParam.KeAP_s_SpdExceedDur@ */ /end MEASUREMENT
/begin MEASUREMENT IbAP_InputVrntTunParam.KeAP_cnt_SPMBlinkLEDDur "" UWORD DT24_CVADAS_AP_CodGen_CM_uint16 0 0 0 65535 ECU_ADDRESS 0x0000 /* @ECU_Address@IbAP_InputVrntTunParam.KeAP_cnt_SPMBlinkLEDDur@ */ /end MEASUREMENT
/begin MEASUREMENT IbAP_InputVrntTunParam.KeAP_cm_VehContour_FSL_x "" SWORD DT24_CVADAS_AP_CodGen_CM_int16 0 0 -32768 32767 ECU_ADDRESS 0x0000 /* @ECU_Address@IbAP_InputVrntTunParam.KeAP_cm_VehContour_FSL_x@ */ /end MEASUREMENT
/begin MEASUREMENT IbAP_InputVrntTunParam.KeAP_cm_VehContour_FOL_x "" SWORD DT24_CVADAS_AP_CodGen_CM_int16 0 0 -32768 32767 ECU_ADDRESS 0x0000 /* @ECU_Address@IbAP_InputVrntTunParam.KeAP_cm_VehContour_FOL_x@ */ /end MEASUREMENT
/begin MEASUREMENT IbAP_InputVrntTunParam.KeAP_cm_VehContour_FIL_x "" SWORD DT24_CVADAS_AP_CodGen_CM_int16 0 0 -32768 32767 ECU_ADDRESS 0x0000 /* @ECU_Address@IbAP_InputVrntTunParam.KeAP_cm_VehContour_FIL_x@ */ /end MEASUREMENT
/begin MEASUREMENT IbAP_InputVrntTunParam.KeAP_cm_VehContour_FIR_x "" SWORD DT24_CVADAS_AP_CodGen_CM_int16 0 0 -32768 32767 ECU_ADDRESS 0x0000 /* @ECU_Address@IbAP_InputVrntTunParam.KeAP_cm_VehContour_FIR_x@ */ /end MEASUREMENT
/begin MEASUREMENT IbAP_InputVrntTunParam.KeAP_cm_VehContour_FOR_x "" SWORD DT24_CVADAS_AP_CodGen_CM_int16 0 0 -32768 32767 ECU_ADDRESS 0x0000 /* @ECU_Address@IbAP_InputVrntTunParam.KeAP_cm_VehContour_FOR_x@ */ /end MEASUREMENT
/begin MEASUREMENT IbAP_InputVrntTunParam.KeAP_cm_VehContour_FSR_x "" SWORD DT24_CVADAS_AP_CodGen_CM_int16 0 0 -32768 32767 ECU_ADDRESS 0x0000 /* @ECU_Address@IbAP_InputVrntTunParam.KeAP_cm_VehContour_FSR_x@ */ /end MEASUREMENT
/begin MEASUREMENT IbAP_InputVrntTunParam.KeAP_cm_VehContour_FSL_y "" SWORD DT24_CVADAS_AP_CodGen_CM_int16 0 0 -32768 32767 ECU_ADDRESS 0x0000 /* @ECU_Address@IbAP_InputVrntTunParam.KeAP_cm_VehContour_FSL_y@ */ /end MEASUREMENT
/begin MEASUREMENT IbAP_InputVrntTunParam.KeAP_cm_VehContour_FOL_y "" SWORD DT24_CVADAS_AP_CodGen_CM_int16 0 0 -32768 32767 ECU_ADDRESS 0x0000 /* @ECU_Address@IbAP_InputVrntTunParam.KeAP_cm_VehContour_FOL_y@ */ /end MEASUREMENT
/begin MEASUREMENT IbAP_InputVrntTunParam.KeAP_cm_VehContour_FIL_y "" SWORD DT24_CVADAS_AP_CodGen_CM_int16 0 0 -32768 32767 ECU_ADDRESS 0x0000 /* @ECU_Address@IbAP_InputVrntTunParam.KeAP_cm_VehContour_FIL_y@ */ /end MEASUREMENT
/begin MEASUREMENT IbAP_InputVrntTunParam.KeAP_cm_VehContour_FIR_y "" SWORD DT24_CVADAS_AP_CodGen_CM_int16 0 0 -32768 32767 ECU_ADDRESS 0x0000 /* @ECU_Address@IbAP_InputVrntTunParam.KeAP_cm_VehContour_FIR_y@ */ /end MEASUREMENT
/begin MEASUREMENT IbAP_InputVrntTunParam.KeAP_cm_VehContour_FOR_y "" SWORD DT24_CVADAS_AP_CodGen_CM_int16 0 0 -32768 32767 ECU_ADDRESS 0x0000 /* @ECU_Address@IbAP_InputVrntTunParam.KeAP_cm_VehContour_FOR_y@ */ /end MEASUREMENT
/begin MEASUREMENT IbAP_InputVrntTunParam.KeAP_cm_VehContour_FSR_y "" SWORD DT24_CVADAS_AP_CodGen_CM_int16 0 0 -32768 32767 ECU_ADDRESS 0x0000 /* @ECU_Address@IbAP_InputVrntTunParam.KeAP_cm_VehContour_FSR_y@ */ /end MEASUREMENT
/begin MEASUREMENT IbAP_InputVrntTunParam.KeAP_cm_VehContour_RSR_x "" SWORD DT24_CVADAS_AP_CodGen_CM_int16 0 0 -32768 32767 ECU_ADDRESS 0x0000 /* @ECU_Address@IbAP_InputVrntTunParam.KeAP_cm_VehContour_RSR_x@ */ /end MEASUREMENT
/begin MEASUREMENT IbAP_InputVrntTunParam.KeAP_cm_VehContour_ROR_x "" SWORD DT24_CVADAS_AP_CodGen_CM_int16 0 0 -32768 32767 ECU_ADDRESS 0x0000 /* @ECU_Address@IbAP_InputVrntTunParam.KeAP_cm_VehContour_ROR_x@ */ /end MEASUREMENT
/begin MEASUREMENT IbAP_InputVrntTunParam.KeAP_cm_VehContour_RIR_x "" SWORD DT24_CVADAS_AP_CodGen_CM_int16 0 0 -32768 32767 ECU_ADDRESS 0x0000 /* @ECU_Address@IbAP_InputVrntTunParam.KeAP_cm_VehContour_RIR_x@ */ /end MEASUREMENT
/begin MEASUREMENT IbAP_InputVrntTunParam.KeAP_cm_VehContour_RIL_x "" SWORD DT24_CVADAS_AP_CodGen_CM_int16 0 0 -32768 32767 ECU_ADDRESS 0x0000 /* @ECU_Address@IbAP_InputVrntTunParam.KeAP_cm_VehContour_RIL_x@ */ /end MEASUREMENT
/begin MEASUREMENT IbAP_InputVrntTunParam.KeAP_cm_VehContour_ROL_x "" SWORD DT24_CVADAS_AP_CodGen_CM_int16 0 0 -32768 32767 ECU_ADDRESS 0x0000 /* @ECU_Address@IbAP_InputVrntTunParam.KeAP_cm_VehContour_ROL_x@ */ /end MEASUREMENT
/begin MEASUREMENT IbAP_InputVrntTunParam.KeAP_cm_VehContour_RSL_x "" SWORD DT24_CVADAS_AP_CodGen_CM_int16 0 0 -32768 32767 ECU_ADDRESS 0x0000 /* @ECU_Address@IbAP_InputVrntTunParam.KeAP_cm_VehContour_RSL_x@ */ /end MEASUREMENT
/begin MEASUREMENT IbAP_InputVrntTunParam.KeAP_cm_VehContour_RSR_y "" SWORD DT24_CVADAS_AP_CodGen_CM_int16 0 0 -32768 32767 ECU_ADDRESS 0x0000 /* @ECU_Address@IbAP_InputVrntTunParam.KeAP_cm_VehContour_RSR_y@ */ /end MEASUREMENT
/begin MEASUREMENT IbAP_InputVrntTunParam.KeAP_cm_VehContour_ROR_y "" SWORD DT24_CVADAS_AP_CodGen_CM_int16 0 0 -32768 32767 ECU_ADDRESS 0x0000 /* @ECU_Address@IbAP_InputVrntTunParam.KeAP_cm_VehContour_ROR_y@ */ /end MEASUREMENT
/begin MEASUREMENT IbAP_InputVrntTunParam.KeAP_cm_VehContour_RIR_y "" SWORD DT24_CVADAS_AP_CodGen_CM_int16 0 0 -32768 32767 ECU_ADDRESS 0x0000 /* @ECU_Address@IbAP_InputVrntTunParam.KeAP_cm_VehContour_RIR_y@ */ /end MEASUREMENT
/begin MEASUREMENT IbAP_InputVrntTunParam.KeAP_cm_VehContour_RIL_y "" SWORD DT24_CVADAS_AP_CodGen_CM_int16 0 0 -32768 32767 ECU_ADDRESS 0x0000 /* @ECU_Address@IbAP_InputVrntTunParam.KeAP_cm_VehContour_RIL_y@ */ /end MEASUREMENT
/begin MEASUREMENT IbAP_InputVrntTunParam.KeAP_cm_VehContour_ROL_y "" SWORD DT24_CVADAS_AP_CodGen_CM_int16 0 0 -32768 32767 ECU_ADDRESS 0x0000 /* @ECU_Address@IbAP_InputVrntTunParam.KeAP_cm_VehContour_ROL_y@ */ /end MEASUREMENT
/begin MEASUREMENT IbAP_InputVrntTunParam.KeAP_cm_VehContour_RSL_y "" SWORD DT24_CVADAS_AP_CodGen_CM_int16 0 0 -32768 32767 ECU_ADDRESS 0x0000 /* @ECU_Address@IbAP_InputVrntTunParam.KeAP_cm_VehContour_RSL_y@ */ /end MEASUREMENT
/begin MEASUREMENT IbAP_InputVrntTunParam.KeAP_cm_DistZone1 "" SWORD DT24_CVADAS_AP_CodGen_CM_int16 0 0 -32768 32767 ECU_ADDRESS 0x0000 /* @ECU_Address@IbAP_InputVrntTunParam.KeAP_cm_DistZone1@ */ /end MEASUREMENT
/begin MEASUREMENT IbAP_InputVrntTunParam.KeAP_cm_DistZone2 "" SWORD DT24_CVADAS_AP_CodGen_CM_int16 0 0 -32768 32767 ECU_ADDRESS 0x0000 /* @ECU_Address@IbAP_InputVrntTunParam.KeAP_cm_DistZone2@ */ /end MEASUREMENT
/begin MEASUREMENT IbAP_InputVrntTunParam.KeAP_cm_DistZone3 "" SWORD DT24_CVADAS_AP_CodGen_CM_int16 0 0 -32768 32767 ECU_ADDRESS 0x0000 /* @ECU_Address@IbAP_InputVrntTunParam.KeAP_cm_DistZone3@ */ /end MEASUREMENT
/begin MEASUREMENT IbAP_InputVrntTunParam.KeAP_cm_DistZone4 "" SWORD DT24_CVADAS_AP_CodGen_CM_int16 0 0 -32768 32767 ECU_ADDRESS 0x0000 /* @ECU_Address@IbAP_InputVrntTunParam.KeAP_cm_DistZone4@ */ /end MEASUREMENT
/begin MEASUREMENT IbAP_InputVrntTunParam.KeAP_cm_DistZone5 "" SWORD DT24_CVADAS_AP_CodGen_CM_int16 0 0 -32768 32767 ECU_ADDRESS 0x0000 /* @ECU_Address@IbAP_InputVrntTunParam.KeAP_cm_DistZone5@ */ /end MEASUREMENT
/begin MEASUREMENT IbAP_InputVrntTunParam.KeAP_cm_DistZone6 "" SWORD DT24_CVADAS_AP_CodGen_CM_int16 0 0 -32768 32767 ECU_ADDRESS 0x0000 /* @ECU_Address@IbAP_InputVrntTunParam.KeAP_cm_DistZone6@ */ /end MEASUREMENT
/begin MEASUREMENT IbAP_InputVrntTunParam.KeAP_cnt_DebounceTimeThd "" SWORD DT24_CVADAS_AP_CodGen_CM_int16 0 0 -32768 32767 ECU_ADDRESS 0x0000 /* @ECU_Address@IbAP_InputVrntTunParam.KeAP_cnt_DebounceTimeThd@ */ /end MEASUREMENT
/begin MEASUREMENT IbAP_InputVrntTunParam.KeAP_cm_FrntLongDistAdj "" SWORD DT24_CVADAS_AP_CodGen_CM_int16 0 0 -32768 32767 ECU_ADDRESS 0x0000 /* @ECU_Address@IbAP_InputVrntTunParam.KeAP_cm_FrntLongDistAdj@ */ /end MEASUREMENT
/begin MEASUREMENT IbAP_InputVrntTunParam.KeAP_cm_HalfVehicleWidth "" SWORD DT24_CVADAS_AP_CodGen_CM_int16 0 0 -32768 32767 ECU_ADDRESS 0x0000 /* @ECU_Address@IbAP_InputVrntTunParam.KeAP_cm_HalfVehicleWidth@ */ /end MEASUREMENT
/begin MEASUREMENT IbAP_InputVrntTunParam.KeAP_cm_HookDistOffset "" SWORD DT24_CVADAS_AP_CodGen_CM_int16 0 0 -32768 32767 ECU_ADDRESS 0x0000 /* @ECU_Address@IbAP_InputVrntTunParam.KeAP_cm_HookDistOffset@ */ /end MEASUREMENT
/begin MEASUREMENT IbAP_InputVrntTunParam.KeAP_cm_MaxNoObjDetctDist "" SWORD DT24_CVADAS_AP_CodGen_CM_int16 0 0 -32768 32767 ECU_ADDRESS 0x0000 /* @ECU_Address@IbAP_InputVrntTunParam.KeAP_cm_MaxNoObjDetctDist@ */ /end MEASUREMENT
/begin MEASUREMENT IbAP_InputVrntTunParam.KeAP_cm_RearLongDistAdj "" SWORD DT24_CVADAS_AP_CodGen_CM_int16 0 0 -32768 32767 ECU_ADDRESS 0x0000 /* @ECU_Address@IbAP_InputVrntTunParam.KeAP_cm_RearLongDistAdj@ */ /end MEASUREMENT
/begin MEASUREMENT IbAP_InputVrntTunParam.KeAP_cm_WarnOffset "" SWORD DT24_CVADAS_AP_CodGen_CM_int16 0 0 -32768 32767 ECU_ADDRESS 0x0000 /* @ECU_Address@IbAP_InputVrntTunParam.KeAP_cm_WarnOffset@ */ /end MEASUREMENT
/begin MEASUREMENT IbAP_InputVrntTunParam.KeAP_e_GbTypAT "" UBYTE DT24_CVADAS_AP_CodGen_CM_uint8 0 0 0 255 ECU_ADDRESS 0x0000 /* @ECU_Address@IbAP_InputVrntTunParam.KeAP_e_GbTypAT@ */ /end MEASUREMENT
/begin MEASUREMENT IbAP_InputVrntTunParam.KeAP_pct_ObjConfidenceThd "" UBYTE DT24_CVADAS_AP_CodGen_CM_uint8 0 0 0 255 ECU_ADDRESS 0x0000 /* @ECU_Address@IbAP_InputVrntTunParam.KeAP_pct_ObjConfidenceThd@ */ /end MEASUREMENT
/begin MEASUREMENT IbAP_InputVrntTunParam.Reverse_Gr_num "" UBYTE DT24_CVADAS_AP_CodGen_CM_uint8 0 0 0 255 ECU_ADDRESS 0x0000 /* @ECU_Address@IbAP_InputVrntTunParam.Reverse_Gr_num@ */ /end MEASUREMENT
/begin MEASUREMENT IbAP_InputVrntTunParam.KeAP_b_AutoParkEn "" UBYTE DT24_CVADAS_AP_CodGen_CM_boolean 0 0 0 1 ECU_ADDRESS 0x0000 /* @ECU_Address@IbAP_InputVrntTunParam.KeAP_b_AutoParkEn@ */ /end MEASUREMENT
/begin MEASUREMENT IbAP_InputVrntTunParam.KeAP_b_FPAEn "" UBYTE DT24_CVADAS_AP_CodGen_CM_boolean 0 0 0 1 ECU_ADDRESS 0x0000 /* @ECU_Address@IbAP_InputVrntTunParam.KeAP_b_FPAEn@ */ /end MEASUREMENT
/begin MEASUREMENT IbAP_InputVrntTunParam.KeAP_b_FullAutoPark "" UBYTE DT24_CVADAS_AP_CodGen_CM_boolean 0 0 0 1 ECU_ADDRESS 0x0000 /* @ECU_Address@IbAP_InputVrntTunParam.KeAP_b_FullAutoPark@ */ /end MEASUREMENT
/begin MEASUREMENT IbAP_InputVrntTunParam.KeAP_b_HookConnected "" UBYTE DT24_CVADAS_AP_CodGen_CM_boolean 0 0 0 1 ECU_ADDRESS 0x0000 /* @ECU_Address@IbAP_InputVrntTunParam.KeAP_b_HookConnected@ */ /end MEASUREMENT
/begin MEASUREMENT IbAP_InputVrntTunParam.KeAP_b_RPAwithBrk "" UBYTE DT24_CVADAS_AP_CodGen_CM_boolean 0 0 0 1 ECU_ADDRESS 0x0000 /* @ECU_Address@IbAP_InputVrntTunParam.KeAP_b_RPAwithBrk@ */ /end MEASUREMENT
/begin MEASUREMENT IbAP_InputVrntTunParam.KeAP_b_RPAwithSurroundView "" UBYTE DT24_CVADAS_AP_CodGen_CM_boolean 0 0 0 1 ECU_ADDRESS 0x0000 /* @ECU_Address@IbAP_InputVrntTunParam.KeAP_b_RPAwithSurroundView@ */ /end MEASUREMENT
/begin MEASUREMENT IbAP_InputVrntTunParam.KeAP_b_SteerOnlyAutoPark "" UBYTE DT24_CVADAS_AP_CodGen_CM_boolean 0 0 0 1 ECU_ADDRESS 0x0000 /* @ECU_Address@IbAP_InputVrntTunParam.KeAP_b_SteerOnlyAutoPark@ */ /end MEASUREMENT
/begin MEASUREMENT IbAP_InputVrntTunParam.KeCMbB_b_EnblOncObjDbnc "" UBYTE DT24_CVADAS_AP_CodGen_CM_boolean 0 0 0 1 ECU_ADDRESS 0x0000 /* @ECU_Address@IbAP_InputVrntTunParam.KeCMbB_b_EnblOncObjDbnc@ */ /end MEASUREMENT
/begin MEASUREMENT IbAP_InputVrntTunParam.KeAP_cnt_EngagedFullWaitCnt "" UWORD DT24_CVADAS_AP_CodGen_CM_uint16 0 0 0 65535 ECU_ADDRESS 0x0000 /* @ECU_Address@IbAP_InputVrntTunParam.KeAP_cnt_EngagedFullWaitCnt@ */ /end MEASUREMENT
/begin MEASUREMENT DriveAssistStatOut.MeAP_s_FaultWaitTime "" FLOAT32_IEEE DT24_CVADAS_AP_CodGen_CM_single 0 0 -3.4E+38 3.4E+38 ECU_ADDRESS 0x0000 /* @ECU_Address@DriveAssistStatOut.MeAP_s_FaultWaitTime@ */ /end MEASUREMENT
/begin MEASUREMENT DriveAssistStatOut.IeAutoPark_e_ChimeReq "" SLONG DT24_CVADAS_AP_CodGen_CM_TeAutoPark_e_ChimeReq 0 0 0 2147483647 ECU_ADDRESS 0x0000 /* @ECU_Address@DriveAssistStatOut.IeAutoPark_e_ChimeReq@ */ /end MEASUREMENT
/begin MEASUREMENT DriveAssistStatOut.IeAP_e_ScanDir "" SLONG DT24_CVADAS_AP_CodGen_CM_TeAutoPark_e_ScanDir 0 0 0 2147483647 ECU_ADDRESS 0x0000 /* @ECU_Address@DriveAssistStatOut.IeAP_e_ScanDir@ */ /end MEASUREMENT
/begin MEASUREMENT DriveAssistStatOut.IeAP_e_AutoParkStatus "" SLONG DT24_CVADAS_AP_CodGen_CM_TeAutoPark_e_AutoParkStatus 0 0 0 2147483647 ECU_ADDRESS 0x0000 /* @ECU_Address@DriveAssistStatOut.IeAP_e_AutoParkStatus@ */ /end MEASUREMENT
/begin MEASUREMENT DriveAssistStatOut.IeAP_e_AlgoState "" SLONG DT24_CVADAS_AP_CodGen_CM_TeAP_e_AlgoState 0 0 0 2147483647 ECU_ADDRESS 0x0000 /* @ECU_Address@DriveAssistStatOut.IeAP_e_AlgoState@ */ /end MEASUREMENT
/begin MEASUREMENT DriveAssistStatOut.IeAP_e_ParKMnvrActv "" SLONG DT24_CVADAS_AP_CodGen_CM_TeAP_e_ParKMnvrActv 0 0 0 2147483647 ECU_ADDRESS 0x0000 /* @ECU_Address@DriveAssistStatOut.IeAP_e_ParKMnvrActv@ */ /end MEASUREMENT
/begin MEASUREMENT DriveAssistStatOut.IeAP_e_InterfaceBSM "" SLONG DT24_CVADAS_AP_CodGen_CM_TeAP_e_InterfaceBSM 0 0 0 2147483647 ECU_ADDRESS 0x0000 /* @ECU_Address@DriveAssistStatOut.IeAP_e_InterfaceBSM@ */ /end MEASUREMENT
/begin MEASUREMENT DriveAssistStatOut.IeAP_e_SPMLatCtrlReqSts "" SLONG DT24_CVADAS_AP_CodGen_CM_TeAP_e_SPMLatCtrlReqSts 0 0 0 2147483647 ECU_ADDRESS 0x0000 /* @ECU_Address@DriveAssistStatOut.IeAP_e_SPMLatCtrlReqSts@ */ /end MEASUREMENT
/begin MEASUREMENT DriveAssistStatOut.IeAP_e_SPMLedSts "" SLONG DT24_CVADAS_AP_CodGen_CM_TeAP_e_PAMLedCtrlStatus 0 0 0 2147483647 ECU_ADDRESS 0x0000 /* @ECU_Address@DriveAssistStatOut.IeAP_e_SPMLedSts@ */ /end MEASUREMENT
/begin MEASUREMENT DriveAssistStatOut.IeAP_e_SPMActvStat "" SLONG DT24_CVADAS_AP_CodGen_CM_TeAP_e_SPMActvStat 0 0 0 2147483647 ECU_ADDRESS 0x0000 /* @ECU_Address@DriveAssistStatOut.IeAP_e_SPMActvStat@ */ /end MEASUREMENT
/begin MEASUREMENT DriveAssistStatOut.IeAP_e_DispView2 "" SLONG DT24_CVADAS_AP_CodGen_CM_TeAP_e_DispView2 0 0 0 2147483647 ECU_ADDRESS 0x0000 /* @ECU_Address@DriveAssistStatOut.IeAP_e_DispView2@ */ /end MEASUREMENT
/begin MEASUREMENT DriveAssistStatOut.IeAP_e_GearShiftReq "" SLONG DT24_CVADAS_AP_CodGen_CM_TeAP_e_GearShiftReq 0 0 0 2147483647 ECU_ADDRESS 0x0000 /* @ECU_Address@DriveAssistStatOut.IeAP_e_GearShiftReq@ */ /end MEASUREMENT
/begin MEASUREMENT DriveAssistStatOut.MeAP_e_PAMVolSigSVM "" SLONG DT24_CVADAS_AP_CodGen_CM_TeAP_e_PAMVolSig 0 0 0 2147483647 ECU_ADDRESS 0x0000 /* @ECU_Address@DriveAssistStatOut.MeAP_e_PAMVolSigSVM@ */ /end MEASUREMENT
/begin MEASUREMENT DriveAssistStatOut.MeAP_e_PAMChimeTypSVM "" SLONG DT24_CVADAS_AP_CodGen_CM_TeAP_e_PAMChimeTyp 0 0 0 2147483647 ECU_ADDRESS 0x0000 /* @ECU_Address@DriveAssistStatOut.MeAP_e_PAMChimeTypSVM@ */ /end MEASUREMENT
/begin MEASUREMENT DriveAssistStatOut.MeAP_e_PAMChimeRepnRateSVM "" SLONG DT24_CVADAS_AP_CodGen_CM_TeAP_e_PAMChimeRepnRate 0 0 0 2147483647 ECU_ADDRESS 0x0000 /* @ECU_Address@DriveAssistStatOut.MeAP_e_PAMChimeRepnRateSVM@ */ /end MEASUREMENT
/begin MEASUREMENT DriveAssistStatOut.IeAP_e_HMIDispReq "" UBYTE DT24_CVADAS_AP_CodGen_CM_uint8 0 0 0 255 ECU_ADDRESS 0x0000 /* @ECU_Address@DriveAssistStatOut.IeAP_e_HMIDispReq@ */ /end MEASUREMENT
/begin MEASUREMENT DriveAssistStatOut.IeAP_b_WrngSpdExceed "" UBYTE DT24_CVADAS_AP_CodGen_CM_boolean 0 0 0 1 ECU_ADDRESS 0x0000 /* @ECU_Address@DriveAssistStatOut.IeAP_b_WrngSpdExceed@ */ /end MEASUREMENT
/begin MEASUREMENT DriveAssistStatOut.IeAP_b_FaultStatus "" UBYTE DT24_CVADAS_AP_CodGen_CM_boolean 0 0 0 1 ECU_ADDRESS 0x0000 /* @ECU_Address@DriveAssistStatOut.IeAP_b_FaultStatus@ */ /end MEASUREMENT
/begin MEASUREMENT DriveAssistStatOut.IeAP_b_ParkInOutSuccess "" UBYTE DT24_CVADAS_AP_CodGen_CM_boolean 0 0 0 1 ECU_ADDRESS 0x0000 /* @ECU_Address@DriveAssistStatOut.IeAP_b_ParkInOutSuccess@ */ /end MEASUREMENT
/begin MEASUREMENT DriveAssistStatOut.IeAP_b_ParkInOutAbort "" UBYTE DT24_CVADAS_AP_CodGen_CM_boolean 0 0 0 1 ECU_ADDRESS 0x0000 /* @ECU_Address@DriveAssistStatOut.IeAP_b_ParkInOutAbort@ */ /end MEASUREMENT
/begin MEASUREMENT DriveAssistStatOut.IeAP_b_FeatureAvl "" UBYTE DT24_CVADAS_AP_CodGen_CM_boolean 0 0 0 1 ECU_ADDRESS 0x0000 /* @ECU_Address@DriveAssistStatOut.IeAP_b_FeatureAvl@ */ /end MEASUREMENT
/begin MEASUREMENT DriveAssistStatOut.IeAP_b_ParkOutAvailable "" UBYTE DT24_CVADAS_AP_CodGen_CM_boolean 0 0 0 1 ECU_ADDRESS 0x0000 /* @ECU_Address@DriveAssistStatOut.IeAP_b_ParkOutAvailable@ */ /end MEASUREMENT
/begin MEASUREMENT DriveAssistStatOut.IeAP_b_ImgDefeatReqSts "" UBYTE DT24_CVADAS_AP_CodGen_CM_boolean 0 0 0 1 ECU_ADDRESS 0x0000 /* @ECU_Address@DriveAssistStatOut.IeAP_b_ImgDefeatReqSts@ */ /end MEASUREMENT
/begin MEASUREMENT DriveAssistStatOut.IeAP_b_SPMScrnReq "" UBYTE DT24_CVADAS_AP_CodGen_CM_boolean 0 0 0 1 ECU_ADDRESS 0x0000 /* @ECU_Address@DriveAssistStatOut.IeAP_b_SPMScrnReq@ */ /end MEASUREMENT
/begin MEASUREMENT DriveAssistStatOut.IeAP_b_SPMFailSts "" UBYTE DT24_CVADAS_AP_CodGen_CM_boolean 0 0 0 1 ECU_ADDRESS 0x0000 /* @ECU_Address@DriveAssistStatOut.IeAP_b_SPMFailSts@ */ /end MEASUREMENT
/begin MEASUREMENT DriveAssistStatOut.IeAP_b_SPMFaultSts "" UBYTE DT24_CVADAS_AP_CodGen_CM_boolean 0 0 0 1 ECU_ADDRESS 0x0000 /* @ECU_Address@DriveAssistStatOut.IeAP_b_SPMFaultSts@ */ /end MEASUREMENT
/begin MEASUREMENT DriveAssistStatOut.IeAP_b_VehMnvrDirSPM "" UBYTE DT24_CVADAS_AP_CodGen_CM_boolean 0 0 0 1 ECU_ADDRESS 0x0000 /* @ECU_Address@DriveAssistStatOut.IeAP_b_VehMnvrDirSPM@ */ /end MEASUREMENT
/begin MEASUREMENT DriveAssistStatOut.IeAP_b_AutoParkOverride "" UBYTE DT24_CVADAS_AP_CodGen_CM_boolean 0 0 0 1 ECU_ADDRESS 0x0000 /* @ECU_Address@DriveAssistStatOut.IeAP_b_AutoParkOverride@ */ /end MEASUREMENT
/begin MEASUREMENT DriveAssistStatOut.MeAP_b_SensorFltSts "" UBYTE DT24_CVADAS_AP_CodGen_CM_boolean 0 0 0 1 ECU_ADDRESS 0x0000 /* @ECU_Address@DriveAssistStatOut.MeAP_b_SensorFltSts@ */ /end MEASUREMENT
/begin MEASUREMENT DriveAssistStatOut.MeAP_b_ChimeActvReqLHFSVM "" UBYTE DT24_CVADAS_AP_CodGen_CM_boolean 0 0 0 1 ECU_ADDRESS 0x0000 /* @ECU_Address@DriveAssistStatOut.MeAP_b_ChimeActvReqLHFSVM@ */ /end MEASUREMENT
/begin MEASUREMENT DriveAssistStatOut.MeAP_b_ChimeActvReqLHRSVM "" UBYTE DT24_CVADAS_AP_CodGen_CM_boolean 0 0 0 1 ECU_ADDRESS 0x0000 /* @ECU_Address@DriveAssistStatOut.MeAP_b_ChimeActvReqLHRSVM@ */ /end MEASUREMENT
/begin MEASUREMENT DriveAssistStatOut.MeAP_b_ChimeActvReqRHFSVM "" UBYTE DT24_CVADAS_AP_CodGen_CM_boolean 0 0 0 1 ECU_ADDRESS 0x0000 /* @ECU_Address@DriveAssistStatOut.MeAP_b_ChimeActvReqRHFSVM@ */ /end MEASUREMENT
/begin MEASUREMENT DriveAssistStatOut.MeAP_b_ChimeActvReqRHRSVM "" UBYTE DT24_CVADAS_AP_CodGen_CM_boolean 0 0 0 1 ECU_ADDRESS 0x0000 /* @ECU_Address@DriveAssistStatOut.MeAP_b_ChimeActvReqRHRSVM@ */ /end MEASUREMENT
/begin MEASUREMENT MbNVM_ProxyParam.KeAP_b_CanNode67DTCM "" UBYTE DT24_CVADAS_AP_CodGen_CM_boolean 0 0 0 1 ECU_ADDRESS 0x0000 /* @ECU_Address@MbNVM_ProxyParam.KeAP_b_CanNode67DTCM@ */ /end MEASUREMENT
/begin MEASUREMENT MbNVM_ProxyParam.KeAP_b_CanNode63TTM "" UBYTE DT24_CVADAS_AP_CodGen_CM_boolean 0 0 0 1 ECU_ADDRESS 0x0000 /* @ECU_Address@MbNVM_ProxyParam.KeAP_b_CanNode63TTM@ */ /end MEASUREMENT
/begin MEASUREMENT MbNVM_ProxyParam.KeAP_b_StopAndStrt "" UBYTE DT24_CVADAS_AP_CodGen_CM_boolean 0 0 0 1 ECU_ADDRESS 0x0000 /* @ECU_Address@MbNVM_ProxyParam.KeAP_b_StopAndStrt@ */ /end MEASUREMENT
/begin MEASUREMENT MbNVM_ProxyParam.KeAP_mm_TyreSz "" UWORD DT24_CVADAS_AP_CodGen_CM_uint16 0 0 0 65535 ECU_ADDRESS 0x0000 /* @ECU_Address@MbNVM_ProxyParam.KeAP_mm_TyreSz@ */ /end MEASUREMENT
/begin MEASUREMENT MbNVM_ProxyParam.KeAP_e_SteerRatRackPinionTyp "" SLONG DT24_CVADAS_AP_CodGen_CM_TeAP_e_SteerRatRackPinionTyp 0 0 0 2 ECU_ADDRESS 0x0000 /* @ECU_Address@MbNVM_ProxyParam.KeAP_e_SteerRatRackPinionTyp@ */ /end MEASUREMENT
/begin MEASUREMENT MbNVM_ProxyParam.KeAP_e_DrvTypVrnt "" SLONG DT24_CVADAS_AP_CodGen_CM_TeAP_e_DrvTypVrnt 0 0 0 4 ECU_ADDRESS 0x0000 /* @ECU_Address@MbNVM_ProxyParam.KeAP_e_DrvTypVrnt@ */ /end MEASUREMENT
/begin MEASUREMENT MbNVM_ProxyParam.KeAP_e_GbTyp "" SLONG DT24_CVADAS_AP_CodGen_CM_TeAP_e_GbTyp 0 0 0 4 ECU_ADDRESS 0x0000 /* @ECU_Address@MbNVM_ProxyParam.KeAP_e_GbTyp@ */ /end MEASUREMENT
/begin MEASUREMENT MbNVM_ProxyParam.KeAP_e_PAMTunSet "" SLONG DT24_CVADAS_AP_CodGen_CM_TeAP_e_PAMTunSet 0 0 0 4 ECU_ADDRESS 0x0000 /* @ECU_Address@MbNVM_ProxyParam.KeAP_e_PAMTunSet@ */ /end MEASUREMENT
/begin MEASUREMENT MbNVM_ProxyParam.KeAP_e_VehLineCfg "" UBYTE DT24_CVADAS_AP_CodGen_CM_uint8 0 0 0 255 ECU_ADDRESS 0x0000 /* @ECU_Address@MbNVM_ProxyParam.KeAP_e_VehLineCfg@ */ /end MEASUREMENT
/begin MEASUREMENT MbNVM_ProxyParam.KeAP_e_CtryCod "" SLONG DT24_CVADAS_AP_CodGen_CM_TeAP_e_CtryCod 0 0 0 215 ECU_ADDRESS 0x0000 /* @ECU_Address@MbNVM_ProxyParam.KeAP_e_CtryCod@ */ /end MEASUREMENT
/begin MEASUREMENT MbNVM_ProxyParam.KeAP_e_HybTyp "" SLONG DT24_CVADAS_AP_CodGen_CM_TeAP_e_HybTyp 0 0 0 5 ECU_ADDRESS 0x0000 /* @ECU_Address@MbNVM_ProxyParam.KeAP_e_HybTyp@ */ /end MEASUREMENT
/begin MEASUREMENT MbNVM_ProxyParam.KeAP_e_WhlBas "" SLONG DT24_CVADAS_AP_CodGen_CM_TeAP_e_WhlBas 0 0 0 2 ECU_ADDRESS 0x0000 /* @ECU_Address@MbNVM_ProxyParam.KeAP_e_WhlBas@ */ /end MEASUREMENT
/begin MEASUREMENT MbNVM_ProxyParam.KeAP_b_ParkWithStop "" UBYTE DT24_CVADAS_AP_CodGen_CM_boolean 0 0 0 1 ECU_ADDRESS 0x0000 /* @ECU_Address@MbNVM_ProxyParam.KeAP_b_ParkWithStop@ */ /end MEASUREMENT
/begin MEASUREMENT MbNVM_ProxyParam.KeAP_b_PAMCfg "" UBYTE DT24_CVADAS_AP_CodGen_CM_boolean 0 0 0 1 ECU_ADDRESS 0x0000 /* @ECU_Address@MbNVM_ProxyParam.KeAP_b_PAMCfg@ */ /end MEASUREMENT
/begin MEASUREMENT MbNVM_ProxyParam.KeAP_e_RadioDispTyp "" SLONG DT24_CVADAS_AP_CodGen_CM_TeAP_e_RadioDispTyp 0 0 0 9 ECU_ADDRESS 0x0000 /* @ECU_Address@MbNVM_ProxyParam.KeAP_e_RadioDispTyp@ */ /end MEASUREMENT
/begin MEASUREMENT MbNVM_ProxyParam.KeAP_b_CanNode95ITBMTCM "" UBYTE DT24_CVADAS_AP_CodGen_CM_boolean 0 0 0 1 ECU_ADDRESS 0x0000 /* @ECU_Address@MbNVM_ProxyParam.KeAP_b_CanNode95ITBMTCM@ */ /end MEASUREMENT
/begin MEASUREMENT MbNVM_ProxyParam.KeAP_b_DrvSide "" UBYTE DT24_CVADAS_AP_CodGen_CM_boolean 0 0 0 1 ECU_ADDRESS 0x0000 /* @ECU_Address@MbNVM_ProxyParam.KeAP_b_DrvSide@ */ /end MEASUREMENT
/begin MEASUREMENT MbNVM_ProxyParam.KeAP_b_SemiAutoPrkgSys "" UBYTE DT24_CVADAS_AP_CodGen_CM_boolean 0 0 0 1 ECU_ADDRESS 0x0000 /* @ECU_Address@MbNVM_ProxyParam.KeAP_b_SemiAutoPrkgSys@ */ /end MEASUREMENT
/begin MEASUREMENT MbNVM_ProxyParam.KeAP_e_MdlYr "" UWORD DT24_CVADAS_AP_CodGen_CM_uint16 0 0 0 65535 ECU_ADDRESS 0x0000 /* @ECU_Address@MbNVM_ProxyParam.KeAP_e_MdlYr@ */ /end MEASUREMENT
/begin MEASUREMENT MbNVM_ProxyParam.KeAP_b_PullOutCtrlPres "" UBYTE DT24_CVADAS_AP_CodGen_CM_boolean 0 0 0 1 ECU_ADDRESS 0x0000 /* @ECU_Address@MbNVM_ProxyParam.KeAP_b_PullOutCtrlPres@ */ /end MEASUREMENT
/begin MEASUREMENT MbNVM_ProxyParam.KeAP_b_FullAutoPrkgSys "" UBYTE DT24_CVADAS_AP_CodGen_CM_boolean 0 0 0 1 ECU_ADDRESS 0x0000 /* @ECU_Address@MbNVM_ProxyParam.KeAP_b_FullAutoPrkgSys@ */ /end MEASUREMENT
/begin MEASUREMENT MbNVM_ProxyParam.KeAP_b_TrlrHitchAsstPres "" UBYTE DT24_CVADAS_AP_CodGen_CM_boolean 0 0 0 1 ECU_ADDRESS 0x0000 /* @ECU_Address@MbNVM_ProxyParam.KeAP_b_TrlrHitchAsstPres@ */ /end MEASUREMENT
/begin MEASUREMENT MbNVM_ProxyParam.KeAP_b_TrlrRvsSteerPres "" UBYTE DT24_CVADAS_AP_CodGen_CM_boolean 0 0 0 1 ECU_ADDRESS 0x0000 /* @ECU_Address@MbNVM_ProxyParam.KeAP_b_TrlrRvsSteerPres@ */ /end MEASUREMENT
/begin MEASUREMENT MbNVM_ProxyParam.KeAP_b_SVSPresent "" UBYTE DT24_CVADAS_AP_CodGen_CM_boolean 0 0 0 1 ECU_ADDRESS 0x0000 /* @ECU_Address@MbNVM_ProxyParam.KeAP_b_SVSPresent@ */ /end MEASUREMENT
/begin MEASUREMENT MbNVM_ProxyParam.KeAP_k_VariantID "" UBYTE DT24_CVADAS_AP_CodGen_CM_uint8 0 0 0 255 ECU_ADDRESS 0x0000 /* @ECU_Address@MbNVM_ProxyParam.KeAP_k_VariantID@ */ /end MEASUREMENT
/begin MEASUREMENT VCActuatorOut.IeAP_nm_StrwTrqReq "" FLOAT32_IEEE DT24_CVADAS_AP_CodGen_CM_single 0 0 -3.4E+38 3.4E+38 ECU_ADDRESS 0x0000 /* @ECU_Address@VCActuatorOut.IeAP_nm_StrwTrqReq@ */ /end MEASUREMENT
/begin MEASUREMENT VCActuatorOut.IeAP_a_DecelMax "" FLOAT32_IEEE DT24_CVADAS_AP_CodGen_CM_single 0 0 -3.4E+38 3.4E+38 ECU_ADDRESS 0x0000 /* @ECU_Address@VCActuatorOut.IeAP_a_DecelMax@ */ /end MEASUREMENT
/begin MEASUREMENT VCActuatorOut.IeAP_a_DecelMin "" FLOAT32_IEEE DT24_CVADAS_AP_CodGen_CM_single 0 0 -3.4E+38 3.4E+38 ECU_ADDRESS 0x0000 /* @ECU_Address@VCActuatorOut.IeAP_a_DecelMin@ */ /end MEASUREMENT
/begin MEASUREMENT VCActuatorOut.IeAP_a_JerkDecelMax "" FLOAT32_IEEE DT24_CVADAS_AP_CodGen_CM_single 0 0 -3.4E+38 3.4E+38 ECU_ADDRESS 0x0000 /* @ECU_Address@VCActuatorOut.IeAP_a_JerkDecelMax@ */ /end MEASUREMENT
/begin MEASUREMENT VCActuatorOut.IeAP_a_JerkDecelMin "" FLOAT32_IEEE DT24_CVADAS_AP_CodGen_CM_single 0 0 -3.4E+38 3.4E+38 ECU_ADDRESS 0x0000 /* @ECU_Address@VCActuatorOut.IeAP_a_JerkDecelMin@ */ /end MEASUREMENT
/begin MEASUREMENT VCActuatorOut.IeAP_a_AcclMin "" FLOAT32_IEEE DT24_CVADAS_AP_CodGen_CM_single 0 0 -3.4E+38 3.4E+38 ECU_ADDRESS 0x0000 /* @ECU_Address@VCActuatorOut.IeAP_a_AcclMin@ */ /end MEASUREMENT
/begin MEASUREMENT VCActuatorOut.IeAP_a_AcclMax "" FLOAT32_IEEE DT24_CVADAS_AP_CodGen_CM_single 0 0 -3.4E+38 3.4E+38 ECU_ADDRESS 0x0000 /* @ECU_Address@VCActuatorOut.IeAP_a_AcclMax@ */ /end MEASUREMENT
/begin MEASUREMENT VCActuatorOut.IeAP_da_JerkAcclMax "" FLOAT32_IEEE DT24_CVADAS_AP_CodGen_CM_single 0 0 -3.4E+38 3.4E+38 ECU_ADDRESS 0x0000 /* @ECU_Address@VCActuatorOut.IeAP_da_JerkAcclMax@ */ /end MEASUREMENT
/begin MEASUREMENT VCActuatorOut.IeAP_da_JerkAcclMin "" FLOAT32_IEEE DT24_CVADAS_AP_CodGen_CM_single 0 0 -3.4E+38 3.4E+38 ECU_ADDRESS 0x0000 /* @ECU_Address@VCActuatorOut.IeAP_da_JerkAcclMin@ */ /end MEASUREMENT
/begin MEASUREMENT VCActuatorOut.IeAP_cm_TrgtDist "" FLOAT32_IEEE DT24_CVADAS_AP_CodGen_CM_single 0 0 -3.4E+38 3.4E+38 ECU_ADDRESS 0x0000 /* @ECU_Address@VCActuatorOut.IeAP_cm_TrgtDist@ */ /end MEASUREMENT
/begin MEASUREMENT VCActuatorOut.IeAP_kph_TrgtVehSpd "" FLOAT32_IEEE DT24_CVADAS_AP_CodGen_CM_single 0 0 -3.4E+38 3.4E+38 ECU_ADDRESS 0x0000 /* @ECU_Address@VCActuatorOut.IeAP_kph_TrgtVehSpd@ */ /end MEASUREMENT
/begin MEASUREMENT VCActuatorOut.IeAP_e_TurnIndicReq "" SLONG DT24_CVADAS_AP_CodGen_CM_int32 0 0 -2147483648 2147483647 ECU_ADDRESS 0x0000 /* @ECU_Address@VCActuatorOut.IeAP_e_TurnIndicReq@ */ /end MEASUREMENT
/begin MEASUREMENT VCActuatorOut.IeAP_b_StandstillReq "" UBYTE DT24_CVADAS_AP_CodGen_CM_boolean 0 0 0 1 ECU_ADDRESS 0x0000 /* @ECU_Address@VCActuatorOut.IeAP_b_StandstillReq@ */ /end MEASUREMENT
/begin MEASUREMENT RPAWarnOut.IeAP_e_DispArcCHR "" SLONG DT24_CVADAS_AP_CodGen_CM_TeAP_e_Alert 0 0 0 7 ECU_ADDRESS 0x0000 /* @ECU_Address@RPAWarnOut.IeAP_e_DispArcCHR@ */ /end MEASUREMENT
/begin MEASUREMENT RPAWarnOut.IeAP_e_DispArcLHR "" SLONG DT24_CVADAS_AP_CodGen_CM_TeAP_e_Alert 0 0 0 7 ECU_ADDRESS 0x0000 /* @ECU_Address@RPAWarnOut.IeAP_e_DispArcLHR@ */ /end MEASUREMENT
/begin MEASUREMENT RPAWarnOut.IeAP_e_DispArcRHR "" SLONG DT24_CVADAS_AP_CodGen_CM_TeAP_e_Alert 0 0 0 7 ECU_ADDRESS 0x0000 /* @ECU_Address@RPAWarnOut.IeAP_e_DispArcRHR@ */ /end MEASUREMENT
/begin MEASUREMENT RPAWarnOut.IeAP_e_ArcFlashRateCHR "" SLONG DT24_CVADAS_AP_CodGen_CM_TeAP_e_GraphicFlshRate 0 0 0 2147483647 ECU_ADDRESS 0x0000 /* @ECU_Address@RPAWarnOut.IeAP_e_ArcFlashRateCHR@ */ /end MEASUREMENT
/begin MEASUREMENT RPAWarnOut.IeAP_e_ArcFlashRateLHR "" SLONG DT24_CVADAS_AP_CodGen_CM_TeAP_e_GraphicFlshRate 0 0 0 2147483647 ECU_ADDRESS 0x0000 /* @ECU_Address@RPAWarnOut.IeAP_e_ArcFlashRateLHR@ */ /end MEASUREMENT
/begin MEASUREMENT RPAWarnOut.IeAP_e_ArcFlashRateRHR "" SLONG DT24_CVADAS_AP_CodGen_CM_TeAP_e_GraphicFlshRate 0 0 0 2147483647 ECU_ADDRESS 0x0000 /* @ECU_Address@RPAWarnOut.IeAP_e_ArcFlashRateRHR@ */ /end MEASUREMENT
/begin MEASUREMENT RPAWarnOut.IeAP_cm_RearDisttoNearObst "" UWORD DT24_CVADAS_AP_CodGen_CM_uint16 0 0 0 65535 ECU_ADDRESS 0x0000 /* @ECU_Address@RPAWarnOut.IeAP_cm_RearDisttoNearObst@ */ /end MEASUREMENT
/begin MEASUREMENT RPAWarnOut.IeAP_b_ChimeActvReqLHR "" UBYTE DT24_CVADAS_AP_CodGen_CM_boolean 0 0 0 1 ECU_ADDRESS 0x0000 /* @ECU_Address@RPAWarnOut.IeAP_b_ChimeActvReqLHR@ */ /end MEASUREMENT
/begin MEASUREMENT RPAWarnOut.IeAP_b_ChimeActvReqRHR "" UBYTE DT24_CVADAS_AP_CodGen_CM_boolean 0 0 0 1 ECU_ADDRESS 0x0000 /* @ECU_Address@RPAWarnOut.IeAP_b_ChimeActvReqRHR@ */ /end MEASUREMENT
/begin MEASUREMENT PAStateOut.IeAP_e_PAMChimeRepnRate "" SLONG DT24_CVADAS_AP_CodGen_CM_TeAP_e_PAMChimeRepnRate 0 0 0 2147483647 ECU_ADDRESS 0x0000 /* @ECU_Address@PAStateOut.IeAP_e_PAMChimeRepnRate@ */ /end MEASUREMENT
/begin MEASUREMENT PAStateOut.IeAP_e_PAMVolSig "" SLONG DT24_CVADAS_AP_CodGen_CM_TeAP_e_PAMVolume 0 0 0 2147483647 ECU_ADDRESS 0x0000 /* @ECU_Address@PAStateOut.IeAP_e_PAMVolSig@ */ /end MEASUREMENT
/begin MEASUREMENT PAStateOut.IeAP_e_FrntParkLEDSts "" SLONG DT24_CVADAS_AP_CodGen_CM_TeAP_e_PAMLedCtrlStatus 0 0 0 2147483647 ECU_ADDRESS 0x0000 /* @ECU_Address@PAStateOut.IeAP_e_FrntParkLEDSts@ */ /end MEASUREMENT
/begin MEASUREMENT PAStateOut.IeAP_e_PAMLedCtrl "" SLONG DT24_CVADAS_AP_CodGen_CM_TeAP_e_PAMLedCtrlStatus 0 0 0 2147483647 ECU_ADDRESS 0x0000 /* @ECU_Address@PAStateOut.IeAP_e_PAMLedCtrl@ */ /end MEASUREMENT
/begin MEASUREMENT PAStateOut.IeAP_e_PAMChimeTyp "" SLONG DT24_CVADAS_AP_CodGen_CM_TeAP_e_PAMChimeTyp 0 0 0 2147483647 ECU_ADDRESS 0x0000 /* @ECU_Address@PAStateOut.IeAP_e_PAMChimeTyp@ */ /end MEASUREMENT
/begin MEASUREMENT PAStateOut.IeAP_e_ParkSensePopUpReq "" SLONG DT24_CVADAS_AP_CodGen_CM_TeAP_e_PAMPopUpReq 0 0 0 2147483647 ECU_ADDRESS 0x0000 /* @ECU_Address@PAStateOut.IeAP_e_ParkSensePopUpReq@ */ /end MEASUREMENT
/begin MEASUREMENT PAStateOut.IeAP_b_PAMRearBrkReq "" UBYTE DT24_CVADAS_AP_CodGen_CM_boolean 0 0 0 1 ECU_ADDRESS 0x0000 /* @ECU_Address@PAStateOut.IeAP_b_PAMRearBrkReq@ */ /end MEASUREMENT
/begin MEASUREMENT PAStateOut.IeAP_b_PAMRearCtrlSts "" UBYTE DT24_CVADAS_AP_CodGen_CM_boolean 0 0 0 1 ECU_ADDRESS 0x0000 /* @ECU_Address@PAStateOut.IeAP_b_PAMRearCtrlSts@ */ /end MEASUREMENT
/begin MEASUREMENT FPAWarnOut.IeAP_e_DispArcCHF "" SLONG DT24_CVADAS_AP_CodGen_CM_TeAP_e_Alert 0 0 0 7 ECU_ADDRESS 0x0000 /* @ECU_Address@FPAWarnOut.IeAP_e_DispArcCHF@ */ /end MEASUREMENT
/begin MEASUREMENT FPAWarnOut.IeAP_e_DispArcLHF "" SLONG DT24_CVADAS_AP_CodGen_CM_TeAP_e_Alert 0 0 0 7 ECU_ADDRESS 0x0000 /* @ECU_Address@FPAWarnOut.IeAP_e_DispArcLHF@ */ /end MEASUREMENT
/begin MEASUREMENT FPAWarnOut.IeAP_e_DispArcRHF "" SLONG DT24_CVADAS_AP_CodGen_CM_TeAP_e_Alert 0 0 0 7 ECU_ADDRESS 0x0000 /* @ECU_Address@FPAWarnOut.IeAP_e_DispArcRHF@ */ /end MEASUREMENT
/begin MEASUREMENT FPAWarnOut.IeAP_e_ArcFlashRateLHF "" SLONG DT24_CVADAS_AP_CodGen_CM_TeAP_e_GraphicFlshRate 0 0 0 2147483647 ECU_ADDRESS 0x0000 /* @ECU_Address@FPAWarnOut.IeAP_e_ArcFlashRateLHF@ */ /end MEASUREMENT
/begin MEASUREMENT FPAWarnOut.IeAP_e_ArcFlashRateRHF "" SLONG DT24_CVADAS_AP_CodGen_CM_TeAP_e_GraphicFlshRate 0 0 0 2147483647 ECU_ADDRESS 0x0000 /* @ECU_Address@FPAWarnOut.IeAP_e_ArcFlashRateRHF@ */ /end MEASUREMENT
/begin MEASUREMENT FPAWarnOut.IeAP_e_ArcFlashRateCHF "" SLONG DT24_CVADAS_AP_CodGen_CM_TeAP_e_GraphicFlshRate 0 0 0 2147483647 ECU_ADDRESS 0x0000 /* @ECU_Address@FPAWarnOut.IeAP_e_ArcFlashRateCHF@ */ /end MEASUREMENT
/begin MEASUREMENT FPAWarnOut.IeAP_b_ChimeActvReqLHF "" UBYTE DT24_CVADAS_AP_CodGen_CM_boolean 0 0 0 1 ECU_ADDRESS 0x0000 /* @ECU_Address@FPAWarnOut.IeAP_b_ChimeActvReqLHF@ */ /end MEASUREMENT
/begin MEASUREMENT FPAWarnOut.IeAP_b_ChimeActvReqRHF "" UBYTE DT24_CVADAS_AP_CodGen_CM_boolean 0 0 0 1 ECU_ADDRESS 0x0000 /* @ECU_Address@FPAWarnOut.IeAP_b_ChimeActvReqRHF@ */ /end MEASUREMENT
/begin MEASUREMENT APSMPAOut.IeAP_e_PAMFlt "" SLONG DT24_CVADAS_AP_CodGen_CM_TeAP_e_PAMSystemFault 0 0 0 2147483647 ECU_ADDRESS 0x0000 /* @ECU_Address@APSMPAOut.IeAP_e_PAMFlt@ */ /end MEASUREMENT
/begin MEASUREMENT APSMPAOut.IeAP_e_FrntRearParkSts "" SLONG DT24_CVADAS_AP_CodGen_CM_TeAP_e_PAMOffStatus2BT 0 0 0 2147483647 ECU_ADDRESS 0x0000 /* @ECU_Address@APSMPAOut.IeAP_e_FrntRearParkSts@ */ /end MEASUREMENT
/begin MEASUREMENT APSMPAOut.IeAP_e_FrntSensorActvSts "" SLONG DT24_CVADAS_AP_CodGen_CM_TeAP_e_FrntSnsrStatus 0 0 0 2147483647 ECU_ADDRESS 0x0000 /* @ECU_Address@APSMPAOut.IeAP_e_FrntSensorActvSts@ */ /end MEASUREMENT
/begin MEASUREMENT APSMPAOut.IeAP_e_RearSnsrActvSts "" SLONG DT24_CVADAS_AP_CodGen_CM_TeAP_e_RearSnsrStatus 0 0 0 2147483647 ECU_ADDRESS 0x0000 /* @ECU_Address@APSMPAOut.IeAP_e_RearSnsrActvSts@ */ /end MEASUREMENT
/begin MEASUREMENT DS_WheelSpeed_RL "" FLOAT32_IEEE DT24_CVADAS_AP_CodGen_CM_single 0 0 -3.4E+38 3.4E+38 ECU_ADDRESS 0x0000 /* @ECU_Address@DS_WheelSpeed_RL@ */ /end MEASUREMENT
/begin MEASUREMENT DS_WheelSpeed_RR "" FLOAT32_IEEE DT24_CVADAS_AP_CodGen_CM_single 0 0 -3.4E+38 3.4E+38 ECU_ADDRESS 0x0000 /* @ECU_Address@DS_WheelSpeed_RR@ */ /end MEASUREMENT
/begin MEASUREMENT DS_ANGLE "" FLOAT32_IEEE DT24_CVADAS_AP_CodGen_CM_single 0 0 -3.4E+38 3.4E+38 ECU_ADDRESS 0x0000 /* @ECU_Address@DS_ANGLE@ */ /end MEASUREMENT
/begin MEASUREMENT MaAP_m_ParkSpot1FrntStreetX "" FLOAT32_IEEE DT24_CVADAS_AP_CodGen_CM_single 0 0 -3.4E+38 3.4E+38 ECU_ADDRESS 0x0000 /* @ECU_Address@MaAP_m_ParkSpot1FrntStreetX@ */ /end MEASUREMENT
/begin MEASUREMENT MaAP_m_ParkSpot1FrntStreetY "" FLOAT32_IEEE DT24_CVADAS_AP_CodGen_CM_single 0 0 -3.4E+38 3.4E+38 ECU_ADDRESS 0x0000 /* @ECU_Address@MaAP_m_ParkSpot1FrntStreetY@ */ /end MEASUREMENT
/begin MEASUREMENT MaAP_m_ParkSpot2FrntBorderX "" FLOAT32_IEEE DT24_CVADAS_AP_CodGen_CM_single 0 0 -3.4E+38 3.4E+38 ECU_ADDRESS 0x0000 /* @ECU_Address@MaAP_m_ParkSpot2FrntBorderX@ */ /end MEASUREMENT
/begin MEASUREMENT MaAP_m_ParkSpot2FrntBorderY "" FLOAT32_IEEE DT24_CVADAS_AP_CodGen_CM_single 0 0 -3.4E+38 3.4E+38 ECU_ADDRESS 0x0000 /* @ECU_Address@MaAP_m_ParkSpot2FrntBorderY@ */ /end MEASUREMENT
/begin MEASUREMENT MaAP_m_ParkSpot3RearBorderX "" FLOAT32_IEEE DT24_CVADAS_AP_CodGen_CM_single 0 0 -3.4E+38 3.4E+38 ECU_ADDRESS 0x0000 /* @ECU_Address@MaAP_m_ParkSpot3RearBorderX@ */ /end MEASUREMENT
/begin MEASUREMENT MaAP_m_ParkSpot3RearBorderY "" FLOAT32_IEEE DT24_CVADAS_AP_CodGen_CM_single 0 0 -3.4E+38 3.4E+38 ECU_ADDRESS 0x0000 /* @ECU_Address@MaAP_m_ParkSpot3RearBorderY@ */ /end MEASUREMENT
/begin MEASUREMENT MaAP_m_ParkSpot4RearStreetX "" FLOAT32_IEEE DT24_CVADAS_AP_CodGen_CM_single 0 0 -3.4E+38 3.4E+38 ECU_ADDRESS 0x0000 /* @ECU_Address@MaAP_m_ParkSpot4RearStreetX@ */ /end MEASUREMENT
/begin MEASUREMENT MaAP_m_ParkSpot4RearStreetY "" FLOAT32_IEEE DT24_CVADAS_AP_CodGen_CM_single 0 0 -3.4E+38 3.4E+38 ECU_ADDRESS 0x0000 /* @ECU_Address@MaAP_m_ParkSpot4RearStreetY@ */ /end MEASUREMENT
/begin MEASUREMENT dx_cm "" FLOAT32_IEEE DT24_CVADAS_AP_CodGen_CM_single 0 0 -3.4E+38 3.4E+38 ECU_ADDRESS 0x0000 /* @ECU_Address@dx_cm@ */ /end MEASUREMENT
/begin MEASUREMENT IeHMI_e_UsrParkOutSideSel "" SLONG DT24_CVADAS_AP_CodGen_CM_TeHMI_e_UsrParkOutSide 0 0 0 2 ECU_ADDRESS 0x0000 /* @ECU_Address@IeHMI_e_UsrParkOutSideSel@ */ /end MEASUREMENT
/begin MEASUREMENT IeHMI_e_ParkStyle "" SLONG DT24_CVADAS_AP_CodGen_CM_TeAutoPark_e_ParkStyle 0 0 0 2147483647 ECU_ADDRESS 0x0000 /* @ECU_Address@IeHMI_e_ParkStyle@ */ /end MEASUREMENT
/begin MEASUREMENT MeAP_e_AutoParkStatus "" SLONG DT24_CVADAS_AP_CodGen_CM_TeAutoPark_e_AutoParkStatus 0 0 0 2147483647 ECU_ADDRESS 0x0000 /* @ECU_Address@MeAP_e_AutoParkStatus@ */ /end MEASUREMENT
/begin MEASUREMENT IeHMI_e_UsrPPPAManeuverSel "" SLONG DT24_CVADAS_AP_CodGen_CM_TeAP_e_UsrPPPAManeuverSel 0 0 0 2147483647 ECU_ADDRESS 0x0000 /* @ECU_Address@IeHMI_e_UsrPPPAManeuverSel@ */ /end MEASUREMENT
/begin MEASUREMENT MeAutoPark_e_AlgoState "" SLONG DT24_CVADAS_AP_CodGen_CM_TeAP_e_AlgoState 0 0 0 2147483647 ECU_ADDRESS 0x0000 /* @ECU_Address@MeAutoPark_e_AlgoState@ */ /end MEASUREMENT
/begin MEASUREMENT MeAP_cm_RearRightMinXDist "" SWORD DT24_CVADAS_AP_CodGen_CM_int16 0 0 -32768 32767 ECU_ADDRESS 0x0000 /* @ECU_Address@MeAP_cm_RearRightMinXDist@ */ /end MEASUREMENT
/begin MEASUREMENT MeAP_cm_RearLeftMinXDist "" SWORD DT24_CVADAS_AP_CodGen_CM_int16 0 0 -32768 32767 ECU_ADDRESS 0x0000 /* @ECU_Address@MeAP_cm_RearLeftMinXDist@ */ /end MEASUREMENT
/begin MEASUREMENT MeAP_cm_RearCenterMinXDist "" SWORD DT24_CVADAS_AP_CodGen_CM_int16 0 0 -32768 32767 ECU_ADDRESS 0x0000 /* @ECU_Address@MeAP_cm_RearCenterMinXDist@ */ /end MEASUREMENT
/begin MEASUREMENT MeAP_cm_FrntRightMinXDist "" SWORD DT24_CVADAS_AP_CodGen_CM_int16 0 0 -32768 32767 ECU_ADDRESS 0x0000 /* @ECU_Address@MeAP_cm_FrntRightMinXDist@ */ /end MEASUREMENT
/begin MEASUREMENT MeAP_cm_FrntLeftMinXDist "" SWORD DT24_CVADAS_AP_CodGen_CM_int16 0 0 -32768 32767 ECU_ADDRESS 0x0000 /* @ECU_Address@MeAP_cm_FrntLeftMinXDist@ */ /end MEASUREMENT
/begin MEASUREMENT MeAP_cm_FrntCenterMinXDist "" SWORD DT24_CVADAS_AP_CodGen_CM_int16 0 0 -32768 32767 ECU_ADDRESS 0x0000 /* @ECU_Address@MeAP_cm_FrntCenterMinXDist@ */ /end MEASUREMENT
/begin MEASUREMENT MeAP_b_ExternalFail "" UBYTE DT24_CVADAS_AP_CodGen_CM_boolean 0 0 0 1 ECU_ADDRESS 0x0000 /* @ECU_Address@MeAP_b_ExternalFail@ */ /end MEASUREMENT
/begin MEASUREMENT MeAP_b_SystemFail "" UBYTE DT24_CVADAS_AP_CodGen_CM_boolean 0 0 0 1 ECU_ADDRESS 0x0000 /* @ECU_Address@MeAP_b_SystemFail@ */ /end MEASUREMENT
/begin MEASUREMENT MeAP_b_FPADisable "" UBYTE DT24_CVADAS_AP_CodGen_CM_boolean 0 0 0 1 ECU_ADDRESS 0x0000 /* @ECU_Address@MeAP_b_FPADisable@ */ /end MEASUREMENT
/begin MEASUREMENT MeAP_b_RPADisable "" UBYTE DT24_CVADAS_AP_CodGen_CM_boolean 0 0 0 1 ECU_ADDRESS 0x0000 /* @ECU_Address@MeAP_b_RPADisable@ */ /end MEASUREMENT
/begin MEASUREMENT MeAP_b_RPAActvTrlr_27 "" UBYTE DT24_CVADAS_AP_CodGen_CM_boolean 0 0 0 1 ECU_ADDRESS 0x0000 /* @ECU_Address@MeAP_b_RPAActvTrlr_27@ */ /end MEASUREMENT
/begin MEASUREMENT MeAP_b_RPAActvTrlr_29 "" UBYTE DT24_CVADAS_AP_CodGen_CM_boolean 0 0 0 1 ECU_ADDRESS 0x0000 /* @ECU_Address@MeAP_b_RPAActvTrlr_29@ */ /end MEASUREMENT
/begin MEASUREMENT MeAP_b_PAVolDefMed "" UBYTE DT24_CVADAS_AP_CodGen_CM_boolean 0 0 0 1 ECU_ADDRESS 0x0000 /* @ECU_Address@MeAP_b_PAVolDefMed@ */ /end MEASUREMENT
/begin MEASUREMENT MeAP_b_FPAVolDefMed "" UBYTE DT24_CVADAS_AP_CodGen_CM_boolean 0 0 0 1 ECU_ADDRESS 0x0000 /* @ECU_Address@MeAP_b_FPAVolDefMed@ */ /end MEASUREMENT
/begin MEASUREMENT MeAP_b_RPAVolDefMed "" UBYTE DT24_CVADAS_AP_CodGen_CM_boolean 0 0 0 1 ECU_ADDRESS 0x0000 /* @ECU_Address@MeAP_b_RPAVolDefMed@ */ /end MEASUREMENT
/begin MEASUREMENT MeAP_b_FrntSenorFail "" UBYTE DT24_CVADAS_AP_CodGen_CM_boolean 0 0 0 1 ECU_ADDRESS 0x0000 /* @ECU_Address@MeAP_b_FrntSenorFail@ */ /end MEASUREMENT
/begin MEASUREMENT MeAP_b_FrntSenorBlock "" UBYTE DT24_CVADAS_AP_CodGen_CM_boolean 0 0 0 1 ECU_ADDRESS 0x0000 /* @ECU_Address@MeAP_b_FrntSenorBlock@ */ /end MEASUREMENT
/begin MEASUREMENT MeAP_b_RearSenorFail "" UBYTE DT24_CVADAS_AP_CodGen_CM_boolean 0 0 0 1 ECU_ADDRESS 0x0000 /* @ECU_Address@MeAP_b_RearSenorFail@ */ /end MEASUREMENT
/begin MEASUREMENT MeAP_b_RearSenorBlock "" UBYTE DT24_CVADAS_AP_CodGen_CM_boolean 0 0 0 1 ECU_ADDRESS 0x0000 /* @ECU_Address@MeAP_b_RearSenorBlock@ */ /end MEASUREMENT
/begin MEASUREMENT MeAP_b_PARBActvTrlr_27 "" UBYTE DT24_CVADAS_AP_CodGen_CM_boolean 0 0 0 1 ECU_ADDRESS 0x0000 /* @ECU_Address@MeAP_b_PARBActvTrlr_27@ */ /end MEASUREMENT
/begin MEASUREMENT MeAP_b_PARBActvTrlr_29 "" UBYTE DT24_CVADAS_AP_CodGen_CM_boolean 0 0 0 1 ECU_ADDRESS 0x0000 /* @ECU_Address@MeAP_b_PARBActvTrlr_29@ */ /end MEASUREMENT
/begin MEASUREMENT MeAP_b_PARBActv4LOW "" UBYTE DT24_CVADAS_AP_CodGen_CM_boolean 0 0 0 1 ECU_ADDRESS 0x0000 /* @ECU_Address@MeAP_b_PARBActv4LOW@ */ /end MEASUREMENT
/begin MEASUREMENT MeAP_b_PARBDiable "" UBYTE DT24_CVADAS_AP_CodGen_CM_boolean 0 0 0 1 ECU_ADDRESS 0x0000 /* @ECU_Address@MeAP_b_PARBDiable@ */ /end MEASUREMENT
/begin MEASUREMENT MeAP_b_PPPAActvTrlr "" UBYTE DT24_CVADAS_AP_CodGen_CM_boolean 0 0 0 1 ECU_ADDRESS 0x0000 /* @ECU_Address@MeAP_b_PPPAActvTrlr@ */ /end MEASUREMENT
/begin MEASUREMENT MeAP_b_PPPAActv4LOW "" UBYTE DT24_CVADAS_AP_CodGen_CM_boolean 0 0 0 1 ECU_ADDRESS 0x0000 /* @ECU_Address@MeAP_b_PPPAActv4LOW@ */ /end MEASUREMENT
/begin MEASUREMENT MeAP_b_PPPADefEng "" UBYTE DT24_CVADAS_AP_CodGen_CM_boolean 0 0 0 1 ECU_ADDRESS 0x0000 /* @ECU_Address@MeAP_b_PPPADefEng@ */ /end MEASUREMENT
/begin MEASUREMENT MeAP_b_PPPADisable "" UBYTE DT24_CVADAS_AP_CodGen_CM_boolean 0 0 0 1 ECU_ADDRESS 0x0000 /* @ECU_Address@MeAP_b_PPPADisable@ */ /end MEASUREMENT
/begin MEASUREMENT IeHMI_b_UsrSlotSelStatus "" UBYTE DT24_CVADAS_AP_CodGen_CM_boolean 0 0 0 1 ECU_ADDRESS 0x0000 /* @ECU_Address@IeHMI_b_UsrSlotSelStatus@ */ /end MEASUREMENT
/begin MEASUREMENT IeHMI_b_HMIHandshake "" UBYTE DT24_CVADAS_AP_CodGen_CM_boolean 0 0 0 1 ECU_ADDRESS 0x0000 /* @ECU_Address@IeHMI_b_HMIHandshake@ */ /end MEASUREMENT
/begin MEASUREMENT IeHMI_b_BackBtnPsd "" UBYTE DT24_CVADAS_AP_CodGen_CM_boolean 0 0 0 1 ECU_ADDRESS 0x0000 /* @ECU_Address@IeHMI_b_BackBtnPsd@ */ /end MEASUREMENT
/begin MEASUREMENT IeAP_b_DisForceNoiseMode "" UBYTE DT24_CVADAS_AP_CodGen_CM_boolean 0 0 0 1 ECU_ADDRESS 0x0000 /* @ECU_Address@IeAP_b_DisForceNoiseMode@ */ /end MEASUREMENT
/begin MEASUREMENT MeAP_b_FPASwtStatus "" UBYTE DT24_CVADAS_AP_CodGen_CM_boolean 0 0 0 1 ECU_ADDRESS 0x0000 /* @ECU_Address@MeAP_b_FPASwtStatus@ */ /end MEASUREMENT
/begin MEASUREMENT MeAP_b_RPASwtStatus "" UBYTE DT24_CVADAS_AP_CodGen_CM_boolean 0 0 0 1 ECU_ADDRESS 0x0000 /* @ECU_Address@MeAP_b_RPASwtStatus@ */ /end MEASUREMENT
/begin MEASUREMENT MeAP_b_ResetKM "" UBYTE DT24_CVADAS_AP_CodGen_CM_boolean 0 0 0 1 ECU_ADDRESS 0x0000 /* @ECU_Address@MeAP_b_ResetKM@ */ /end MEASUREMENT
/begin MEASUREMENT MeAP_b_ObjInPath "" UBYTE DT24_CVADAS_AP_CodGen_CM_boolean 0 0 0 1 ECU_ADDRESS 0x0000 /* @ECU_Address@MeAP_b_ObjInPath@ */ /end MEASUREMENT
/begin COMPU_METHOD DT24_CVADAS_AP_CodGen_CM_single "Q = V" RAT_FUNC "%8.6" "" COEFFS 0 1 0 0 0 1 /end COMPU_METHOD
/begin COMPU_METHOD DT24_CVADAS_AP_CodGen_CM_single_degC "Q = V" RAT_FUNC "%8.6" "degC" COEFFS 0 1 0 0 0 1 /end COMPU_METHOD
/begin COMPU_METHOD DT24_CVADAS_AP_CodGen_CM_single_kph "Q = V" RAT_FUNC "%8.6" "kph" COEFFS 0 1 0 0 0 1 /end COMPU_METHOD
/begin COMPU_METHOD DT24_CVADAS_AP_CodGen_CM_single_sec "Q = V" RAT_FUNC "%8.6" "sec" COEFFS 0 1 0 0 0 1 /end COMPU_METHOD
/begin COMPU_METHOD DT24_CVADAS_AP_CodGen_CM_single_m "Q = V" RAT_FUNC "%8.6" "m" COEFFS 0 1 0 0 0 1 /end COMPU_METHOD
/begin COMPU_METHOD DT24_CVADAS_AP_CodGen_CM_int16 "Q = V" RAT_FUNC "%5.0" "" COEFFS 0 1 0 0 0 1 /end COMPU_METHOD
/begin COMPU_METHOD DT24_CVADAS_AP_CodGen_CM_int16_cm "Q = V" RAT_FUNC "%5.0" "cm" COEFFS 0 1 0 0 0 1 /end COMPU_METHOD
/begin COMPU_METHOD DT24_CVADAS_AP_CodGen_CM_int16_sec "Q = V" RAT_FUNC "%5.0" "sec" COEFFS 0 1 0 0 0 1 /end COMPU_METHOD
/begin COMPU_METHOD DT24_CVADAS_AP_CodGen_CM_int16_cnt "Q = V" RAT_FUNC "%5.0" "cnt" COEFFS 0 1 0 0 0 1 /end COMPU_METHOD
/begin COMPU_METHOD DT24_CVADAS_AP_CodGen_CM_uint16 "Q = V" RAT_FUNC "%5.0" "" COEFFS 0 1 0 0 0 1 /end COMPU_METHOD
/begin COMPU_METHOD DT24_CVADAS_AP_CodGen_CM_uint16_ms "Q = V" RAT_FUNC "%5.0" "ms" COEFFS 0 1 0 0 0 1 /end COMPU_METHOD
/begin COMPU_METHOD DT24_CVADAS_AP_CodGen_CM_uint16_cm "Q = V" RAT_FUNC "%5.0" "cm" COEFFS 0 1 0 0 0 1 /end COMPU_METHOD
/begin COMPU_METHOD DT24_CVADAS_AP_CodGen_CM_uint16_sec "Q = V" RAT_FUNC "%5.0" "sec" COEFFS 0 1 0 0 0 1 /end COMPU_METHOD
/begin COMPU_METHOD DT24_CVADAS_AP_CodGen_CM_uint16_cnt "Q = V" RAT_FUNC "%5.0" "cnt" COEFFS 0 1 0 0 0 1 /end COMPU_METHOD
/begin COMPU_METHOD DT24_CVADAS_AP_CodGen_CM_boolean "Q = V" RAT_FUNC "%1.0" "" COEFFS 0 1 0 0 0 1 /end COMPU_METHOD
/begin COMPU_METHOD DT24_CVADAS_AP_CodGen_CM_uint8 "Q = V" RAT_FUNC "%3.0" "" COEFFS 0 1 0 0 0 1 /end COMPU_METHOD
/begin COMPU_METHOD DT24_CVADAS_AP_CodGen_CM_uint8_pct "Q = V" RAT_FUNC "%3.0" "pct" COEFFS 0 1 0 0 0 1 /end COMPU_METHOD
/begin COMPU_METHOD DT24_CVADAS_AP_CodGen_CM_TeAutoPark_e_ChimeReq "Enumerated data type: TeAutoPark_e_ChimeReq" TAB_VERB "%0.6" "" COMPU_TAB_REF VTAB_FOR_DT24_CVADAS_AP_CodGen_CM_TeAutoPark_e_ChimeReq /end COMPU_METHOD
/begin COMPU_VTAB VTAB_FOR_DT24_CVADAS_AP_CodGen_CM_TeAutoPark_e_ChimeReq "Enumerated data type: TeAutoPark_e_ChimeReq" TAB_VERB 10 0 "TeAutoPark_e_ChimeReq_No_chime" 1 "TeAutoPark_e_ChimeReq_Engagement_chime" 2 "TeAutoPark_e_ChimeReq_Disengagement_chime" 3 "TeAutoPark_e_ChimeReq_Fault_chime" 4 "TeAutoPark_e_ChimeReq_Chime_for_Warning_Light_Amber" 5 "TeAutoPark_e_ChimeReq_Chime_for_Warning_Light_Yellow" 6 "TeAutoPark_e_ChimeReq_Chime_for_Warning_Light_Red" 7 "TeAutoPark_e_ChimeReq_Reserved" 8 "TeAutoPark_e_ChimeReq_Reserved_1" 2147483647 "TeAutoPark_e_ChimeReq_MAX" /end COMPU_VTAB
/begin COMPU_METHOD DT24_CVADAS_AP_CodGen_CM_TeAutoPark_e_ScanDir "Enumerated data type: TeAutoPark_e_ScanDir" TAB_VERB "%0.6" "" COMPU_TAB_REF VTAB_FOR_DT24_CVADAS_AP_CodGen_CM_TeAutoPark_e_ScanDir /end COMPU_METHOD
/begin COMPU_VTAB VTAB_FOR_DT24_CVADAS_AP_CodGen_CM_TeAutoPark_e_ScanDir "Enumerated data type: TeAutoPark_e_ScanDir" TAB_VERB 5 0 "TeAutoPark_e_ScanDir_Not_scanning" 1 "TeAutoPark_e_ScanDir_Left" 2 "TeAutoPark_e_ScanDir_Right" 3 "TeAutoPark_e_ScanDir_Both" 2147483647 "TeAutoPark_e_ScanDir_MAX" /end COMPU_VTAB
/begin COMPU_METHOD DT24_CVADAS_AP_CodGen_CM_TeAutoPark_e_AutoParkStatus "Enumerated data type: TeAutoPark_e_AutoParkStatus" TAB_VERB "%0.6" "" COMPU_TAB_REF VTAB_FOR_DT24_CVADAS_AP_CodGen_CM_TeAutoPark_e_AutoParkStatus /end COMPU_METHOD
/begin COMPU_VTAB VTAB_FOR_DT24_CVADAS_AP_CodGen_CM_TeAutoPark_e_AutoParkStatus "Enumerated data type: TeAutoPark_e_AutoParkStatus" TAB_VERB 8 0 "TeAutoPark_e_AutoParkStatus_Off" 1 "TeAutoPark_e_AutoParkStatus_Initialize" 2 "TeAutoPark_e_AutoParkStatus_Standby" 3 "TeAutoPark_e_AutoParkStatus_Active" 4 "TeAutoPark_e_AutoParkStatus_Fault" 5 "TeAutoPark_e_AutoParkStatus_Abort" 6 "TeAutoPark_e_AutoParkStatus_Complete" 2147483647 "TeAutoPark_e_AutoParkStatus_MAX" /end COMPU_VTAB
/begin COMPU_METHOD DT24_CVADAS_AP_CodGen_CM_TeAP_e_AlgoState "Enumerated data type: TeAP_e_AlgoState" TAB_VERB "%0.6" "" COMPU_TAB_REF VTAB_FOR_DT24_CVADAS_AP_CodGen_CM_TeAP_e_AlgoState /end COMPU_METHOD
/begin COMPU_VTAB VTAB_FOR_DT24_CVADAS_AP_CodGen_CM_TeAP_e_AlgoState "Enumerated data type: TeAP_e_AlgoState" TAB_VERB 6 0 "TeAP_e_AlgoState_Idle" 1 "TeAP_e_AlgoState_Scanning" 2 "TeAP_e_AlgoState_Park_In" 3 "TeAP_e_AlgoState_Park_Out" 4 "TeAP_e_AlgoState_Handshake" 2147483647 "TeAP_e_AlgoState_MAX" /end COMPU_VTAB
/begin COMPU_METHOD DT24_CVADAS_AP_CodGen_CM_TeAP_e_ParKMnvrActv "Enumerated data type: TeAP_e_ParKMnvrActv" TAB_VERB "%0.6" "" COMPU_TAB_REF VTAB_FOR_DT24_CVADAS_AP_CodGen_CM_TeAP_e_ParKMnvrActv /end COMPU_METHOD
/begin COMPU_VTAB VTAB_FOR_DT24_CVADAS_AP_CodGen_CM_TeAP_e_ParKMnvrActv "Enumerated data type: TeAP_e_ParKMnvrActv" TAB_VERB 6 0 "TeAP_e_ParKMnvrActv_Idle" 1 "TeAP_e_ParKMnvrActv_Enabled_Seeking" 2 "TeAP_e_ParKMnvrActv_Engaged_Semi" 3 "TeAP_e_ParKMnvrActv_Engaged_Full" 7 "TeAP_e_ParKMnvrActv_SNA" 2147483647 "TeAP_e_ParKMnvrActv_MAX" /end COMPU_VTAB
/begin COMPU_METHOD DT24_CVADAS_AP_CodGen_CM_TeAP_e_InterfaceBSM "Enumerated data type: TeAP_e_InterfaceBSM" TAB_VERB "%0.6" "" COMPU_TAB_REF VTAB_FOR_DT24_CVADAS_AP_CodGen_CM_TeAP_e_InterfaceBSM /end COMPU_METHOD
/begin COMPU_VTAB VTAB_FOR_DT24_CVADAS_AP_CodGen_CM_TeAP_e_InterfaceBSM "Enumerated data type: TeAP_e_InterfaceBSM" TAB_VERB 5 0 "TeAP_e_InterfaceBSM_Idle" 1 "TeAP_e_InterfaceBSM_CVPAM_Request" 2 "TeAP_e_InterfaceBSM_Faulted" 3 "TeAP_e_InterfaceBSM_SNA" 2147483647 "TeAP_e_InterfaceBSM_MAX" /end COMPU_VTAB
/begin COMPU_METHOD DT24_CVADAS_AP_CodGen_CM_TeAP_e_SPMLatCtrlReqSts "Enumerated data type: TeAP_e_SPMLatCtrlReqSts" TAB_VERB "%0.6" "" COMPU_TAB_REF VTAB_FOR_DT24_CVADAS_AP_CodGen_CM_TeAP_e_SPMLatCtrlReqSts /end COMPU_METHOD
/begin COMPU_VTAB VTAB_FOR_DT24_CVADAS_AP_CodGen_CM_TeAP_e_SPMLatCtrlReqSts "Enumerated data type: TeAP_e_SPMLatCtrlReqSts" TAB_VERB 4 0 "TeAP_e_SPMLatCtrlReqSts_Idle" 1 "TeAP_e_SPMLatCtrlReqSts_Faulted" 2 "TeAP_e_SPMLatCtrlReqSts_SPM_Request" 2147483647 "TeAP_e_SPMLatCtrlReqSts_MAX" /end COMPU_VTAB
/begin COMPU_METHOD DT24_CVADAS_AP_CodGen_CM_TeAP_e_PAMLedCtrlStatus "Enumerated data type: TeAP_e_PAMLedCtrlStatus" TAB_VERB "%0.6" "" COMPU_TAB_REF VTAB_FOR_DT24_CVADAS_AP_CodGen_CM_TeAP_e_PAMLedCtrlStatus /end COMPU_METHOD
/begin COMPU_VTAB VTAB_FOR_DT24_CVADAS_AP_CodGen_CM_TeAP_e_PAMLedCtrlStatus "Enumerated data type: TeAP_e_PAMLedCtrlStatus" TAB_VERB 5 0 "TeAP_e_PAMLedCtrlStatus_Off" 1 "TeAP_e_PAMLedCtrlStatus_ContinousLight" 2 "TeAP_e_PAMLedCtrlStatus_BlinkingLight" 3 "TeAP_e_PAMLedCtrlStatus_SNA" 2147483647 "TeAP_e_PAMLedCtrlStatus_MAX" /end COMPU_VTAB
/begin COMPU_METHOD DT24_CVADAS_AP_CodGen_CM_TeAP_e_SPMActvStat "Enumerated data type: TeAP_e_SPMActvStat" TAB_VERB "%0.6" "" COMPU_TAB_REF VTAB_FOR_DT24_CVADAS_AP_CodGen_CM_TeAP_e_SPMActvStat /end COMPU_METHOD
/begin COMPU_VTAB VTAB_FOR_DT24_CVADAS_AP_CodGen_CM_TeAP_e_SPMActvStat "Enumerated data type: TeAP_e_SPMActvStat" TAB_VERB 5 0 "TeAP_e_SPMActvStat_Not_Active" 1 "TeAP_e_SPMActvStat_Active_ParallelParking" 2 "TeAP_e_SPMActvStat_Active_PerpendicularParking" 3 "TeAP_e_SPMActvStat_Active_OutParking" 2147483647 "TeAP_e_SPMActvStat_MAX" /end COMPU_VTAB
/begin COMPU_METHOD DT24_CVADAS_AP_CodGen_CM_TeAP_e_DispView2 "Enumerated data type: TeAP_e_DispView2" TAB_VERB "%0.6" "" COMPU_TAB_REF VTAB_FOR_DT24_CVADAS_AP_CodGen_CM_TeAP_e_DispView2 /end COMPU_METHOD
/begin COMPU_VTAB VTAB_FOR_DT24_CVADAS_AP_CodGen_CM_TeAP_e_DispView2 "Enumerated data type: TeAP_e_DispView2" TAB_VERB 17 0 "TeAP_e_DispView2_OFF" 1 "TeAP_e_DispView2_VIEW_1" 2 "TeAP_e_DispView2_VIEW_2" 3 "TeAP_e_DispView2_VIEW_3" 4 "TeAP_e_DispView2_VIEW_4" 5 "TeAP_e_DispView2_VIEW_5" 6 "TeAP_e_DispView2_VIEW_6" 7 "TeAP_e_DispView2_VIEW_7" 8 "TeAP_e_DispView2_VIEW_8" 9 "TeAP_e_DispView2_VIEW_9" 10 "TeAP_e_DispView2_VIEW_10" 11 "TeAP_e_DispView2_VIEW_11" 12 "TeAP_e_DispView2_VIEW_12" 13 "TeAP_e_DispView2_VIEW_13" 14 "TeAP_e_DispView2_VIEW_14" 15 "TeAP_e_DispView2_VIEW_15" 2147483647 "TeAP_e_DispView2_MAX" /end COMPU_VTAB
/begin COMPU_METHOD DT24_CVADAS_AP_CodGen_CM_TeAP_e_GearShiftReq "Enumerated data type: TeAP_e_GearShiftReq" TAB_VERB "%0.6" "" COMPU_TAB_REF VTAB_FOR_DT24_CVADAS_AP_CodGen_CM_TeAP_e_GearShiftReq /end COMPU_METHOD
/begin COMPU_VTAB VTAB_FOR_DT24_CVADAS_AP_CodGen_CM_TeAP_e_GearShiftReq "Enumerated data type: TeAP_e_GearShiftReq" TAB_VERB 7 0 "TeAP_e_GearShiftReq_Idle" 1 "TeAP_e_GearShiftReq_P" 2 "TeAP_e_GearShiftReq_R" 3 "TeAP_e_GearShiftReq_N" 4 "TeAP_e_GearShiftReq_D" 7 "TeAP_e_GearShiftReq_SNA" 2147483647 "TeAP_e_GearShiftReq_MAX" /end COMPU_VTAB
/begin COMPU_METHOD DT24_CVADAS_AP_CodGen_CM_TeAP_e_PAMVolSig "Enumerated data type: TeAP_e_PAMVolSig" TAB_VERB "%0.6" "" COMPU_TAB_REF VTAB_FOR_DT24_CVADAS_AP_CodGen_CM_TeAP_e_PAMVolSig /end COMPU_METHOD
/begin COMPU_VTAB VTAB_FOR_DT24_CVADAS_AP_CodGen_CM_TeAP_e_PAMVolSig "Enumerated data type: TeAP_e_PAMVolSig" TAB_VERB 5 0 "TeAP_e_PAMVolSig_None" 1 "TeAP_e_PAMVolSig_Low" 2 "TeAP_e_PAMVolSig_Medium" 3 "TeAP_e_PAMVolSig_High" 2147483647 "TeAP_e_PAMVolSig_MAX" /end COMPU_VTAB
/begin COMPU_METHOD DT24_CVADAS_AP_CodGen_CM_TeAP_e_PAMChimeTyp "Enumerated data type: TeAP_e_PAMChimeTyp" TAB_VERB "%0.6" "" COMPU_TAB_REF VTAB_FOR_DT24_CVADAS_AP_CodGen_CM_TeAP_e_PAMChimeTyp /end COMPU_METHOD
/begin COMPU_VTAB VTAB_FOR_DT24_CVADAS_AP_CodGen_CM_TeAP_e_PAMChimeTyp "Enumerated data type: TeAP_e_PAMChimeTyp" TAB_VERB 17 0 "TeAP_e_PAMChimeTyp_None" 1 "TeAP_e_PAMChimeTyp_Type1" 2 "TeAP_e_PAMChimeTyp_Type2" 3 "TeAP_e_PAMChimeTyp_Type3" 4 "TeAP_e_PAMChimeTyp_Type4" 5 "TeAP_e_PAMChimeTyp_Type5" 6 "TeAP_e_PAMChimeTyp_Type6" 7 "TeAP_e_PAMChimeTyp_Type7" 8 "TeAP_e_PAMChimeTyp_Type8" 9 "TeAP_e_PAMChimeTyp_Type9" 10 "TeAP_e_PAMChimeTyp_Type10" 11 "TeAP_e_PAMChimeTyp_Type11" 12 "TeAP_e_PAMChimeTyp_Type12" 13 "TeAP_e_PAMChimeTyp_Type13" 14 "TeAP_e_PAMChimeTyp_Type14" 15 "TeAP_e_PAMChimeTyp_Type15" 2147483647 "TeAP_e_PAMChimeTyp_MAX" /end COMPU_VTAB
/begin COMPU_METHOD DT24_CVADAS_AP_CodGen_CM_TeAP_e_PAMChimeRepnRate "Enumerated data type: TeAP_e_PAMChimeRepnRate" TAB_VERB "%0.6" "" COMPU_TAB_REF VTAB_FOR_DT24_CVADAS_AP_CodGen_CM_TeAP_e_PAMChimeRepnRate /end COMPU_METHOD
/begin COMPU_VTAB VTAB_FOR_DT24_CVADAS_AP_CodGen_CM_TeAP_e_PAMChimeRepnRate "Enumerated data type: TeAP_e_PAMChimeRepnRate" TAB_VERB 6 0 "TeAP_e_PAMChimeRepnRate_Continous_0_Hz" 2 "TeAP_e_PAMChimeRepnRate_Slow_2_Hz" 3 "TeAP_e_PAMChimeRepnRate_Slow_3_Hz" 4 "TeAP_e_PAMChimeRepnRate_Fast_4_Hz" 5 "TeAP_e_PAMChimeRepnRate_Fast_5_Hz" 2147483647 "TeAP_e_PAMChimeRepnRate_MAX" /end COMPU_VTAB
/begin COMPU_METHOD DT24_CVADAS_AP_CodGen_CM_TeAP_e_SteerRatRackPinionTyp "Enumerated data type: TeAP_e_SteerRatRackPinionTyp" TAB_VERB "%0.6" "" COMPU_TAB_REF VTAB_FOR_DT24_CVADAS_AP_CodGen_CM_TeAP_e_SteerRatRackPinionTyp /end COMPU_METHOD
/begin COMPU_VTAB VTAB_FOR_DT24_CVADAS_AP_CodGen_CM_TeAP_e_SteerRatRackPinionTyp "Enumerated data type: TeAP_e_SteerRatRackPinionTyp" TAB_VERB 3 0 "TeAP_e_SteerRatRackPinionTyp_Type_1" 1 "TeAP_e_SteerRatRackPinionTyp_Type_2" 2 "TeAP_e_SteerRatRackPinionTyp_Type_3" /end COMPU_VTAB
/begin COMPU_METHOD DT24_CVADAS_AP_CodGen_CM_TeAP_e_DrvTypVrnt "Enumerated data type: TeAP_e_DrvTypVrnt" TAB_VERB "%0.6" "" COMPU_TAB_REF VTAB_FOR_DT24_CVADAS_AP_CodGen_CM_TeAP_e_DrvTypVrnt /end COMPU_METHOD
/begin COMPU_VTAB VTAB_FOR_DT24_CVADAS_AP_CodGen_CM_TeAP_e_DrvTypVrnt "Enumerated data type: TeAP_e_DrvTypVrnt" TAB_VERB 5 0 "TeAP_e_DrvTypVrnt_FWD" 1 "TeAP_e_DrvTypVrnt_RWD" 2 "TeAP_e_DrvTypVrnt_Single_Speed_AWD" 3 "TeAP_e_DrvTypVrnt_Double_Speed_4WD" 4 "TeAP_e_DrvTypVrnt_Double_Speed_4WDwith_ELSD" /end COMPU_VTAB
/begin COMPU_METHOD DT24_CVADAS_AP_CodGen_CM_TeAP_e_GbTyp "Enumerated data type: TeAP_e_GbTyp" TAB_VERB "%0.6" "" COMPU_TAB_REF VTAB_FOR_DT24_CVADAS_AP_CodGen_CM_TeAP_e_GbTyp /end COMPU_METHOD
/begin COMPU_VTAB VTAB_FOR_DT24_CVADAS_AP_CodGen_CM_TeAP_e_GbTyp "Enumerated data type: TeAP_e_GbTyp" TAB_VERB 5 0 "TeAP_e_GbTyp_Not_Valid" 1 "TeAP_e_GbTyp_MTX" 2 "TeAP_e_GbTyp_MTA" 3 "TeAP_e_GbTyp_DDCT" 4 "TeAP_e_GbTyp_ATX" /end COMPU_VTAB
/begin COMPU_METHOD DT24_CVADAS_AP_CodGen_CM_TeAP_e_PAMTunSet "Enumerated data type: TeAP_e_PAMTunSet" TAB_VERB "%0.6" "" COMPU_TAB_REF VTAB_FOR_DT24_CVADAS_AP_CodGen_CM_TeAP_e_PAMTunSet /end COMPU_METHOD
/begin COMPU_VTAB VTAB_FOR_DT24_CVADAS_AP_CodGen_CM_TeAP_e_PAMTunSet "Enumerated data type: TeAP_e_PAMTunSet" TAB_VERB 5 0 "TeAP_e_PAMTunSet_None" 1 "TeAP_e_PAMTunSet_Base" 2 "TeAP_e_PAMTunSet_Rebel" 3 "TeAP_e_PAMTunSet_TRX" 4 "TeAP_e_PAMTunSet_Tungsten" /end COMPU_VTAB
/begin COMPU_METHOD DT24_CVADAS_AP_CodGen_CM_TeAP_e_CtryCod "Enumerated data type: TeAP_e_CtryCod" TAB_VERB "%0.6" "" COMPU_TAB_REF VTAB_FOR_DT24_CVADAS_AP_CodGen_CM_TeAP_e_CtryCod /end COMPU_METHOD
/begin COMPU_VTAB VTAB_FOR_DT24_CVADAS_AP_CodGen_CM_TeAP_e_CtryCod "Enumerated data type: TeAP_e_CtryCod" TAB_VERB 14 0 "TeAP_e_CtryCod_World" 2 "TeAP_e_CtryCod_USA" 4 "TeAP_e_CtryCod_Canada" 14 "TeAP_e_CtryCod_Mexico" 18 "TeAP_e_CtryCod_Bahrain" 97 "TeAP_e_CtryCod_Iraq" 104 "TeAP_e_CtryCod_Jordan" 108 "TeAP_e_CtryCod_Kuwait" 112 "TeAP_e_CtryCod_Lebanon" 149 "TeAP_e_CtryCod_Oman" 160 "TeAP_e_CtryCod_Qatar" 165 "TeAP_e_CtryCod_Saudi_Arabia" 204 "TeAP_e_CtryCod_UAE" 215 "TeAP_e_CtryCod_Yemen" /end COMPU_VTAB
/begin COMPU_METHOD DT24_CVADAS_AP_CodGen_CM_TeAP_e_HybTyp "Enumerated data type: TeAP_e_HybTyp" TAB_VERB "%0.6" "" COMPU_TAB_REF VTAB_FOR_DT24_CVADAS_AP_CodGen_CM_TeAP_e_HybTyp /end COMPU_METHOD
/begin COMPU_VTAB VTAB_FOR_DT24_CVADAS_AP_CodGen_CM_TeAP_e_HybTyp "Enumerated data type: TeAP_e_HybTyp" TAB_VERB 6 0 "TeAP_e_HybTyp_Not_Applicable" 1 "TeAP_e_HybTyp_Battery_Electric_Vehicle" 2 "TeAP_e_HybTyp_Hybrid_Electric_Vehicle" 3 "TeAP_e_HybTyp_Plugin_Hybrid_Electric_Vehicle" 4 "TeAP_e_HybTyp_Belt48V_Start_Generator" 5 "TeAP_e_HybTyp_Belt12V_Start_Generator" /end COMPU_VTAB
/begin COMPU_METHOD DT24_CVADAS_AP_CodGen_CM_TeAP_e_WhlBas "Enumerated data type: TeAP_e_WhlBas" TAB_VERB "%0.6" "" COMPU_TAB_REF VTAB_FOR_DT24_CVADAS_AP_CodGen_CM_TeAP_e_WhlBas /end COMPU_METHOD
/begin COMPU_VTAB VTAB_FOR_DT24_CVADAS_AP_CodGen_CM_TeAP_e_WhlBas "Enumerated data type: TeAP_e_WhlBas" TAB_VERB 3 0 "TeAP_e_WhlBas_Type_1" 1 "TeAP_e_WhlBas_Type_2" 2 "TeAP_e_WhlBas_Type_3" /end COMPU_VTAB
/begin COMPU_METHOD DT24_CVADAS_AP_CodGen_CM_TeAP_e_RadioDispTyp "Enumerated data type: TeAP_e_RadioDispTyp" TAB_VERB "%0.6" "" COMPU_TAB_REF VTAB_FOR_DT24_CVADAS_AP_CodGen_CM_TeAP_e_RadioDispTyp /end COMPU_METHOD
/begin COMPU_VTAB VTAB_FOR_DT24_CVADAS_AP_CodGen_CM_TeAP_e_RadioDispTyp "Enumerated data type: TeAP_e_RadioDispTyp" TAB_VERB 10 0 "TeAP_e_RadioDispTyp_Type_0" 1 "TeAP_e_RadioDispTyp_Type_1" 2 "TeAP_e_RadioDispTyp_Type_2" 3 "TeAP_e_RadioDispTyp_Type_3" 4 "TeAP_e_RadioDispTyp_Type_4" 5 "TeAP_e_RadioDispTyp_Type_5" 6 "TeAP_e_RadioDispTyp_Type_6" 7 "TeAP_e_RadioDispTyp_Type_7" 8 "TeAP_e_RadioDispTyp_Type_8" 9 "TeAP_e_RadioDispTyp_Type_9" /end COMPU_VTAB
/begin COMPU_METHOD DT24_CVADAS_AP_CodGen_CM_int32 "Q = V" RAT_FUNC "%10.0" "" COEFFS 0 1 0 0 0 1 /end COMPU_METHOD
/begin COMPU_METHOD DT24_CVADAS_AP_CodGen_CM_TeAP_e_Alert "Enumerated data type: TeAP_e_Alert" TAB_VERB "%0.6" "" COMPU_TAB_REF VTAB_FOR_DT24_CVADAS_AP_CodGen_CM_TeAP_e_Alert /end COMPU_METHOD
/begin COMPU_VTAB VTAB_FOR_DT24_CVADAS_AP_CodGen_CM_TeAP_e_Alert "Enumerated data type: TeAP_e_Alert" TAB_VERB 8 0 "TeAP_e_Alert_NoObjectDetected" 1 "TeAP_e_Alert_Arc1" 2 "TeAP_e_Alert_Arc2" 3 "TeAP_e_Alert_Arc3" 4 "TeAP_e_Alert_Arc4" 5 "TeAP_e_Alert_Arc5" 6 "TeAP_e_Alert_Arc6" 7 "TeAP_e_Alert_SNA" /end COMPU_VTAB
/begin COMPU_METHOD DT24_CVADAS_AP_CodGen_CM_TeAP_e_GraphicFlshRate "Enumerated data type: TeAP_e_GraphicFlshRate" TAB_VERB "%0.6" "" COMPU_TAB_REF VTAB_FOR_DT24_CVADAS_AP_CodGen_CM_TeAP_e_GraphicFlshRate /end COMPU_METHOD
/begin COMPU_VTAB VTAB_FOR_DT24_CVADAS_AP_CodGen_CM_TeAP_e_GraphicFlshRate "Enumerated data type: TeAP_e_GraphicFlshRate" TAB_VERB 5 0 "TeAP_e_GraphicFlshRate_SlowFlash" 1 "TeAP_e_GraphicFlshRate_Solid" 2 "TeAP_e_GraphicFlshRate_None" 3 "TeAP_e_GraphicFlshRate_SNA" 2147483647 "TeAP_e_GraphicFlshRate_MAX" /end COMPU_VTAB
/begin COMPU_METHOD DT24_CVADAS_AP_CodGen_CM_TeAP_e_PAMVolume "Enumerated data type: TeAP_e_PAMVolume" TAB_VERB "%0.6" "" COMPU_TAB_REF VTAB_FOR_DT24_CVADAS_AP_CodGen_CM_TeAP_e_PAMVolume /end COMPU_METHOD
/begin COMPU_VTAB VTAB_FOR_DT24_CVADAS_AP_CodGen_CM_TeAP_e_PAMVolume "Enumerated data type: TeAP_e_PAMVolume" TAB_VERB 5 0 "TeAP_e_PAMVolume_None" 1 "TeAP_e_PAMVolume_Low" 2 "TeAP_e_PAMVolume_Medium" 3 "TeAP_e_PAMVolume_High" 2147483647 "TeAP_e_PAMVolume_MAX" /end COMPU_VTAB
/begin COMPU_METHOD DT24_CVADAS_AP_CodGen_CM_TeAP_e_PAMPopUpReq "Enumerated data type: TeAP_e_PAMPopUpReq" TAB_VERB "%0.6" "" COMPU_TAB_REF VTAB_FOR_DT24_CVADAS_AP_CodGen_CM_TeAP_e_PAMPopUpReq /end COMPU_METHOD
/begin COMPU_VTAB VTAB_FOR_DT24_CVADAS_AP_CodGen_CM_TeAP_e_PAMPopUpReq "Enumerated data type: TeAP_e_PAMPopUpReq" TAB_VERB 103 0 "TeAP_e_PAMPopUpReq_TM0" 1 "TeAP_e_PAMPopUpReq_TM1" 2 "TeAP_e_PAMPopUpReq_TM2" 3 "TeAP_e_PAMPopUpReq_TM3" 4 "TeAP_e_PAMPopUpReq_TM4" 5 "TeAP_e_PAMPopUpReq_TM5" 6 "TeAP_e_PAMPopUpReq_TM6" 7 "TeAP_e_PAMPopUpReq_TM7" 8 "TeAP_e_PAMPopUpReq_TM8" 9 "TeAP_e_PAMPopUpReq_TM9" 10 "TeAP_e_PAMPopUpReq_TM10" 11 "TeAP_e_PAMPopUpReq_TM11" 12 "TeAP_e_PAMPopUpReq_TM12" 13 "TeAP_e_PAMPopUpReq_TM13" 14 "TeAP_e_PAMPopUpReq_TM14" 15 "TeAP_e_PAMPopUpReq_TM15" 16 "TeAP_e_PAMPopUpReq_TM16" 17 "TeAP_e_PAMPopUpReq_TM17" 18 "TeAP_e_PAMPopUpReq_TM18" 19 "TeAP_e_PAMPopUpReq_TM19" 20 "TeAP_e_PAMPopUpReq_TM20" 21 "TeAP_e_PAMPopUpReq_TM21" 22 "TeAP_e_PAMPopUpReq_TM22" 23 "TeAP_e_PAMPopUpReq_TM23" 24 "TeAP_e_PAMPopUpReq_TM24" 25 "TeAP_e_PAMPopUpReq_TM25" 26 "TeAP_e_PAMPopUpReq_TM26" 27 "TeAP_e_PAMPopUpReq_TM27" 28 "TeAP_e_PAMPopUpReq_TM28" 29 "TeAP_e_PAMPopUpReq_TM29" 30 "TeAP_e_PAMPopUpReq_TM30" 31 "TeAP_e_PAMPopUpReq_TM31" 32 "TeAP_e_PAMPopUpReq_TM32" 33 "TeAP_e_PAMPopUpReq_TM33" 34 "TeAP_e_PAMPopUpReq_TM34" 35 "TeAP_e_PAMPopUpReq_TM35" 36 "TeAP_e_PAMPopUpReq_TM36" 37 "TeAP_e_PAMPopUpReq_TM37" 38 "TeAP_e_PAMPopUpReq_TM38" 39 "TeAP_e_PAMPopUpReq_TM39" 40 "TeAP_e_PAMPopUpReq_TM40" 41 "TeAP_e_PAMPopUpReq_TM41" 42 "TeAP_e_PAMPopUpReq_TM42" 43 "TeAP_e_PAMPopUpReq_TM43" 44 "TeAP_e_PAMPopUpReq_TM44" 45 "TeAP_e_PAMPopUpReq_TM45" 46 "TeAP_e_PAMPopUpReq_TM46" 47 "TeAP_e_PAMPopUpReq_TM47" 48 "TeAP_e_PAMPopUpReq_TM48" 49 "TeAP_e_PAMPopUpReq_TM49" 50 "TeAP_e_PAMPopUpReq_TM50" 51 "TeAP_e_PAMPopUpReq_TM51" 52 "TeAP_e_PAMPopUpReq_TM52" 53 "TeAP_e_PAMPopUpReq_TM53" 54 "TeAP_e_PAMPopUpReq_TM54" 55 "TeAP_e_PAMPopUpReq_TM55" 56 "TeAP_e_PAMPopUpReq_TM56" 57 "TeAP_e_PAMPopUpReq_TM57" 58 "TeAP_e_PAMPopUpReq_TM58" 59 "TeAP_e_PAMPopUpReq_TM59" 60 "TeAP_e_PAMPopUpReq_TM60" 61 "TeAP_e_PAMPopUpReq_TM61" 62 "TeAP_e_PAMPopUpReq_TM62" 63 "TeAP_e_PAMPopUpReq_TM63" 64 "TeAP_e_PAMPopUpReq_TM64" 65 "TeAP_e_PAMPopUpReq_TM65" 66 "TeAP_e_PAMPopUpReq_TM66" 67 "TeAP_e_PAMPopUpReq_TM67" 68 "TeAP_e_PAMPopUpReq_TM68" 69 "TeAP_e_PAMPopUpReq_TM69" 70 "TeAP_e_PAMPopUpReq_TM70" 71 "TeAP_e_PAMPopUpReq_TM71" 72 "TeAP_e_PAMPopUpReq_TM72" 73 "TeAP_e_PAMPopUpReq_TM73" 74 "TeAP_e_PAMPopUpReq_TM74" 75 "TeAP_e_PAMPopUpReq_TM75" 76 "TeAP_e_PAMPopUpReq_TM76" 77 "TeAP_e_PAMPopUpReq_TM77" 78 "TeAP_e_PAMPopUpReq_TM78" 79 "TeAP_e_PAMPopUpReq_TM79" 80 "TeAP_e_PAMPopUpReq_TM80" 81 "TeAP_e_PAMPopUpReq_TM81" 82 "TeAP_e_PAMPopUpReq_TM82" 83 "TeAP_e_PAMPopUpReq_TM83" 84 "TeAP_e_PAMPopUpReq_TM84" 85 "TeAP_e_PAMPopUpReq_TM85" 86 "TeAP_e_PAMPopUpReq_TM86" 87 "TeAP_e_PAMPopUpReq_TM87" 88 "TeAP_e_PAMPopUpReq_TM88" 89 "TeAP_e_PAMPopUpReq_TM89" 90 "TeAP_e_PAMPopUpReq_TM90" 91 "TeAP_e_PAMPopUpReq_TM91" 92 "TeAP_e_PAMPopUpReq_TM92" 93 "TeAP_e_PAMPopUpReq_TM93" 94 "TeAP_e_PAMPopUpReq_TM94" 95 "TeAP_e_PAMPopUpReq_TM95" 96 "TeAP_e_PAMPopUpReq_TM96" 97 "TeAP_e_PAMPopUpReq_TM97" 98 "TeAP_e_PAMPopUpReq_TM98" 99 "TeAP_e_PAMPopUpReq_TM99" 100 "TeAP_e_PAMPopUpReq_TM100" 255 "TeAP_e_PAMPopUpReq_SNA" 2147483647 "TeAP_e_PAMPopUpReq_MAX" /end COMPU_VTAB
/begin COMPU_METHOD DT24_CVADAS_AP_CodGen_CM_TeAP_e_PAMSystemFault "Enumerated data type: TeAP_e_PAMSystemFault" TAB_VERB "%0.6" "" COMPU_TAB_REF VTAB_FOR_DT24_CVADAS_AP_CodGen_CM_TeAP_e_PAMSystemFault /end COMPU_METHOD
/begin COMPU_VTAB VTAB_FOR_DT24_CVADAS_AP_CodGen_CM_TeAP_e_PAMSystemFault "Enumerated data type: TeAP_e_PAMSystemFault" TAB_VERB 5 0 "TeAP_e_PAMSystemFault_False" 1 "TeAP_e_PAMSystemFault_TemporaryFailure" 2 "TeAP_e_PAMSystemFault_ExternalFailure" 3 "TeAP_e_PAMSystemFault_SystemFailure" 2147483647 "TeAP_e_PAMSystemFault_MAX" /end COMPU_VTAB
/begin COMPU_METHOD DT24_CVADAS_AP_CodGen_CM_TeAP_e_PAMOffStatus2BT "Enumerated data type: TeAP_e_PAMOffStatus2BT" TAB_VERB "%0.6" "" COMPU_TAB_REF VTAB_FOR_DT24_CVADAS_AP_CodGen_CM_TeAP_e_PAMOffStatus2BT /end COMPU_METHOD
/begin COMPU_VTAB VTAB_FOR_DT24_CVADAS_AP_CodGen_CM_TeAP_e_PAMOffStatus2BT "Enumerated data type: TeAP_e_PAMOffStatus2BT" TAB_VERB 5 0 "TeAP_e_PAMOffStatus2BT_FT_OFF_RR_OFF" 1 "TeAP_e_PAMOffStatus2BT_FT_OFF_RR_ON" 2 "TeAP_e_PAMOffStatus2BT_FT_ON_RR_OFF" 3 "TeAP_e_PAMOffStatus2BT_FT_ON_RR_ON" 2147483647 "TeAP_e_PAMOffStatus2BT_MAX" /end COMPU_VTAB
/begin COMPU_METHOD DT24_CVADAS_AP_CodGen_CM_TeAP_e_FrntSnsrStatus "Enumerated data type: TeAP_e_FrntSnsrStatus" TAB_VERB "%0.6" "" COMPU_TAB_REF VTAB_FOR_DT24_CVADAS_AP_CodGen_CM_TeAP_e_FrntSnsrStatus /end COMPU_METHOD
/begin COMPU_VTAB VTAB_FOR_DT24_CVADAS_AP_CodGen_CM_TeAP_e_FrntSnsrStatus "Enumerated data type: TeAP_e_FrntSnsrStatus" TAB_VERB 5 0 "TeAP_e_FrntSnsrStatus_Active" 1 "TeAP_e_FrntSnsrStatus_NotActive_Blocked" 2 "TeAP_e_FrntSnsrStatus_NotActive_Failure" 3 "TeAP_e_FrntSnsrStatus_SNA" 2147483647 "TeAP_e_FrntSnsrStatus_MAX" /end COMPU_VTAB
/begin COMPU_METHOD DT24_CVADAS_AP_CodGen_CM_TeAP_e_RearSnsrStatus "Enumerated data type: TeAP_e_RearSnsrStatus" TAB_VERB "%0.6" "" COMPU_TAB_REF VTAB_FOR_DT24_CVADAS_AP_CodGen_CM_TeAP_e_RearSnsrStatus /end COMPU_METHOD
/begin COMPU_VTAB VTAB_FOR_DT24_CVADAS_AP_CodGen_CM_TeAP_e_RearSnsrStatus "Enumerated data type: TeAP_e_RearSnsrStatus" TAB_VERB 5 0 "TeAP_e_RearSnsrStatus_Active" 1 "TeAP_e_RearSnsrStatus_NotActive_Blocked" 2 "TeAP_e_RearSnsrStatus_NotActive_Failure" 3 "TeAP_e_RearSnsrStatus_SNA" 2147483647 "TeAP_e_RearSnsrStatus_MAX" /end COMPU_VTAB
/begin COMPU_METHOD DT24_CVADAS_AP_CodGen_CM_TeHMI_e_UsrParkOutSide "Enumerated data type: TeHMI_e_UsrParkOutSide" TAB_VERB "%0.6" "" COMPU_TAB_REF VTAB_FOR_DT24_CVADAS_AP_CodGen_CM_TeHMI_e_UsrParkOutSide /end COMPU_METHOD
/begin COMPU_VTAB VTAB_FOR_DT24_CVADAS_AP_CodGen_CM_TeHMI_e_UsrParkOutSide "Enumerated data type: TeHMI_e_UsrParkOutSide" TAB_VERB 3 0 "TeHMI_e_UsrParkOutSide_None" 1 "TeHMI_e_UsrParkOutSide_Left" 2 "TeHMI_e_UsrParkOutSide_Right" /end COMPU_VTAB
/begin COMPU_METHOD DT24_CVADAS_AP_CodGen_CM_TeAutoPark_e_ParkStyle "Enumerated data type: TeAutoPark_e_ParkStyle" TAB_VERB "%0.6" "" COMPU_TAB_REF VTAB_FOR_DT24_CVADAS_AP_CodGen_CM_TeAutoPark_e_ParkStyle /end COMPU_METHOD
/begin COMPU_VTAB VTAB_FOR_DT24_CVADAS_AP_CodGen_CM_TeAutoPark_e_ParkStyle "Enumerated data type: TeAutoPark_e_ParkStyle" TAB_VERB 4 0 "TeAutoPark_e_ParkStyle_None" 1 "TeAutoPark_e_ParkStyle_Rear_In" 2 "TeAutoPark_e_ParkStyle_Front_In" 2147483647 "TeAutoPark_e_ParkStyle_MAX" /end COMPU_VTAB
/begin COMPU_METHOD DT24_CVADAS_AP_CodGen_CM_TeAP_e_UsrPPPAManeuverSel "Enumerated data type: TeAP_e_UsrPPPAManeuverSel" TAB_VERB "%0.6" "" COMPU_TAB_REF VTAB_FOR_DT24_CVADAS_AP_CodGen_CM_TeAP_e_UsrPPPAManeuverSel /end COMPU_METHOD
/begin COMPU_VTAB VTAB_FOR_DT24_CVADAS_AP_CodGen_CM_TeAP_e_UsrPPPAManeuverSel "Enumerated data type: TeAP_e_UsrPPPAManeuverSel" TAB_VERB 4 0 "TeAP_e_UsrPPPAManeuverSel_None" 1 "TeAP_e_UsrPPPAManeuverSel_ParkIn" 2 "TeAP_e_UsrPPPAManeuverSel_ParkExit" 2147483647 "TeAP_e_UsrPPPAManeuverSel_MAX" /end COMPU_VTAB
/begin GROUP DT24_CVADAS_AP_CodGen "DT24_CVADAS_AP_CodGen" /* Root */ ROOT
 /begin SUB_GROUP Root_Input_Adapter Root_Output_Adapter mr_grp2link_DT24_CVADAS_AutoPark_Func /end SUB_GROUP
 /begin REF_MEASUREMENT MaAP_m_ParkSpot1FrntStreetX MaAP_m_ParkSpot1FrntStreetY MaAP_m_ParkSpot2FrntBorderX MaAP_m_ParkSpot2FrntBorderY MaAP_m_ParkSpot3RearBorderX MaAP_m_ParkSpot3RearBorderY MaAP_m_ParkSpot4RearStreetX MaAP_m_ParkSpot4RearStreetY MeAP_b_FPASwtStatus MeAP_b_RPASwtStatus MeAP_b_ResetKM MeAP_e_AutoParkStatus MeAutoPark_e_AlgoState /end REF_MEASUREMENT
/end GROUP
/begin GROUP Root_Input_Adapter "DT24_CVADAS_AP_CodGen/Input_Adapter"
 /begin SUB_GROUP S3_DevlopmentTest1 S3_FID_InputProcessing1 S3_FPA_InputProcessing S3_HMI_InputProcessing S3_Inputs_Signal_Processing_VC S3_KM_InputProcessing S3_ObjectMinDistanceCalculator S3_ParkManoeuvreObjDet S3_ProxyParam_InputProcessing S3_Subsystem6 S3_VCAN_InputPreProcessing S3_VCAN_InputProcessing S3_VrntTunParam /end SUB_GROUP
 /begin REF_CHARACTERISTIC KePA_b_EnbAppBlckg /end REF_CHARACTERISTIC
/end GROUP
/begin GROUP Root_Output_Adapter "DT24_CVADAS_AP_CodGen/Output_Adapter"
 /begin SUB_GROUP S5_OutputAdapter_APSM S5_Output_Adapter_APA S5_Output_Adapter_VC /end SUB_GROUP
/end GROUP
/begin GROUP S3_DevlopmentTest1 "DT24_CVADAS_AP_CodGen/Input_Adapter/DevlopmentTest1" /begin REF_CHARACTERISTIC KeAP_b_DevlopmentTest KeHMI_e_ParkStyleTest /end REF_CHARACTERISTIC /end GROUP
/begin GROUP S3_FID_InputProcessing1 "DT24_CVADAS_AP_CodGen/Input_Adapter/FID_InputProcessing1" /begin SUB_GROUP S8_Subsystem /end SUB_GROUP
 /begin REF_MEASUREMENT MeAP_b_ExternalFail MeAP_b_FPAVolDefMed MeAP_b_FrntSenorBlock MeAP_b_FrntSenorFail MeAP_b_PARBActv4LOW MeAP_b_PARBActvTrlr_27 MeAP_b_PARBActvTrlr_29 MeAP_b_PARBDiable MeAP_b_PAVolDefMed MeAP_b_PPPAActv4LOW MeAP_b_PPPAActvTrlr MeAP_b_PPPADefEng MeAP_b_PPPADisable MeAP_b_RPAActvTrlr_27 MeAP_b_RPAActvTrlr_29 MeAP_b_RPAVolDefMed MeAP_b_RearSenorBlock MeAP_b_RearSenorFail MeAP_b_SystemFail /end REF_MEASUREMENT
/end GROUP
/begin GROUP S3_FPA_InputProcessing "DT24_CVADAS_AP_CodGen/Input_Adapter/FPA_InputProcessing" /begin REF_CHARACTERISTIC KeAP_b_DevlopmentTest /end REF_CHARACTERISTIC /end GROUP
/begin GROUP S3_HMI_InputProcessing "DT24_CVADAS_AP_CodGen/Input_Adapter/HMI_InputProcessing"
 /begin REF_MEASUREMENT IeHMI_b_BackBtnPsd IeHMI_b_HMIHandshake IeHMI_b_UsrSlotSelStatus IeHMI_e_ParkStyle IeHMI_e_UsrPPPAManeuverSel IeHMI_e_UsrParkOutSideSel /end REF_MEASUREMENT
/end GROUP
/begin GROUP S3_Inputs_Signal_Processing_VC "DT24_CVADAS_AP_CodGen/Input_Adapter/Inputs_Signal_Processing_VC" /begin REF_MEASUREMENT DS_ANGLE MeAP_b_ObjInPath /end REF_MEASUREMENT /end GROUP
/begin GROUP S3_KM_InputProcessing "DT24_CVADAS_AP_CodGen/Input_Adapter/KM_InputProcessing" /begin REF_CHARACTERISTIC KeAP_sec_SampleTime /end REF_CHARACTERISTIC /begin REF_MEASUREMENT dx_cm /end REF_MEASUREMENT /end GROUP
/begin GROUP S3_ObjectMinDistanceCalculator "DT24_CVADAS_AP_CodGen/Input_Adapter/ObjectMinDistanceCalculator" /begin SUB_GROUP S15_CalcMinDistance S15_StandstillTimer /end SUB_GROUP /end GROUP
/begin GROUP S3_ParkManoeuvreObjDet "DT24_CVADAS_AP_CodGen/Input_Adapter/ParkManoeuvreObjDet" /begin REF_CHARACTERISTIC KeAP_cm_ObjPrestFCDistThd KeAP_cm_ObjPrestRCDistThd /end REF_CHARACTERISTIC /end GROUP
/begin GROUP S3_ProxyParam_InputProcessing "DT24_CVADAS_AP_CodGen/Input_Adapter/ProxyParam_InputProcessing" /begin SUB_GROUP MbNVM_ProxyParam /end SUB_GROUP /end GROUP
/begin GROUP S3_Subsystem6 "DT24_CVADAS_AP_CodGen/Input_Adapter/Subsystem6" /begin SUB_GROUP S19_Subsystem S19_TimerForVehKey /end SUB_GROUP /begin REF_CHARACTERISTIC KeAP_b_EnFeatForceNoiseMode /end REF_CHARACTERISTIC /begin REF_MEASUREMENT IeAP_b_DisForceNoiseMode /end REF_MEASUREMENT /end GROUP
/begin GROUP S3_VCAN_InputPreProcessing "DT24_CVADAS_AP_CodGen/Input_Adapter/VCAN_InputPreProcessing" /begin REF_MEASUREMENT DS_WheelSpeed_RL DS_WheelSpeed_RR /end REF_MEASUREMENT /end GROUP
/begin GROUP S3_VCAN_InputProcessing "DT24_CVADAS_AP_CodGen/Input_Adapter/VCAN_InputProcessing" /begin SUB_GROUP S24_TargetGearFiltering /end SUB_GROUP /end GROUP
/begin GROUP S3_VrntTunParam "DT24_CVADAS_AP_CodGen/Input_Adapter/VrntTunParam" /begin SUB_GROUP IbAP_InputVrntTunParam /end SUB_GROUP
 /begin REF_CHARACTERISTIC K_Overlap_Thrsld_RAEB K_e_RAEB_VehicleWidth KeAP_Cnt_GearFiltTimeThd KeAP_Cnt_GearOverrideTimeThd KeAP_b_AutoParkEn KeAP_b_DevlopmentTest KeAP_b_FPAEn KeAP_b_FullAutoPark KeAP_b_HookConnected KeAP_b_RPAwithBrk KeAP_b_RPAwithSurroundView KeAP_b_SteerOnlyAutoPark KeAP_cm_DistZone1 KeAP_cm_DistZone2 KeAP_cm_DistZone3 KeAP_cm_DistZone4 KeAP_cm_DistZone5 KeAP_cm_DistZone6 KeAP_cm_FrntLongDistAdj KeAP_cm_HalfVehicleWidth KeAP_cm_HookDistOffset KeAP_cm_MaxNoObjDetctDist KeAP_cm_ObjPrestFCDistThd KeAP_cm_ObjPrestRCDistThd KeAP_cm_RearLongDistAdj KeAP_cm_VehContour_FIL_x KeAP_cm_VehContour_FIL_y KeAP_cm_VehContour_FIR_x KeAP_cm_VehContour_FIR_y KeAP_cm_VehContour_FOL_x KeAP_cm_VehContour_FOL_y KeAP_cm_VehContour_FOR_x KeAP_cm_VehContour_FOR_y KeAP_cm_VehContour_FSL_x KeAP_cm_VehContour_FSL_y KeAP_cm_VehContour_FSR_x KeAP_cm_VehContour_FSR_y KeAP_cm_VehContour_RIL_x KeAP_cm_VehContour_RIL_y KeAP_cm_VehContour_RIR_x KeAP_cm_VehContour_RIR_y KeAP_cm_VehContour_ROL_x KeAP_cm_VehContour_ROL_y KeAP_cm_VehContour_ROR_x KeAP_cm_VehContour_ROR_y KeAP_cm_VehContour_RSL_x KeAP_cm_VehContour_RSL_y KeAP_cm_VehContour_RSR_x KeAP_cm_VehContour_RSR_y KeAP_cm_VehicleWidth KeAP_cm_WarnOffset KeAP_cnt_ChimeVolChgAlert KeAP_cnt_DebounceTimeThd KeAP_cnt_FrntChimeDisTimeThd KeAP_cnt_HalfSecChimeAlert KeAP_cnt_LEDBlinkTimeThd KeAP_cnt_SPMBlinkLEDDur KeAP_cnt_SwtStuckTimeThd KeAP_cnt_TimeStep KeAP_cnt_VehKeyOnTimeThd KeAP_degC_OperatingTempThd KeAP_e_GbTypAT KeAP_k_BrakeIGain KeAP_k_BrakeLowerLimit KeAP_k_BrakePGain KeAP_k_BrakeUpperLimit KeAP_k_CtrlOutCollDetActivate KeAP_k_CtrlOutCollDetCollDistLimit KeAP_k_CtrlOutCollDetRedStopVal KeAP_k_CtrlOutGearDrive KeAP_k_CtrlOutGearPark KeAP_k_CtrlOutGearReverse KeAP_k_CtrlOutRemainDistNA KeAP_k_CtrlOutVehSpdMaxSpotSteer KeAP_k_CtrlOutVehSpdMaxSpotStrRackDevThd KeAP_k_CtrlOutVehSpdMaxSpotStrTime KeAP_k_DetWP_PreviewTime KeAP_k_LatHeadDevDGain KeAP_k_LatHeadDevIGain KeAP_k_LatHeadDevPGain KeAP_k_LatPathDevDGain KeAP_k_LatPathDevIGain KeAP_k_LatPathDevPGain KeAP_k_PathSepaMinSpd KeAP_k_PathSepaSpdRampGrd KeAP_k_SteerLowerLimit KeAP_k_SteerUpperLimit KeAP_k_WhlCircum KeAP_kph_EnblHysThd KeAP_kph_FrntWarnMaxSpdThd KeAP_kph_PSDOffThd KeAP_kph_PSDOnThd KeAP_kph_ParkMnvThd KeAP_kph_RearWarnMaxSpdThd KeAP_pct_ObjConfidenceThd KeAP_s_BSMInterfaceCntTimeout KeAP_s_BSMInterfaceCntTimeoutTest KeAP_s_CamHandshakeDur KeAP_s_CamHandshakeDurTest KeAP_s_EPSInterfaceCntTimeout KeAP_s_EPSInterfaceCntTimeoutTest KeAP_s_GearShiftWaitCntTimeout KeAP_s_MaxStandstillTimeThd KeAP_s_ObjInPathTimeoutDur KeAP_s_PausedPressBtnTimeoutDur KeCMbB_b_EnblOncObjDbnc KeTOS_s_InTurnDbncTm KeTOS_s_StrDrvDbncTm KeTOS_s_TurnExitDbncTm KeTOS_x_InTurnThd KeTOS_x_TurnExitThd Obj_DistTable Overlap_Thrsld_Switch RAEB_Envelope_Offset RAEB_Lateral_Distance_Notification RAEB_Minimum_Object_Heigh Reverse_Gr_num Steering_Angle_DeadZone_End Steering_Angle_DeadZone_Start Straight_Driving_Thresold_rads2 keInpAdptr_e_StWhOffset keVehParam_e_StrWhlRatioBrkPnts keVehParam_e_VehSteerRatioTable keVehParam_m_DistWhlBse sampling_time /end REF_CHARACTERISTIC
/end GROUP
/begin GROUP S5_OutputAdapter_APSM "DT24_CVADAS_AP_CodGen/Output_Adapter/OutputAdapter_APSM" /begin SUB_GROUP APSMPAOut DriveAssistStatOut /end SUB_GROUP /end GROUP
/begin GROUP S5_Output_Adapter_APA "DT24_CVADAS_AP_CodGen/Output_Adapter/Output_Adapter_APA" /begin SUB_GROUP FPAWarnOut PAStateOut RPAWarnOut /end SUB_GROUP /end GROUP
/begin GROUP S5_Output_Adapter_VC "DT24_CVADAS_AP_CodGen/Output_Adapter/Output_Adapter_VC" /begin SUB_GROUP VCActuatorOut /end SUB_GROUP /end GROUP
/begin GROUP S8_Subsystem "DT24_CVADAS_AP_CodGen/Input_Adapter/FID_InputProcessing1/Subsystem" /begin REF_MEASUREMENT MeAP_b_FPADisable MeAP_b_RPADisable /end REF_MEASUREMENT /end GROUP
/begin GROUP S15_CalcMinDistance "DT24_CVADAS_AP_CodGen/Input_Adapter/ObjectMinDistanceCalculator/CalcMinDistance"
 /begin SUB_GROUP S88_CalculateMinDistances1 S88_FromtMinDist S88_RearMinDist S88_SuppArcMinDist S88_VehicleContourXY /end SUB_GROUP
 /begin REF_CHARACTERISTIC KeAP_b_CruisAgeBasedGhsObjDet KeAP_b_DensityBasedGhstObjDet KeAP_b_FeatDetectWall KeAP_b_ForceEnArcTrack KeAP_cm_CenterWarnLatThreshold KeAP_cm_DistZone2 KeAP_cm_DistZone4 KeAP_cm_DistZone6 KeAP_cm_StndStillObjMinDistThd KeAP_cm_VIMGhstObjMinDistThd KeAP_cm_WarnOffset KeAP_cnt_DensStdStlHighPntConfThd KeAP_cnt_DensStdStlLowPntConfThd KeAP_cnt_DensStdStlObjCruiseAgeThd KeAP_cnt_DensVIMHighPntConfThd KeAP_cnt_DensVIMLowPntConfThd KeAP_cnt_DensVIMObjCruiseAgeThd KeAP_cnt_StndStSideCruiseAgeThd KeAP_cnt_StndStSideLowCruiseAgeThd KeAP_cnt_StndStillCruiseAgeThd KeAP_cnt_StndStillPntConfThd KeAP_cnt_StndStillSideLowPntConfThd KeAP_cnt_StndStillSidePntConfThd KeAP_cnt_VIMGhstObjCruiseAgeThd KeAP_cnt_VIMGhstObjPntConfThd KeAP_cnt_VIMSideLowPntConfThd KeAP_cnt_VIMSideObjCruiseAgeThd KeAP_cnt_VIMSideObjLowCruiseAgeThd KeAP_cnt_VIMSidePntConfThd KeAP_kph_ConfThdSpdBrkPnts KeAP_pct_SpdBasedObjConfThd KePA_b_EnFeatPointSplitImp KePA_cm_FrntWallDetectLatThd KePA_cm_FrntWallDetectLongThd KePA_cm_RearWallDetectLatThd KePA_cm_RearWallDetectLongThd KePA_cnt_FrntWallPntCntThd KePA_cnt_RearWallPntCntThd /end REF_CHARACTERISTIC
/end GROUP
/begin GROUP S15_StandstillTimer "DT24_CVADAS_AP_CodGen/Input_Adapter/ObjectMinDistanceCalculator/StandstillTimer" /begin REF_CHARACTERISTIC KeAP_cnt_TimeStep /end REF_CHARACTERISTIC /end GROUP
/begin GROUP S19_Subsystem "DT24_CVADAS_AP_CodGen/Input_Adapter/Subsystem6/Subsystem" /begin REF_CHARACTERISTIC KeAP_cnt_VehMovementCntThd /end REF_CHARACTERISTIC /end GROUP
/begin GROUP S19_TimerForVehKey "DT24_CVADAS_AP_CodGen/Input_Adapter/Subsystem6/TimerForVehKey" /begin REF_CHARACTERISTIC KeAP_cnt_ForceNoiseModeTimeThd KeAP_cnt_TimeStep /end REF_CHARACTERISTIC /end GROUP
/begin GROUP S24_TargetGearFiltering "DT24_CVADAS_AP_CodGen/Input_Adapter/VCAN_InputProcessing/TargetGearFiltering" /begin SUB_GROUP S176_TargetGearFiltering2 /end SUB_GROUP /end GROUP
/begin GROUP S88_FromtMinDist "DT24_CVADAS_AP_CodGen/Input_Adapter/ObjectMinDistanceCalculator/CalcMinDistance/FromtMinDist"
 /begin SUB_GROUP S92_FrontCenterDistAvg S92_FrontCenterDistAvg1 S92_FrontLeftDistAvg S92_FrontRightDistAvg S92_PA_FC_DBNC S92_PA_FL_DBNC S92_PA_FR_DBNC /end SUB_GROUP
 /begin REF_CHARACTERISTIC KeAP_b_HeightFlagEnabled KeAP_cm_FrntDistZone2 KeAP_cm_FrntDistZone4 KeAP_cnt_CruisAgeBasedDbncCount /end REF_CHARACTERISTIC
 /begin REF_MEASUREMENT MeAP_cm_FrntCenterMinXDist MeAP_cm_FrntLeftMinXDist MeAP_cm_FrntRightMinXDist /end REF_MEASUREMENT
/end GROUP
/begin GROUP S88_RearMinDist "DT24_CVADAS_AP_CodGen/Input_Adapter/ObjectMinDistanceCalculator/CalcMinDistance/RearMinDist"
 /begin SUB_GROUP S93_FrontCenterDistAvg S93_FrontLeftDistAvg S93_FrontRightDistAvg S93_PA_RC_DBNC S93_PA_RL_DBNC S93_PA_RR_DBNC S93_RearCenterDistAvg1 /end SUB_GROUP
 /begin REF_CHARACTERISTIC KeAP_b_HeightFlagEnabled KeAP_b_HookConnected KeAP_cm_DistZone2 KeAP_cm_DistZone6 KeAP_cm_HookDistOffset KeAP_cnt_CruisAgeBasedDbncCount /end REF_CHARACTERISTIC
 /begin REF_MEASUREMENT MeAP_cm_RearCenterMinXDist MeAP_cm_RearLeftMinXDist MeAP_cm_RearRightMinXDist /end REF_MEASUREMENT
/end GROUP
/begin GROUP S88_SuppArcMinDist "DT24_CVADAS_AP_CodGen/Input_Adapter/ObjectMinDistanceCalculator/CalcMinDistance/SuppArcMinDist"
 /begin SUB_GROUP S94_SuppArcMinDist S94_SuppArcMinDist1 S94_SuppArcMinDist2 S94_SuppArcMinDist3 S94_SuppArcMinDist4 S94_SuppArcMinDist5 S94_SuppArcMinDist6 S94_SuppArcMinDist7 /end SUB_GROUP
/end GROUP
/begin GROUP S88_VehicleContourXY "DT24_CVADAS_AP_CodGen/Input_Adapter/ObjectMinDistanceCalculator/CalcMinDistance/VehicleContourXY"
 /begin REF_CHARACTERISTIC KeAP_cm_VehContourFrntXAdj KeAP_cm_VehContourRearXAdj KeAP_cm_VehContour_FSL_y KeAP_cm_VehContour_FSR_y KeAP_cm_VehContour_RSL_y KeAP_cm_VehContour_RSR_y KeAP_cm_WarnOffset /end REF_CHARACTERISTIC
/end GROUP
/begin GROUP S88_CalculateMinDistances1 "DT24_CVADAS_AP_CodGen/Input_Adapter/ObjectMinDistanceCalculator/CalcMinDistance/CalculateMinDistances1" /begin SUB_GROUP S91_NeighbourHoodCheck S91_UpdateDistNoDetection /end SUB_GROUP /end GROUP
/begin GROUP S176_TargetGearFiltering2 "DT24_CVADAS_AP_CodGen/Input_Adapter/VCAN_InputProcessing/TargetGearFiltering/TargetGearFiltering2" /begin REF_CHARACTERISTIC KeAP_Cnt_GearFiltTimeThd KeAP_cnt_TimeStep /end REF_CHARACTERISTIC /end GROUP
/begin GROUP S92_FrontCenterDistAvg "DT24_CVADAS_AP_CodGen/Input_Adapter/ObjectMinDistanceCalculator/CalcMinDistance/FromtMinDist/FrontCenterDistAvg" /begin SUB_GROUP S108_ArcDistOffset /end SUB_GROUP /end GROUP
/begin GROUP S92_FrontCenterDistAvg1 "DT24_CVADAS_AP_CodGen/Input_Adapter/ObjectMinDistanceCalculator/CalcMinDistance/FromtMinDist/FrontCenterDistAvg1" /begin SUB_GROUP S109_ArcDistOffset /end SUB_GROUP /end GROUP
/begin GROUP S92_FrontLeftDistAvg "DT24_CVADAS_AP_CodGen/Input_Adapter/ObjectMinDistanceCalculator/CalcMinDistance/FromtMinDist/FrontLeftDistAvg" /begin SUB_GROUP S110_ArcDistOffset /end SUB_GROUP /end GROUP
/begin GROUP S92_FrontRightDistAvg "DT24_CVADAS_AP_CodGen/Input_Adapter/ObjectMinDistanceCalculator/CalcMinDistance/FromtMinDist/FrontRightDistAvg" /begin SUB_GROUP S111_ArcDistOffset /end SUB_GROUP /end GROUP
/begin GROUP S92_PA_FC_DBNC "DT24_CVADAS_AP_CodGen/Input_Adapter/ObjectMinDistanceCalculator/CalcMinDistance/FromtMinDist/PA_FC_DBNC" /begin REF_CHARACTERISTIC CeAP_ms_SampleTime KeAP_b_DbncEnabld KeAP_ms_DbncTimeThsd /end REF_CHARACTERISTIC /end GROUP
/begin GROUP S92_PA_FL_DBNC "DT24_CVADAS_AP_CodGen/Input_Adapter/ObjectMinDistanceCalculator/CalcMinDistance/FromtMinDist/PA_FL_DBNC" /begin REF_CHARACTERISTIC CeAP_ms_SampleTime KeAP_b_DbncEnabld KeAP_ms_DbncTimeThsd /end REF_CHARACTERISTIC /end GROUP
/begin GROUP S92_PA_FR_DBNC "DT24_CVADAS_AP_CodGen/Input_Adapter/ObjectMinDistanceCalculator/CalcMinDistance/FromtMinDist/PA_FR_DBNC" /begin REF_CHARACTERISTIC CeAP_ms_SampleTime KeAP_b_DbncEnabld KeAP_ms_DbncTimeThsd /end REF_CHARACTERISTIC /end GROUP
/begin GROUP S93_FrontCenterDistAvg "DT24_CVADAS_AP_CodGen/Input_Adapter/ObjectMinDistanceCalculator/CalcMinDistance/RearMinDist/FrontCenterDistAvg" /begin SUB_GROUP S130_ArcDistOffset /end SUB_GROUP /end GROUP
/begin GROUP S93_FrontLeftDistAvg "DT24_CVADAS_AP_CodGen/Input_Adapter/ObjectMinDistanceCalculator/CalcMinDistance/RearMinDist/FrontLeftDistAvg" /begin SUB_GROUP S131_ArcDistOffset /end SUB_GROUP /end GROUP
/begin GROUP S93_FrontRightDistAvg "DT24_CVADAS_AP_CodGen/Input_Adapter/ObjectMinDistanceCalculator/CalcMinDistance/RearMinDist/FrontRightDistAvg" /begin SUB_GROUP S132_ArcDistOffset /end SUB_GROUP /end GROUP
/begin GROUP S93_PA_RC_DBNC "DT24_CVADAS_AP_CodGen/Input_Adapter/ObjectMinDistanceCalculator/CalcMinDistance/RearMinDist/PA_RC_DBNC" /begin REF_CHARACTERISTIC CeAP_ms_SampleTime KeAP_b_DbncEnabld KeAP_ms_DbncTimeThsd /end REF_CHARACTERISTIC /end GROUP
/begin GROUP S93_PA_RL_DBNC "DT24_CVADAS_AP_CodGen/Input_Adapter/ObjectMinDistanceCalculator/CalcMinDistance/RearMinDist/PA_RL_DBNC" /begin REF_CHARACTERISTIC CeAP_ms_SampleTime KeAP_b_DbncEnabld KeAP_ms_DbncTimeThsd /end REF_CHARACTERISTIC /end GROUP
/begin GROUP S93_PA_RR_DBNC "DT24_CVADAS_AP_CodGen/Input_Adapter/ObjectMinDistanceCalculator/CalcMinDistance/RearMinDist/PA_RR_DBNC" /begin REF_CHARACTERISTIC CeAP_ms_SampleTime KeAP_b_DbncEnabld KeAP_ms_DbncTimeThsd /end REF_CHARACTERISTIC /end GROUP
/begin GROUP S93_RearCenterDistAvg1 "DT24_CVADAS_AP_CodGen/Input_Adapter/ObjectMinDistanceCalculator/CalcMinDistance/RearMinDist/RearCenterDistAvg1" /begin SUB_GROUP S139_ArcDistOffset /end SUB_GROUP /end GROUP
/begin GROUP S94_SuppArcMinDist "DT24_CVADAS_AP_CodGen/Input_Adapter/ObjectMinDistanceCalculator/CalcMinDistance/SuppArcMinDist/SuppArcMinDist" /begin REF_CHARACTERISTIC KeAP_b_SuppArcInNoForceNoise /end REF_CHARACTERISTIC /end GROUP
/begin GROUP S94_SuppArcMinDist1 "DT24_CVADAS_AP_CodGen/Input_Adapter/ObjectMinDistanceCalculator/CalcMinDistance/SuppArcMinDist/SuppArcMinDist1" /begin REF_CHARACTERISTIC KeAP_b_SuppArcInNoForceNoise /end REF_CHARACTERISTIC /end GROUP
/begin GROUP S94_SuppArcMinDist2 "DT24_CVADAS_AP_CodGen/Input_Adapter/ObjectMinDistanceCalculator/CalcMinDistance/SuppArcMinDist/SuppArcMinDist2" /begin REF_CHARACTERISTIC KeAP_b_SuppArcInNoForceNoise /end REF_CHARACTERISTIC /end GROUP
/begin GROUP S94_SuppArcMinDist3 "DT24_CVADAS_AP_CodGen/Input_Adapter/ObjectMinDistanceCalculator/CalcMinDistance/SuppArcMinDist/SuppArcMinDist3" /begin REF_CHARACTERISTIC KeAP_b_SuppArcInNoForceNoise /end REF_CHARACTERISTIC /end GROUP
/begin GROUP S94_SuppArcMinDist4 "DT24_CVADAS_AP_CodGen/Input_Adapter/ObjectMinDistanceCalculator/CalcMinDistance/SuppArcMinDist/SuppArcMinDist4" /begin REF_CHARACTERISTIC KeAP_b_SuppArcInNoForceNoise /end REF_CHARACTERISTIC /end GROUP
/begin GROUP S94_SuppArcMinDist5 "DT24_CVADAS_AP_CodGen/Input_Adapter/ObjectMinDistanceCalculator/CalcMinDistance/SuppArcMinDist/SuppArcMinDist5" /begin REF_CHARACTERISTIC KeAP_b_SuppArcInNoForceNoise /end REF_CHARACTERISTIC /end GROUP
/begin GROUP S94_SuppArcMinDist6 "DT24_CVADAS_AP_CodGen/Input_Adapter/ObjectMinDistanceCalculator/CalcMinDistance/SuppArcMinDist/SuppArcMinDist6" /begin REF_CHARACTERISTIC KeAP_b_SuppArcInNoForceNoise /end REF_CHARACTERISTIC /end GROUP
/begin GROUP S94_SuppArcMinDist7 "DT24_CVADAS_AP_CodGen/Input_Adapter/ObjectMinDistanceCalculator/CalcMinDistance/SuppArcMinDist/SuppArcMinDist7" /begin REF_CHARACTERISTIC KeAP_b_SuppArcInNoForceNoise /end REF_CHARACTERISTIC /end GROUP
/begin GROUP S91_NeighbourHoodCheck "DT24_CVADAS_AP_CodGen/Input_Adapter/ObjectMinDistanceCalculator/CalcMinDistance/CalculateMinDistances1/NeighbourHoodCheck"
 /begin REF_CHARACTERISTIC KeAP_cm_NhXmaxOffset KeAP_cm_NhXminOffset KeAP_cm_NhYmaxOffset KeAP_cm_NhYminOffset /end REF_CHARACTERISTIC
/end GROUP
/begin GROUP S91_UpdateDistNoDetection "DT24_CVADAS_AP_CodGen/Input_Adapter/ObjectMinDistanceCalculator/CalcMinDistance/CalculateMinDistances1/UpdateDistNoDetection" /begin REF_CHARACTERISTIC KeAP_b_ForceEnArcTrack KeAP_cm_DistZone2 /end REF_CHARACTERISTIC /end GROUP
/begin GROUP S108_ArcDistOffset "DT24_CVADAS_AP_CodGen/Input_Adapter/ObjectMinDistanceCalculator/CalcMinDistance/FromtMinDist/FrontCenterDistAvg/ArcDistOffset" /begin REF_CHARACTERISTIC KeAP_cm_FrntDistArcComp /end REF_CHARACTERISTIC /end GROUP
/begin GROUP S109_ArcDistOffset "DT24_CVADAS_AP_CodGen/Input_Adapter/ObjectMinDistanceCalculator/CalcMinDistance/FromtMinDist/FrontCenterDistAvg1/ArcDistOffset" /begin REF_CHARACTERISTIC KeAP_cm_FrntDistArcComp /end REF_CHARACTERISTIC /end GROUP
/begin GROUP S110_ArcDistOffset "DT24_CVADAS_AP_CodGen/Input_Adapter/ObjectMinDistanceCalculator/CalcMinDistance/FromtMinDist/FrontLeftDistAvg/ArcDistOffset" /begin REF_CHARACTERISTIC KeAP_cm_FrntDistArcComp /end REF_CHARACTERISTIC /end GROUP
/begin GROUP S111_ArcDistOffset "DT24_CVADAS_AP_CodGen/Input_Adapter/ObjectMinDistanceCalculator/CalcMinDistance/FromtMinDist/FrontRightDistAvg/ArcDistOffset" /begin REF_CHARACTERISTIC KeAP_cm_FrntDistArcComp /end REF_CHARACTERISTIC /end GROUP
/begin GROUP S130_ArcDistOffset "DT24_CVADAS_AP_CodGen/Input_Adapter/ObjectMinDistanceCalculator/CalcMinDistance/RearMinDist/FrontCenterDistAvg/ArcDistOffset" /begin REF_CHARACTERISTIC KeAP_cm_RearDistArcComp /end REF_CHARACTERISTIC /end GROUP
/begin GROUP S131_ArcDistOffset "DT24_CVADAS_AP_CodGen/Input_Adapter/ObjectMinDistanceCalculator/CalcMinDistance/RearMinDist/FrontLeftDistAvg/ArcDistOffset" /begin REF_CHARACTERISTIC KeAP_cm_RearDistArcComp /end REF_CHARACTERISTIC /end GROUP
/begin GROUP S132_ArcDistOffset "DT24_CVADAS_AP_CodGen/Input_Adapter/ObjectMinDistanceCalculator/CalcMinDistance/RearMinDist/FrontRightDistAvg/ArcDistOffset" /begin REF_CHARACTERISTIC KeAP_cm_RearDistArcComp /end REF_CHARACTERISTIC /end GROUP
/begin GROUP S139_ArcDistOffset "DT24_CVADAS_AP_CodGen/Input_Adapter/ObjectMinDistanceCalculator/CalcMinDistance/RearMinDist/RearCenterDistAvg1/ArcDistOffset" /begin REF_CHARACTERISTIC KeAP_cm_RearDistArcComp /end REF_CHARACTERISTIC /end GROUP
/begin GROUP IbAP_InputVrntTunParam ""
 /begin REF_MEASUREMENT IbAP_InputVrntTunParam.K_Overlap_Thrsld_RAEB IbAP_InputVrntTunParam.K_e_RAEB_VehicleWidth IbAP_InputVrntTunParam.KeAP_Cnt_GearFiltTimeThd IbAP_InputVrntTunParam.KeAP_Cnt_GearOverrideTimeThd IbAP_InputVrntTunParam.KeAP_b_AutoParkEn IbAP_InputVrntTunParam.KeAP_b_FPAEn IbAP_InputVrntTunParam.KeAP_b_FullAutoPark IbAP_InputVrntTunParam.KeAP_b_HookConnected IbAP_InputVrntTunParam.KeAP_b_RPAwithBrk IbAP_InputVrntTunParam.KeAP_b_RPAwithSurroundView IbAP_InputVrntTunParam.KeAP_b_SteerOnlyAutoPark IbAP_InputVrntTunParam.KeAP_cm_DistZone1 IbAP_InputVrntTunParam.KeAP_cm_DistZone2 IbAP_InputVrntTunParam.KeAP_cm_DistZone3 IbAP_InputVrntTunParam.KeAP_cm_DistZone4 IbAP_InputVrntTunParam.KeAP_cm_DistZone5 IbAP_InputVrntTunParam.KeAP_cm_DistZone6 IbAP_InputVrntTunParam.KeAP_cm_FrntLongDistAdj IbAP_InputVrntTunParam.KeAP_cm_HalfVehicleWidth IbAP_InputVrntTunParam.KeAP_cm_HookDistOffset IbAP_InputVrntTunParam.KeAP_cm_MaxNoObjDetctDist IbAP_InputVrntTunParam.KeAP_cm_ObjPrestFCDistThd IbAP_InputVrntTunParam.KeAP_cm_ObjPrestRCDistThd IbAP_InputVrntTunParam.KeAP_cm_RearLongDistAdj IbAP_InputVrntTunParam.KeAP_cm_VehContour_FIL_x IbAP_InputVrntTunParam.KeAP_cm_VehContour_FIL_y IbAP_InputVrntTunParam.KeAP_cm_VehContour_FIR_x IbAP_InputVrntTunParam.KeAP_cm_VehContour_FIR_y IbAP_InputVrntTunParam.KeAP_cm_VehContour_FOL_x IbAP_InputVrntTunParam.KeAP_cm_VehContour_FOL_y IbAP_InputVrntTunParam.KeAP_cm_VehContour_FOR_x IbAP_InputVrntTunParam.KeAP_cm_VehContour_FOR_y IbAP_InputVrntTunParam.KeAP_cm_VehContour_FSL_x IbAP_InputVrntTunParam.KeAP_cm_VehContour_FSL_y IbAP_InputVrntTunParam.KeAP_cm_VehContour_FSR_x IbAP_InputVrntTunParam.KeAP_cm_VehContour_FSR_y IbAP_InputVrntTunParam.KeAP_cm_VehContour_RIL_x IbAP_InputVrntTunParam.KeAP_cm_VehContour_RIL_y IbAP_InputVrntTunParam.KeAP_cm_VehContour_RIR_x IbAP_InputVrntTunParam.KeAP_cm_VehContour_RIR_y IbAP_InputVrntTunParam.KeAP_cm_VehContour_ROL_x IbAP_InputVrntTunParam.KeAP_cm_VehContour_ROL_y IbAP_InputVrntTunParam.KeAP_cm_VehContour_ROR_x IbAP_InputVrntTunParam.KeAP_cm_VehContour_ROR_y IbAP_InputVrntTunParam.KeAP_cm_VehContour_RSL_x IbAP_InputVrntTunParam.KeAP_cm_VehContour_RSL_y IbAP_InputVrntTunParam.KeAP_cm_VehContour_RSR_x IbAP_InputVrntTunParam.KeAP_cm_VehContour_RSR_y IbAP_InputVrntTunParam.KeAP_cm_VehicleWidth IbAP_InputVrntTunParam.KeAP_cm_WarnOffset IbAP_InputVrntTunParam.KeAP_cnt_ChimeVolChgAlert IbAP_InputVrntTunParam.KeAP_cnt_DebounceTimeThd IbAP_InputVrntTunParam.KeAP_cnt_EngagedFullWaitCnt IbAP_InputVrntTunParam.KeAP_cnt_FrntChimeDisTimeThd IbAP_InputVrntTunParam.KeAP_cnt_HalfSecChimeAlert IbAP_InputVrntTunParam.KeAP_cnt_LEDBlinkTimeThd IbAP_InputVrntTunParam.KeAP_cnt_SPMBlinkLEDDur IbAP_InputVrntTunParam.KeAP_cnt_SwtStuckTimeThd IbAP_InputVrntTunParam.KeAP_cnt_TimeStep IbAP_InputVrntTunParam.KeAP_cnt_VehKeyOnTimeThd IbAP_InputVrntTunParam.KeAP_degC_OperatingTempThd IbAP_InputVrntTunParam.KeAP_e_GbTypAT IbAP_InputVrntTunParam.KeAP_k_BrakeIGain IbAP_InputVrntTunParam.KeAP_k_BrakeLowerLimit IbAP_InputVrntTunParam.KeAP_k_BrakePGain IbAP_InputVrntTunParam.KeAP_k_BrakeUpperLimit IbAP_InputVrntTunParam.KeAP_k_CtrlOutCollDetActivate IbAP_InputVrntTunParam.KeAP_k_CtrlOutCollDetCollDistLimit IbAP_InputVrntTunParam.KeAP_k_CtrlOutCollDetRedStopVal IbAP_InputVrntTunParam.KeAP_k_CtrlOutGearDrive IbAP_InputVrntTunParam.KeAP_k_CtrlOutGearPark IbAP_InputVrntTunParam.KeAP_k_CtrlOutGearReverse IbAP_InputVrntTunParam.KeAP_k_CtrlOutRemainDistNA IbAP_InputVrntTunParam.KeAP_k_CtrlOutVehSpdMaxSpotSteer IbAP_InputVrntTunParam.KeAP_k_CtrlOutVehSpdMaxSpotStrRackDevThd IbAP_InputVrntTunParam.KeAP_k_CtrlOutVehSpdMaxSpotStrTime IbAP_InputVrntTunParam.KeAP_k_DetWP_PreviewTime IbAP_InputVrntTunParam.KeAP_k_LatHeadDevDGain IbAP_InputVrntTunParam.KeAP_k_LatHeadDevIGain IbAP_InputVrntTunParam.KeAP_k_LatHeadDevPGain IbAP_InputVrntTunParam.KeAP_k_LatPathDevDGain IbAP_InputVrntTunParam.KeAP_k_LatPathDevIGain IbAP_InputVrntTunParam.KeAP_k_LatPathDevPGain IbAP_InputVrntTunParam.KeAP_k_PathSepaMinSpd IbAP_InputVrntTunParam.KeAP_k_PathSepaSpdRampGrd IbAP_InputVrntTunParam.KeAP_k_SteerLowerLimit IbAP_InputVrntTunParam.KeAP_k_SteerUpperLimit IbAP_InputVrntTunParam.KeAP_k_WhlCircum IbAP_InputVrntTunParam.KeAP_kph_EnblHysThd IbAP_InputVrntTunParam.KeAP_kph_FrntWarnMaxSpdThd IbAP_InputVrntTunParam.KeAP_kph_PSDOffThd IbAP_InputVrntTunParam.KeAP_kph_PSDOnThd IbAP_InputVrntTunParam.KeAP_kph_ParkMnvThd IbAP_InputVrntTunParam.KeAP_kph_RearWarnMaxSpdThd IbAP_InputVrntTunParam.KeAP_kph_USSActiveSpdThd IbAP_InputVrntTunParam.KeAP_pct_ObjConfidenceThd IbAP_InputVrntTunParam.KeAP_s_BSMInterfaceCntTimeout IbAP_InputVrntTunParam.KeAP_s_CamHandshakeDur IbAP_InputVrntTunParam.KeAP_s_EPSInterfaceCntTimeout IbAP_InputVrntTunParam.KeAP_s_GearShiftWaitCntTimeout IbAP_InputVrntTunParam.KeAP_s_MaxStandstillTimeThd IbAP_InputVrntTunParam.KeAP_s_ObjInPathTimeoutDur IbAP_InputVrntTunParam.KeAP_s_PausedPressBtnTimeoutDur IbAP_InputVrntTunParam.KeAP_s_SeekPhaseTimeoutDur IbAP_InputVrntTunParam.KeAP_s_SpdExceedDur IbAP_InputVrntTunParam.KeCMbB_b_EnblOncObjDbnc IbAP_InputVrntTunParam.KeTOS_s_InTurnDbncTm IbAP_InputVrntTunParam.KeTOS_s_StrDrvDbncTm IbAP_InputVrntTunParam.KeTOS_s_TurnExitDbncTm IbAP_InputVrntTunParam.KeTOS_x_InTurnThd IbAP_InputVrntTunParam.KeTOS_x_TurnExitThd IbAP_InputVrntTunParam.Obj_DistTable IbAP_InputVrntTunParam.Overlap_Thrsld_Switch IbAP_InputVrntTunParam.RAEB_Envelope_Offset IbAP_InputVrntTunParam.RAEB_Lateral_Distance_Notification IbAP_InputVrntTunParam.RAEB_Minimum_Object_Heigh IbAP_InputVrntTunParam.Reverse_Gr_num IbAP_InputVrntTunParam.Steering_Angle_DeadZone_End IbAP_InputVrntTunParam.Steering_Angle_DeadZone_Start IbAP_InputVrntTunParam.Straight_Driving_Thresold_rads2 IbAP_InputVrntTunParam.keInpAdptr_e_StWhOffset IbAP_InputVrntTunParam.keVehParam_e_StrWhlRatioBrkPnts IbAP_InputVrntTunParam.keVehParam_e_VehSteerRatioTable IbAP_InputVrntTunParam.keVehParam_m_DistWhlBse IbAP_InputVrntTunParam.sampling_time /end REF_MEASUREMENT
/end GROUP
/begin GROUP DriveAssistStatOut ""
 /begin REF_MEASUREMENT DriveAssistStatOut.IeAP_b_AutoParkOverride DriveAssistStatOut.IeAP_b_FaultStatus DriveAssistStatOut.IeAP_b_FeatureAvl DriveAssistStatOut.IeAP_b_ImgDefeatReqSts DriveAssistStatOut.IeAP_b_ParkInOutAbort DriveAssistStatOut.IeAP_b_ParkInOutSuccess DriveAssistStatOut.IeAP_b_ParkOutAvailable DriveAssistStatOut.IeAP_b_SPMFailSts DriveAssistStatOut.IeAP_b_SPMFaultSts DriveAssistStatOut.IeAP_b_SPMScrnReq DriveAssistStatOut.IeAP_b_VehMnvrDirSPM DriveAssistStatOut.IeAP_b_WrngSpdExceed DriveAssistStatOut.IeAP_e_AlgoState DriveAssistStatOut.IeAP_e_AutoParkStatus DriveAssistStatOut.IeAP_e_DispView2 DriveAssistStatOut.IeAP_e_GearShiftReq DriveAssistStatOut.IeAP_e_HMIDispReq DriveAssistStatOut.IeAP_e_InterfaceBSM DriveAssistStatOut.IeAP_e_ParKMnvrActv DriveAssistStatOut.IeAP_e_SPMActvStat DriveAssistStatOut.IeAP_e_SPMLatCtrlReqSts DriveAssistStatOut.IeAP_e_SPMLedSts DriveAssistStatOut.IeAP_e_ScanDir DriveAssistStatOut.IeAutoPark_e_ChimeReq DriveAssistStatOut.MeAP_b_ChimeActvReqLHFSVM DriveAssistStatOut.MeAP_b_ChimeActvReqLHRSVM DriveAssistStatOut.MeAP_b_ChimeActvReqRHFSVM DriveAssistStatOut.MeAP_b_ChimeActvReqRHRSVM DriveAssistStatOut.MeAP_b_SensorFltSts DriveAssistStatOut.MeAP_e_PAMChimeRepnRateSVM DriveAssistStatOut.MeAP_e_PAMChimeTypSVM DriveAssistStatOut.MeAP_e_PAMVolSigSVM DriveAssistStatOut.MeAP_s_FaultWaitTime /end REF_MEASUREMENT
/end GROUP
/begin GROUP MbNVM_ProxyParam ""
 /begin REF_MEASUREMENT MbNVM_ProxyParam.KeAP_b_CanNode63TTM MbNVM_ProxyParam.KeAP_b_CanNode67DTCM MbNVM_ProxyParam.KeAP_b_CanNode95ITBMTCM MbNVM_ProxyParam.KeAP_b_DrvSide MbNVM_ProxyParam.KeAP_b_FullAutoPrkgSys MbNVM_ProxyParam.KeAP_b_PAMCfg MbNVM_ProxyParam.KeAP_b_ParkWithStop MbNVM_ProxyParam.KeAP_b_PullOutCtrlPres MbNVM_ProxyParam.KeAP_b_SVSPresent MbNVM_ProxyParam.KeAP_b_SemiAutoPrkgSys MbNVM_ProxyParam.KeAP_b_StopAndStrt MbNVM_ProxyParam.KeAP_b_TrlrHitchAsstPres MbNVM_ProxyParam.KeAP_b_TrlrRvsSteerPres MbNVM_ProxyParam.KeAP_e_CtryCod MbNVM_ProxyParam.KeAP_e_DrvTypVrnt MbNVM_ProxyParam.KeAP_e_GbTyp MbNVM_ProxyParam.KeAP_e_HybTyp MbNVM_ProxyParam.KeAP_e_MdlYr MbNVM_ProxyParam.KeAP_e_PAMTunSet MbNVM_ProxyParam.KeAP_e_RadioDispTyp MbNVM_ProxyParam.KeAP_e_SteerRatRackPinionTyp MbNVM_ProxyParam.KeAP_e_VehLineCfg MbNVM_ProxyParam.KeAP_e_WhlBas MbNVM_ProxyParam.KeAP_k_VariantID MbNVM_ProxyParam.KeAP_mm_TyreSz /end REF_MEASUREMENT
/end GROUP
/begin GROUP VCActuatorOut ""
 /begin REF_MEASUREMENT VCActuatorOut.IeAP_a_AcclMax VCActuatorOut.IeAP_a_AcclMin VCActuatorOut.IeAP_a_DecelMax VCActuatorOut.IeAP_a_DecelMin VCActuatorOut.IeAP_a_JerkDecelMax VCActuatorOut.IeAP_a_JerkDecelMin VCActuatorOut.IeAP_b_StandstillReq VCActuatorOut.IeAP_cm_TrgtDist VCActuatorOut.IeAP_da_JerkAcclMax VCActuatorOut.IeAP_da_JerkAcclMin VCActuatorOut.IeAP_e_TurnIndicReq VCActuatorOut.IeAP_kph_TrgtVehSpd VCActuatorOut.IeAP_nm_StrwTrqReq /end REF_MEASUREMENT
/end GROUP
/begin GROUP RPAWarnOut ""
 /begin REF_MEASUREMENT RPAWarnOut.IeAP_b_ChimeActvReqLHR RPAWarnOut.IeAP_b_ChimeActvReqRHR RPAWarnOut.IeAP_cm_RearDisttoNearObst RPAWarnOut.IeAP_e_ArcFlashRateCHR RPAWarnOut.IeAP_e_ArcFlashRateLHR RPAWarnOut.IeAP_e_ArcFlashRateRHR RPAWarnOut.IeAP_e_DispArcCHR RPAWarnOut.IeAP_e_DispArcLHR RPAWarnOut.IeAP_e_DispArcRHR /end REF_MEASUREMENT
/end GROUP
/begin GROUP PAStateOut ""
 /begin REF_MEASUREMENT PAStateOut.IeAP_b_PAMRearBrkReq PAStateOut.IeAP_b_PAMRearCtrlSts PAStateOut.IeAP_e_FrntParkLEDSts PAStateOut.IeAP_e_PAMChimeRepnRate PAStateOut.IeAP_e_PAMChimeTyp PAStateOut.IeAP_e_PAMLedCtrl PAStateOut.IeAP_e_PAMVolSig PAStateOut.IeAP_e_ParkSensePopUpReq /end REF_MEASUREMENT
/end GROUP
/begin GROUP FPAWarnOut ""
 /begin REF_MEASUREMENT FPAWarnOut.IeAP_b_ChimeActvReqLHF FPAWarnOut.IeAP_b_ChimeActvReqRHF FPAWarnOut.IeAP_e_ArcFlashRateCHF FPAWarnOut.IeAP_e_ArcFlashRateLHF FPAWarnOut.IeAP_e_ArcFlashRateRHF FPAWarnOut.IeAP_e_DispArcCHF FPAWarnOut.IeAP_e_DispArcLHF FPAWarnOut.IeAP_e_DispArcRHF /end REF_MEASUREMENT
/end GROUP
/begin GROUP APSMPAOut ""
 /begin REF_MEASUREMENT APSMPAOut.IeAP_e_FrntRearParkSts APSMPAOut.IeAP_e_FrntSensorActvSts APSMPAOut.IeAP_e_PAMFlt APSMPAOut.IeAP_e_RearSnsrActvSts /end REF_MEASUREMENT
/end GROUP
/end MODULE
/end PROJECT
/* (add any file trailer comments here) */
/* EOF DT24_CVADAS_AP_CodGen.a2l */
