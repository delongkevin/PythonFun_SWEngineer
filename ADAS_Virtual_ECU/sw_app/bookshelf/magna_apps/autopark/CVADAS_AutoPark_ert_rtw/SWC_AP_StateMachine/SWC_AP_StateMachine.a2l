/******************************************************************************
* ASAP2 file: SWC_AP_StateMachine.a2l
* Code generation for model "SWC_AP_StateMachine".
* Model version : 1.2855
* Simulink Coder version : 9.2 (R2019b) 18-Jul-2019
* C source code generated on : Tue Nov 11 20:49:36 2025
* Target selection: ert.tlc
* Embedded hardware selection: ARM Compatible->ARM Cortex
* Code generation objectives:
* 1. MISRA C:2012 guidelines
* 2. RAM efficiency
* 3. ROM efficiency
* Validation result: Not run
* (add additional file header information here)
******************************************************************************/ ASAP2_VERSION 1 31
/* Version 1.31 */
/begin PROJECT ProjectName "Project Comment Goes Here"
/begin HEADER "Header Comments go here" /end HEADER
/begin MODULE ModuleName "Module Comment Goes Here"
/begin MOD_PAR "MOD PAR Comment Goes Here" /end MOD_PAR
/begin MOD_COMMON "Mod Common Comment Here" BYTE_ORDER MSB_LAST /end MOD_COMMON
/begin RECORD_LAYOUT Scalar_BOOLEAN FNC_VALUES 1 UBYTE COLUMN_DIR DIRECT /end RECORD_LAYOUT
/begin RECORD_LAYOUT Scalar_UBYTE FNC_VALUES 1 UBYTE COLUMN_DIR DIRECT /end RECORD_LAYOUT
/begin RECORD_LAYOUT Scalar_BYTE FNC_VALUES 1 SBYTE COLUMN_DIR DIRECT /end RECORD_LAYOUT
/begin RECORD_LAYOUT Scalar_UWORD FNC_VALUES 1 UWORD COLUMN_DIR DIRECT /end RECORD_LAYOUT
/begin RECORD_LAYOUT Scalar_SWORD FNC_VALUES 1 SWORD COLUMN_DIR DIRECT /end RECORD_LAYOUT
/begin RECORD_LAYOUT Scalar_ULONG FNC_VALUES 1 ULONG COLUMN_DIR DIRECT /end RECORD_LAYOUT
/begin RECORD_LAYOUT Scalar_LONG FNC_VALUES 1 SLONG COLUMN_DIR DIRECT /end RECORD_LAYOUT
/begin RECORD_LAYOUT Scalar_FLOAT32_IEEE FNC_VALUES 1 FLOAT32_IEEE COLUMN_DIR DIRECT /end RECORD_LAYOUT
/begin RECORD_LAYOUT Scalar_FLOAT64_IEEE FNC_VALUES 1 FLOAT64_IEEE COLUMN_DIR DIRECT /end RECORD_LAYOUT
/begin RECORD_LAYOUT Lookup1D_BOOLEAN FNC_VALUES 1 UBYTE COLUMN_DIR DIRECT /end RECORD_LAYOUT
/begin RECORD_LAYOUT Lookup1D_X_BOOLEAN AXIS_PTS_X 1 UBYTE INDEX_INCR DIRECT /end RECORD_LAYOUT
/begin RECORD_LAYOUT Lookup1D_BYTE FNC_VALUES 1 SBYTE COLUMN_DIR DIRECT /end RECORD_LAYOUT
/begin RECORD_LAYOUT Lookup1D_X_BYTE AXIS_PTS_X 1 SBYTE INDEX_INCR DIRECT /end RECORD_LAYOUT
/begin RECORD_LAYOUT Lookup1D_UBYTE FNC_VALUES 1 UBYTE COLUMN_DIR DIRECT /end RECORD_LAYOUT
/begin RECORD_LAYOUT Lookup1D_X_UBYTE AXIS_PTS_X 1 UBYTE INDEX_INCR DIRECT /end RECORD_LAYOUT
/begin RECORD_LAYOUT Lookup1D_UWORD FNC_VALUES 1 UWORD COLUMN_DIR DIRECT /end RECORD_LAYOUT
/begin RECORD_LAYOUT Lookup1D_X_UWORD AXIS_PTS_X 1 UWORD INDEX_INCR DIRECT /end RECORD_LAYOUT
/begin RECORD_LAYOUT Lookup1D_WORD FNC_VALUES 1 SWORD COLUMN_DIR DIRECT /end RECORD_LAYOUT
/begin RECORD_LAYOUT Lookup1D_X_WORD AXIS_PTS_X 1 SWORD INDEX_INCR DIRECT /end RECORD_LAYOUT
/begin RECORD_LAYOUT Lookup1D_ULONG FNC_VALUES 1 ULONG COLUMN_DIR DIRECT /end RECORD_LAYOUT
/begin RECORD_LAYOUT Lookup1D_X_ULONG AXIS_PTS_X 1 ULONG INDEX_INCR DIRECT /end RECORD_LAYOUT
/begin RECORD_LAYOUT Lookup1D_SLONG FNC_VALUES 1 SLONG COLUMN_DIR DIRECT /end RECORD_LAYOUT
/begin RECORD_LAYOUT Lookup1D_X_LONG AXIS_PTS_X 1 SLONG INDEX_INCR DIRECT /end RECORD_LAYOUT
/begin RECORD_LAYOUT Lookup1D_FLOAT32_IEEE FNC_VALUES 1 FLOAT32_IEEE COLUMN_DIR DIRECT /end RECORD_LAYOUT
/begin RECORD_LAYOUT Lookup1D_X_FLOAT32_IEEE AXIS_PTS_X 1 FLOAT32_IEEE INDEX_INCR DIRECT /end RECORD_LAYOUT
/begin RECORD_LAYOUT Lookup1D_FLOAT64_IEEE FNC_VALUES 1 FLOAT64_IEEE COLUMN_DIR DIRECT /end RECORD_LAYOUT
/begin RECORD_LAYOUT Lookup1D_X_FLOAT64_IEEE AXIS_PTS_X 1 FLOAT64_IEEE INDEX_INCR DIRECT /end RECORD_LAYOUT
/begin RECORD_LAYOUT Lookup2D_BOOLEAN FNC_VALUES 1 UBYTE COLUMN_DIR DIRECT /end RECORD_LAYOUT
/begin RECORD_LAYOUT Lookup2D_X_BOOLEAN AXIS_PTS_X 1 UBYTE INDEX_INCR DIRECT /end RECORD_LAYOUT
/begin RECORD_LAYOUT Lookup2D_UBYTE FNC_VALUES 1 UBYTE COLUMN_DIR DIRECT /end RECORD_LAYOUT
/begin RECORD_LAYOUT Lookup2D_X_UBYTE AXIS_PTS_X 1 UBYTE INDEX_INCR DIRECT /end RECORD_LAYOUT
/begin RECORD_LAYOUT Lookup2D_BYTE FNC_VALUES 1 SBYTE COLUMN_DIR DIRECT /end RECORD_LAYOUT
/begin RECORD_LAYOUT Lookup2D_X_BYTE AXIS_PTS_X 1 SBYTE INDEX_INCR DIRECT /end RECORD_LAYOUT
/begin RECORD_LAYOUT Lookup2D_UWORD FNC_VALUES 1 UWORD COLUMN_DIR DIRECT /end RECORD_LAYOUT
/begin RECORD_LAYOUT Lookup2D_X_UWORD AXIS_PTS_X 1 UWORD INDEX_INCR DIRECT /end RECORD_LAYOUT
/begin RECORD_LAYOUT Lookup2D_WORD FNC_VALUES 1 SWORD COLUMN_DIR DIRECT /end RECORD_LAYOUT
/begin RECORD_LAYOUT Lookup2D_X_WORD AXIS_PTS_X 1 SWORD INDEX_INCR DIRECT /end RECORD_LAYOUT
/begin RECORD_LAYOUT Lookup2D_ULONG FNC_VALUES 1 ULONG COLUMN_DIR DIRECT /end RECORD_LAYOUT
/begin RECORD_LAYOUT Lookup2D_X_ULONG AXIS_PTS_X 1 ULONG INDEX_INCR DIRECT /end RECORD_LAYOUT
/begin RECORD_LAYOUT Lookup2D_LONG FNC_VALUES 1 SLONG COLUMN_DIR DIRECT /end RECORD_LAYOUT
/begin RECORD_LAYOUT Lookup2D_X_LONG AXIS_PTS_X 1 SLONG INDEX_INCR DIRECT /end RECORD_LAYOUT
/begin RECORD_LAYOUT Lookup2D_FLOAT32_IEEE FNC_VALUES 1 FLOAT32_IEEE COLUMN_DIR DIRECT /end RECORD_LAYOUT
/begin RECORD_LAYOUT Lookup2D_X_FLOAT32_IEEE AXIS_PTS_X 1 FLOAT32_IEEE INDEX_INCR DIRECT /end RECORD_LAYOUT
/begin RECORD_LAYOUT Lookup2D_FLOAT64_IEEE FNC_VALUES 1 FLOAT64_IEEE COLUMN_DIR DIRECT /end RECORD_LAYOUT
/begin RECORD_LAYOUT Lookup2D_X_FLOAT64_IEEE AXIS_PTS_X 1 FLOAT64_IEEE INDEX_INCR DIRECT /end RECORD_LAYOUT
/begin CHARACTERISTIC KeAP_cnt_AbortHMIWaitCnt "" VALUE 0x0000 /* @ECU_Address@KeAP_cnt_AbortHMIWaitCnt@ */ Scalar_FLOAT32_IEEE 0 SWC_AP_StateMachine_CM_single_cnt -3.4E+38 3.4E+38 /end CHARACTERISTIC
/begin CHARACTERISTIC KeAP_kph_FrntWarnMaxSpdThd "Vehicle speed threshold during Front Park Assist feature" VALUE 0x0000 /* @ECU_Address@KeAP_kph_FrntWarnMaxSpdThd@ */ Scalar_FLOAT32_IEEE 0 SWC_AP_StateMachine_CM_single_kph 0.0 11.0 /end CHARACTERISTIC
/begin CHARACTERISTIC KeAP_kph_PSDOffThd "Vehicle speed threshold during detection the parking slot" VALUE 0x0000 /* @ECU_Address@KeAP_kph_PSDOffThd@ */ Scalar_FLOAT32_IEEE 0 SWC_AP_StateMachine_CM_single_kph 0.0 45.0 /end CHARACTERISTIC
/begin CHARACTERISTIC KeAP_kph_ParkMnvThd "Ego Vehicle speed limit to continue parking maneuvering" VALUE 0x0000 /* @ECU_Address@KeAP_kph_ParkMnvThd@ */ Scalar_FLOAT32_IEEE 0 SWC_AP_StateMachine_CM_single_kph 0.0 10.0 /end CHARACTERISTIC
/begin CHARACTERISTIC KeAP_kph_RearWarnMaxSpdThd "Vehicle speed threshold during Rear Park Assist feature" VALUE 0x0000 /* @ECU_Address@KeAP_kph_RearWarnMaxSpdThd@ */ Scalar_FLOAT32_IEEE 0 SWC_AP_StateMachine_CM_single_kph 0.0 11.0 /end CHARACTERISTIC
/begin CHARACTERISTIC KeAP_kph_StandStillSpdThd "" VALUE 0x0000 /* @ECU_Address@KeAP_kph_StandStillSpdThd@ */ Scalar_FLOAT32_IEEE 0 SWC_AP_StateMachine_CM_single_Kph -3.4E+38 3.4E+38 /end CHARACTERISTIC
/begin CHARACTERISTIC KeAP_pct_PdlPosActThd "Screen Chime Time Threshold" VALUE 0x0000 /* @ECU_Address@KeAP_pct_PdlPosActThd@ */ Scalar_FLOAT32_IEEE 0 SWC_AP_StateMachine_CM_single -3.4E+38 3.4E+38 /end CHARACTERISTIC
/begin CHARACTERISTIC KeAP_Cnt_GearOverrideTimeThd "Gear override time threshold" VALUE 0x0000 /* @ECU_Address@KeAP_Cnt_GearOverrideTimeThd@ */ Scalar_UWORD 0 SWC_AP_StateMachine_CM_uint16_ms 0 65535 /end CHARACTERISTIC
/begin CHARACTERISTIC KeAP_cnt_AbortDelayWaitCnt "" VALUE 0x0000 /* @ECU_Address@KeAP_cnt_AbortDelayWaitCnt@ */ Scalar_UWORD 0 SWC_AP_StateMachine_CM_uint16_cnt 0 65535 /end CHARACTERISTIC
/begin CHARACTERISTIC KeAP_cnt_RelCntrlWaitThd "" VALUE 0x0000 /* @ECU_Address@KeAP_cnt_RelCntrlWaitThd@ */ Scalar_UWORD 0 SWC_AP_StateMachine_CM_uint16_cnt 0 65535 /end CHARACTERISTIC
/begin CHARACTERISTIC KeAP_cnt_ScreenChimeTimeoutDur "Screen Chime Time Threshold" VALUE 0x0000 /* @ECU_Address@KeAP_cnt_ScreenChimeTimeoutDur@ */ Scalar_UWORD 0 SWC_AP_StateMachine_CM_uint16 0 65535 /end CHARACTERISTIC
/begin CHARACTERISTIC KeAP_cnt_ScreenWaitTimeoutDur "" VALUE 0x0000 /* @ECU_Address@KeAP_cnt_ScreenWaitTimeoutDur@ */ Scalar_UWORD 0 SWC_AP_StateMachine_CM_uint16_ms 0 65535 /end CHARACTERISTIC
/begin CHARACTERISTIC KeAP_cnt_StandstillTimeoutDur " Standstill Timer 9 min 50sec" VALUE 0x0000 /* @ECU_Address@KeAP_cnt_StandstillTimeoutDur@ */ Scalar_UWORD 0 SWC_AP_StateMachine_CM_uint16_cnt 0 65535 /end CHARACTERISTIC
/begin CHARACTERISTIC KeAP_cnt_TimeStep "Time Step for Counter " VALUE 0x0000 /* @ECU_Address@KeAP_cnt_TimeStep@ */ Scalar_UWORD 0 SWC_AP_StateMachine_CM_uint16_sec 0 65535 /end CHARACTERISTIC
/begin CHARACTERISTIC KeAP_s_GearShiftReqWaitCnt "" VALUE 0x0000 /* @ECU_Address@KeAP_s_GearShiftReqWaitCnt@ */ Scalar_UWORD 0 SWC_AP_StateMachine_CM_uint16_cnt 0 65535 /end CHARACTERISTIC
/begin CHARACTERISTIC KeAP_s_WaitEngineOnThd "Engine On Time THreshold" VALUE 0x0000 /* @ECU_Address@KeAP_s_WaitEngineOnThd@ */ Scalar_UWORD 0 SWC_AP_StateMachine_CM_uint16 0 65535 /end CHARACTERISTIC
/begin CHARACTERISTIC KeAP_b_DevlopmentTest "Test Parameter used to change value of Tunable parameter while Testing" VALUE 0x0000 /* @ECU_Address@KeAP_b_DevlopmentTest@ */ Scalar_BOOLEAN 0 SWC_AP_StateMachine_CM_boolean 0 1 /end CHARACTERISTIC
/begin MEASUREMENT MeAP_cnt_StateDebugVar "" ULONG SWC_AP_StateMachine_CM_uint32 0 0 0 4294967295 ECU_ADDRESS 0x0000 /* @ECU_Address@MeAP_cnt_StateDebugVar@ */ /end MEASUREMENT
/begin MEASUREMENT MeAP_cnt_TransDebugVar "" ULONG SWC_AP_StateMachine_CM_uint32 0 0 0 4294967295 ECU_ADDRESS 0x0000 /* @ECU_Address@MeAP_cnt_TransDebugVar@ */ /end MEASUREMENT
/begin MEASUREMENT MeAP_b_InitBrkPedlPressed "" UBYTE SWC_AP_StateMachine_CM_boolean 0 0 0 1 ECU_ADDRESS 0x0000 /* @ECU_Address@MeAP_b_InitBrkPedlPressed@ */ /end MEASUREMENT
/begin MEASUREMENT MeAP_b_BtnPsd "" UBYTE SWC_AP_StateMachine_CM_boolean 0 0 0 1 ECU_ADDRESS 0x0000 /* @ECU_Address@MeAP_b_BtnPsd@ */ /end MEASUREMENT
/begin MEASUREMENT MeAP_b_DoorOpen "" UBYTE SWC_AP_StateMachine_CM_boolean 0 0 0 1 ECU_ADDRESS 0x0000 /* @ECU_Address@MeAP_b_DoorOpen@ */ /end MEASUREMENT
/begin MEASUREMENT MeAP_b_LifeGateOpen "" UBYTE SWC_AP_StateMachine_CM_boolean 0 0 0 1 ECU_ADDRESS 0x0000 /* @ECU_Address@MeAP_b_LifeGateOpen@ */ /end MEASUREMENT
/begin MEASUREMENT MeAP_b_ESCActive "" UBYTE SWC_AP_StateMachine_CM_boolean 0 0 0 1 ECU_ADDRESS 0x0000 /* @ECU_Address@MeAP_b_ESCActive@ */ /end MEASUREMENT
/begin MEASUREMENT MeAP_b_SeekSpdExceed "" UBYTE SWC_AP_StateMachine_CM_boolean 0 0 0 1 ECU_ADDRESS 0x0000 /* @ECU_Address@MeAP_b_SeekSpdExceed@ */ /end MEASUREMENT
/begin MEASUREMENT MeAP_b_MnvSpdExceed "" UBYTE SWC_AP_StateMachine_CM_boolean 0 0 0 1 ECU_ADDRESS 0x0000 /* @ECU_Address@MeAP_b_MnvSpdExceed@ */ /end MEASUREMENT
/begin MEASUREMENT MeAP_b_Lo4DriveTrain "" UBYTE SWC_AP_StateMachine_CM_boolean 0 0 0 1 ECU_ADDRESS 0x0000 /* @ECU_Address@MeAP_b_Lo4DriveTrain@ */ /end MEASUREMENT
/begin MEASUREMENT MeAP_b_TrlrConn "" UBYTE SWC_AP_StateMachine_CM_boolean 0 0 0 1 ECU_ADDRESS 0x0000 /* @ECU_Address@MeAP_b_TrlrConn@ */ /end MEASUREMENT
/begin MEASUREMENT MeAP_b_FrntSnsrBlk "" UBYTE SWC_AP_StateMachine_CM_boolean 0 0 0 1 ECU_ADDRESS 0x0000 /* @ECU_Address@MeAP_b_FrntSnsrBlk@ */ /end MEASUREMENT
/begin MEASUREMENT MeAP_b_RearSnsrBlk "" UBYTE SWC_AP_StateMachine_CM_boolean 0 0 0 1 ECU_ADDRESS 0x0000 /* @ECU_Address@MeAP_b_RearSnsrBlk@ */ /end MEASUREMENT
/begin MEASUREMENT MeAP_b_ACCEngg "" UBYTE SWC_AP_StateMachine_CM_boolean 0 0 0 1 ECU_ADDRESS 0x0000 /* @ECU_Address@MeAP_b_ACCEngg@ */ /end MEASUREMENT
/begin MEASUREMENT MeAP_b_AbortCon1 "" UBYTE SWC_AP_StateMachine_CM_boolean 0 0 0 1 ECU_ADDRESS 0x0000 /* @ECU_Address@MeAP_b_AbortCon1@ */ /end MEASUREMENT
/begin MEASUREMENT MeAP_b_HandsOn "" UBYTE SWC_AP_StateMachine_CM_boolean 0 0 0 1 ECU_ADDRESS 0x0000 /* @ECU_Address@MeAP_b_HandsOn@ */ /end MEASUREMENT
/begin MEASUREMENT MeAP_b_ManualParkReq "" UBYTE SWC_AP_StateMachine_CM_boolean 0 0 0 1 ECU_ADDRESS 0x0000 /* @ECU_Address@MeAP_b_ManualParkReq@ */ /end MEASUREMENT
/begin MEASUREMENT MeAP_b_AbortCon2 "" UBYTE SWC_AP_StateMachine_CM_boolean 0 0 0 1 ECU_ADDRESS 0x0000 /* @ECU_Address@MeAP_b_AbortCon2@ */ /end MEASUREMENT
/begin MEASUREMENT MeAP_b_BSMHandshakeFailed "" UBYTE SWC_AP_StateMachine_CM_boolean 0 0 0 1 ECU_ADDRESS 0x0000 /* @ECU_Address@MeAP_b_BSMHandshakeFailed@ */ /end MEASUREMENT
/begin MEASUREMENT MeAP_b_EPSHandshakeFailed "" UBYTE SWC_AP_StateMachine_CM_boolean 0 0 0 1 ECU_ADDRESS 0x0000 /* @ECU_Address@MeAP_b_EPSHandshakeFailed@ */ /end MEASUREMENT
/begin MEASUREMENT MeAP_b_TCMFailed "" UBYTE SWC_AP_StateMachine_CM_boolean 0 0 0 1 ECU_ADDRESS 0x0000 /* @ECU_Address@MeAP_b_TCMFailed@ */ /end MEASUREMENT
/begin MEASUREMENT MeAP_b_ETMHandshakeFailed "" UBYTE SWC_AP_StateMachine_CM_boolean 0 0 0 1 ECU_ADDRESS 0x0000 /* @ECU_Address@MeAP_b_ETMHandshakeFailed@ */ /end MEASUREMENT
/begin MEASUREMENT MeAP_b_ObjInPathTimeout "" UBYTE SWC_AP_StateMachine_CM_boolean 0 0 0 1 ECU_ADDRESS 0x0000 /* @ECU_Address@MeAP_b_ObjInPathTimeout@ */ /end MEASUREMENT
/begin MEASUREMENT MeAP_b_PausedPressBtnTimeout "" UBYTE SWC_AP_StateMachine_CM_boolean 0 0 0 1 ECU_ADDRESS 0x0000 /* @ECU_Address@MeAP_b_PausedPressBtnTimeout@ */ /end MEASUREMENT
/begin MEASUREMENT MeAP_b_EPBStsFaulted "" UBYTE SWC_AP_StateMachine_CM_boolean 0 0 0 1 ECU_ADDRESS 0x0000 /* @ECU_Address@MeAP_b_EPBStsFaulted@ */ /end MEASUREMENT
/begin MEASUREMENT MeAP_b_AbortCon3 "" UBYTE SWC_AP_StateMachine_CM_boolean 0 0 0 1 ECU_ADDRESS 0x0000 /* @ECU_Address@MeAP_b_AbortCon3@ */ /end MEASUREMENT
/begin MEASUREMENT MeAP_b_BrkPedlOverride "" UBYTE SWC_AP_StateMachine_CM_boolean 0 0 0 1 ECU_ADDRESS 0x0000 /* @ECU_Address@MeAP_b_BrkPedlOverride@ */ /end MEASUREMENT
/begin MEASUREMENT MeAP_b_GasPedlOverride "" UBYTE SWC_AP_StateMachine_CM_boolean 0 0 0 1 ECU_ADDRESS 0x0000 /* @ECU_Address@MeAP_b_GasPedlOverride@ */ /end MEASUREMENT
/begin MEASUREMENT MeAP_b_GearShiftOverride "" UBYTE SWC_AP_StateMachine_CM_boolean 0 0 0 1 ECU_ADDRESS 0x0000 /* @ECU_Address@MeAP_b_GearShiftOverride@ */ /end MEASUREMENT
/begin MEASUREMENT MeAP_b_EPBOverride "" UBYTE SWC_AP_StateMachine_CM_boolean 0 0 0 1 ECU_ADDRESS 0x0000 /* @ECU_Address@MeAP_b_EPBOverride@ */ /end MEASUREMENT
/begin MEASUREMENT MeAP_b_DriverOverride "" UBYTE SWC_AP_StateMachine_CM_boolean 0 0 0 1 ECU_ADDRESS 0x0000 /* @ECU_Address@MeAP_b_DriverOverride@ */ /end MEASUREMENT
/begin MEASUREMENT MeAP_b_VehCndSts "" UBYTE SWC_AP_StateMachine_CM_boolean 0 0 0 1 ECU_ADDRESS 0x0000 /* @ECU_Address@MeAP_b_VehCndSts@ */ /end MEASUREMENT
/begin MEASUREMENT MeAP_b_APActConAvl "" UBYTE SWC_AP_StateMachine_CM_boolean 0 0 0 1 ECU_ADDRESS 0x0000 /* @ECU_Address@MeAP_b_APActConAvl@ */ /end MEASUREMENT
/begin MEASUREMENT MeAP_s_GearShiftReqWaitCnt "" UWORD SWC_AP_StateMachine_CM_uint16 0 0 0 65535 ECU_ADDRESS 0x0000 /* @ECU_Address@MeAP_s_GearShiftReqWaitCnt@ */ /end MEASUREMENT
/begin MEASUREMENT MeAP_b_PreEPSInterfaceAbort2 "" UBYTE SWC_AP_StateMachine_CM_boolean 0 0 0 1 ECU_ADDRESS 0x0000 /* @ECU_Address@MeAP_b_PreEPSInterfaceAbort2@ */ /end MEASUREMENT
/begin MEASUREMENT MeAP_b_PreEPSInterfaceAbort1 "" UBYTE SWC_AP_StateMachine_CM_boolean 0 0 0 1 ECU_ADDRESS 0x0000 /* @ECU_Address@MeAP_b_PreEPSInterfaceAbort1@ */ /end MEASUREMENT
/begin MEASUREMENT MeAP_b_GearShiftReqWaitTimeout "" UBYTE SWC_AP_StateMachine_CM_boolean 0 0 0 1 ECU_ADDRESS 0x0000 /* @ECU_Address@MeAP_b_GearShiftReqWaitTimeout@ */ /end MEASUREMENT
/begin COMPU_METHOD SWC_AP_StateMachine_CM_single_cnt "Q = V" RAT_FUNC "%8.6" "cnt" COEFFS 0 1 0 0 0 1 /end COMPU_METHOD
/begin COMPU_METHOD SWC_AP_StateMachine_CM_single_kph "Q = V" RAT_FUNC "%8.6" "kph" COEFFS 0 1 0 0 0 1 /end COMPU_METHOD
/begin COMPU_METHOD SWC_AP_StateMachine_CM_single_Kph "Q = V" RAT_FUNC "%8.6" "Kph" COEFFS 0 1 0 0 0 1 /end COMPU_METHOD
/begin COMPU_METHOD SWC_AP_StateMachine_CM_single "Q = V" RAT_FUNC "%8.6" "" COEFFS 0 1 0 0 0 1 /end COMPU_METHOD
/begin COMPU_METHOD SWC_AP_StateMachine_CM_uint16_ms "Q = V" RAT_FUNC "%5.0" "ms" COEFFS 0 1 0 0 0 1 /end COMPU_METHOD
/begin COMPU_METHOD SWC_AP_StateMachine_CM_uint16_cnt "Q = V" RAT_FUNC "%5.0" "cnt" COEFFS 0 1 0 0 0 1 /end COMPU_METHOD
/begin COMPU_METHOD SWC_AP_StateMachine_CM_uint16 "Q = V" RAT_FUNC "%5.0" "" COEFFS 0 1 0 0 0 1 /end COMPU_METHOD
/begin COMPU_METHOD SWC_AP_StateMachine_CM_uint16_sec "Q = V" RAT_FUNC "%5.0" "sec" COEFFS 0 1 0 0 0 1 /end COMPU_METHOD
/begin COMPU_METHOD SWC_AP_StateMachine_CM_boolean "Q = V" RAT_FUNC "%1.0" "" COEFFS 0 1 0 0 0 1 /end COMPU_METHOD
/begin COMPU_METHOD SWC_AP_StateMachine_CM_uint32 "Q = V" RAT_FUNC "%10.0" "" COEFFS 0 1 0 0 0 1 /end COMPU_METHOD
/begin GROUP SWC_AP_StateMachine "SWC_AP_StateMachine" /* Root */ ROOT /begin SUB_GROUP Root_SWC_AP_StateMachine /end SUB_GROUP /end GROUP
/begin GROUP Root_SWC_AP_StateMachine "SWC_AP_StateMachine/SWC_AP_StateMachine"
 /begin SUB_GROUP S3_AP_PreRequisits S3_AP_Statemachine S3_USSFiringModes S3_VC_InputPreProcessing /end SUB_GROUP
/end GROUP
/begin GROUP S3_AP_PreRequisits "SWC_AP_StateMachine/SWC_AP_StateMachine/AP_PreRequisits"
 /begin SUB_GROUP S4_AP_EnablingCondition S4_AbortCondition S4_AbortConditionCheck /end SUB_GROUP
/end GROUP
/begin GROUP S3_AP_Statemachine "SWC_AP_StateMachine/SWC_AP_StateMachine/AP_Statemachine"
 /begin REF_CHARACTERISTIC KeAP_cnt_AbortDelayWaitCnt KeAP_cnt_AbortHMIWaitCnt KeAP_cnt_RelCntrlWaitThd KeAP_cnt_ScreenChimeTimeoutDur KeAP_cnt_ScreenWaitTimeoutDur KeAP_cnt_StandstillTimeoutDur KeAP_kph_StandStillSpdThd KeAP_s_GearShiftReqWaitCnt KeAP_s_WaitEngineOnThd /end REF_CHARACTERISTIC
 /begin REF_MEASUREMENT MeAP_b_GearShiftReqWaitTimeout MeAP_b_InitBrkPedlPressed MeAP_b_PreEPSInterfaceAbort1 MeAP_b_PreEPSInterfaceAbort2 MeAP_cnt_StateDebugVar MeAP_cnt_TransDebugVar MeAP_s_GearShiftReqWaitCnt /end REF_MEASUREMENT
/end GROUP
/begin GROUP S3_USSFiringModes "SWC_AP_StateMachine/SWC_AP_StateMachine/USSFiringModes" /begin SUB_GROUP S9_USSReInit S9_USSSystemModeCal /end SUB_GROUP /end GROUP
/begin GROUP S3_VC_InputPreProcessing "SWC_AP_StateMachine/SWC_AP_StateMachine/VC_InputPreProcessing" /begin SUB_GROUP S10_ResetKM1 /end SUB_GROUP /end GROUP
/begin GROUP S4_AP_EnablingCondition "SWC_AP_StateMachine/SWC_AP_StateMachine/AP_PreRequisits/AP_EnablingCondition"
 /begin SUB_GROUP S12_AP_FeatureEnable S12_AP_VehicleConditions S12_DriverOverride /end SUB_GROUP
/end GROUP
/begin GROUP S4_AbortCondition "SWC_AP_StateMachine/SWC_AP_StateMachine/AP_PreRequisits/AbortCondition" /begin REF_CHARACTERISTIC KeAP_b_DevlopmentTest /end REF_CHARACTERISTIC /begin REF_MEASUREMENT MeAP_b_AbortCon1 MeAP_b_AbortCon2 MeAP_b_AbortCon3 /end REF_MEASUREMENT /end GROUP
/begin GROUP S4_AbortConditionCheck "SWC_AP_StateMachine/SWC_AP_StateMachine/AP_PreRequisits/AbortConditionCheck" /begin REF_CHARACTERISTIC KeAP_kph_PSDOffThd KeAP_kph_ParkMnvThd /end REF_CHARACTERISTIC
 /begin REF_MEASUREMENT MeAP_b_ACCEngg MeAP_b_BSMHandshakeFailed MeAP_b_BtnPsd MeAP_b_DoorOpen MeAP_b_EPBStsFaulted MeAP_b_EPSHandshakeFailed MeAP_b_ESCActive MeAP_b_ETMHandshakeFailed MeAP_b_FrntSnsrBlk MeAP_b_HandsOn MeAP_b_LifeGateOpen MeAP_b_Lo4DriveTrain MeAP_b_ManualParkReq MeAP_b_MnvSpdExceed MeAP_b_ObjInPathTimeout MeAP_b_PausedPressBtnTimeout MeAP_b_RearSnsrBlk MeAP_b_SeekSpdExceed MeAP_b_TCMFailed MeAP_b_TrlrConn /end REF_MEASUREMENT
/end GROUP
/begin GROUP S9_USSReInit "SWC_AP_StateMachine/SWC_AP_StateMachine/USSFiringModes/USSReInit" /begin REF_CHARACTERISTIC KeAP_kph_FrntWarnMaxSpdThd /end REF_CHARACTERISTIC /end GROUP
/begin GROUP S9_USSSystemModeCal "SWC_AP_StateMachine/SWC_AP_StateMachine/USSFiringModes/USSSystemModeCal" /begin REF_CHARACTERISTIC KeAP_kph_FrntWarnMaxSpdThd KeAP_kph_RearWarnMaxSpdThd /end REF_CHARACTERISTIC /end GROUP
/begin GROUP S10_ResetKM1 "SWC_AP_StateMachine/SWC_AP_StateMachine/VC_InputPreProcessing/ResetKM1" /begin REF_CHARACTERISTIC KeAP_kph_FrntWarnMaxSpdThd /end REF_CHARACTERISTIC /end GROUP
/begin GROUP S12_AP_FeatureEnable "SWC_AP_StateMachine/SWC_AP_StateMachine/AP_PreRequisits/AP_EnablingCondition/AP_FeatureEnable" /begin REF_MEASUREMENT MeAP_b_APActConAvl /end REF_MEASUREMENT /end GROUP
/begin GROUP S12_AP_VehicleConditions "SWC_AP_StateMachine/SWC_AP_StateMachine/AP_PreRequisits/AP_EnablingCondition/AP_VehicleConditions" /begin REF_MEASUREMENT MeAP_b_VehCndSts /end REF_MEASUREMENT /end GROUP
/begin GROUP S12_DriverOverride "SWC_AP_StateMachine/SWC_AP_StateMachine/AP_PreRequisits/AP_EnablingCondition/DriverOverride" /begin SUB_GROUP S31_OnTimer /end SUB_GROUP
 /begin REF_CHARACTERISTIC KeAP_Cnt_GearOverrideTimeThd KeAP_cnt_TimeStep KeAP_pct_PdlPosActThd /end REF_CHARACTERISTIC
 /begin REF_MEASUREMENT MeAP_b_BrkPedlOverride MeAP_b_DriverOverride MeAP_b_EPBOverride MeAP_b_GasPedlOverride /end REF_MEASUREMENT
/end GROUP
/begin GROUP S31_OnTimer "SWC_AP_StateMachine/SWC_AP_StateMachine/AP_PreRequisits/AP_EnablingCondition/DriverOverride/OnTimer" /begin REF_MEASUREMENT MeAP_b_GearShiftOverride /end REF_MEASUREMENT /end GROUP
/end MODULE
/end PROJECT
/* (add any file trailer comments here) */
/* EOF SWC_AP_StateMachine.a2l */
