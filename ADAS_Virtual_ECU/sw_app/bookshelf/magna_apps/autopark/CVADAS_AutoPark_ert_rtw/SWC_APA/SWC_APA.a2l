/******************************************************************************
* ASAP2 file: SWC_APA.a2l
* Code generation for model "SWC_APA".
* Model version : 1.594
* Simulink Coder version : 9.2 (R2019b) 18-Jul-2019
* C source code generated on : Wed Nov 12 18:11:22 2025
* Target selection: ert.tlc
* Embedded hardware selection: ARM Compatible->ARM Cortex
* Code generation objectives:
* 1. MISRA C:2012 guidelines
* 2. RAM efficiency
* 3. ROM efficiency
* Validation result: Not run
* (add additional file header information here)
******************************************************************************/ ASAP2_VERSION 1 31
/* Version 1.31 */
/begin PROJECT ProjectName "Project Comment Goes Here"
/begin HEADER "Header Comments go here" /end HEADER
/begin MODULE ModuleName "Module Comment Goes Here"
/begin MOD_PAR "MOD PAR Comment Goes Here" /end MOD_PAR
/begin MOD_COMMON "Mod Common Comment Here" BYTE_ORDER MSB_LAST /end MOD_COMMON
/begin RECORD_LAYOUT Scalar_BOOLEAN FNC_VALUES 1 UBYTE COLUMN_DIR DIRECT /end RECORD_LAYOUT
/begin RECORD_LAYOUT Scalar_UBYTE FNC_VALUES 1 UBYTE COLUMN_DIR DIRECT /end RECORD_LAYOUT
/begin RECORD_LAYOUT Scalar_BYTE FNC_VALUES 1 SBYTE COLUMN_DIR DIRECT /end RECORD_LAYOUT
/begin RECORD_LAYOUT Scalar_UWORD FNC_VALUES 1 UWORD COLUMN_DIR DIRECT /end RECORD_LAYOUT
/begin RECORD_LAYOUT Scalar_SWORD FNC_VALUES 1 SWORD COLUMN_DIR DIRECT /end RECORD_LAYOUT
/begin RECORD_LAYOUT Scalar_ULONG FNC_VALUES 1 ULONG COLUMN_DIR DIRECT /end RECORD_LAYOUT
/begin RECORD_LAYOUT Scalar_LONG FNC_VALUES 1 SLONG COLUMN_DIR DIRECT /end RECORD_LAYOUT
/begin RECORD_LAYOUT Scalar_FLOAT32_IEEE FNC_VALUES 1 FLOAT32_IEEE COLUMN_DIR DIRECT /end RECORD_LAYOUT
/begin RECORD_LAYOUT Scalar_FLOAT64_IEEE FNC_VALUES 1 FLOAT64_IEEE COLUMN_DIR DIRECT /end RECORD_LAYOUT
/begin RECORD_LAYOUT Lookup1D_BOOLEAN FNC_VALUES 1 UBYTE COLUMN_DIR DIRECT /end RECORD_LAYOUT
/begin RECORD_LAYOUT Lookup1D_X_BOOLEAN AXIS_PTS_X 1 UBYTE INDEX_INCR DIRECT /end RECORD_LAYOUT
/begin RECORD_LAYOUT Lookup1D_BYTE FNC_VALUES 1 SBYTE COLUMN_DIR DIRECT /end RECORD_LAYOUT
/begin RECORD_LAYOUT Lookup1D_X_BYTE AXIS_PTS_X 1 SBYTE INDEX_INCR DIRECT /end RECORD_LAYOUT
/begin RECORD_LAYOUT Lookup1D_UBYTE FNC_VALUES 1 UBYTE COLUMN_DIR DIRECT /end RECORD_LAYOUT
/begin RECORD_LAYOUT Lookup1D_X_UBYTE AXIS_PTS_X 1 UBYTE INDEX_INCR DIRECT /end RECORD_LAYOUT
/begin RECORD_LAYOUT Lookup1D_UWORD FNC_VALUES 1 UWORD COLUMN_DIR DIRECT /end RECORD_LAYOUT
/begin RECORD_LAYOUT Lookup1D_X_UWORD AXIS_PTS_X 1 UWORD INDEX_INCR DIRECT /end RECORD_LAYOUT
/begin RECORD_LAYOUT Lookup1D_WORD FNC_VALUES 1 SWORD COLUMN_DIR DIRECT /end RECORD_LAYOUT
/begin RECORD_LAYOUT Lookup1D_X_WORD AXIS_PTS_X 1 SWORD INDEX_INCR DIRECT /end RECORD_LAYOUT
/begin RECORD_LAYOUT Lookup1D_ULONG FNC_VALUES 1 ULONG COLUMN_DIR DIRECT /end RECORD_LAYOUT
/begin RECORD_LAYOUT Lookup1D_X_ULONG AXIS_PTS_X 1 ULONG INDEX_INCR DIRECT /end RECORD_LAYOUT
/begin RECORD_LAYOUT Lookup1D_SLONG FNC_VALUES 1 SLONG COLUMN_DIR DIRECT /end RECORD_LAYOUT
/begin RECORD_LAYOUT Lookup1D_X_LONG AXIS_PTS_X 1 SLONG INDEX_INCR DIRECT /end RECORD_LAYOUT
/begin RECORD_LAYOUT Lookup1D_FLOAT32_IEEE FNC_VALUES 1 FLOAT32_IEEE COLUMN_DIR DIRECT /end RECORD_LAYOUT
/begin RECORD_LAYOUT Lookup1D_X_FLOAT32_IEEE AXIS_PTS_X 1 FLOAT32_IEEE INDEX_INCR DIRECT /end RECORD_LAYOUT
/begin RECORD_LAYOUT Lookup1D_FLOAT64_IEEE FNC_VALUES 1 FLOAT64_IEEE COLUMN_DIR DIRECT /end RECORD_LAYOUT
/begin RECORD_LAYOUT Lookup1D_X_FLOAT64_IEEE AXIS_PTS_X 1 FLOAT64_IEEE INDEX_INCR DIRECT /end RECORD_LAYOUT
/begin RECORD_LAYOUT Lookup2D_BOOLEAN FNC_VALUES 1 UBYTE COLUMN_DIR DIRECT /end RECORD_LAYOUT
/begin RECORD_LAYOUT Lookup2D_X_BOOLEAN AXIS_PTS_X 1 UBYTE INDEX_INCR DIRECT /end RECORD_LAYOUT
/begin RECORD_LAYOUT Lookup2D_UBYTE FNC_VALUES 1 UBYTE COLUMN_DIR DIRECT /end RECORD_LAYOUT
/begin RECORD_LAYOUT Lookup2D_X_UBYTE AXIS_PTS_X 1 UBYTE INDEX_INCR DIRECT /end RECORD_LAYOUT
/begin RECORD_LAYOUT Lookup2D_BYTE FNC_VALUES 1 SBYTE COLUMN_DIR DIRECT /end RECORD_LAYOUT
/begin RECORD_LAYOUT Lookup2D_X_BYTE AXIS_PTS_X 1 SBYTE INDEX_INCR DIRECT /end RECORD_LAYOUT
/begin RECORD_LAYOUT Lookup2D_UWORD FNC_VALUES 1 UWORD COLUMN_DIR DIRECT /end RECORD_LAYOUT
/begin RECORD_LAYOUT Lookup2D_X_UWORD AXIS_PTS_X 1 UWORD INDEX_INCR DIRECT /end RECORD_LAYOUT
/begin RECORD_LAYOUT Lookup2D_WORD FNC_VALUES 1 SWORD COLUMN_DIR DIRECT /end RECORD_LAYOUT
/begin RECORD_LAYOUT Lookup2D_X_WORD AXIS_PTS_X 1 SWORD INDEX_INCR DIRECT /end RECORD_LAYOUT
/begin RECORD_LAYOUT Lookup2D_ULONG FNC_VALUES 1 ULONG COLUMN_DIR DIRECT /end RECORD_LAYOUT
/begin RECORD_LAYOUT Lookup2D_X_ULONG AXIS_PTS_X 1 ULONG INDEX_INCR DIRECT /end RECORD_LAYOUT
/begin RECORD_LAYOUT Lookup2D_LONG FNC_VALUES 1 SLONG COLUMN_DIR DIRECT /end RECORD_LAYOUT
/begin RECORD_LAYOUT Lookup2D_X_LONG AXIS_PTS_X 1 SLONG INDEX_INCR DIRECT /end RECORD_LAYOUT
/begin RECORD_LAYOUT Lookup2D_FLOAT32_IEEE FNC_VALUES 1 FLOAT32_IEEE COLUMN_DIR DIRECT /end RECORD_LAYOUT
/begin RECORD_LAYOUT Lookup2D_X_FLOAT32_IEEE AXIS_PTS_X 1 FLOAT32_IEEE INDEX_INCR DIRECT /end RECORD_LAYOUT
/begin RECORD_LAYOUT Lookup2D_FLOAT64_IEEE FNC_VALUES 1 FLOAT64_IEEE COLUMN_DIR DIRECT /end RECORD_LAYOUT
/begin RECORD_LAYOUT Lookup2D_X_FLOAT64_IEEE AXIS_PTS_X 1 FLOAT64_IEEE INDEX_INCR DIRECT /end RECORD_LAYOUT
/begin CHARACTERISTIC KeAP_cm_FrntWallZone1Adj "" VALUE 0x0000 /* @ECU_Address@KeAP_cm_FrntWallZone1Adj@ */ Scalar_FLOAT32_IEEE 0 SWC_APA_CM_single 0.0 100.0 /end CHARACTERISTIC
/begin CHARACTERISTIC KeAP_cm_RearBrkDistChngLwThresh "Rear Braking Dist Change lower Threshold" VALUE 0x0000 /* @ECU_Address@KeAP_cm_RearBrkDistChngLwThresh@ */ Scalar_FLOAT32_IEEE 0 SWC_APA_CM_single -3.4E+38 3.4E+38 /end CHARACTERISTIC
/begin CHARACTERISTIC KeAP_cm_RearBrkDistChngUpThresh "Rear Braking Dist Change upper Threshold" VALUE 0x0000 /* @ECU_Address@KeAP_cm_RearBrkDistChngUpThresh@ */ Scalar_FLOAT32_IEEE 0 SWC_APA_CM_single -3.4E+38 3.4E+38 /end CHARACTERISTIC
/begin CHARACTERISTIC KeAP_cm_RearWallZone1Adj "" VALUE 0x0000 /* @ECU_Address@KeAP_cm_RearWallZone1Adj@ */ Scalar_FLOAT32_IEEE 0 SWC_APA_CM_single 0.0 100.0 /end CHARACTERISTIC
/begin CHARACTERISTIC KeAP_cnt_ArcBlipVehSpdThd "" VAL_BLK 0x0000 /* @ECU_Address@KeAP_cnt_ArcBlipVehSpdThd@ */ Scalar_FLOAT32_IEEE 0 SWC_APA_CM_single -3.4E+38 3.4E+38 /* Array Size */ NUMBER 6 /end CHARACTERISTIC
/begin CHARACTERISTIC KeAP_kph_EnblHysThd "Hystere sis threshold to apply for all vehicle speed related threshold parameters" VALUE 0x0000 /* @ECU_Address@KeAP_kph_EnblHysThd@ */ Scalar_FLOAT32_IEEE 0 SWC_APA_CM_single_kph 0.0 2.0 /end CHARACTERISTIC
/begin CHARACTERISTIC KeAP_kph_FrntWarnMaxSpdThd "Vehicle speed threshold during Front Park Assist feature" VALUE 0x0000 /* @ECU_Address@KeAP_kph_FrntWarnMaxSpdThd@ */ Scalar_FLOAT32_IEEE 0 SWC_APA_CM_single_kph 0.0 11.0 /end CHARACTERISTIC
/begin CHARACTERISTIC KeAP_kph_RearWarnMaxSpdThd "Vehicle speed threshold during Rear Park Assist feature" VALUE 0x0000 /* @ECU_Address@KeAP_kph_RearWarnMaxSpdThd@ */ Scalar_FLOAT32_IEEE 0 SWC_APA_CM_single_kph 0.0 11.0 /end CHARACTERISTIC
/begin CHARACTERISTIC KeAP_cm_DistZone1 "Warning Zone 1 Dist" VALUE 0x0000 /* @ECU_Address@KeAP_cm_DistZone1@ */ Scalar_SWORD 0 SWC_APA_CM_int16_cm 0.0 32767 /end CHARACTERISTIC
/begin CHARACTERISTIC KeAP_cm_DistZone2 "Warning Zone 2 Dist" VALUE 0x0000 /* @ECU_Address@KeAP_cm_DistZone2@ */ Scalar_SWORD 0 SWC_APA_CM_int16_cm 0.0 32767 /end CHARACTERISTIC
/begin CHARACTERISTIC KeAP_cm_DistZone3 "Warning Zone 3 Dist" VALUE 0x0000 /* @ECU_Address@KeAP_cm_DistZone3@ */ Scalar_SWORD 0 SWC_APA_CM_int16_cm 0.0 32767 /end CHARACTERISTIC
/begin CHARACTERISTIC KeAP_cm_DistZone4 "Warning Zone 4 Dist" VALUE 0x0000 /* @ECU_Address@KeAP_cm_DistZone4@ */ Scalar_SWORD 0 SWC_APA_CM_int16_cm 0.0 32767 /end CHARACTERISTIC
/begin CHARACTERISTIC KeAP_cm_DistZone5 "Warning Zone 5 Dist" VALUE 0x0000 /* @ECU_Address@KeAP_cm_DistZone5@ */ Scalar_SWORD 0 SWC_APA_CM_int16_cm 0.0 32767 /end CHARACTERISTIC
/begin CHARACTERISTIC KeAP_cm_DistZone6 "Warning Zone 6 Dist" VALUE 0x0000 /* @ECU_Address@KeAP_cm_DistZone6@ */ Scalar_SWORD 0 SWC_APA_CM_int16_cm 0.0 32767 /end CHARACTERISTIC
/begin CHARACTERISTIC KeAP_cm_FrntDistZone1 "Warning Zone 1 Dist" VALUE 0x0000 /* @ECU_Address@KeAP_cm_FrntDistZone1@ */ Scalar_SWORD 0 SWC_APA_CM_int16_cm 0.0 32767 /end CHARACTERISTIC
/begin CHARACTERISTIC KeAP_cm_FrntDistZone2 "Warning Zone 2 Dist" VALUE 0x0000 /* @ECU_Address@KeAP_cm_FrntDistZone2@ */ Scalar_SWORD 0 SWC_APA_CM_int16_cm 0.0 32767 /end CHARACTERISTIC
/begin CHARACTERISTIC KeAP_cm_FrntDistZone3 "Warning Zone 3 Dist" VALUE 0x0000 /* @ECU_Address@KeAP_cm_FrntDistZone3@ */ Scalar_SWORD 0 SWC_APA_CM_int16_cm 0.0 32767 /end CHARACTERISTIC
/begin CHARACTERISTIC KeAP_cm_FrntDistZone4 "Warning Zone 4 Dist" VALUE 0x0000 /* @ECU_Address@KeAP_cm_FrntDistZone4@ */ Scalar_SWORD 0 SWC_APA_CM_int16_cm 0.0 32767 /end CHARACTERISTIC
/begin CHARACTERISTIC KeAP_cm_FrntDistZone5 "Warning Zone 5 Dist" VALUE 0x0000 /* @ECU_Address@KeAP_cm_FrntDistZone5@ */ Scalar_SWORD 0 SWC_APA_CM_int16_cm 0.0 32767 /end CHARACTERISTIC
/begin CHARACTERISTIC KeAP_cm_FrntDistZone6 "Warning Zone 6 Dist" VALUE 0x0000 /* @ECU_Address@KeAP_cm_FrntDistZone6@ */ Scalar_SWORD 0 SWC_APA_CM_int16_cm 0.0 32767 /end CHARACTERISTIC
/begin CHARACTERISTIC CeAP_ms_SampleTime "" VALUE 0x0000 /* @ECU_Address@CeAP_ms_SampleTime@ */ Scalar_UWORD 0 SWC_APA_CM_uint16 0.0 65535 /end CHARACTERISTIC
/begin CHARACTERISTIC KeAP_cnt_ArcBlipStandstillTimer "" VALUE 0x0000 /* @ECU_Address@KeAP_cnt_ArcBlipStandstillTimer@ */ Scalar_UWORD 0 SWC_APA_CM_uint16 0 65535 /end CHARACTERISTIC
/begin CHARACTERISTIC KeAP_cnt_ArcBlipVehInMotTimer "" VAL_BLK 0x0000 /* @ECU_Address@KeAP_cnt_ArcBlipVehInMotTimer@ */ Scalar_UWORD 0 SWC_APA_CM_uint16 0 65535 /* Array Size */ NUMBER 6 /end CHARACTERISTIC
/begin CHARACTERISTIC KeAP_cnt_BootupTimeThd "Time threshold for ECU bootup" VALUE 0x0000 /* @ECU_Address@KeAP_cnt_BootupTimeThd@ */ Scalar_UWORD 0 SWC_APA_CM_uint16_cnt 0 65535 /end CHARACTERISTIC
/begin CHARACTERISTIC KeAP_cnt_BtnPressPopUpTimeThd "Time for which Startup PopUp Requests are shown" VALUE 0x0000 /* @ECU_Address@KeAP_cnt_BtnPressPopUpTimeThd@ */ Scalar_UWORD 0 SWC_APA_CM_uint16_cnt 0.0 65535 /end CHARACTERISTIC
/begin CHARACTERISTIC KeAP_cnt_PlntModeLEDBlinkTimeThd "Time Step for LED blinking for ECU-In Plant Mode" VALUE 0x0000 /* @ECU_Address@KeAP_cnt_PlntModeLEDBlinkTimeThd@ */ Scalar_UWORD 0 SWC_APA_CM_uint16_sec 0 65535 /end CHARACTERISTIC
/begin CHARACTERISTIC KeAP_cnt_TimeStep "Time Step for Counter " VALUE 0x0000 /* @ECU_Address@KeAP_cnt_TimeStep@ */ Scalar_UWORD 0 SWC_APA_CM_uint16_sec 0 65535 /end CHARACTERISTIC
/begin CHARACTERISTIC KeAP_b_EnVehStandstillArcBlip "" VALUE 0x0000 /* @ECU_Address@KeAP_b_EnVehStandstillArcBlip@ */ Scalar_BOOLEAN 0 SWC_APA_CM_boolean 0 1 /end CHARACTERISTIC
/begin CHARACTERISTIC KeAP_b_EnWallAcurracy "" VALUE 0x0000 /* @ECU_Address@KeAP_b_EnWallAcurracy@ */ Scalar_BOOLEAN 0 SWC_APA_CM_boolean 0.0 1.0 /end CHARACTERISTIC
/begin CHARACTERISTIC KeAP_b_RPAwithBrk "Ego vehicle shall be equipped with Rear Park Assist with Brake" VALUE 0x0000 /* @ECU_Address@KeAP_b_RPAwithBrk@ */ Scalar_BOOLEAN 0 SWC_APA_CM_boolean 0.0 1.0 /end CHARACTERISTIC
/begin CHARACTERISTIC KeAP_b_SwitchOldAlgo "" VALUE 0x0000 /* @ECU_Address@KeAP_b_SwitchOldAlgo@ */ Scalar_BOOLEAN 0 SWC_APA_CM_boolean 0.0 1 /end CHARACTERISTIC
/begin CHARACTERISTIC KeAP_e_GbTypAT "ATX Gear_Box_Type" VALUE 0x0000 /* @ECU_Address@KeAP_e_GbTypAT@ */ Scalar_UBYTE 0 SWC_APA_CM_uint8 0 255 /end CHARACTERISTIC
/begin CHARACTERISTIC KePA_b_EnHeightFlagFrontSideArcs "Enable DNN Flag check for Side front arcs" VALUE 0x0000 /* @ECU_Address@KePA_b_EnHeightFlagFrontSideArcs@ */ Scalar_UBYTE 0 SWC_APA_CM_uint8 0.0 1.0 /end CHARACTERISTIC
/begin CHARACTERISTIC KePA_b_EnHeightFlagRearSideArcs "Enable DNN Flag check for Side rear arc" VALUE 0x0000 /* @ECU_Address@KePA_b_EnHeightFlagRearSideArcs@ */ Scalar_UBYTE 0 SWC_APA_CM_uint8 0.0 1.0 /end CHARACTERISTIC
/begin CHARACTERISTIC KePA_b_IsDnnHeightLow "Enable DNN Flag check" VALUE 0x0000 /* @ECU_Address@KePA_b_IsDnnHeightLow@ */ Scalar_UBYTE 0 SWC_APA_CM_uint8 0.0 1.0 /end CHARACTERISTIC
/begin MEASUREMENT SWC_APA_B.MeAP_TransitionDebugVar "" UBYTE SWC_APA_CM_uint8 0 0 0 255 ECU_ADDRESS 0x0000 /* @ECU_Address@SWC_APA_B.MeAP_TransitionDebugVar@ */ /end MEASUREMENT
/begin MEASUREMENT MeAP_b_FrontParkAssistEnbl "" UBYTE SWC_APA_CM_boolean 0 0 0 1 ECU_ADDRESS 0x0000 /* @ECU_Address@MeAP_b_FrontParkAssistEnbl@ */ /end MEASUREMENT
/begin MEASUREMENT MeAP_b_FrntParkAssistStatus "" UBYTE SWC_APA_CM_boolean 0 0 0 1 ECU_ADDRESS 0x0000 /* @ECU_Address@MeAP_b_FrntParkAssistStatus@ */ /end MEASUREMENT
/begin MEASUREMENT MeAP_b_RearParkAssistEnbl "" UBYTE SWC_APA_CM_boolean 0 0 0 1 ECU_ADDRESS 0x0000 /* @ECU_Address@MeAP_b_RearParkAssistEnbl@ */ /end MEASUREMENT
/begin MEASUREMENT MeAP_b_RearParkAssistStatus "" UBYTE SWC_APA_CM_boolean 0 0 0 1 ECU_ADDRESS 0x0000 /* @ECU_Address@MeAP_b_RearParkAssistStatus@ */ /end MEASUREMENT
/begin MEASUREMENT MeAP_b_RPASwtStuckStatus "" UBYTE SWC_APA_CM_boolean 0 0 0 1 ECU_ADDRESS 0x0000 /* @ECU_Address@MeAP_b_RPASwtStuckStatus@ */ /end MEASUREMENT
/begin MEASUREMENT MeAP_b_FPASwtStuckStatus "" UBYTE SWC_APA_CM_boolean 0 0 0 1 ECU_ADDRESS 0x0000 /* @ECU_Address@MeAP_b_FPASwtStuckStatus@ */ /end MEASUREMENT
/begin COMPU_METHOD SWC_APA_CM_single "Q = V" RAT_FUNC "%8.6" "" COEFFS 0 1 0 0 0 1 /end COMPU_METHOD
/begin COMPU_METHOD SWC_APA_CM_single_kph "Q = V" RAT_FUNC "%8.6" "kph" COEFFS 0 1 0 0 0 1 /end COMPU_METHOD
/begin COMPU_METHOD SWC_APA_CM_int16_cm "Q = V" RAT_FUNC "%5.0" "cm" COEFFS 0 1 0 0 0 1 /end COMPU_METHOD
/begin COMPU_METHOD SWC_APA_CM_uint16 "Q = V" RAT_FUNC "%5.0" "" COEFFS 0 1 0 0 0 1 /end COMPU_METHOD
/begin COMPU_METHOD SWC_APA_CM_uint16_cnt "Q = V" RAT_FUNC "%5.0" "cnt" COEFFS 0 1 0 0 0 1 /end COMPU_METHOD
/begin COMPU_METHOD SWC_APA_CM_uint16_sec "Q = V" RAT_FUNC "%5.0" "sec" COEFFS 0 1 0 0 0 1 /end COMPU_METHOD
/begin COMPU_METHOD SWC_APA_CM_boolean "Q = V" RAT_FUNC "%1.0" "" COEFFS 0 1 0 0 0 1 /end COMPU_METHOD
/begin COMPU_METHOD SWC_APA_CM_uint8 "Q = V" RAT_FUNC "%3.0" "" COEFFS 0 1 0 0 0 1 /end COMPU_METHOD
/begin GROUP SWC_APA "SWC_APA" /* Root */ ROOT /begin SUB_GROUP Root_SWC_APA /end SUB_GROUP /end GROUP
/begin GROUP Root_SWC_APA "SWC_APA/SWC_APA"
 /begin SUB_GROUP S2_PA_EnableCondition S2_PA_StateMachine S2_Rear_Front_ParkAssist /end SUB_GROUP
/end GROUP
/begin GROUP S2_PA_EnableCondition "SWC_APA/SWC_APA/PA_EnableCondition" /begin SUB_GROUP S4_APA_EnablingCondition S4_SnsrStatusUpdate /end SUB_GROUP /end GROUP
/begin GROUP S2_PA_StateMachine "SWC_APA/SWC_APA/PA_StateMachine" /begin REF_MEASUREMENT SWC_APA_B.MeAP_TransitionDebugVar /end REF_MEASUREMENT /end GROUP
/begin GROUP S2_Rear_Front_ParkAssist "SWC_APA/SWC_APA/Rear_Front_ParkAssist" /begin SUB_GROUP S6_FPA S6_PAMPopUpReq_Gen S6_RPA S6_RPAwithBrk /end SUB_GROUP /end GROUP
/begin GROUP S4_APA_EnablingCondition "SWC_APA/SWC_APA/PA_EnableCondition/APA_EnablingCondition"
 /begin SUB_GROUP S8_FPA_EnablingCondition S8_PAM2BTSwtStatusUpdate S8_PAMSwtStatusUpdate S8_RPA_EnablingCondition /end SUB_GROUP
/end GROUP
/begin GROUP S4_SnsrStatusUpdate "SWC_APA/SWC_APA/PA_EnableCondition/SnsrStatusUpdate" /begin SUB_GROUP S10_FrntSnsrStatusUpdate S10_RearSnsrStatusUpdate /end SUB_GROUP /end GROUP
/begin GROUP S6_FPA "SWC_APA/SWC_APA/Rear_Front_ParkAssist/FPA"
 /begin SUB_GROUP S52_AP_FrntPAMLedStatusGen S52_FPA_ChimeAlertUpdate S52_FPA_GraphicAlertGen S52_FrontHysteresis /end SUB_GROUP
/end GROUP
/begin GROUP S6_PAMPopUpReq_Gen "SWC_APA/SWC_APA/Rear_Front_ParkAssist/PAMPopUpReq_Gen"
 /begin SUB_GROUP S54_HoldPopUpRq S54_PopUpRq_Conditions S54_TimerForFrontSwitchPress S54_TimerForRearSwitchPress /end SUB_GROUP
/end GROUP
/begin GROUP S6_RPA "SWC_APA/SWC_APA/Rear_Front_ParkAssist/RPA"
 /begin SUB_GROUP S56_AP_RearPAMLedStatusGen S56_RPA_ChimeAlertUpdate S56_RPA_GraphicAlertGen S56_RearHysteresis /end SUB_GROUP
/end GROUP
/begin GROUP S6_RPAwithBrk "SWC_APA/SWC_APA/Rear_Front_ParkAssist/RPAwithBrk"
 /begin SUB_GROUP S57_BrkReqStatusUpdate S57_DisableRearBraking S57_RearDistHoldLogic mr_grp2link_Rear_ObjectDection /end SUB_GROUP
 /begin REF_CHARACTERISTIC KeAP_b_RPAwithBrk /end REF_CHARACTERISTIC
/end GROUP
/begin GROUP S8_FPA_EnablingCondition "SWC_APA/SWC_APA/PA_EnableCondition/APA_EnablingCondition/FPA_EnablingCondition" /begin REF_MEASUREMENT MeAP_b_FrontParkAssistEnbl /end REF_MEASUREMENT /end GROUP
/begin GROUP S8_PAM2BTSwtStatusUpdate "SWC_APA/SWC_APA/PA_EnableCondition/APA_EnablingCondition/PAM2BTSwtStatusUpdate" /begin SUB_GROUP S13_FPASwtStuckStatusUpdate S13_RPASwtStuckStatusUpdate /end SUB_GROUP /end GROUP
/begin GROUP S8_PAMSwtStatusUpdate "SWC_APA/SWC_APA/PA_EnableCondition/APA_EnablingCondition/PAMSwtStatusUpdate" /begin REF_MEASUREMENT MeAP_b_FrntParkAssistStatus MeAP_b_RearParkAssistStatus /end REF_MEASUREMENT /end GROUP
/begin GROUP S8_RPA_EnablingCondition "SWC_APA/SWC_APA/PA_EnableCondition/APA_EnablingCondition/RPA_EnablingCondition" /begin REF_MEASUREMENT MeAP_b_RearParkAssistEnbl /end REF_MEASUREMENT /end GROUP
/begin GROUP S10_FrntSnsrStatusUpdate "SWC_APA/SWC_APA/PA_EnableCondition/SnsrStatusUpdate/FrntSnsrStatusUpdate" /begin REF_CHARACTERISTIC KeAP_kph_FrntWarnMaxSpdThd /end REF_CHARACTERISTIC /end GROUP
/begin GROUP S10_RearSnsrStatusUpdate "SWC_APA/SWC_APA/PA_EnableCondition/SnsrStatusUpdate/RearSnsrStatusUpdate" /begin REF_CHARACTERISTIC KeAP_kph_RearWarnMaxSpdThd /end REF_CHARACTERISTIC /end GROUP
/begin GROUP S52_AP_FrntPAMLedStatusGen "SWC_APA/SWC_APA/Rear_Front_ParkAssist/FPA/AP_FrntPAMLedStatusGen" /begin SUB_GROUP S78_TimerForFrontSwitchPress /end SUB_GROUP /begin REF_CHARACTERISTIC KeAP_cnt_PlntModeLEDBlinkTimeThd /end REF_CHARACTERISTIC /end GROUP
/begin GROUP S52_FPA_ChimeAlertUpdate "SWC_APA/SWC_APA/Rear_Front_ParkAssist/FPA/FPA_ChimeAlertUpdate" /begin REF_CHARACTERISTIC KeAP_cnt_BootupTimeThd KeAP_cnt_TimeStep /end REF_CHARACTERISTIC /end GROUP
/begin GROUP S52_FPA_GraphicAlertGen "SWC_APA/SWC_APA/Rear_Front_ParkAssist/FPA/FPA_GraphicAlertGen"
 /begin SUB_GROUP S82_CenterGraphicAlertGen S82_CheckDNNFlag S82_LeftGraphicAlertGen S82_RightGraphicAlertGen /end SUB_GROUP
/end GROUP
/begin GROUP S52_FrontHysteresis "SWC_APA/SWC_APA/Rear_Front_ParkAssist/FPA/FrontHysteresis" /begin SUB_GROUP S83_Subsystem1 S83_Subsystem2 S83_Subsystem3 /end SUB_GROUP
 /begin REF_CHARACTERISTIC KeAP_cm_FrntDistZone1 KeAP_cm_FrntDistZone2 KeAP_cm_FrntDistZone3 KeAP_cm_FrntDistZone4 KeAP_cm_FrntDistZone5 KeAP_cm_FrntDistZone6 /end REF_CHARACTERISTIC
/end GROUP
/begin GROUP S54_HoldPopUpRq "SWC_APA/SWC_APA/Rear_Front_ParkAssist/PAMPopUpReq_Gen/HoldPopUpRq" /begin SUB_GROUP S244_BtnPrssTimer /end SUB_GROUP /end GROUP
/begin GROUP S54_PopUpRq_Conditions "SWC_APA/SWC_APA/Rear_Front_ParkAssist/PAMPopUpReq_Gen/PopUpRq_Conditions" /begin SUB_GROUP S246_PAM_CarGraphic S246_SpeedTooHigh /end SUB_GROUP /end GROUP
/begin GROUP S54_TimerForFrontSwitchPress "SWC_APA/SWC_APA/Rear_Front_ParkAssist/PAMPopUpReq_Gen/TimerForFrontSwitchPress" /begin REF_CHARACTERISTIC KeAP_cnt_BtnPressPopUpTimeThd /end REF_CHARACTERISTIC /end GROUP
/begin GROUP S54_TimerForRearSwitchPress "SWC_APA/SWC_APA/Rear_Front_ParkAssist/PAMPopUpReq_Gen/TimerForRearSwitchPress" /begin REF_CHARACTERISTIC KeAP_cnt_BtnPressPopUpTimeThd /end REF_CHARACTERISTIC /end GROUP
/begin GROUP S56_AP_RearPAMLedStatusGen "SWC_APA/SWC_APA/Rear_Front_ParkAssist/RPA/AP_RearPAMLedStatusGen" /begin SUB_GROUP S480_TimerForRearSwitchPress /end SUB_GROUP /begin REF_CHARACTERISTIC KeAP_cnt_PlntModeLEDBlinkTimeThd /end REF_CHARACTERISTIC /end GROUP
/begin GROUP S56_RPA_ChimeAlertUpdate "SWC_APA/SWC_APA/Rear_Front_ParkAssist/RPA/RPA_ChimeAlertUpdate" /begin REF_CHARACTERISTIC KeAP_cnt_BootupTimeThd KeAP_cnt_TimeStep /end REF_CHARACTERISTIC /end GROUP
/begin GROUP S56_RPA_GraphicAlertGen "SWC_APA/SWC_APA/Rear_Front_ParkAssist/RPA/RPA_GraphicAlertGen" /begin SUB_GROUP S483_CenterGraphicAlertGen S483_CheckDNNFlag /end SUB_GROUP /end GROUP
/begin GROUP S56_RearHysteresis "SWC_APA/SWC_APA/Rear_Front_ParkAssist/RPA/RearHysteresis" /begin SUB_GROUP S484_Subsystem2 S484_Subsystem3 S484_Subsystem4 /end SUB_GROUP
 /begin REF_CHARACTERISTIC KeAP_cm_DistZone1 KeAP_cm_DistZone2 KeAP_cm_DistZone3 KeAP_cm_DistZone4 KeAP_cm_DistZone5 KeAP_cm_DistZone6 /end REF_CHARACTERISTIC
/end GROUP
/begin GROUP S57_BrkReqStatusUpdate "SWC_APA/SWC_APA/Rear_Front_ParkAssist/RPAwithBrk/BrkReqStatusUpdate" /begin REF_CHARACTERISTIC KeAP_e_GbTypAT /end REF_CHARACTERISTIC /end GROUP
/begin GROUP S57_DisableRearBraking "SWC_APA/SWC_APA/Rear_Front_ParkAssist/RPAwithBrk/DisableRearBraking" /begin SUB_GROUP S651_RateLimiter /end SUB_GROUP /begin REF_CHARACTERISTIC KeAP_cm_RearBrkDistChngLwThresh /end REF_CHARACTERISTIC /end GROUP
/begin GROUP S57_RearDistHoldLogic "SWC_APA/SWC_APA/Rear_Front_ParkAssist/RPAwithBrk/RearDistHoldLogic" /begin REF_CHARACTERISTIC CeAP_ms_SampleTime /end REF_CHARACTERISTIC /end GROUP
/begin GROUP S13_FPASwtStuckStatusUpdate "SWC_APA/SWC_APA/PA_EnableCondition/APA_EnablingCondition/PAM2BTSwtStatusUpdate/FPASwtStuckStatusUpdate" /begin REF_CHARACTERISTIC KeAP_b_SwitchOldAlgo /end REF_CHARACTERISTIC /begin REF_MEASUREMENT MeAP_b_FPASwtStuckStatus /end REF_MEASUREMENT /end GROUP
/begin GROUP S13_RPASwtStuckStatusUpdate "SWC_APA/SWC_APA/PA_EnableCondition/APA_EnablingCondition/PAM2BTSwtStatusUpdate/RPASwtStuckStatusUpdate" /begin REF_CHARACTERISTIC KeAP_b_SwitchOldAlgo /end REF_CHARACTERISTIC /begin REF_MEASUREMENT MeAP_b_RPASwtStuckStatus /end REF_MEASUREMENT /end GROUP
/begin GROUP S78_TimerForFrontSwitchPress "SWC_APA/SWC_APA/Rear_Front_ParkAssist/FPA/AP_FrntPAMLedStatusGen/TimerForFrontSwitchPress" /begin REF_CHARACTERISTIC KeAP_cnt_BtnPressPopUpTimeThd /end REF_CHARACTERISTIC /end GROUP
/begin GROUP S82_CenterGraphicAlertGen "SWC_APA/SWC_APA/Rear_Front_ParkAssist/FPA/FPA_GraphicAlertGen/CenterGraphicAlertGen"
 /begin REF_CHARACTERISTIC KeAP_b_EnWallAcurracy KeAP_cm_FrntDistZone1 KeAP_cm_FrntDistZone2 KeAP_cm_FrntDistZone3 KeAP_cm_FrntDistZone4 KeAP_cm_FrntWallZone1Adj /end REF_CHARACTERISTIC
/end GROUP
/begin GROUP S82_CheckDNNFlag "SWC_APA/SWC_APA/Rear_Front_ParkAssist/FPA/FPA_GraphicAlertGen/CheckDNNFlag" /begin REF_CHARACTERISTIC KePA_b_EnHeightFlagFrontSideArcs KePA_b_IsDnnHeightLow /end REF_CHARACTERISTIC /end GROUP
/begin GROUP S82_LeftGraphicAlertGen "SWC_APA/SWC_APA/Rear_Front_ParkAssist/FPA/FPA_GraphicAlertGen/LeftGraphicAlertGen" /begin REF_CHARACTERISTIC KeAP_cm_FrntDistZone1 KeAP_cm_FrntDistZone2 /end REF_CHARACTERISTIC /end GROUP
/begin GROUP S82_RightGraphicAlertGen "SWC_APA/SWC_APA/Rear_Front_ParkAssist/FPA/FPA_GraphicAlertGen/RightGraphicAlertGen" /begin REF_CHARACTERISTIC KeAP_cm_FrntDistZone1 KeAP_cm_FrntDistZone2 /end REF_CHARACTERISTIC /end GROUP
/begin GROUP S83_Subsystem1 "SWC_APA/SWC_APA/Rear_Front_ParkAssist/FPA/FrontHysteresis/Subsystem1"
 /begin REF_CHARACTERISTIC KeAP_b_EnVehStandstillArcBlip KeAP_cnt_ArcBlipStandstillTimer KeAP_cnt_ArcBlipVehInMotTimer KeAP_cnt_ArcBlipVehSpdThd /end REF_CHARACTERISTIC
/end GROUP
/begin GROUP S83_Subsystem2 "SWC_APA/SWC_APA/Rear_Front_ParkAssist/FPA/FrontHysteresis/Subsystem2"
 /begin REF_CHARACTERISTIC KeAP_b_EnVehStandstillArcBlip KeAP_cnt_ArcBlipStandstillTimer KeAP_cnt_ArcBlipVehInMotTimer KeAP_cnt_ArcBlipVehSpdThd /end REF_CHARACTERISTIC
/end GROUP
/begin GROUP S83_Subsystem3 "SWC_APA/SWC_APA/Rear_Front_ParkAssist/FPA/FrontHysteresis/Subsystem3"
 /begin REF_CHARACTERISTIC KeAP_b_EnVehStandstillArcBlip KeAP_cnt_ArcBlipStandstillTimer KeAP_cnt_ArcBlipVehInMotTimer KeAP_cnt_ArcBlipVehSpdThd /end REF_CHARACTERISTIC
/end GROUP
/begin GROUP S244_BtnPrssTimer "SWC_APA/SWC_APA/Rear_Front_ParkAssist/PAMPopUpReq_Gen/HoldPopUpRq/BtnPrssTimer" /begin REF_CHARACTERISTIC KeAP_cnt_BtnPressPopUpTimeThd /end REF_CHARACTERISTIC /end GROUP
/begin GROUP S246_PAM_CarGraphic "SWC_APA/SWC_APA/Rear_Front_ParkAssist/PAMPopUpReq_Gen/PopUpRq_Conditions/PAM_CarGraphic" /begin SUB_GROUP S264_CarGraphicCond1 S264_CarGraphicCond2 /end SUB_GROUP /end GROUP
/begin GROUP S246_SpeedTooHigh "SWC_APA/SWC_APA/Rear_Front_ParkAssist/PAMPopUpReq_Gen/PopUpRq_Conditions/SpeedTooHigh" /begin SUB_GROUP S266_SPEED_TOO_HIGH /end SUB_GROUP /end GROUP
/begin GROUP S480_TimerForRearSwitchPress "SWC_APA/SWC_APA/Rear_Front_ParkAssist/RPA/AP_RearPAMLedStatusGen/TimerForRearSwitchPress" /begin REF_CHARACTERISTIC KeAP_cnt_BtnPressPopUpTimeThd /end REF_CHARACTERISTIC /end GROUP
/begin GROUP S483_CenterGraphicAlertGen "SWC_APA/SWC_APA/Rear_Front_ParkAssist/RPA/RPA_GraphicAlertGen/CenterGraphicAlertGen" /begin REF_CHARACTERISTIC KeAP_b_EnWallAcurracy KeAP_cm_RearWallZone1Adj /end REF_CHARACTERISTIC /end GROUP
/begin GROUP S483_CheckDNNFlag "SWC_APA/SWC_APA/Rear_Front_ParkAssist/RPA/RPA_GraphicAlertGen/CheckDNNFlag" /begin REF_CHARACTERISTIC KePA_b_EnHeightFlagRearSideArcs KePA_b_IsDnnHeightLow /end REF_CHARACTERISTIC /end GROUP
/begin GROUP S484_Subsystem2 "SWC_APA/SWC_APA/Rear_Front_ParkAssist/RPA/RearHysteresis/Subsystem2"
 /begin REF_CHARACTERISTIC KeAP_b_EnVehStandstillArcBlip KeAP_cnt_ArcBlipStandstillTimer KeAP_cnt_ArcBlipVehInMotTimer KeAP_cnt_ArcBlipVehSpdThd /end REF_CHARACTERISTIC
/end GROUP
/begin GROUP S484_Subsystem3 "SWC_APA/SWC_APA/Rear_Front_ParkAssist/RPA/RearHysteresis/Subsystem3"
 /begin REF_CHARACTERISTIC KeAP_b_EnVehStandstillArcBlip KeAP_cnt_ArcBlipStandstillTimer KeAP_cnt_ArcBlipVehInMotTimer KeAP_cnt_ArcBlipVehSpdThd /end REF_CHARACTERISTIC
/end GROUP
/begin GROUP S484_Subsystem4 "SWC_APA/SWC_APA/Rear_Front_ParkAssist/RPA/RearHysteresis/Subsystem4"
 /begin REF_CHARACTERISTIC KeAP_b_EnVehStandstillArcBlip KeAP_cnt_ArcBlipStandstillTimer KeAP_cnt_ArcBlipVehInMotTimer KeAP_cnt_ArcBlipVehSpdThd /end REF_CHARACTERISTIC
/end GROUP
/begin GROUP S651_RateLimiter "SWC_APA/SWC_APA/Rear_Front_ParkAssist/RPAwithBrk/DisableRearBraking/RateLimiter"
 /begin REF_CHARACTERISTIC KeAP_cm_RearBrkDistChngLwThresh KeAP_cm_RearBrkDistChngUpThresh /end REF_CHARACTERISTIC
/end GROUP
/begin GROUP S264_CarGraphicCond1 "SWC_APA/SWC_APA/Rear_Front_ParkAssist/PAMPopUpReq_Gen/PopUpRq_Conditions/PAM_CarGraphic/CarGraphicCond1" /begin REF_CHARACTERISTIC KeAP_kph_RearWarnMaxSpdThd /end REF_CHARACTERISTIC /end GROUP
/begin GROUP S264_CarGraphicCond2 "SWC_APA/SWC_APA/Rear_Front_ParkAssist/PAMPopUpReq_Gen/PopUpRq_Conditions/PAM_CarGraphic/CarGraphicCond2" /begin REF_CHARACTERISTIC KeAP_kph_RearWarnMaxSpdThd /end REF_CHARACTERISTIC /end GROUP
/begin GROUP S266_SPEED_TOO_HIGH "SWC_APA/SWC_APA/Rear_Front_ParkAssist/PAMPopUpReq_Gen/PopUpRq_Conditions/SpeedTooHigh/SPEED_TOO_HIGH" /begin REF_CHARACTERISTIC KeAP_kph_EnblHysThd KeAP_kph_RearWarnMaxSpdThd /end REF_CHARACTERISTIC /end GROUP
/end MODULE
/end PROJECT
/* (add any file trailer comments here) */
/* EOF SWC_APA.a2l */
