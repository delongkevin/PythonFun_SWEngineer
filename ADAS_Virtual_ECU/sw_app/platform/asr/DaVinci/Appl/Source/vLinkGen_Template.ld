/**********************************************************************************************************************
 *  EXAMPLE CODE ONLY
 *  -------------------------------------------------------------------------------------------------------------------
 *  This Example Code is only intended for illustrating an example of a possible BSW integration and BSW configuration.
 *  The Example Code has not passed any quality control measures and may be incomplete. The Example Code is neither
 *  intended nor qualified for use in series production. The Example Code as well as any of its modifications and/or
 *  implementations must be tested with diligent care and must comply with all quality requirements which are necessary
 *  according to the state of the art before their use.
 *********************************************************************************************************************/


/**********************************************************************************************************************
 * CAUTION - DO NOT EDIT
 * -------------------------------------------------------------------------------------------------------------------
 * Never manually edit the following memory definitions in this file. Only change them in the vLinkGen configuration
 * (/MICROSAR/vLinkGen/vLinkGenMemLayout/vLinkGenMemoryRegion/vLinkGenMemoryRegionBlock) and regenerate the files.
 *********************************************************************************************************************/
MEMORY
{
  MCU_MSRAM_Common : ORIGIN = 0x41C3F000 , LENGTH = 0x0000C000 /* 48 KiB */
  MCU_MSRAM_Common_NonCache : ORIGIN = 0x41C4B000 , LENGTH = 0x00000400 /* 1024 Byte */
  MCU_MSRAM_Core0 : ORIGIN = 0x41C4B400 , LENGTH = 0x00000400 /* 1024 Byte */
  MCU_MSRAM_Core1 : ORIGIN = 0x41C4B800 , LENGTH = 0x00000400 /* 1024 Byte */
  MCU_MSRAM_Core2 : ORIGIN = 0x41C4BC00 , LENGTH = 0x00000400 /* 1024 Byte */
  MCU_MSRAM_Core3 : ORIGIN = 0x41C4C000 , LENGTH = 0x00000400 /* 1024 Byte */
  MCU_MSRAM_Core4 : ORIGIN = 0x41C4C400 , LENGTH = 0x00000400 /* 1024 Byte */
  MCU_MSRAM_Core5 : ORIGIN = 0x41C4C800 , LENGTH = 0x00000400 /* 1024 Byte */
  DDR0 : ORIGIN = 0x97000000 , LENGTH = 0x01000000 /* 16 MiB */
}

SECTIONS
{
  .OS_STACKS_CORE0_VAR_NOINIT :
  {
    . = ALIGN(4096);
    *(.OS_STACK_BOOTAPPOSTASK_VAR_NOINIT)
    *(.OS_STACK_OSCORE0_ERROR_VAR_NOINIT)
    *(.OS_STACK_OSCORE0_INIT_VAR_NOINIT)
    *(.OS_STACK_OSCORE0_ISR_CORE_VAR_NOINIT)
    *(.OS_STACK_OSCORE0_KERNEL_VAR_NOINIT)
    . = ALIGN(1024);
    *(.OS_STACK_OSCORE0_PROTECTION_VAR_NOINIT)
    . = ALIGN(1024);
    *(.OS_STACK_OSCORE0_SHUTDOWN_VAR_NOINIT)
    . = ALIGN(512);
    *(.OS_STACK_OSCORE0_TASK_PRIO100_VAR_NOINIT)
    *(.OS_STACK_OSCORE0_TASK_PRIO4294967295_VAR_NOINIT)
    . = ALIGN(32768);
    *(.OS_STACK_OSCORE0_TASK_PRIO50_VAR_NOINIT)
    . = ALIGN(4096);
    *(.OS_STACK_OSCORE0_TASK_PRIO54_VAR_NOINIT)
    . = ALIGN(16384);
    *(.OS_STACK_OSCORE0_TASK_PRIO78_VAR_NOINIT)
    . = ALIGN(8192);
    *(.OS_STACK_OSCORE0_TASK_PRIO79_VAR_NOINIT)
    . = ALIGN(2048);
    *(.OS_STACK_OSCORE0_TASK_PRIO88_VAR_NOINIT)
    . = ALIGN(2048);
    *(.OS_STACK_OSCORE0_TASK_PRIO90_VAR_NOINIT)
    . = ALIGN(4096);
    *(.OS_STACK_QM_COMTASK_10MS_VAR_NOINIT)
    . = ALIGN(1024);
    *(.OS_STACK_QM_COMTASK_5MS_VAR_NOINIT)
    . = ALIGN(4096);
    *(.OS_STACK_QM_DIAGTASK_10MS_VAR_NOINIT)
    . = ALIGN(1024);
    *(.OS_STACK_QM_MEMTASK_10MS_VAR_NOINIT)
    . = ALIGN(512);
    *(.OS_STACK_QM_TASK_200MS_VAR_NOINIT)
    . = ALIGN(1024);
    *(.OS_STACK_SAFETY_TASK_200MS_VAR_NOINIT)
    . = ALIGN(1024);
    *(.OS_STACK_SAFETY_WDGTASK_10MS_VAR_NOINIT)
    . = ALIGN(4096);
    *(.OS_STACK_SCISERVERHIGHOSTASK_VAR_NOINIT)
    . = ALIGN(4096);
    *(.OS_STACK_SCISERVERLOWOSTASK_VAR_NOINIT)
  } > DDR0,
  RUN_START(_OS_STACKS_CORE0_VAR_NOINIT_RUN_START),
  RUN_END(_OS_STACKS_CORE0_VAR_NOINIT_RUN_LIMIT)

  .OS_STACKS_CORE0_VAR_LABELS :
  {
    _OS_STACKS_CORE0_VAR_NOINIT_START = _OS_STACKS_CORE0_VAR_NOINIT_RUN_START;
    _OS_STACKS_CORE0_VAR_NOINIT_LIMIT = _OS_STACKS_CORE0_VAR_NOINIT_RUN_LIMIT;
    _OS_STACKS_CORE0_VAR_NOINIT_END = _OS_STACKS_CORE0_VAR_NOINIT_LIMIT - 1;
    _OS_STACKS_CORE0_VAR_ALL_START = _OS_STACKS_CORE0_VAR_NOINIT_START;
    _OS_STACKS_CORE0_VAR_ALL_END = _OS_STACKS_CORE0_VAR_NOINIT_END;
    _OS_STACKS_CORE0_VAR_ALL_LIMIT = _OS_STACKS_CORE0_VAR_NOINIT_LIMIT;
  }

  .STACK_C0 : ALIGN(4)
  {
    . += 1024;
    . = ALIGN(4);
  } > MCU_MSRAM_Common,
  RUN_START(_STACK_C0_RUN_START),
  RUN_END(_STACK_C0_RUN_LIMIT)

  .STACK_C0_LABELS :
  {
    _STACK_C0_START = _STACK_C0_RUN_START;
    _STACK_C0_LIMIT = _STACK_C0_RUN_LIMIT;
    _STACK_C0_END = _STACK_C0_LIMIT - 1;
    _STACK_C0_ALL_START = _STACK_C0_START;
    _STACK_C0_ALL_END = _STACK_C0_END;
    _STACK_C0_ALL_LIMIT = _STACK_C0_LIMIT;
  }

  .OS_CODE :
  {
    *(.OS_CODE)
    *(.OS_OS_COREINITHOOK_CODE)
  } > DDR0,
  RUN_START(_OS_CODE_RUN_START),
  RUN_END(_OS_CODE_RUN_LIMIT)

  .OS_CODE_LABELS :
  {
    _OS_CODE_START = _OS_CODE_RUN_START;
    _OS_CODE_LIMIT = _OS_CODE_RUN_LIMIT;
    _OS_CODE_END = _OS_CODE_LIMIT - 1;
    _OS_CODE_ALL_START = _OS_CODE_START;
    _OS_CODE_ALL_END = _OS_CODE_END;
    _OS_CODE_ALL_LIMIT = _OS_CODE_LIMIT;
  }

  .OS_CONST :
  {
    *(.OS_CONST)
    *(.OS_CORE0_CONST)
    *(.OS_SystemApplication_OsCore0_CONST)
  } > DDR0,
  RUN_START(_OS_CONST_RUN_START),
  RUN_END(_OS_CONST_RUN_LIMIT)

  .OS_CONST_LABELS :
  {
    _OS_CONST_START = _OS_CONST_RUN_START;
    _OS_CONST_LIMIT = _OS_CONST_RUN_LIMIT;
    _OS_CONST_END = _OS_CONST_LIMIT - 1;
    _OS_CONST_ALL_START = _OS_CONST_START;
    _OS_CONST_ALL_END = _OS_CONST_END;
    _OS_CONST_ALL_LIMIT = _OS_CONST_LIMIT;
  }

  .OS_DATA_CORE0_VAR_INIT : ALIGN(4)
  {
    *(.OS_CORE0_VAR)
    *(.OS_CORE0_VAR_NOCACHE)
    *(.OS_SystemApplication_OsCore0_VAR)
    *(.OS_SystemApplication_OsCore0_VAR_NOCACHE)
    *(.OS_SystemApplication_OsCore0_VAR_SAVED_ZONE)
    . = ALIGN(4);
  } > DDR0, RUN > DDR0,
  RUN_START(_OS_DATA_CORE0_VAR_INIT_RUN_START),
  RUN_END(_OS_DATA_CORE0_VAR_INIT_RUN_LIMIT),
  LOAD_START(_OS_DATA_CORE0_VAR_INIT_ROM_START),
  LOAD_END(_OS_DATA_CORE0_VAR_INIT_ROM_LIMIT)

  .OS_DATA_CORE0_VAR_NOINIT :
  {
    *(.OS_CORE0_VAR_NOCACHE_NOINIT)
    *(.OS_CORE0_VAR_NOINIT)
    *(.OS_SystemApplication_OsCore0_VAR_NOCACHE_NOINIT)
    *(.OS_SystemApplication_OsCore0_VAR_NOINIT)
    *(.OS_SystemApplication_OsCore0_VAR_SAVED_ZONE_NOINIT)
  } > DDR0,
  RUN_START(_OS_DATA_CORE0_VAR_NOINIT_RUN_START),
  RUN_END(_OS_DATA_CORE0_VAR_NOINIT_RUN_LIMIT)

  .OS_DATA_CORE0_VAR_ZERO_INIT : ALIGN(4)
  {
    *(.OS_SystemApplication_OsCore0_VAR_NOCACHE_ZERO_INIT)
    *(.OS_SystemApplication_OsCore0_VAR_ZERO_INIT)
    . = ALIGN(4);
  } > DDR0,
  RUN_START(_OS_DATA_CORE0_VAR_ZERO_INIT_RUN_START),
  RUN_END(_OS_DATA_CORE0_VAR_ZERO_INIT_RUN_LIMIT)

  .OS_DATA_CORE0_VAR_ZERO_INIT_bss : ALIGN(4)
  {
    *(.OS_SystemApplication_OsCore0_VAR_NOCACHE_ZERO_INIT_bss)
    *(.OS_SystemApplication_OsCore0_VAR_ZERO_INIT_bss)
    . = ALIGN(4);
  } > DDR0,
  RUN_START(_OS_DATA_CORE0_VAR_ZERO_INIT_bss_RUN_START),
  RUN_END(_OS_DATA_CORE0_VAR_ZERO_INIT_bss_RUN_LIMIT)

  .OS_DATA_CORE0_VAR_LABELS :
  {
    _OS_DATA_CORE0_VAR_INIT_START = _OS_DATA_CORE0_VAR_INIT_RUN_START;
    _OS_DATA_CORE0_VAR_INIT_LIMIT = _OS_DATA_CORE0_VAR_INIT_RUN_LIMIT;
    _OS_DATA_CORE0_VAR_INIT_END = _OS_DATA_CORE0_VAR_INIT_LIMIT - 1;
    _OS_DATA_CORE0_VAR_NOINIT_START = _OS_DATA_CORE0_VAR_NOINIT_RUN_START;
    _OS_DATA_CORE0_VAR_NOINIT_LIMIT = _OS_DATA_CORE0_VAR_NOINIT_RUN_LIMIT;
    _OS_DATA_CORE0_VAR_NOINIT_END = _OS_DATA_CORE0_VAR_NOINIT_LIMIT - 1;
    _OS_DATA_CORE0_VAR_ZERO_INIT_START = _OS_DATA_CORE0_VAR_ZERO_INIT_RUN_START;
    _OS_DATA_CORE0_VAR_ZERO_INIT_LIMIT = _OS_DATA_CORE0_VAR_ZERO_INIT_RUN_LIMIT;
    _OS_DATA_CORE0_VAR_ZERO_INIT_END = _OS_DATA_CORE0_VAR_ZERO_INIT_LIMIT - 1;
    _OS_DATA_CORE0_VAR_ZERO_INIT_bss_START = _OS_DATA_CORE0_VAR_ZERO_INIT_bss_RUN_START;
    _OS_DATA_CORE0_VAR_ZERO_INIT_bss_LIMIT = _OS_DATA_CORE0_VAR_ZERO_INIT_bss_RUN_LIMIT;
    _OS_DATA_CORE0_VAR_ZERO_INIT_bss_END = _OS_DATA_CORE0_VAR_ZERO_INIT_bss_LIMIT - 1;
    _OS_DATA_CORE0_VAR_ALL_START = _OS_DATA_CORE0_VAR_INIT_START;
    _OS_DATA_CORE0_VAR_ALL_END = _OS_DATA_CORE0_VAR_ZERO_INIT_bss_END;
    _OS_DATA_CORE0_VAR_ALL_LIMIT = _OS_DATA_CORE0_VAR_ZERO_INIT_bss_LIMIT;
  }

  .OS_DATA_SHARED_VAR_INIT : ALIGN(4)
  {
    *(.OS_VAR_NOCACHE)
    . = ALIGN(4);
  } > DDR0, RUN > MCU_MSRAM_Common_NonCache,
  RUN_START(_OS_DATA_SHARED_VAR_INIT_RUN_START),
  RUN_END(_OS_DATA_SHARED_VAR_INIT_RUN_LIMIT),
  LOAD_START(_OS_DATA_SHARED_VAR_INIT_ROM_START),
  LOAD_END(_OS_DATA_SHARED_VAR_INIT_ROM_LIMIT)

  .OS_DATA_SHARED_VAR_NOINIT :
  {
    *(.OS_BARRIER_CORE0_VAR_NOCACHE_NOINIT)
    *(.OS_CORESTATUS_CORE0_VAR_NOCACHE_NOINIT)
    *(.OS_PUBLIC_CORE0_VAR_NOINIT)
    *(.OS_VAR_NOCACHE_NOINIT)
  } > MCU_MSRAM_Common_NonCache,
  RUN_START(_OS_DATA_SHARED_VAR_NOINIT_RUN_START),
  RUN_END(_OS_DATA_SHARED_VAR_NOINIT_RUN_LIMIT)

  .OS_DATA_SHARED_VAR_LABELS :
  {
    _OS_DATA_SHARED_VAR_INIT_START = _OS_DATA_SHARED_VAR_INIT_RUN_START;
    _OS_DATA_SHARED_VAR_INIT_LIMIT = _OS_DATA_SHARED_VAR_INIT_RUN_LIMIT;
    _OS_DATA_SHARED_VAR_INIT_END = _OS_DATA_SHARED_VAR_INIT_LIMIT - 1;
    _OS_DATA_SHARED_VAR_NOINIT_START = _OS_DATA_SHARED_VAR_NOINIT_RUN_START;
    _OS_DATA_SHARED_VAR_NOINIT_LIMIT = _OS_DATA_SHARED_VAR_NOINIT_RUN_LIMIT;
    _OS_DATA_SHARED_VAR_NOINIT_END = _OS_DATA_SHARED_VAR_NOINIT_LIMIT - 1;
    _OS_DATA_SHARED_VAR_ALL_START = _OS_DATA_SHARED_VAR_INIT_START;
    _OS_DATA_SHARED_VAR_ALL_END = _OS_DATA_SHARED_VAR_NOINIT_END;
    _OS_DATA_SHARED_VAR_ALL_LIMIT = _OS_DATA_SHARED_VAR_NOINIT_LIMIT;
  }

  .OS_EXCVEC_CORE0_CODE :
  {
    *(.OS_EXCVEC_CORE0_CODE)
  } > MCU_MSRAM_Core0,
  RUN_START(_OS_EXCVEC_CORE0_CODE_RUN_START),
  RUN_END(_OS_EXCVEC_CORE0_CODE_RUN_LIMIT)

  .OS_EXCVEC_CORE0_CODE_LABELS :
  {
    _OS_EXCVEC_CORE0_CODE_START = _OS_EXCVEC_CORE0_CODE_RUN_START;
    _OS_EXCVEC_CORE0_CODE_LIMIT = _OS_EXCVEC_CORE0_CODE_RUN_LIMIT;
    _OS_EXCVEC_CORE0_CODE_END = _OS_EXCVEC_CORE0_CODE_LIMIT - 1;
    _OS_EXCVEC_CORE0_CODE_ALL_START = _OS_EXCVEC_CORE0_CODE_START;
    _OS_EXCVEC_CORE0_CODE_ALL_END = _OS_EXCVEC_CORE0_CODE_END;
    _OS_EXCVEC_CORE0_CODE_ALL_LIMIT = _OS_EXCVEC_CORE0_CODE_LIMIT;
  }

  .OS_EXCVEC_CORE0_CONST :
  {
    *(.OS_EXCVEC_CORE0_CONST)
  } > MCU_MSRAM_Common,
  RUN_START(_OS_EXCVEC_CORE0_CONST_RUN_START),
  RUN_END(_OS_EXCVEC_CORE0_CONST_RUN_LIMIT)

  .OS_EXCVEC_CORE0_CONST_LABELS :
  {
    _OS_EXCVEC_CORE0_CONST_START = _OS_EXCVEC_CORE0_CONST_RUN_START;
    _OS_EXCVEC_CORE0_CONST_LIMIT = _OS_EXCVEC_CORE0_CONST_RUN_LIMIT;
    _OS_EXCVEC_CORE0_CONST_END = _OS_EXCVEC_CORE0_CONST_LIMIT - 1;
    _OS_EXCVEC_CORE0_CONST_ALL_START = _OS_EXCVEC_CORE0_CONST_START;
    _OS_EXCVEC_CORE0_CONST_ALL_END = _OS_EXCVEC_CORE0_CONST_END;
    _OS_EXCVEC_CORE0_CONST_ALL_LIMIT = _OS_EXCVEC_CORE0_CONST_LIMIT;
  }

  .OS_GLOBALSHARED_CONST :
  {
    *(.OS_GLOBALSHARED_CONST)
  } > DDR0,
  RUN_START(_OS_GLOBALSHARED_CONST_RUN_START),
  RUN_END(_OS_GLOBALSHARED_CONST_RUN_LIMIT)

  .OS_GLOBALSHARED_CONST_LABELS :
  {
    _OS_GLOBALSHARED_CONST_START = _OS_GLOBALSHARED_CONST_RUN_START;
    _OS_GLOBALSHARED_CONST_LIMIT = _OS_GLOBALSHARED_CONST_RUN_LIMIT;
    _OS_GLOBALSHARED_CONST_END = _OS_GLOBALSHARED_CONST_LIMIT - 1;
    _OS_GLOBALSHARED_CONST_ALL_START = _OS_GLOBALSHARED_CONST_START;
    _OS_GLOBALSHARED_CONST_ALL_END = _OS_GLOBALSHARED_CONST_END;
    _OS_GLOBALSHARED_CONST_ALL_LIMIT = _OS_GLOBALSHARED_CONST_LIMIT;
  }

  .OS_GLOBALSHARED_VAR_INIT : ALIGN(4)
  {
    *(.OS_GLOBALSHARED_VAR)
    *(.OS_GLOBALSHARED_VAR_NOCACHE)
    . = ALIGN(4);
  } > DDR0, RUN > MCU_MSRAM_Common_NonCache,
  RUN_START(_OS_GLOBALSHARED_VAR_INIT_RUN_START),
  RUN_END(_OS_GLOBALSHARED_VAR_INIT_RUN_LIMIT),
  LOAD_START(_OS_GLOBALSHARED_VAR_INIT_ROM_START),
  LOAD_END(_OS_GLOBALSHARED_VAR_INIT_ROM_LIMIT)

  .OS_GLOBALSHARED_VAR_NOINIT :
  {
    *(.OS_GLOBALSHARED_VAR_NOCACHE_NOINIT)
    *(.OS_GLOBALSHARED_VAR_NOINIT)
  } > MCU_MSRAM_Common_NonCache,
  RUN_START(_OS_GLOBALSHARED_VAR_NOINIT_RUN_START),
  RUN_END(_OS_GLOBALSHARED_VAR_NOINIT_RUN_LIMIT)

  .OS_GLOBALSHARED_VAR_ZERO_INIT : ALIGN(4)
  {
    *(.OS_GLOBALSHARED_VAR_NOCACHE_ZERO_INIT)
    *(.OS_GLOBALSHARED_VAR_ZERO_INIT)
    . = ALIGN(4);
  } > MCU_MSRAM_Common_NonCache,
  RUN_START(_OS_GLOBALSHARED_VAR_ZERO_INIT_RUN_START),
  RUN_END(_OS_GLOBALSHARED_VAR_ZERO_INIT_RUN_LIMIT)

  .OS_GLOBALSHARED_VAR_ZERO_INIT_bss : ALIGN(4)
  {
    *(.OS_GLOBALSHARED_VAR_NOCACHE_ZERO_INIT_bss)
    *(.OS_GLOBALSHARED_VAR_ZERO_INIT_bss)
    . = ALIGN(4);
  } > MCU_MSRAM_Common_NonCache,
  RUN_START(_OS_GLOBALSHARED_VAR_ZERO_INIT_bss_RUN_START),
  RUN_END(_OS_GLOBALSHARED_VAR_ZERO_INIT_bss_RUN_LIMIT)

  .OS_GLOBALSHARED_VAR_LABELS :
  {
    _OS_GLOBALSHARED_VAR_INIT_START = _OS_GLOBALSHARED_VAR_INIT_RUN_START;
    _OS_GLOBALSHARED_VAR_INIT_LIMIT = _OS_GLOBALSHARED_VAR_INIT_RUN_LIMIT;
    _OS_GLOBALSHARED_VAR_INIT_END = _OS_GLOBALSHARED_VAR_INIT_LIMIT - 1;
    _OS_GLOBALSHARED_VAR_NOINIT_START = _OS_GLOBALSHARED_VAR_NOINIT_RUN_START;
    _OS_GLOBALSHARED_VAR_NOINIT_LIMIT = _OS_GLOBALSHARED_VAR_NOINIT_RUN_LIMIT;
    _OS_GLOBALSHARED_VAR_NOINIT_END = _OS_GLOBALSHARED_VAR_NOINIT_LIMIT - 1;
    _OS_GLOBALSHARED_VAR_ZERO_INIT_START = _OS_GLOBALSHARED_VAR_ZERO_INIT_RUN_START;
    _OS_GLOBALSHARED_VAR_ZERO_INIT_LIMIT = _OS_GLOBALSHARED_VAR_ZERO_INIT_RUN_LIMIT;
    _OS_GLOBALSHARED_VAR_ZERO_INIT_END = _OS_GLOBALSHARED_VAR_ZERO_INIT_LIMIT - 1;
    _OS_GLOBALSHARED_VAR_ZERO_INIT_bss_START = _OS_GLOBALSHARED_VAR_ZERO_INIT_bss_RUN_START;
    _OS_GLOBALSHARED_VAR_ZERO_INIT_bss_LIMIT = _OS_GLOBALSHARED_VAR_ZERO_INIT_bss_RUN_LIMIT;
    _OS_GLOBALSHARED_VAR_ZERO_INIT_bss_END = _OS_GLOBALSHARED_VAR_ZERO_INIT_bss_LIMIT - 1;
    _OS_GLOBALSHARED_VAR_ALL_START = _OS_GLOBALSHARED_VAR_INIT_START;
    _OS_GLOBALSHARED_VAR_ALL_END = _OS_GLOBALSHARED_VAR_ZERO_INIT_bss_END;
    _OS_GLOBALSHARED_VAR_ALL_LIMIT = _OS_GLOBALSHARED_VAR_ZERO_INIT_bss_LIMIT;
  }

  .OS_GLOBALSHARED_VAR_SAVED_ZONE_INIT : ALIGN(4)
  {
    *(.OS_GLOBALSHARED_VAR_SAVED_ZONE)
    . = ALIGN(4);
  } > DDR0, RUN > MCU_MSRAM_Common_NonCache,
  RUN_START(_OS_GLOBALSHARED_VAR_SAVED_ZONE_INIT_RUN_START),
  RUN_END(_OS_GLOBALSHARED_VAR_SAVED_ZONE_INIT_RUN_LIMIT),
  LOAD_START(_OS_GLOBALSHARED_VAR_SAVED_ZONE_INIT_ROM_START),
  LOAD_END(_OS_GLOBALSHARED_VAR_SAVED_ZONE_INIT_ROM_LIMIT)

  .OS_GLOBALSHARED_VAR_SAVED_ZONE_NOINIT :
  {
    *(.OS_GLOBALSHARED_VAR_SAVED_ZONE_NOINIT)
  } > MCU_MSRAM_Common_NonCache,
  RUN_START(_OS_GLOBALSHARED_VAR_SAVED_ZONE_NOINIT_RUN_START),
  RUN_END(_OS_GLOBALSHARED_VAR_SAVED_ZONE_NOINIT_RUN_LIMIT)

  .OS_GLOBALSHARED_VAR_SAVED_ZONE_LABELS :
  {
    _OS_GLOBALSHARED_VAR_SAVED_ZONE_INIT_START = _OS_GLOBALSHARED_VAR_SAVED_ZONE_INIT_RUN_START;
    _OS_GLOBALSHARED_VAR_SAVED_ZONE_INIT_LIMIT = _OS_GLOBALSHARED_VAR_SAVED_ZONE_INIT_RUN_LIMIT;
    _OS_GLOBALSHARED_VAR_SAVED_ZONE_INIT_END = _OS_GLOBALSHARED_VAR_SAVED_ZONE_INIT_LIMIT - 1;
    _OS_GLOBALSHARED_VAR_SAVED_ZONE_NOINIT_START = _OS_GLOBALSHARED_VAR_SAVED_ZONE_NOINIT_RUN_START;
    _OS_GLOBALSHARED_VAR_SAVED_ZONE_NOINIT_LIMIT = _OS_GLOBALSHARED_VAR_SAVED_ZONE_NOINIT_RUN_LIMIT;
    _OS_GLOBALSHARED_VAR_SAVED_ZONE_NOINIT_END = _OS_GLOBALSHARED_VAR_SAVED_ZONE_NOINIT_LIMIT - 1;
    _OS_GLOBALSHARED_VAR_SAVED_ZONE_ALL_START = _OS_GLOBALSHARED_VAR_SAVED_ZONE_INIT_START;
    _OS_GLOBALSHARED_VAR_SAVED_ZONE_ALL_END = _OS_GLOBALSHARED_VAR_SAVED_ZONE_NOINIT_END;
    _OS_GLOBALSHARED_VAR_SAVED_ZONE_ALL_LIMIT = _OS_GLOBALSHARED_VAR_SAVED_ZONE_NOINIT_LIMIT;
  }

  .OS_INTVEC_CODE :
  {
    *(.OS_INTVEC_CODE)
  } > DDR0,
  RUN_START(_OS_INTVEC_CODE_RUN_START),
  RUN_END(_OS_INTVEC_CODE_RUN_LIMIT)

  .OS_INTVEC_CODE_LABELS :
  {
    _OS_INTVEC_CODE_START = _OS_INTVEC_CODE_RUN_START;
    _OS_INTVEC_CODE_LIMIT = _OS_INTVEC_CODE_RUN_LIMIT;
    _OS_INTVEC_CODE_END = _OS_INTVEC_CODE_LIMIT - 1;
    _OS_INTVEC_CODE_ALL_START = _OS_INTVEC_CODE_START;
    _OS_INTVEC_CODE_ALL_END = _OS_INTVEC_CODE_END;
    _OS_INTVEC_CODE_ALL_LIMIT = _OS_INTVEC_CODE_LIMIT;
  }

  .OS_INTVEC_CONST :
  {
    *(.OS_INTVEC_CONST)
  } > DDR0,
  RUN_START(_OS_INTVEC_CONST_RUN_START),
  RUN_END(_OS_INTVEC_CONST_RUN_LIMIT)

  .OS_INTVEC_CONST_LABELS :
  {
    _OS_INTVEC_CONST_START = _OS_INTVEC_CONST_RUN_START;
    _OS_INTVEC_CONST_LIMIT = _OS_INTVEC_CONST_RUN_LIMIT;
    _OS_INTVEC_CONST_END = _OS_INTVEC_CONST_LIMIT - 1;
    _OS_INTVEC_CONST_ALL_START = _OS_INTVEC_CONST_START;
    _OS_INTVEC_CONST_ALL_END = _OS_INTVEC_CONST_END;
    _OS_INTVEC_CONST_ALL_LIMIT = _OS_INTVEC_CONST_LIMIT;
  }

  .OS_INTVEC_CORE0_CODE :
  {
    *(.OS_INTVEC_CORE0_CODE)
  } > DDR0,
  RUN_START(_OS_INTVEC_CORE0_CODE_RUN_START),
  RUN_END(_OS_INTVEC_CORE0_CODE_RUN_LIMIT)

  .OS_INTVEC_CORE0_CODE_LABELS :
  {
    _OS_INTVEC_CORE0_CODE_START = _OS_INTVEC_CORE0_CODE_RUN_START;
    _OS_INTVEC_CORE0_CODE_LIMIT = _OS_INTVEC_CORE0_CODE_RUN_LIMIT;
    _OS_INTVEC_CORE0_CODE_END = _OS_INTVEC_CORE0_CODE_LIMIT - 1;
    _OS_INTVEC_CORE0_CODE_ALL_START = _OS_INTVEC_CORE0_CODE_START;
    _OS_INTVEC_CORE0_CODE_ALL_END = _OS_INTVEC_CORE0_CODE_END;
    _OS_INTVEC_CORE0_CODE_ALL_LIMIT = _OS_INTVEC_CORE0_CODE_LIMIT;
  }

  .OS_INTVEC_CORE0_CONST :
  {
    *(.OS_INTVEC_CORE0_CONST)
  } > DDR0,
  RUN_START(_OS_INTVEC_CORE0_CONST_RUN_START),
  RUN_END(_OS_INTVEC_CORE0_CONST_RUN_LIMIT)

  .OS_INTVEC_CORE0_CONST_LABELS :
  {
    _OS_INTVEC_CORE0_CONST_START = _OS_INTVEC_CORE0_CONST_RUN_START;
    _OS_INTVEC_CORE0_CONST_LIMIT = _OS_INTVEC_CORE0_CONST_RUN_LIMIT;
    _OS_INTVEC_CORE0_CONST_END = _OS_INTVEC_CORE0_CONST_LIMIT - 1;
    _OS_INTVEC_CORE0_CONST_ALL_START = _OS_INTVEC_CORE0_CONST_START;
    _OS_INTVEC_CORE0_CONST_ALL_END = _OS_INTVEC_CORE0_CONST_END;
    _OS_INTVEC_CORE0_CONST_ALL_LIMIT = _OS_INTVEC_CORE0_CONST_LIMIT;
  }

  .OS_OsApplication_QM_VAR_INIT : ALIGN(4)
  {
    *(.OS_OsApplication_QM_VAR)
    *(.OS_OsApplication_QM_VAR_NOCACHE)
    . = ALIGN(4);
  } > DDR0, RUN > MCU_MSRAM_Common_NonCache,
  RUN_START(_OS_OsApplication_QM_VAR_INIT_RUN_START),
  RUN_END(_OS_OsApplication_QM_VAR_INIT_RUN_LIMIT),
  LOAD_START(_OS_OsApplication_QM_VAR_INIT_ROM_START),
  LOAD_END(_OS_OsApplication_QM_VAR_INIT_ROM_LIMIT)

  .OS_OsApplication_QM_VAR_NOINIT :
  {
    *(.OS_OsApplication_QM_VAR_NOCACHE_NOINIT)
    *(.OS_OsApplication_QM_VAR_NOINIT)
  } > MCU_MSRAM_Common_NonCache,
  RUN_START(_OS_OsApplication_QM_VAR_NOINIT_RUN_START),
  RUN_END(_OS_OsApplication_QM_VAR_NOINIT_RUN_LIMIT)

  .OS_OsApplication_QM_VAR_ZERO_INIT : ALIGN(4)
  {
    *(.OS_OsApplication_QM_VAR_NOCACHE_ZERO_INIT)
    *(.OS_OsApplication_QM_VAR_ZERO_INIT)
    . = ALIGN(4);
  } > MCU_MSRAM_Common_NonCache,
  RUN_START(_OS_OsApplication_QM_VAR_ZERO_INIT_RUN_START),
  RUN_END(_OS_OsApplication_QM_VAR_ZERO_INIT_RUN_LIMIT)

  .OS_OsApplication_QM_VAR_ZERO_INIT_bss : ALIGN(4)
  {
    *(.OS_OsApplication_QM_VAR_NOCACHE_ZERO_INIT_bss)
    *(.OS_OsApplication_QM_VAR_ZERO_INIT_bss)
    . = ALIGN(4);
  } > MCU_MSRAM_Common_NonCache,
  RUN_START(_OS_OsApplication_QM_VAR_ZERO_INIT_bss_RUN_START),
  RUN_END(_OS_OsApplication_QM_VAR_ZERO_INIT_bss_RUN_LIMIT)

  .OS_OsApplication_QM_VAR_LABELS :
  {
    _OS_OsApplication_QM_VAR_INIT_START = _OS_OsApplication_QM_VAR_INIT_RUN_START;
    _OS_OsApplication_QM_VAR_INIT_LIMIT = _OS_OsApplication_QM_VAR_INIT_RUN_LIMIT;
    _OS_OsApplication_QM_VAR_INIT_END = _OS_OsApplication_QM_VAR_INIT_LIMIT - 1;
    _OS_OsApplication_QM_VAR_NOINIT_START = _OS_OsApplication_QM_VAR_NOINIT_RUN_START;
    _OS_OsApplication_QM_VAR_NOINIT_LIMIT = _OS_OsApplication_QM_VAR_NOINIT_RUN_LIMIT;
    _OS_OsApplication_QM_VAR_NOINIT_END = _OS_OsApplication_QM_VAR_NOINIT_LIMIT - 1;
    _OS_OsApplication_QM_VAR_ZERO_INIT_START = _OS_OsApplication_QM_VAR_ZERO_INIT_RUN_START;
    _OS_OsApplication_QM_VAR_ZERO_INIT_LIMIT = _OS_OsApplication_QM_VAR_ZERO_INIT_RUN_LIMIT;
    _OS_OsApplication_QM_VAR_ZERO_INIT_END = _OS_OsApplication_QM_VAR_ZERO_INIT_LIMIT - 1;
    _OS_OsApplication_QM_VAR_ZERO_INIT_bss_START = _OS_OsApplication_QM_VAR_ZERO_INIT_bss_RUN_START;
    _OS_OsApplication_QM_VAR_ZERO_INIT_bss_LIMIT = _OS_OsApplication_QM_VAR_ZERO_INIT_bss_RUN_LIMIT;
    _OS_OsApplication_QM_VAR_ZERO_INIT_bss_END = _OS_OsApplication_QM_VAR_ZERO_INIT_bss_LIMIT - 1;
    _OS_OsApplication_QM_VAR_ALL_START = _OS_OsApplication_QM_VAR_INIT_START;
    _OS_OsApplication_QM_VAR_ALL_END = _OS_OsApplication_QM_VAR_ZERO_INIT_bss_END;
    _OS_OsApplication_QM_VAR_ALL_LIMIT = _OS_OsApplication_QM_VAR_ZERO_INIT_bss_LIMIT;
  }

  .OS_OsApplication_QM_VAR_SAVED_ZONE_INIT : ALIGN(4)
  {
    *(.OS_OsApplication_QM_VAR_SAVED_ZONE)
    . = ALIGN(4);
  } > DDR0, RUN > MCU_MSRAM_Common_NonCache,
  RUN_START(_OS_OsApplication_QM_VAR_SAVED_ZONE_INIT_RUN_START),
  RUN_END(_OS_OsApplication_QM_VAR_SAVED_ZONE_INIT_RUN_LIMIT),
  LOAD_START(_OS_OsApplication_QM_VAR_SAVED_ZONE_INIT_ROM_START),
  LOAD_END(_OS_OsApplication_QM_VAR_SAVED_ZONE_INIT_ROM_LIMIT)

  .OS_OsApplication_QM_VAR_SAVED_ZONE_NOINIT :
  {
    *(.OS_OsApplication_QM_VAR_SAVED_ZONE_NOINIT)
  } > MCU_MSRAM_Common_NonCache,
  RUN_START(_OS_OsApplication_QM_VAR_SAVED_ZONE_NOINIT_RUN_START),
  RUN_END(_OS_OsApplication_QM_VAR_SAVED_ZONE_NOINIT_RUN_LIMIT)

  .OS_OsApplication_QM_VAR_SAVED_ZONE_LABELS :
  {
    _OS_OsApplication_QM_VAR_SAVED_ZONE_INIT_START = _OS_OsApplication_QM_VAR_SAVED_ZONE_INIT_RUN_START;
    _OS_OsApplication_QM_VAR_SAVED_ZONE_INIT_LIMIT = _OS_OsApplication_QM_VAR_SAVED_ZONE_INIT_RUN_LIMIT;
    _OS_OsApplication_QM_VAR_SAVED_ZONE_INIT_END = _OS_OsApplication_QM_VAR_SAVED_ZONE_INIT_LIMIT - 1;
    _OS_OsApplication_QM_VAR_SAVED_ZONE_NOINIT_START = _OS_OsApplication_QM_VAR_SAVED_ZONE_NOINIT_RUN_START;
    _OS_OsApplication_QM_VAR_SAVED_ZONE_NOINIT_LIMIT = _OS_OsApplication_QM_VAR_SAVED_ZONE_NOINIT_RUN_LIMIT;
    _OS_OsApplication_QM_VAR_SAVED_ZONE_NOINIT_END = _OS_OsApplication_QM_VAR_SAVED_ZONE_NOINIT_LIMIT - 1;
    _OS_OsApplication_QM_VAR_SAVED_ZONE_ALL_START = _OS_OsApplication_QM_VAR_SAVED_ZONE_INIT_START;
    _OS_OsApplication_QM_VAR_SAVED_ZONE_ALL_END = _OS_OsApplication_QM_VAR_SAVED_ZONE_NOINIT_END;
    _OS_OsApplication_QM_VAR_SAVED_ZONE_ALL_LIMIT = _OS_OsApplication_QM_VAR_SAVED_ZONE_NOINIT_LIMIT;
  }

  .OS_OsApplication_Safety_VAR_INIT : ALIGN(4)
  {
    *(.OS_OsApplication_Safety_VAR)
    *(.OS_OsApplication_Safety_VAR_NOCACHE)
    . = ALIGN(4);
  } > DDR0, RUN > MCU_MSRAM_Common_NonCache,
  RUN_START(_OS_OsApplication_Safety_VAR_INIT_RUN_START),
  RUN_END(_OS_OsApplication_Safety_VAR_INIT_RUN_LIMIT),
  LOAD_START(_OS_OsApplication_Safety_VAR_INIT_ROM_START),
  LOAD_END(_OS_OsApplication_Safety_VAR_INIT_ROM_LIMIT)

  .OS_OsApplication_Safety_VAR_NOINIT :
  {
    *(.OS_OsApplication_Safety_VAR_NOCACHE_NOINIT)
    *(.OS_OsApplication_Safety_VAR_NOINIT)
  } > MCU_MSRAM_Common_NonCache,
  RUN_START(_OS_OsApplication_Safety_VAR_NOINIT_RUN_START),
  RUN_END(_OS_OsApplication_Safety_VAR_NOINIT_RUN_LIMIT)

  .OS_OsApplication_Safety_VAR_ZERO_INIT : ALIGN(4)
  {
    *(.OS_OsApplication_Safety_VAR_NOCACHE_ZERO_INIT)
    *(.OS_OsApplication_Safety_VAR_ZERO_INIT)
    . = ALIGN(4);
  } > MCU_MSRAM_Common_NonCache,
  RUN_START(_OS_OsApplication_Safety_VAR_ZERO_INIT_RUN_START),
  RUN_END(_OS_OsApplication_Safety_VAR_ZERO_INIT_RUN_LIMIT)

  .OS_OsApplication_Safety_VAR_ZERO_INIT_bss : ALIGN(4)
  {
    *(.OS_OsApplication_Safety_VAR_NOCACHE_ZERO_INIT_bss)
    *(.OS_OsApplication_Safety_VAR_ZERO_INIT_bss)
    . = ALIGN(4);
  } > MCU_MSRAM_Common_NonCache,
  RUN_START(_OS_OsApplication_Safety_VAR_ZERO_INIT_bss_RUN_START),
  RUN_END(_OS_OsApplication_Safety_VAR_ZERO_INIT_bss_RUN_LIMIT)

  .OS_OsApplication_Safety_VAR_LABELS :
  {
    _OS_OsApplication_Safety_VAR_INIT_START = _OS_OsApplication_Safety_VAR_INIT_RUN_START;
    _OS_OsApplication_Safety_VAR_INIT_LIMIT = _OS_OsApplication_Safety_VAR_INIT_RUN_LIMIT;
    _OS_OsApplication_Safety_VAR_INIT_END = _OS_OsApplication_Safety_VAR_INIT_LIMIT - 1;
    _OS_OsApplication_Safety_VAR_NOINIT_START = _OS_OsApplication_Safety_VAR_NOINIT_RUN_START;
    _OS_OsApplication_Safety_VAR_NOINIT_LIMIT = _OS_OsApplication_Safety_VAR_NOINIT_RUN_LIMIT;
    _OS_OsApplication_Safety_VAR_NOINIT_END = _OS_OsApplication_Safety_VAR_NOINIT_LIMIT - 1;
    _OS_OsApplication_Safety_VAR_ZERO_INIT_START = _OS_OsApplication_Safety_VAR_ZERO_INIT_RUN_START;
    _OS_OsApplication_Safety_VAR_ZERO_INIT_LIMIT = _OS_OsApplication_Safety_VAR_ZERO_INIT_RUN_LIMIT;
    _OS_OsApplication_Safety_VAR_ZERO_INIT_END = _OS_OsApplication_Safety_VAR_ZERO_INIT_LIMIT - 1;
    _OS_OsApplication_Safety_VAR_ZERO_INIT_bss_START = _OS_OsApplication_Safety_VAR_ZERO_INIT_bss_RUN_START;
    _OS_OsApplication_Safety_VAR_ZERO_INIT_bss_LIMIT = _OS_OsApplication_Safety_VAR_ZERO_INIT_bss_RUN_LIMIT;
    _OS_OsApplication_Safety_VAR_ZERO_INIT_bss_END = _OS_OsApplication_Safety_VAR_ZERO_INIT_bss_LIMIT - 1;
    _OS_OsApplication_Safety_VAR_ALL_START = _OS_OsApplication_Safety_VAR_INIT_START;
    _OS_OsApplication_Safety_VAR_ALL_END = _OS_OsApplication_Safety_VAR_ZERO_INIT_bss_END;
    _OS_OsApplication_Safety_VAR_ALL_LIMIT = _OS_OsApplication_Safety_VAR_ZERO_INIT_bss_LIMIT;
  }

  .OS_OsApplication_Safety_VAR_SAVED_ZONE_INIT : ALIGN(4)
  {
    *(.OS_OsApplication_Safety_VAR_SAVED_ZONE)
    . = ALIGN(4);
  } > DDR0, RUN > MCU_MSRAM_Common_NonCache,
  RUN_START(_OS_OsApplication_Safety_VAR_SAVED_ZONE_INIT_RUN_START),
  RUN_END(_OS_OsApplication_Safety_VAR_SAVED_ZONE_INIT_RUN_LIMIT),
  LOAD_START(_OS_OsApplication_Safety_VAR_SAVED_ZONE_INIT_ROM_START),
  LOAD_END(_OS_OsApplication_Safety_VAR_SAVED_ZONE_INIT_ROM_LIMIT)

  .OS_OsApplication_Safety_VAR_SAVED_ZONE_NOINIT :
  {
    *(.OS_OsApplication_Safety_VAR_SAVED_ZONE_NOINIT)
  } > MCU_MSRAM_Common_NonCache,
  RUN_START(_OS_OsApplication_Safety_VAR_SAVED_ZONE_NOINIT_RUN_START),
  RUN_END(_OS_OsApplication_Safety_VAR_SAVED_ZONE_NOINIT_RUN_LIMIT)

  .OS_OsApplication_Safety_VAR_SAVED_ZONE_LABELS :
  {
    _OS_OsApplication_Safety_VAR_SAVED_ZONE_INIT_START = _OS_OsApplication_Safety_VAR_SAVED_ZONE_INIT_RUN_START;
    _OS_OsApplication_Safety_VAR_SAVED_ZONE_INIT_LIMIT = _OS_OsApplication_Safety_VAR_SAVED_ZONE_INIT_RUN_LIMIT;
    _OS_OsApplication_Safety_VAR_SAVED_ZONE_INIT_END = _OS_OsApplication_Safety_VAR_SAVED_ZONE_INIT_LIMIT - 1;
    _OS_OsApplication_Safety_VAR_SAVED_ZONE_NOINIT_START = _OS_OsApplication_Safety_VAR_SAVED_ZONE_NOINIT_RUN_START;
    _OS_OsApplication_Safety_VAR_SAVED_ZONE_NOINIT_LIMIT = _OS_OsApplication_Safety_VAR_SAVED_ZONE_NOINIT_RUN_LIMIT;
    _OS_OsApplication_Safety_VAR_SAVED_ZONE_NOINIT_END = _OS_OsApplication_Safety_VAR_SAVED_ZONE_NOINIT_LIMIT - 1;
    _OS_OsApplication_Safety_VAR_SAVED_ZONE_ALL_START = _OS_OsApplication_Safety_VAR_SAVED_ZONE_INIT_START;
    _OS_OsApplication_Safety_VAR_SAVED_ZONE_ALL_END = _OS_OsApplication_Safety_VAR_SAVED_ZONE_NOINIT_END;
    _OS_OsApplication_Safety_VAR_SAVED_ZONE_ALL_LIMIT = _OS_OsApplication_Safety_VAR_SAVED_ZONE_NOINIT_LIMIT;
  }

  .OS_OsApplication_Trusted_Core0_VAR_INIT : ALIGN(4)
  {
    *(.OS_OsApplication_Trusted_Core0_VAR)
    *(.OS_OsApplication_Trusted_Core0_VAR_NOCACHE)
    . = ALIGN(4);
  } > MCU_MSRAM_Common, RUN > MCU_MSRAM_Common,
  RUN_START(_OS_OsApplication_Trusted_Core0_VAR_INIT_RUN_START),
  RUN_END(_OS_OsApplication_Trusted_Core0_VAR_INIT_RUN_LIMIT),
  LOAD_START(_OS_OsApplication_Trusted_Core0_VAR_INIT_ROM_START),
  LOAD_END(_OS_OsApplication_Trusted_Core0_VAR_INIT_ROM_LIMIT)

  .OS_OsApplication_Trusted_Core0_VAR_NOINIT :
  {
    *(.OS_OsApplication_Trusted_Core0_VAR_NOCACHE_NOINIT)
    *(.OS_OsApplication_Trusted_Core0_VAR_NOINIT)
  } > MCU_MSRAM_Common,
  RUN_START(_OS_OsApplication_Trusted_Core0_VAR_NOINIT_RUN_START),
  RUN_END(_OS_OsApplication_Trusted_Core0_VAR_NOINIT_RUN_LIMIT)

  .OS_OsApplication_Trusted_Core0_VAR_ZERO_INIT : ALIGN(4)
  {
    *(.OS_OsApplication_Trusted_Core0_VAR_NOCACHE_ZERO_INIT)
    *(.OS_OsApplication_Trusted_Core0_VAR_ZERO_INIT)
    . = ALIGN(4);
  } > MCU_MSRAM_Common,
  RUN_START(_OS_OsApplication_Trusted_Core0_VAR_ZERO_INIT_RUN_START),
  RUN_END(_OS_OsApplication_Trusted_Core0_VAR_ZERO_INIT_RUN_LIMIT)

  .OS_OsApplication_Trusted_Core0_VAR_ZERO_INIT_bss : ALIGN(4)
  {
    *(.OS_OsApplication_Trusted_Core0_VAR_NOCACHE_ZERO_INIT_bss)
    *(.OS_OsApplication_Trusted_Core0_VAR_ZERO_INIT_bss)
    . = ALIGN(4);
  } > MCU_MSRAM_Common,
  RUN_START(_OS_OsApplication_Trusted_Core0_VAR_ZERO_INIT_bss_RUN_START),
  RUN_END(_OS_OsApplication_Trusted_Core0_VAR_ZERO_INIT_bss_RUN_LIMIT)

  .OS_OsApplication_Trusted_Core0_VAR_LABELS :
  {
    _OS_OsApplication_Trusted_Core0_VAR_INIT_START = _OS_OsApplication_Trusted_Core0_VAR_INIT_RUN_START;
    _OS_OsApplication_Trusted_Core0_VAR_INIT_LIMIT = _OS_OsApplication_Trusted_Core0_VAR_INIT_RUN_LIMIT;
    _OS_OsApplication_Trusted_Core0_VAR_INIT_END = _OS_OsApplication_Trusted_Core0_VAR_INIT_LIMIT - 1;
    _OS_OsApplication_Trusted_Core0_VAR_NOINIT_START = _OS_OsApplication_Trusted_Core0_VAR_NOINIT_RUN_START;
    _OS_OsApplication_Trusted_Core0_VAR_NOINIT_LIMIT = _OS_OsApplication_Trusted_Core0_VAR_NOINIT_RUN_LIMIT;
    _OS_OsApplication_Trusted_Core0_VAR_NOINIT_END = _OS_OsApplication_Trusted_Core0_VAR_NOINIT_LIMIT - 1;
    _OS_OsApplication_Trusted_Core0_VAR_ZERO_INIT_START = _OS_OsApplication_Trusted_Core0_VAR_ZERO_INIT_RUN_START;
    _OS_OsApplication_Trusted_Core0_VAR_ZERO_INIT_LIMIT = _OS_OsApplication_Trusted_Core0_VAR_ZERO_INIT_RUN_LIMIT;
    _OS_OsApplication_Trusted_Core0_VAR_ZERO_INIT_END = _OS_OsApplication_Trusted_Core0_VAR_ZERO_INIT_LIMIT - 1;
    _OS_OsApplication_Trusted_Core0_VAR_ZERO_INIT_bss_START = _OS_OsApplication_Trusted_Core0_VAR_ZERO_INIT_bss_RUN_START;
    _OS_OsApplication_Trusted_Core0_VAR_ZERO_INIT_bss_LIMIT = _OS_OsApplication_Trusted_Core0_VAR_ZERO_INIT_bss_RUN_LIMIT;
    _OS_OsApplication_Trusted_Core0_VAR_ZERO_INIT_bss_END = _OS_OsApplication_Trusted_Core0_VAR_ZERO_INIT_bss_LIMIT - 1;
    _OS_OsApplication_Trusted_Core0_VAR_ALL_START = _OS_OsApplication_Trusted_Core0_VAR_INIT_START;
    _OS_OsApplication_Trusted_Core0_VAR_ALL_END = _OS_OsApplication_Trusted_Core0_VAR_ZERO_INIT_bss_END;
    _OS_OsApplication_Trusted_Core0_VAR_ALL_LIMIT = _OS_OsApplication_Trusted_Core0_VAR_ZERO_INIT_bss_LIMIT;
  }

  .OS_OsApplication_Trusted_Core0_VAR_SAVED_ZONE_INIT : ALIGN(4)
  {
    *(.OS_OsApplication_Trusted_Core0_VAR_SAVED_ZONE)
    . = ALIGN(4);
  } > MCU_MSRAM_Common, RUN > MCU_MSRAM_Common,
  RUN_START(_OS_OsApplication_Trusted_Core0_VAR_SAVED_ZONE_INIT_RUN_START),
  RUN_END(_OS_OsApplication_Trusted_Core0_VAR_SAVED_ZONE_INIT_RUN_LIMIT),
  LOAD_START(_OS_OsApplication_Trusted_Core0_VAR_SAVED_ZONE_INIT_ROM_START),
  LOAD_END(_OS_OsApplication_Trusted_Core0_VAR_SAVED_ZONE_INIT_ROM_LIMIT)

  .OS_OsApplication_Trusted_Core0_VAR_SAVED_ZONE_NOINIT :
  {
    *(.OS_OsApplication_Trusted_Core0_VAR_SAVED_ZONE_NOINIT)
  } > MCU_MSRAM_Common,
  RUN_START(_OS_OsApplication_Trusted_Core0_VAR_SAVED_ZONE_NOINIT_RUN_START),
  RUN_END(_OS_OsApplication_Trusted_Core0_VAR_SAVED_ZONE_NOINIT_RUN_LIMIT)

  .OS_OsApplication_Trusted_Core0_VAR_SAVED_ZONE_LABELS :
  {
    _OS_OsApplication_Trusted_Core0_VAR_SAVED_ZONE_INIT_START = _OS_OsApplication_Trusted_Core0_VAR_SAVED_ZONE_INIT_RUN_START;
    _OS_OsApplication_Trusted_Core0_VAR_SAVED_ZONE_INIT_LIMIT = _OS_OsApplication_Trusted_Core0_VAR_SAVED_ZONE_INIT_RUN_LIMIT;
    _OS_OsApplication_Trusted_Core0_VAR_SAVED_ZONE_INIT_END = _OS_OsApplication_Trusted_Core0_VAR_SAVED_ZONE_INIT_LIMIT - 1;
    _OS_OsApplication_Trusted_Core0_VAR_SAVED_ZONE_NOINIT_START = _OS_OsApplication_Trusted_Core0_VAR_SAVED_ZONE_NOINIT_RUN_START;
    _OS_OsApplication_Trusted_Core0_VAR_SAVED_ZONE_NOINIT_LIMIT = _OS_OsApplication_Trusted_Core0_VAR_SAVED_ZONE_NOINIT_RUN_LIMIT;
    _OS_OsApplication_Trusted_Core0_VAR_SAVED_ZONE_NOINIT_END = _OS_OsApplication_Trusted_Core0_VAR_SAVED_ZONE_NOINIT_LIMIT - 1;
    _OS_OsApplication_Trusted_Core0_VAR_SAVED_ZONE_ALL_START = _OS_OsApplication_Trusted_Core0_VAR_SAVED_ZONE_INIT_START;
    _OS_OsApplication_Trusted_Core0_VAR_SAVED_ZONE_ALL_END = _OS_OsApplication_Trusted_Core0_VAR_SAVED_ZONE_NOINIT_END;
    _OS_OsApplication_Trusted_Core0_VAR_SAVED_ZONE_ALL_LIMIT = _OS_OsApplication_Trusted_Core0_VAR_SAVED_ZONE_NOINIT_LIMIT;
  }

  .OS_USER_CODE :
  {
    *(.OS_Adc_IrqUnit0_CODE)
    *(.OS_Adc_IrqUnit1_CODE)
    *(.OS_BootAppOsTask_CODE)
    *(.OS_Can_30_McanIsr_0_CODE)
    *(.OS_Can_30_McanIsr_1_CODE)
    *(.OS_ERRORHOOK_CODE)
    *(.OS_I2c_IrqUnit0_CODE)
    *(.OS_I2c_IrqUnit1_CODE)
    *(.OS_IPC_mailbox1_CODE)
    *(.OS_IPC_mailbox2_CODE)
    *(.OS_MAIN_ESM0_ESM_INT_CFG_LVL_0_CODE)
    *(.OS_MAIN_ESM0_ESM_INT_HI_LVL_0_CODE)
    *(.OS_MAIN_ESM0_ESM_INT_LOW_LVL_0_CODE)
    *(.OS_MCU_ESM0_ESM_INT_CFG_LVL_0_CODE)
    *(.OS_MCU_ESM0_ESM_INT_HI_LVL_0_CODE)
    *(.OS_MCU_ESM0_ESM_INT_LOW_LVL_0_CODE)
    *(.OS_MCU_NAVSS0_UDMASS_INTA_0_INTAGGR_VINTR_PEND_78_CODE)
    *(.OS_MCU_NAVSS0_UDMASS_INTA_0_INTAGGR_VINTR_PEND_79_CODE)
    *(.OS_PANICHOOK_CODE)
    *(.OS_PROTECTIONHOOK_CODE)
    *(.OS_QM_ComTask_10ms_CODE)
    *(.OS_QM_ComTask_5ms_CODE)
    *(.OS_QM_DiagTask_10ms_CODE)
    *(.OS_QM_MemTask_10ms_CODE)
    *(.OS_QM_Task_00_10ms_CODE)
    *(.OS_QM_Task_01_10ms_CODE)
    *(.OS_QM_Task_200ms_CODE)
    *(.OS_QM_Task_Init_CODE)
    *(.OS_Safety_Task_00_10ms_CODE)
    *(.OS_Safety_Task_01_10ms_CODE)
    *(.OS_Safety_Task_200ms_CODE)
    *(.OS_Safety_Task_Init_CODE)
    *(.OS_Safety_WdgTask_10ms_CODE)
    *(.OS_SciServer_OsIsr_UserMsgHwiFxn1_CODE)
    *(.OS_SciServer_OsIsr_UserMsgHwiFxn2_CODE)
    *(.OS_SciServer_OsIsr_UserMsgHwiFxn3_CODE)
    *(.OS_SciServer_OsIsr_UserMsgHwiFxn4_CODE)
    *(.OS_SciServerHighOsTask_CODE)
    *(.OS_SciServerLowOsTask_CODE)
    *(.OS_SDLR_MCU_R5FSS0_CORE0_INTR_AEP_GPU_BXS464_WRAP0_DFT_EMBED_PBIST_0_DFT_PBIST_CPU_0_317_CODE)
    *(.OS_SDLR_MCU_R5FSS0_CORE0_INTR_COMPUTE_CLUSTER0_AC71_4_DFT_LBIST_DFT_LBIST_BIST_DONE_0_295_CODE)
    *(.OS_SDLR_MCU_R5FSS0_CORE0_INTR_COMPUTE_CLUSTER0_AC71_5_DFT_LBIST_DFT_LBIST_BIST_DONE_0_296_CODE)
    *(.OS_SDLR_MCU_R5FSS0_CORE0_INTR_COMPUTE_CLUSTER0_ARM0_DFT_LBIST_DFT_LBIST_BIST_DONE_0_291_CODE)
    *(.OS_SDLR_MCU_R5FSS0_CORE0_INTR_COMPUTE_CLUSTER0_PBIST_WRAP_0_DFT_PBIST_CPU_0_290_CODE)
    *(.OS_SDLR_MCU_R5FSS0_CORE0_INTR_GLUELOGIC_DMPAC_LBIST_GLUE_DFT_LBIST_BIST_DONE_0_299_CODE)
    *(.OS_SDLR_MCU_R5FSS0_CORE0_INTR_GLUELOGIC_MAIN_PULSAR0_LBIST_GLUE_DFT_LBIST_BIST_DONE_0_297_CODE)
    *(.OS_SDLR_MCU_R5FSS0_CORE0_INTR_GLUELOGIC_MAIN_PULSAR1_LBIST_GLUE_DFT_LBIST_BIST_DONE_0_298_CODE)
    *(.OS_SDLR_MCU_R5FSS0_CORE0_INTR_GLUELOGIC_VPAC_LBIST_GLUE_DFT_LBIST_BIST_DONE_0_300_CODE)
    *(.OS_SDLR_MCU_R5FSS0_CORE0_INTR_MCU_PBIST0_DFT_PBIST_CPU_0_47_CODE)
    *(.OS_SDLR_MCU_R5FSS0_CORE0_INTR_MCU_PBIST1_DFT_PBIST_CPU_0_36_CODE)
    *(.OS_SDLR_MCU_R5FSS0_CORE0_INTR_MCU_PBIST2_DFT_PBIST_CPU_0_37_CODE)
    *(.OS_SDLR_MCU_R5FSS0_CORE0_INTR_PBIST0_DFT_PBIST_CPU_0_312_CODE)
    *(.OS_SDLR_MCU_R5FSS0_CORE0_INTR_PBIST10_DFT_PBIST_CPU_0_310_CODE)
    *(.OS_SDLR_MCU_R5FSS0_CORE0_INTR_PBIST11_DFT_PBIST_CPU_0_314_CODE)
    *(.OS_SDLR_MCU_R5FSS0_CORE0_INTR_PBIST1_DFT_PBIST_CPU_0_313_CODE)
    *(.OS_SDLR_MCU_R5FSS0_CORE0_INTR_PBIST2_DFT_PBIST_CPU_0_309_CODE)
    *(.OS_SDLR_MCU_R5FSS0_CORE0_INTR_PBIST3_DFT_PBIST_CPU_0_307_CODE)
    *(.OS_SDLR_MCU_R5FSS0_CORE0_INTR_PBIST4_DFT_PBIST_CPU_0_308_CODE)
    *(.OS_SDLR_MCU_R5FSS0_CORE0_INTR_PBIST5_DFT_PBIST_CPU_0_306_CODE)
    *(.OS_SDLR_MCU_R5FSS0_CORE0_INTR_PBIST7_DFT_PBIST_CPU_0_304_CODE)
    *(.OS_SDLR_MCU_R5FSS0_CORE0_INTR_PBIST8_DFT_PBIST_CPU_0_305_CODE)
    *(.OS_SHUTDOWNHOOK_CODE)
    *(.OS_ShutdownTask_CODE)
    *(.OS_StartUpTask_CODE)
    *(.OS_vHsmResponseIsr_CODE)
    *(.OS_WKUP_ESM0_ESM_INT_CFG_LVL_0_CODE)
    *(.OS_WKUP_ESM0_ESM_INT_HI_LVL_0_CODE)
    *(.OS_WKUP_ESM0_ESM_INT_LOW_LVL_0_CODE)
  } > DDR0,
  RUN_START(_OS_USER_CODE_RUN_START),
  RUN_END(_OS_USER_CODE_RUN_LIMIT)

  .OS_USER_CODE_LABELS :
  {
    _OS_USER_CODE_START = _OS_USER_CODE_RUN_START;
    _OS_USER_CODE_LIMIT = _OS_USER_CODE_RUN_LIMIT;
    _OS_USER_CODE_END = _OS_USER_CODE_LIMIT - 1;
    _OS_USER_CODE_ALL_START = _OS_USER_CODE_START;
    _OS_USER_CODE_ALL_END = _OS_USER_CODE_END;
    _OS_USER_CODE_ALL_LIMIT = _OS_USER_CODE_LIMIT;
  }

  .OS_USER_CONST :
  {
    *(.OS_OsApplication_QM_CONST)
    *(.OS_OsApplication_Safety_CONST)
    *(.OS_OsApplication_Trusted_Core0_CONST)
  } > DDR0,
  RUN_START(_OS_USER_CONST_RUN_START),
  RUN_END(_OS_USER_CONST_RUN_LIMIT)

  .OS_USER_CONST_LABELS :
  {
    _OS_USER_CONST_START = _OS_USER_CONST_RUN_START;
    _OS_USER_CONST_LIMIT = _OS_USER_CONST_RUN_LIMIT;
    _OS_USER_CONST_END = _OS_USER_CONST_LIMIT - 1;
    _OS_USER_CONST_ALL_START = _OS_USER_CONST_START;
    _OS_USER_CONST_ALL_END = _OS_USER_CONST_END;
    _OS_USER_CONST_ALL_LIMIT = _OS_USER_CONST_LIMIT;
  }

  .R5F_Startup_Code :
  {
    *(.startupCode)
  } > MCU_MSRAM_Common,
  RUN_START(_R5F_Startup_Code_RUN_START),
  RUN_END(_R5F_Startup_Code_RUN_LIMIT)

  .R5F_Startup_Code_LABELS :
  {
    _R5F_Startup_Code_START = _R5F_Startup_Code_RUN_START;
    _R5F_Startup_Code_LIMIT = _R5F_Startup_Code_RUN_LIMIT;
    _R5F_Startup_Code_END = _R5F_Startup_Code_LIMIT - 1;
    _R5F_Startup_Code_ALL_START = _R5F_Startup_Code_START;
    _R5F_Startup_Code_ALL_END = _R5F_Startup_Code_END;
    _R5F_Startup_Code_ALL_LIMIT = _R5F_Startup_Code_LIMIT;
  }

  .R5F_Startup_Data :
  {
    *(.startupData)
  } > MCU_MSRAM_Common,
  RUN_START(_R5F_Startup_Data_RUN_START),
  RUN_END(_R5F_Startup_Data_RUN_LIMIT)

  .R5F_Startup_Data_LABELS :
  {
    _R5F_Startup_Data_START = _R5F_Startup_Data_RUN_START;
    _R5F_Startup_Data_LIMIT = _R5F_Startup_Data_RUN_LIMIT;
    _R5F_Startup_Data_END = _R5F_Startup_Data_LIMIT - 1;
    _R5F_Startup_Data_ALL_START = _R5F_Startup_Data_START;
    _R5F_Startup_Data_ALL_END = _R5F_Startup_Data_END;
    _R5F_Startup_Data_ALL_LIMIT = _R5F_Startup_Data_LIMIT;
  }

  .STACK_C1 : ALIGN(4)
  {
    . += 1024;
    . = ALIGN(4);
  } > MCU_MSRAM_Common,
  RUN_START(_STACK_C1_RUN_START),
  RUN_END(_STACK_C1_RUN_LIMIT)

  .STACK_C1_LABELS :
  {
    _STACK_C1_START = _STACK_C1_RUN_START;
    _STACK_C1_LIMIT = _STACK_C1_RUN_LIMIT;
    _STACK_C1_END = _STACK_C1_LIMIT - 1;
    _STACK_C1_ALL_START = _STACK_C1_START;
    _STACK_C1_ALL_END = _STACK_C1_END;
    _STACK_C1_ALL_LIMIT = _STACK_C1_LIMIT;
  }

  .STACK_C2 : ALIGN(4)
  {
    . += 1024;
    . = ALIGN(4);
  } > MCU_MSRAM_Common,
  RUN_START(_STACK_C2_RUN_START),
  RUN_END(_STACK_C2_RUN_LIMIT)

  .STACK_C2_LABELS :
  {
    _STACK_C2_START = _STACK_C2_RUN_START;
    _STACK_C2_LIMIT = _STACK_C2_RUN_LIMIT;
    _STACK_C2_END = _STACK_C2_LIMIT - 1;
    _STACK_C2_ALL_START = _STACK_C2_START;
    _STACK_C2_ALL_END = _STACK_C2_END;
    _STACK_C2_ALL_LIMIT = _STACK_C2_LIMIT;
  }

  .STACK_C3 : ALIGN(4)
  {
    . += 1024;
    . = ALIGN(4);
  } > MCU_MSRAM_Common,
  RUN_START(_STACK_C3_RUN_START),
  RUN_END(_STACK_C3_RUN_LIMIT)

  .STACK_C3_LABELS :
  {
    _STACK_C3_START = _STACK_C3_RUN_START;
    _STACK_C3_LIMIT = _STACK_C3_RUN_LIMIT;
    _STACK_C3_END = _STACK_C3_LIMIT - 1;
    _STACK_C3_ALL_START = _STACK_C3_START;
    _STACK_C3_ALL_END = _STACK_C3_END;
    _STACK_C3_ALL_LIMIT = _STACK_C3_LIMIT;
  }

  .STACK_C4 : ALIGN(4)
  {
    . += 1024;
    . = ALIGN(4);
  } > MCU_MSRAM_Common,
  RUN_START(_STACK_C4_RUN_START),
  RUN_END(_STACK_C4_RUN_LIMIT)

  .STACK_C4_LABELS :
  {
    _STACK_C4_START = _STACK_C4_RUN_START;
    _STACK_C4_LIMIT = _STACK_C4_RUN_LIMIT;
    _STACK_C4_END = _STACK_C4_LIMIT - 1;
    _STACK_C4_ALL_START = _STACK_C4_START;
    _STACK_C4_ALL_END = _STACK_C4_END;
    _STACK_C4_ALL_LIMIT = _STACK_C4_LIMIT;
  }

  .STACK_C5 : ALIGN(4)
  {
    . += 1024;
    . = ALIGN(4);
  } > MCU_MSRAM_Common,
  RUN_START(_STACK_C5_RUN_START),
  RUN_END(_STACK_C5_RUN_LIMIT)

  .STACK_C5_LABELS :
  {
    _STACK_C5_START = _STACK_C5_RUN_START;
    _STACK_C5_LIMIT = _STACK_C5_RUN_LIMIT;
    _STACK_C5_END = _STACK_C5_LIMIT - 1;
    _STACK_C5_ALL_START = _STACK_C5_START;
    _STACK_C5_ALL_END = _STACK_C5_END;
    _STACK_C5_ALL_LIMIT = _STACK_C5_LIMIT;
  }

  .Startup_Code :
  {
    *(.brsStartup)
  } > MCU_MSRAM_Common,
  RUN_START(_Startup_Code_RUN_START),
  RUN_END(_Startup_Code_RUN_LIMIT)

  .Startup_Code_LABELS :
  {
    _Startup_Code_START = _Startup_Code_RUN_START;
    _Startup_Code_LIMIT = _Startup_Code_RUN_LIMIT;
    _Startup_Code_END = _Startup_Code_LIMIT - 1;
    _Startup_Code_ALL_START = _Startup_Code_START;
    _Startup_Code_ALL_END = _Startup_Code_END;
    _Startup_Code_ALL_LIMIT = _Startup_Code_LIMIT;
  }

  .Startup_Labels :
  {
    _RESET = brsStartupEntry;
    _start = brsStartupEntry;
    _start_c1 = brsStartupEntry;
    _start_c2 = brsStartupEntry;
    _start_c3 = brsStartupEntry;
    _start_c4 = brsStartupEntry;
    _start_c5 = brsStartupEntry;
    _brsStartupEntry = brsStartupEntry;
  }

  .Startup_Stack_Symbols :
  {
    __section_stack_c0_end = _STACK_C0_LIMIT;
    __section_stack_c1_end = _STACK_C1_LIMIT;
    __section_stack_c2_end = _STACK_C2_LIMIT;
    __section_stack_c3_end = _STACK_C3_LIMIT;
    __section_stack_c4_end = _STACK_C4_LIMIT;
    __section_stack_c5_end = _STACK_C5_LIMIT;
  }

  .TI_sysfw_sections_bss_devgroup : ALIGN(4)
  {
    *(.boardcfg_data)
    *(.data_user)
    *(.bss.devgroup.DMSC_INTERNAL)
    *(.bss.devgroup.MAIN)
    *(.bss.devgroup.MCU_WAKEUP)
    . = ALIGN(4);
  } > DDR0,
  RUN_START(_TI_sysfw_sections_bss_devgroup_RUN_START),
  RUN_END(_TI_sysfw_sections_bss_devgroup_RUN_LIMIT)

  .TI_sysfw_sections_bss_devgroup_LABELS :
  {
    _TI_sysfw_sections_bss_devgroup_START = _TI_sysfw_sections_bss_devgroup_RUN_START;
    _TI_sysfw_sections_bss_devgroup_LIMIT = _TI_sysfw_sections_bss_devgroup_RUN_LIMIT;
    _TI_sysfw_sections_bss_devgroup_END = _TI_sysfw_sections_bss_devgroup_LIMIT - 1;
    _TI_sysfw_sections_bss_devgroup_ALL_START = _TI_sysfw_sections_bss_devgroup_START;
    _TI_sysfw_sections_bss_devgroup_ALL_END = _TI_sysfw_sections_bss_devgroup_END;
    _TI_sysfw_sections_bss_devgroup_ALL_LIMIT = _TI_sysfw_sections_bss_devgroup_LIMIT;
  }

  .TI_sysfw_sections_const_devgroup : ALIGN(4)
  {
    *(.const.devgroup.DMSC_INTERNAL)
    *(.const.devgroup.MAIN)
    *(.const.devgroup.MCU_WAKEUP)
    . = ALIGN(4);
  } > DDR0,
  RUN_START(_TI_sysfw_sections_const_devgroup_RUN_START),
  RUN_END(_TI_sysfw_sections_const_devgroup_RUN_LIMIT)

  .TI_sysfw_sections_const_devgroup_LABELS :
  {
    _TI_sysfw_sections_const_devgroup_START = _TI_sysfw_sections_const_devgroup_RUN_START;
    _TI_sysfw_sections_const_devgroup_LIMIT = _TI_sysfw_sections_const_devgroup_RUN_LIMIT;
    _TI_sysfw_sections_const_devgroup_END = _TI_sysfw_sections_const_devgroup_LIMIT - 1;
    _TI_sysfw_sections_const_devgroup_ALL_START = _TI_sysfw_sections_const_devgroup_START;
    _TI_sysfw_sections_const_devgroup_ALL_END = _TI_sysfw_sections_const_devgroup_END;
    _TI_sysfw_sections_const_devgroup_ALL_LIMIT = _TI_sysfw_sections_const_devgroup_LIMIT;
  }

  .rodata :
  {
    *(.rodata)
    *(.const)
  } > DDR0,
  RUN_START(_rodata_RUN_START),
  RUN_END(_rodata_RUN_LIMIT)

  .text :
  {
    *(.text)
  } > DDR0,
  RUN_START(_text_RUN_START),
  RUN_END(_text_RUN_LIMIT)

  .Const_Default_LABELS :
  {
    _rodata_START = _rodata_RUN_START;
    _rodata_LIMIT = _rodata_RUN_LIMIT;
    _rodata_END = _rodata_LIMIT - 1;
    _text_START = _text_RUN_START;
    _text_LIMIT = _text_RUN_LIMIT;
    _text_END = _text_LIMIT - 1;
    _Const_Default_ALL_START = _rodata_START;
    _Const_Default_ALL_END = _text_END;
    _Const_Default_ALL_LIMIT = _text_LIMIT;
  }

  .bss : ALIGN(4)
  {
    *(.bss)
    *(.heap)
    *(.stack)
    . = ALIGN(4);
  } > DDR0,
  RUN_START(_bss_RUN_START),
  RUN_END(_bss_RUN_LIMIT)

  .data : ALIGN(4)
  {
    *(.data)
    . = ALIGN(4);
  } > DDR0, RUN > DDR0,
  RUN_START(_data_RUN_START),
  RUN_END(_data_RUN_LIMIT),
  LOAD_START(_data_ROM_START),
  LOAD_END(_data_ROM_LIMIT)

  .Data_Default_LABELS :
  {
    _bss_START = _bss_RUN_START;
    _bss_LIMIT = _bss_RUN_LIMIT;
    _bss_END = _bss_LIMIT - 1;
    _data_START = _data_RUN_START;
    _data_LIMIT = _data_RUN_LIMIT;
    _data_END = _data_LIMIT - 1;
    _Data_Default_ALL_START = _bss_START;
    _Data_Default_ALL_END = _data_END;
    _Data_Default_ALL_LIMIT = _data_LIMIT;
  }

}


