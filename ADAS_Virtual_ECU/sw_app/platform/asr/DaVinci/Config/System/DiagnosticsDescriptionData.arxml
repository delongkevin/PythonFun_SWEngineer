[part 2 of 2: package /InitialEcuC]
AUTOSAR XML (schema 00048)
package /InitialEcuC  (continued)
  module config Dem: module-description=Dem_Impl
    DemConfigSet
      DtcAttributes_41914fb7 (DemDTCAttributes): DemMemoryDestinationRef=PrimaryMemory
      DTCClass_DtcClass_ECU_In_Plant_Mode_C221200 (DemDTCClass): DemDTCSeverity=DEM_DTC_SEV_NO_SEVERITY, DemUdsDTC=6427136, DemDTCAttributesRef=DtcAttributes_41914fb7
      ECU_In_Plant_Mode_C221200 (DemEventParameter):
        DemEventKind = DEM_EVENT_KIND_SWC
        DemMaxNumberFreezeFrameRecords = 2
        DemDTCClassRef = DTCClass_DtcClass_ECU_In_Plant_Mode_C221200
        DemExtendedDataClassRef = ExtendedDataClass_240799f9
        DemFreezeFrameClassRef = FreezeFrame_a2168519
        DemEventClass:
          DemAgingAllowed = true
          DemAgingCycleCounterThreshold = 40
          DemEventPriority = 2
          DemEventSignificance = DEM_EVENT_SIGNIFICANCE_FAULT
          DemEventFailureCycleCounterThreshold = 0
          DemAgingCycleRef = IgnitionCycle
          DemEnableConditionGroupRef = EnableConditionGroup_EC2
          DemOperationCycleRef = IgnitionCycle
          DemDebounceAlgorithmClass
            DemDebounceCounterBased: DemDebounceCounterDecrementStepSize=128, DemDebounceCounterIncrementStepSize=127, DemDebounceCounterJumpDown=false, DemDebounceCounterJumpUp=false
      DTCClass_DtcClass_Park_Assist_PTS_Switch_Stuck_B12852A (DemDTCClass): DemDTCSeverity=DEM_DTC_SEV_NO_SEVERITY, DemUdsDTC=9602346, DemDTCAttributesRef=DtcAttributes_41914fb7
      Park_Assist_PTS_Switch_Stuck_B12852A (DemEventParameter):
        DemEventKind = DEM_EVENT_KIND_SWC
        DemMaxNumberFreezeFrameRecords = 2
        DemDTCClassRef = DTCClass_DtcClass_Park_Assist_PTS_Switch_Stuck_B12852A
        DemExtendedDataClassRef = ExtendedDataClass_240799f9
        DemFreezeFrameClassRef = FreezeFrame_a2168519
        DemEventClass:
          DemAgingAllowed = true
          DemAgingCycleCounterThreshold = 40
          DemEventPriority = 2
          DemEventSignificance = DEM_EVENT_SIGNIFICANCE_FAULT
          DemEventFailureCycleCounterThreshold = 0
          DemAgingCycleRef = IgnitionCycle
          DemEnableConditionGroupRef = EnableConditionGroup_d35ce624
          DemOperationCycleRef = IgnitionCycle
          DemDebounceAlgorithmClass
            DemDebounceCounterBased: DemDebounceCounterDecrementStepSize=128, DemDebounceCounterIncrementStepSize=127, DemDebounceCounterJumpDown=false, DemDebounceCounterJumpUp=false
      DTCClass_DtcClass_PTS_Sensor_1_Circuit_Open_B128E13 (DemDTCClass): DemDTCSeverity=DEM_DTC_SEV_NO_SEVERITY, DemUdsDTC=9604627, DemDTCAttributesRef=DtcAttributes_41914fb7
      PTS_Sensor_1_Circuit_Open_B128E13 (DemEventParameter):
        DemEventKind = DEM_EVENT_KIND_SWC
        DemMaxNumberFreezeFrameRecords = 2
        DemDTCClassRef = DTCClass_DtcClass_PTS_Sensor_1_Circuit_Open_B128E13
        DemExtendedDataClassRef = ExtendedDataClass_240799f9
        DemFreezeFrameClassRef = FreezeFrame_a2168519
        DemEventClass:
          DemAgingAllowed = true
          DemAgingCycleCounterThreshold = 40
          DemEventPriority = 2
          DemEventSignificance = DEM_EVENT_SIGNIFICANCE_FAULT
          DemEventFailureCycleCounterThreshold = 0
          DemAgingCycleRef = IgnitionCycle
          DemEnableConditionGroupRef = EnableConditionGroup_2b31122d
          DemOperationCycleRef = IgnitionCycle
          DemDebounceAlgorithmClass
            DemDebounceCounterBased: DemDebounceCounterDecrementStepSize=128, DemDebounceCounterIncrementStepSize=127, DemDebounceCounterJumpDown=false, DemDebounceCounterJumpUp=false
      DTCClass_DtcClass_PTS_Sensor_1_Performance_or_Incorrect_Operation_B128E92 (DemDTCClass): DemDTCSeverity=DEM_DTC_SEV_NO_SEVERITY, DemUdsDTC=9604754, DemDTCAttributesRef=DtcAttributes_41914fb7
      PTS_Sensor_1_Performance_or_Incorrect_Operation_B128E92 (DemEventParameter):
        DemEventKind = DEM_EVENT_KIND_SWC
        DemMaxNumberFreezeFrameRecords = 2
        DemDTCClassRef = DTCClass_DtcClass_PTS_Sensor_1_Performance_or_Incorrect_Operation_B128E92
        DemExtendedDataClassRef = ExtendedDataClass_240799f9
        DemFreezeFrameClassRef = FreezeFrame_a2168519
        DemEventClass:
          DemAgingAllowed = true
          DemAgingCycleCounterThreshold = 40
          DemEventPriority = 2
          DemEventSignificance = DEM_EVENT_SIGNIFICANCE_FAULT
          DemEventFailureCycleCounterThreshold = 0
          DemAgingCycleRef = IgnitionCycle
          DemEnableConditionGroupRef = EnableConditionGroup_2b31122d
          DemOperationCycleRef = IgnitionCycle
          DemDebounceAlgorithmClass
            DemDebounceCounterBased: DemDebounceCounterDecrementStepSize=128, DemDebounceCounterIncrementStepSize=127, DemDebounceCounterJumpDown=false, DemDebounceCounterJumpUp=false
      DTCClass_DtcClass_PTS_Sensor_2_Circuit_Open_B128F13 (DemDTCClass): DemDTCSeverity=DEM_DTC_SEV_NO_SEVERITY, DemUdsDTC=9604883, DemDTCAttributesRef=DtcAttributes_41914fb7
      PTS_Sensor_2_Circuit_Open_B128F13 (DemEventParameter):
        DemEventKind = DEM_EVENT_KIND_SWC
        DemMaxNumberFreezeFrameRecords = 2
        DemDTCClassRef = DTCClass_DtcClass_PTS_Sensor_2_Circuit_Open_B128F13
        DemExtendedDataClassRef = ExtendedDataClass_240799f9
        DemFreezeFrameClassRef = FreezeFrame_a2168519
        DemEventClass:
          DemAgingAllowed = true
          DemAgingCycleCounterThreshold = 40
          DemEventPriority = 2
          DemEventSignificance = DEM_EVENT_SIGNIFICANCE_FAULT
          DemEventFailureCycleCounterThreshold = 0
          DemAgingCycleRef = IgnitionCycle
          DemEnableConditionGroupRef = EnableConditionGroup_2b31122d
          DemOperationCycleRef = IgnitionCycle
          DemDebounceAlgorithmClass
            DemDebounceCounterBased: DemDebounceCounterDecrementStepSize=128, DemDebounceCounterIncrementStepSize=127, DemDebounceCounterJumpDown=false, DemDebounceCounterJumpUp=false
      DTCClass_DtcClass_PTS_Sensor_2_Performance_or_Incorrect_Operation_B128F92 (DemDTCClass): DemDTCSeverity=DEM_DTC_SEV_NO_SEVERITY, DemUdsDTC=9605010, DemDTCAttributesRef=DtcAttributes_41914fb7
      PTS_Sensor_2_Performance_or_Incorrect_Operation_B128F92 (DemEventParameter):
        DemEventKind = DEM_EVENT_KIND_SWC
        DemMaxNumberFreezeFrameRecords = 2
        DemDTCClassRef = DTCClass_DtcClass_PTS_Sensor_2_Performance_or_Incorrect_Operation_B128F92
        DemExtendedDataClassRef = ExtendedDataClass_240799f9
        DemFreezeFrameClassRef = FreezeFrame_a2168519
        DemEventClass:
          DemAgingAllowed = true
          DemAgingCycleCounterThreshold = 40
          DemEventPriority = 2
          DemEventSignificance = DEM_EVENT_SIGNIFICANCE_FAULT
          DemEventFailureCycleCounterThreshold = 0
          DemAgingCycleRef = IgnitionCycle
          DemEnableConditionGroupRef = EnableConditionGroup_2b31122d
          DemOperationCycleRef = IgnitionCycle
          DemDebounceAlgorithmClass
            DemDebounceCounterBased: DemDebounceCounterDecrementStepSize=128, DemDebounceCounterIncrementStepSize=127, DemDebounceCounterJumpDown=false, DemDebounceCounterJumpUp=false
      DTCClass_DtcClass_PTS_Sensor_3_Circuit_Open_B129013 (DemDTCClass): DemDTCSeverity=DEM_DTC_SEV_NO_SEVERITY, DemUdsDTC=9605139, DemDTCAttributesRef=DtcAttributes_41914fb7
      PTS_Sensor_3_Circuit_Open_B129013 (DemEventParameter):
        DemEventKind = DEM_EVENT_KIND_SWC
        DemMaxNumberFreezeFrameRecords = 2
        DemDTCClassRef = DTCClass_DtcClass_PTS_Sensor_3_Circuit_Open_B129013
        DemExtendedDataClassRef = ExtendedDataClass_240799f9
        DemFreezeFrameClassRef = FreezeFrame_a2168519
        DemEventClass:
          DemAgingAllowed = true
          DemAgingCycleCounterThreshold = 40
          DemEventPriority = 2
          DemEventSignificance = DEM_EVENT_SIGNIFICANCE_FAULT
          DemEventFailureCycleCounterThreshold = 0
          DemAgingCycleRef = IgnitionCycle
          DemEnableConditionGroupRef = EnableConditionGroup_2b31122d
          DemOperationCycleRef = IgnitionCycle
          DemDebounceAlgorithmClass
            DemDebounceCounterBased: DemDebounceCounterDecrementStepSize=128, DemDebounceCounterIncrementStepSize=127, DemDebounceCounterJumpDown=false, DemDebounceCounterJumpUp=false
      DTCClass_DtcClass_PTS_Sensor_3_Performance_or_Incorrect_Operation_B129092 (DemDTCClass): DemDTCSeverity=DEM_DTC_SEV_NO_SEVERITY, DemUdsDTC=9605266, DemDTCAttributesRef=DtcAttributes_41914fb7
      PTS_Sensor_3_Performance_or_Incorrect_Operation_B129092 (DemEventParameter):
        DemEventKind = DEM_EVENT_KIND_SWC
        DemMaxNumberFreezeFrameRecords = 2
        DemDTCClassRef = DTCClass_DtcClass_PTS_Sensor_3_Performance_or_Incorrect_Operation_B129092
        DemExtendedDataClassRef = ExtendedDataClass_240799f9
        DemFreezeFrameClassRef = FreezeFrame_a2168519
        DemEventClass:
          DemAgingAllowed = true
          DemAgingCycleCounterThreshold = 40
          DemEventPriority = 2
          DemEventSignificance = DEM_EVENT_SIGNIFICANCE_FAULT
          DemEventFailureCycleCounterThreshold = 0
          DemAgingCycleRef = IgnitionCycle
          DemEnableConditionGroupRef = EnableConditionGroup_2b31122d
          DemOperationCycleRef = IgnitionCycle
          DemDebounceAlgorithmClass
            DemDebounceCounterBased: DemDebounceCounterDecrementStepSize=128, DemDebounceCounterIncrementStepSize=127, DemDebounceCounterJumpDown=false, DemDebounceCounterJumpUp=false
      DTCClass_DtcClass_PTS_Sensor_4_Circuit_Open_B129113 (DemDTCClass): DemDTCSeverity=DEM_DTC_SEV_NO_SEVERITY, DemUdsDTC=9605395, DemDTCAttributesRef=DtcAttributes_41914fb7
      PTS_Sensor_4_Circuit_Open_B129113 (DemEventParameter):
        DemEventKind = DEM_EVENT_KIND_SWC
        DemMaxNumberFreezeFrameRecords = 2
        DemDTCClassRef = DTCClass_DtcClass_PTS_Sensor_4_Circuit_Open_B129113
        DemExtendedDataClassRef = ExtendedDataClass_240799f9
        DemFreezeFrameClassRef = FreezeFrame_a2168519
        DemEventClass:
          DemAgingAllowed = true
          DemAgingCycleCounterThreshold = 40
          DemEventPriority = 2
          DemEventSignificance = DEM_EVENT_SIGNIFICANCE_FAULT
          DemEventFailureCycleCounterThreshold = 0
          DemAgingCycleRef = IgnitionCycle
          DemEnableConditionGroupRef = EnableConditionGroup_2b31122d
          DemOperationCycleRef = IgnitionCycle
          DemDebounceAlgorithmClass
            DemDebounceCounterBased: DemDebounceCounterDecrementStepSize=128, DemDebounceCounterIncrementStepSize=127, DemDebounceCounterJumpDown=false, DemDebounceCounterJumpUp=false
      DTCClass_DtcClass_PTS_Sensor_4_Performance_or_Incorrect_Operation_B129192 (DemDTCClass): DemDTCSeverity=DEM_DTC_SEV_NO_SEVERITY, DemUdsDTC=9605522, DemDTCAttributesRef=DtcAttributes_41914fb7
      PTS_Sensor_4_Performance_or_Incorrect_Operation_B129192 (DemEventParameter):
        DemEventKind = DEM_EVENT_KIND_SWC
        DemMaxNumberFreezeFrameRecords = 2
        DemDTCClassRef = DTCClass_DtcClass_PTS_Sensor_4_Performance_or_Incorrect_Operation_B129192
        DemExtendedDataClassRef = ExtendedDataClass_240799f9
        DemFreezeFrameClassRef = FreezeFrame_a2168519
        DemEventClass:
          DemAgingAllowed = true
          DemAgingCycleCounterThreshold = 40
          DemEventPriority = 2
          DemEventSignificance = DEM_EVENT_SIGNIFICANCE_FAULT
          DemEventFailureCycleCounterThreshold = 0
          DemAgingCycleRef = IgnitionCycle
          DemEnableConditionGroupRef = EnableConditionGroup_2b31122d
          DemOperationCycleRef = IgnitionCycle
          DemDebounceAlgorithmClass
            DemDebounceCounterBased: DemDebounceCounterDecrementStepSize=128, DemDebounceCounterIncrementStepSize=127, DemDebounceCounterJumpDown=false, DemDebounceCounterJumpUp=false
      DTCClass_DtcClass_PTS_Sensor_5_Circuit_Open_B129213 (DemDTCClass): DemDTCSeverity=DEM_DTC_SEV_NO_SEVERITY, DemUdsDTC=9605651, DemDTCAttributesRef=DtcAttributes_41914fb7
      PTS_Sensor_5_Circuit_Open_B129213 (DemEventParameter):
        DemEventKind = DEM_EVENT_KIND_SWC
        DemMaxNumberFreezeFrameRecords = 2
        DemDTCClassRef = DTCClass_DtcClass_PTS_Sensor_5_Circuit_Open_B129213
        DemExtendedDataClassRef = ExtendedDataClass_240799f9
        DemFreezeFrameClassRef = FreezeFrame_a2168519
        DemEventClass:
          DemAgingAllowed = true
          DemAgingCycleCounterThreshold = 40
          DemEventPriority = 2
          DemEventSignificance = DEM_EVENT_SIGNIFICANCE_FAULT
          DemEventFailureCycleCounterThreshold = 0
          DemAgingCycleRef = IgnitionCycle
          DemEnableConditionGroupRef = EnableConditionGroup_2b31122d
          DemOperationCycleRef = IgnitionCycle
          DemDebounceAlgorithmClass
            DemDebounceCounterBased: DemDebounceCounterDecrementStepSize=128, DemDebounceCounterIncrementStepSize=127, DemDebounceCounterJumpDown=false, DemDebounceCounterJumpUp=false
      DTCClass_DtcClass_PTS_Sensor_5_Performance_or_Incorrect_Operation_B129292 (DemDTCClass): DemDTCSeverity=DEM_DTC_SEV_NO_SEVERITY, DemUdsDTC=9605778, DemDTCAttributesRef=DtcAttributes_41914fb7
      PTS_Sensor_5_Performance_or_Incorrect_Operation_B129292 (DemEventParameter):
        DemEventKind = DEM_EVENT_KIND_SWC
        DemMaxNumberFreezeFrameRecords = 2
        DemDTCClassRef = DTCClass_DtcClass_PTS_Sensor_5_Performance_or_Incorrect_Operation_B129292
        DemExtendedDataClassRef = ExtendedDataClass_240799f9
        DemFreezeFrameClassRef = FreezeFrame_a2168519
        DemEventClass:
          DemAgingAllowed = true
          DemAgingCycleCounterThreshold = 40
          DemEventPriority = 2
          DemEventSignificance = DEM_EVENT_SIGNIFICANCE_FAULT
          DemEventFailureCycleCounterThreshold = 0
          DemAgingCycleRef = IgnitionCycle
          DemEnableConditionGroupRef = EnableConditionGroup_2b31122d
          DemOperationCycleRef = IgnitionCycle
          DemDebounceAlgorithmClass
            DemDebounceCounterBased: DemDebounceCounterDecrementStepSize=128, DemDebounceCounterIncrementStepSize=127, DemDebounceCounterJumpDown=false, DemDebounceCounterJumpUp=false
      DTCClass_DtcClass_PTS_Sensor_6_Circuit_Open_B129313 (DemDTCClass): DemDTCSeverity=DEM_DTC_SEV_NO_SEVERITY, DemUdsDTC=9605907, DemDTCAttributesRef=DtcAttributes_41914fb7
      PTS_Sensor_6_Circuit_Open_B129313 (DemEventParameter):
        DemEventKind = DEM_EVENT_KIND_SWC
        DemMaxNumberFreezeFrameRecords = 2
        DemDTCClassRef = DTCClass_DtcClass_PTS_Sensor_6_Circuit_Open_B129313
        DemExtendedDataClassRef = ExtendedDataClass_240799f9
        DemFreezeFrameClassRef = FreezeFrame_a2168519
        DemEventClass:
          DemAgingAllowed = true
          DemAgingCycleCounterThreshold = 40
          DemEventPriority = 2
          DemEventSignificance = DEM_EVENT_SIGNIFICANCE_FAULT
          DemEventFailureCycleCounterThreshold = 0
          DemAgingCycleRef = IgnitionCycle
          DemEnableConditionGroupRef = EnableConditionGroup_2b31122d
          DemOperationCycleRef = IgnitionCycle
          DemDebounceAlgorithmClass
            DemDebounceCounterBased: DemDebounceCounterDecrementStepSize=128, DemDebounceCounterIncrementStepSize=127, DemDebounceCounterJumpDown=false, DemDebounceCounterJumpUp=false
      DTCClass_DtcClass_PTS_Sensor_6_Performance_or_Incorrect_Operation_B129392 (DemDTCClass): DemDTCSeverity=DEM_DTC_SEV_NO_SEVERITY, DemUdsDTC=9606034, DemDTCAttributesRef=DtcAttributes_41914fb7
      PTS_Sensor_6_Performance_or_Incorrect_Operation_B129392 (DemEventParameter):
        DemEventKind = DEM_EVENT_KIND_SWC
        DemMaxNumberFreezeFrameRecords = 2
        DemDTCClassRef = DTCClass_DtcClass_PTS_Sensor_6_Performance_or_Incorrect_Operation_B129392
        DemExtendedDataClassRef = ExtendedDataClass_240799f9
        DemFreezeFrameClassRef = FreezeFrame_a2168519
        DemEventClass:
          DemAgingAllowed = true
          DemAgingCycleCounterThreshold = 40
          DemEventPriority = 2
          DemEventSignificance = DEM_EVENT_SIGNIFICANCE_FAULT
          DemEventFailureCycleCounterThreshold = 0
          DemAgingCycleRef = IgnitionCycle
          DemEnableConditionGroupRef = EnableConditionGroup_2b31122d
          DemOperationCycleRef = IgnitionCycle
          DemDebounceAlgorithmClass
            DemDebounceCounterBased: DemDebounceCounterDecrementStepSize=128, DemDebounceCounterIncrementStepSize=127, DemDebounceCounterJumpDown=false, DemDebounceCounterJumpUp=false
      DTCClass_DtcClass_PTS_Sensor_7_Circuit_Open_B129413 (DemDTCClass): DemDTCSeverity=DEM_DTC_SEV_NO_SEVERITY, DemUdsDTC=9606163, DemDTCAttributesRef=DtcAttributes_41914fb7
      PTS_Sensor_7_Circuit_Open_B129413 (DemEventParameter):
        DemEventKind = DEM_EVENT_KIND_SWC
        DemMaxNumberFreezeFrameRecords = 2
        DemDTCClassRef = DTCClass_DtcClass_PTS_Sensor_7_Circuit_Open_B129413
        DemExtendedDataClassRef = ExtendedDataClass_240799f9
        DemFreezeFrameClassRef = FreezeFrame_a2168519
        DemEventClass:
          DemAgingAllowed = true
          DemAgingCycleCounterThreshold = 40
          DemEventPriority = 2
          DemEventSignificance = DEM_EVENT_SIGNIFICANCE_FAULT
          DemEventFailureCycleCounterThreshold = 0
          DemAgingCycleRef = IgnitionCycle
          DemEnableConditionGroupRef = EnableConditionGroup_2b31122d
          DemOperationCycleRef = IgnitionCycle
          DemDebounceAlgorithmClass
            DemDebounceCounterBased: DemDebounceCounterDecrementStepSize=128, DemDebounceCounterIncrementStepSize=127, DemDebounceCounterJumpDown=false, DemDebounceCounterJumpUp=false
      DTCClass_DtcClass_PTS_Sensor_7_Performance_or_Incorrect_Operation_B129492 (DemDTCClass): DemDTCSeverity=DEM_DTC_SEV_NO_SEVERITY, DemUdsDTC=9606290, DemDTCAttributesRef=DtcAttributes_41914fb7
      PTS_Sensor_7_Performance_or_Incorrect_Operation_B129492 (DemEventParameter):
        DemEventKind = DEM_EVENT_KIND_SWC
        DemMaxNumberFreezeFrameRecords = 2
        DemDTCClassRef = DTCClass_DtcClass_PTS_Sensor_7_Performance_or_Incorrect_Operation_B129492
        DemExtendedDataClassRef = ExtendedDataClass_240799f9
        DemFreezeFrameClassRef = FreezeFrame_a2168519
        DemEventClass:
          DemAgingAllowed = true
          DemAgingCycleCounterThreshold = 40
          DemEventPriority = 2
          DemEventSignificance = DEM_EVENT_SIGNIFICANCE_FAULT
          DemEventFailureCycleCounterThreshold = 0
          DemAgingCycleRef = IgnitionCycle
          DemEnableConditionGroupRef = EnableConditionGroup_2b31122d
          DemOperationCycleRef = IgnitionCycle
          DemDebounceAlgorithmClass
            DemDebounceCounterBased: DemDebounceCounterDecrementStepSize=128, DemDebounceCounterIncrementStepSize=127, DemDebounceCounterJumpDown=false, DemDebounceCounterJumpUp=false
      DTCClass_DtcClass_PTS_Sensor_8_Circuit_Open_B129513 (DemDTCClass): DemDTCSeverity=DEM_DTC_SEV_NO_SEVERITY, DemUdsDTC=9606419, DemDTCAttributesRef=DtcAttributes_41914fb7
      PTS_Sensor_8_Circuit_Open_B129513 (DemEventParameter):
        DemEventKind = DEM_EVENT_KIND_SWC
        DemMaxNumberFreezeFrameRecords = 2
        DemDTCClassRef = DTCClass_DtcClass_PTS_Sensor_8_Circuit_Open_B129513
        DemExtendedDataClassRef = ExtendedDataClass_240799f9
        DemFreezeFrameClassRef = FreezeFrame_a2168519
        DemEventClass:
          DemAgingAllowed = true
          DemAgingCycleCounterThreshold = 40
          DemEventPriority = 2
          DemEventSignificance = DEM_EVENT_SIGNIFICANCE_FAULT
          DemEventFailureCycleCounterThreshold = 0
          DemAgingCycleRef = IgnitionCycle
          DemEnableConditionGroupRef = EnableConditionGroup_2b31122d
          DemOperationCycleRef = IgnitionCycle
          DemDebounceAlgorithmClass
            DemDebounceCounterBased: DemDebounceCounterDecrementStepSize=128, DemDebounceCounterIncrementStepSize=127, DemDebounceCounterJumpDown=false, DemDebounceCounterJumpUp=false
      DTCClass_DtcClass_PTS_Sensor_8_Performance_or_Incorrect_Operation_B129592 (DemDTCClass): DemDTCSeverity=DEM_DTC_SEV_NO_SEVERITY, DemUdsDTC=9606546, DemDTCAttributesRef=DtcAttributes_41914fb7
      PTS_Sensor_8_Performance_or_Incorrect_Operation_B129592 (DemEventParameter):
        DemEventKind = DEM_EVENT_KIND_SWC
        DemMaxNumberFreezeFrameRecords = 2
        DemDTCClassRef = DTCClass_DtcClass_PTS_Sensor_8_Performance_or_Incorrect_Operation_B129592
        DemExtendedDataClassRef = ExtendedDataClass_240799f9
        DemFreezeFrameClassRef = FreezeFrame_a2168519
        DemEventClass:
          DemAgingAllowed = true
          DemAgingCycleCounterThreshold = 40
          DemEventPriority = 2
          DemEventSignificance = DEM_EVENT_SIGNIFICANCE_FAULT
          DemEventFailureCycleCounterThreshold = 0
          DemAgingCycleRef = IgnitionCycle
          DemEnableConditionGroupRef = EnableConditionGroup_2b31122d
          DemOperationCycleRef = IgnitionCycle
          DemDebounceAlgorithmClass
            DemDebounceCounterBased: DemDebounceCounterDecrementStepSize=128, DemDebounceCounterIncrementStepSize=127, DemDebounceCounterJumpDown=false, DemDebounceCounterJumpUp=false
      DTCClass_DtcClass_PTS_Sensor_9_Circuit_Open_B129613 (DemDTCClass): DemDTCSeverity=DEM_DTC_SEV_NO_SEVERITY, DemUdsDTC=9606675, DemDTCAttributesRef=DtcAttributes_41914fb7
      PTS_Sensor_9_Circuit_Open_B129613 (DemEventParameter):
        DemEventKind = DEM_EVENT_KIND_SWC
        DemMaxNumberFreezeFrameRecords = 2
        DemDTCClassRef = DTCClass_DtcClass_PTS_Sensor_9_Circuit_Open_B129613
        DemExtendedDataClassRef = ExtendedDataClass_240799f9
        DemFreezeFrameClassRef = FreezeFrame_a2168519
        DemEventClass:
          DemAgingAllowed = true
          DemAgingCycleCounterThreshold = 40
          DemEventPriority = 2
          DemEventSignificance = DEM_EVENT_SIGNIFICANCE_FAULT
          DemEventFailureCycleCounterThreshold = 0
          DemAgingCycleRef = IgnitionCycle
          DemEnableConditionGroupRef = EnableConditionGroup_2b31122d
          DemOperationCycleRef = IgnitionCycle
          DemDebounceAlgorithmClass
            DemDebounceCounterBased: DemDebounceCounterDecrementStepSize=128, DemDebounceCounterIncrementStepSize=127, DemDebounceCounterJumpDown=false, DemDebounceCounterJumpUp=false
      DTCClass_DtcClass_PTS_Sensor_9_Performance_or_Incorrect_Operation_B129692 (DemDTCClass): DemDTCSeverity=DEM_DTC_SEV_NO_SEVERITY, DemUdsDTC=9606802, DemDTCAttributesRef=DtcAttributes_41914fb7
      PTS_Sensor_9_Performance_or_Incorrect_Operation_B129692 (DemEventParameter):
        DemEventKind = DEM_EVENT_KIND_SWC
        DemMaxNumberFreezeFrameRecords = 2
        DemDTCClassRef = DTCClass_DtcClass_PTS_Sensor_9_Performance_or_Incorrect_Operation_B129692
        DemExtendedDataClassRef = ExtendedDataClass_240799f9
        DemFreezeFrameClassRef = FreezeFrame_a2168519
        DemEventClass:
          DemAgingAllowed = true
          DemAgingCycleCounterThreshold = 40
          DemEventPriority = 2
          DemEventSignificance = DEM_EVENT_SIGNIFICANCE_FAULT
          DemEventFailureCycleCounterThreshold = 0
          DemAgingCycleRef = IgnitionCycle
          DemEnableConditionGroupRef = EnableConditionGroup_2b31122d
          DemOperationCycleRef = IgnitionCycle
          DemDebounceAlgorithmClass
            DemDebounceCounterBased: DemDebounceCounterDecrementStepSize=128, DemDebounceCounterIncrementStepSize=127, DemDebounceCounterJumpDown=false, DemDebounceCounterJumpUp=false
      DTCClass_DtcClass_PTS_Sensor_10_Circuit_Open_B129713 (DemDTCClass): DemDTCSeverity=DEM_DTC_SEV_NO_SEVERITY, DemUdsDTC=9606931, DemDTCAttributesRef=DtcAttributes_41914fb7
      PTS_Sensor_10_Circuit_Open_B129713 (DemEventParameter):
        DemEventKind = DEM_EVENT_KIND_SWC
        DemMaxNumberFreezeFrameRecords = 2
        DemDTCClassRef = DTCClass_DtcClass_PTS_Sensor_10_Circuit_Open_B129713
        DemExtendedDataClassRef = ExtendedDataClass_240799f9
        DemFreezeFrameClassRef = FreezeFrame_a2168519
        DemEventClass:
          DemAgingAllowed = true
          DemAgingCycleCounterThreshold = 40
          DemEventPriority = 2
          DemEventSignificance = DEM_EVENT_SIGNIFICANCE_FAULT
          DemEventFailureCycleCounterThreshold = 0
          DemAgingCycleRef = IgnitionCycle
          DemEnableConditionGroupRef = EnableConditionGroup_2b31122d
          DemOperationCycleRef = IgnitionCycle
          DemDebounceAlgorithmClass
            DemDebounceCounterBased: DemDebounceCounterDecrementStepSize=128, DemDebounceCounterIncrementStepSize=127, DemDebounceCounterJumpDown=false, DemDebounceCounterJumpUp=false
      DTCClass_DtcClass_PTS_Sensor_10_Performance_or_Incorrect_Operation_B129792 (DemDTCClass): DemDTCSeverity=DEM_DTC_SEV_NO_SEVERITY, DemUdsDTC=9607058, DemDTCAttributesRef=DtcAttributes_41914fb7
      PTS_Sensor_10_Performance_or_Incorrect_Operation_B129792 (DemEventParameter):
        DemEventKind = DEM_EVENT_KIND_SWC
        DemMaxNumberFreezeFrameRecords = 2
        DemDTCClassRef = DTCClass_DtcClass_PTS_Sensor_10_Performance_or_Incorrect_Operation_B129792
        DemExtendedDataClassRef = ExtendedDataClass_240799f9
        DemFreezeFrameClassRef = FreezeFrame_a2168519
        DemEventClass:
          DemAgingAllowed = true
          DemAgingCycleCounterThreshold = 40
          DemEventPriority = 2
          DemEventSignificance = DEM_EVENT_SIGNIFICANCE_FAULT
          DemEventFailureCycleCounterThreshold = 0
          DemAgingCycleRef = IgnitionCycle
          DemEnableConditionGroupRef = EnableConditionGroup_2b31122d
          DemOperationCycleRef = IgnitionCycle
          DemDebounceAlgorithmClass
            DemDebounceCounterBased: DemDebounceCounterDecrementStepSize=128, DemDebounceCounterIncrementStepSize=127, DemDebounceCounterJumpDown=false, DemDebounceCounterJumpUp=false
      DTCClass_DtcClass_PTS_Sensor_11_Circuit_Open_B129813 (DemDTCClass): DemDTCSeverity=DEM_DTC_SEV_NO_SEVERITY, DemUdsDTC=9607187, DemDTCAttributesRef=DtcAttributes_41914fb7
      PTS_Sensor_11_Circuit_Open_B129813 (DemEventParameter):
        DemEventKind = DEM_EVENT_KIND_SWC
        DemMaxNumberFreezeFrameRecords = 2
        DemDTCClassRef = DTCClass_DtcClass_PTS_Sensor_11_Circuit_Open_B129813
        DemExtendedDataClassRef = ExtendedDataClass_240799f9
        DemFreezeFrameClassRef = FreezeFrame_a2168519
        DemEventClass:
          DemAgingAllowed = true
          DemAgingCycleCounterThreshold = 40
          DemEventPriority = 2
          DemEventSignificance = DEM_EVENT_SIGNIFICANCE_FAULT
          DemEventFailureCycleCounterThreshold = 0
          DemAgingCycleRef = IgnitionCycle
          DemEnableConditionGroupRef = EnableConditionGroup_2b31122d
          DemOperationCycleRef = IgnitionCycle
          DemDebounceAlgorithmClass
            DemDebounceCounterBased: DemDebounceCounterDecrementStepSize=128, DemDebounceCounterIncrementStepSize=127, DemDebounceCounterJumpDown=false, DemDebounceCounterJumpUp=false
      DTCClass_DtcClass_PTS_Sensor_11_Performance_or_Incorrect_Operation_B129892 (DemDTCClass): DemDTCSeverity=DEM_DTC_SEV_NO_SEVERITY, DemUdsDTC=9607314, DemDTCAttributesRef=DtcAttributes_41914fb7
      PTS_Sensor_11_Performance_or_Incorrect_Operation_B129892 (DemEventParameter):
        DemEventKind = DEM_EVENT_KIND_SWC
        DemMaxNumberFreezeFrameRecords = 2
        DemDTCClassRef = DTCClass_DtcClass_PTS_Sensor_11_Performance_or_Incorrect_Operation_B129892
        DemExtendedDataClassRef = ExtendedDataClass_240799f9
        DemFreezeFrameClassRef = FreezeFrame_a2168519
        DemEventClass:
          DemAgingAllowed = true
          DemAgingCycleCounterThreshold = 40
          DemEventPriority = 2
          DemEventSignificance = DEM_EVENT_SIGNIFICANCE_FAULT
          DemEventFailureCycleCounterThreshold = 0
          DemAgingCycleRef = IgnitionCycle
          DemEnableConditionGroupRef = EnableConditionGroup_2b31122d
          DemOperationCycleRef = IgnitionCycle
          DemDebounceAlgorithmClass
            DemDebounceCounterBased: DemDebounceCounterDecrementStepSize=128, DemDebounceCounterIncrementStepSize=127, DemDebounceCounterJumpDown=false, DemDebounceCounterJumpUp=false
      DTCClass_DtcClass_PTS_Sensor_12_Circuit_Open_B129913 (DemDTCClass): DemDTCSeverity=DEM_DTC_SEV_NO_SEVERITY, DemUdsDTC=9607443, DemDTCAttributesRef=DtcAttributes_41914fb7
      PTS_Sensor_12_Circuit_Open_B129913 (DemEventParameter):
        DemEventKind = DEM_EVENT_KIND_SWC
        DemMaxNumberFreezeFrameRecords = 2
        DemDTCClassRef = DTCClass_DtcClass_PTS_Sensor_12_Circuit_Open_B129913
        DemExtendedDataClassRef = ExtendedDataClass_240799f9
        DemFreezeFrameClassRef = FreezeFrame_a2168519
        DemEventClass:
          DemAgingAllowed = true
          DemAgingCycleCounterThreshold = 40
          DemEventPriority = 2
          DemEventSignificance = DEM_EVENT_SIGNIFICANCE_FAULT
          DemEventFailureCycleCounterThreshold = 0
          DemAgingCycleRef = IgnitionCycle
          DemEnableConditionGroupRef = EnableConditionGroup_2b31122d
          DemOperationCycleRef = IgnitionCycle
          DemDebounceAlgorithmClass
            DemDebounceCounterBased: DemDebounceCounterDecrementStepSize=128, DemDebounceCounterIncrementStepSize=127, DemDebounceCounterJumpDown=false, DemDebounceCounterJumpUp=false
      DTCClass_DtcClass_PTS_Sensor_12_Performance_or_Incorrect_Operation_B129992 (DemDTCClass): DemDTCSeverity=DEM_DTC_SEV_NO_SEVERITY, DemUdsDTC=9607570, DemDTCAttributesRef=DtcAttributes_41914fb7
      PTS_Sensor_12_Performance_or_Incorrect_Operation_B129992 (DemEventParameter):
        DemEventKind = DEM_EVENT_KIND_SWC
        DemMaxNumberFreezeFrameRecords = 2
        DemDTCClassRef = DTCClass_DtcClass_PTS_Sensor_12_Performance_or_Incorrect_Operation_B129992
        DemExtendedDataClassRef = ExtendedDataClass_240799f9
        DemFreezeFrameClassRef = FreezeFrame_a2168519
        DemEventClass:
          DemAgingAllowed = true
          DemAgingCycleCounterThreshold = 40
          DemEventPriority = 2
          DemEventSignificance = DEM_EVENT_SIGNIFICANCE_FAULT
          DemEventFailureCycleCounterThreshold = 0
          DemAgingCycleRef = IgnitionCycle
          DemEnableConditionGroupRef = EnableConditionGroup_2b31122d
          DemOperationCycleRef = IgnitionCycle
          DemDebounceAlgorithmClass
            DemDebounceCounterBased: DemDebounceCounterDecrementStepSize=128, DemDebounceCounterIncrementStepSize=127, DemDebounceCounterJumpDown=false, DemDebounceCounterJumpUp=false
      DTCClass_DtcClass_PPP_Assist_Switch_Stuck_B12B22A (DemDTCClass): DemDTCSeverity=DEM_DTC_SEV_NO_SEVERITY, DemUdsDTC=9613866, DemDTCAttributesRef=DtcAttributes_41914fb7
      PPP_Assist_Switch_Stuck_B12B22A (DemEventParameter):
        DemEventKind = DEM_EVENT_KIND_SWC
        DemMaxNumberFreezeFrameRecords = 2
        DemDTCClassRef = DTCClass_DtcClass_PPP_Assist_Switch_Stuck_B12B22A
        DemExtendedDataClassRef = ExtendedDataClass_240799f9
        DemFreezeFrameClassRef = FreezeFrame_a2168519
        DemEventClass:
          DemAgingAllowed = true
          DemAgingCycleCounterThreshold = 40
          DemEventPriority = 2
          DemEventSignificance = DEM_EVENT_SIGNIFICANCE_FAULT
          DemEventFailureCycleCounterThreshold = 0
          DemAgingCycleRef = IgnitionCycle
          DemEnableConditionGroupRef = EnableConditionGroup_bf4488aa
          DemOperationCycleRef = IgnitionCycle
          DemDebounceAlgorithmClass
            DemDebounceCounterBased: DemDebounceCounterDecrementStepSize=128, DemDebounceCounterIncrementStepSize=127, DemDebounceCounterJumpDown=false, DemDebounceCounterJumpUp=false
      DTCClass_DtcClass_Battery_Voltage_Under_Voltage_B210C16 (DemDTCClass): DemDTCSeverity=DEM_DTC_SEV_NO_SEVERITY, DemUdsDTC=10554390, DemDTCAttributesRef=DtcAttributes_41914fb7
      Battery_Voltage_Under_Voltage_B210C16 (DemEventParameter):
        DemEventKind = DEM_EVENT_KIND_SWC
        DemMaxNumberFreezeFrameRecords = 2
        DemDTCClassRef = DTCClass_DtcClass_Battery_Voltage_Under_Voltage_B210C16
        DemExtendedDataClassRef = ExtendedDataClass_240799f9
        DemFreezeFrameClassRef = FreezeFrame_a2168519
        DemEventClass:
          DemAgingAllowed = true
          DemAgingCycleCounterThreshold = 40
          DemEventPriority = 2
          DemEventSignificance = DEM_EVENT_SIGNIFICANCE_FAULT
          DemEventFailureCycleCounterThreshold = 0
          DemAgingCycleRef = IgnitionCycle
          DemEnableConditionGroupRef = EnableConditionGroup_35222079
          DemOperationCycleRef = IgnitionCycle
          DemDebounceAlgorithmClass
            DemDebounceCounterBased: DemDebounceCounterDecrementStepSize=128, DemDebounceCounterIncrementStepSize=127, DemDebounceCounterJumpDown=false, DemDebounceCounterJumpUp=false
      DTCClass_DtcClass_Battery_Voltage_Over_Voltage_B210C17 (DemDTCClass): DemDTCSeverity=DEM_DTC_SEV_NO_SEVERITY, DemUdsDTC=10554391, DemDTCAttributesRef=DtcAttributes_41914fb7
      Battery_Voltage_Over_Voltage_B210C17 (DemEventParameter):
        DemEventKind = DEM_EVENT_KIND_SWC
        DemMaxNumberFreezeFrameRecords = 2
        DemDTCClassRef = DTCClass_DtcClass_Battery_Voltage_Over_Voltage_B210C17
        DemExtendedDataClassRef = ExtendedDataClass_240799f9
        DemFreezeFrameClassRef = FreezeFrame_a2168519
        DemEventClass:
          DemAgingAllowed = true
          DemAgingCycleCounterThreshold = 40
          DemEventPriority = 2
          DemEventSignificance = DEM_EVENT_SIGNIFICANCE_FAULT
          DemEventFailureCycleCounterThreshold = 0
          DemAgingCycleRef = IgnitionCycle
          DemEnableConditionGroupRef = EnableConditionGroup_EC1
          DemOperationCycleRef = IgnitionCycle
          DemDebounceAlgorithmClass
            DemDebounceCounterBased: DemDebounceCounterDecrementStepSize=128, DemDebounceCounterIncrementStepSize=127, DemDebounceCounterJumpDown=false, DemDebounceCounterJumpUp=false
      DTCClass_DtcClass_Front_Sensors_PS_Bus_Sig_Msg_Failures_B212A08 (DemDTCClass): DemDTCSeverity=DEM_DTC_SEV_NO_SEVERITY, DemUdsDTC=10562056, DemDTCAttributesRef=DtcAttributes_41914fb7
      Front_Sensors_PS_Bus_Sig_Msg_Failures_B212A08 (DemEventParameter):
        DemEventKind = DEM_EVENT_KIND_SWC
        DemMaxNumberFreezeFrameRecords = 2
        DemDTCClassRef = DTCClass_DtcClass_Front_Sensors_PS_Bus_Sig_Msg_Failures_B212A08
        DemExtendedDataClassRef = ExtendedDataClass_240799f9
        DemFreezeFrameClassRef = FreezeFrame_a2168519
        DemEventClass:
          DemAgingAllowed = true
          DemAgingCycleCounterThreshold = 40
          DemEventPriority = 2
          DemEventSignificance = DEM_EVENT_SIGNIFICANCE_FAULT
          DemEventFailureCycleCounterThreshold = 0
          DemAgingCycleRef = IgnitionCycle
          DemEnableConditionGroupRef = EnableConditionGroup_f0773a88
          DemOperationCycleRef = IgnitionCycle
          DemDebounceAlgorithmClass
            DemDebounceCounterBased: DemDebounceCounterDecrementStepSize=128, DemDebounceCounterIncrementStepSize=127, DemDebounceCounterJumpDown=false, DemDebounceCounterJumpUp=false
      DTCClass_DtcClass_Front_Sensors_PS_VltgeBelowThreshold_B212A16 (DemDTCClass): DemDTCSeverity=DEM_DTC_SEV_NO_SEVERITY, DemUdsDTC=10562070, DemDTCAttributesRef=DtcAttributes_41914fb7
      Front_Sensors_PS_VltgeBelowThreshold_B212A16 (DemEventParameter):
        DemEventKind = DEM_EVENT_KIND_SWC
        DemMaxNumberFreezeFrameRecords = 2
        DemDTCClassRef = DTCClass_DtcClass_Front_Sensors_PS_VltgeBelowThreshold_B212A16
        DemExtendedDataClassRef = ExtendedDataClass_240799f9
        DemFreezeFrameClassRef = FreezeFrame_a2168519
        DemEventClass:
          DemAgingAllowed = true
          DemAgingCycleCounterThreshold = 40
          DemEventPriority = 2
          DemEventSignificance = DEM_EVENT_SIGNIFICANCE_FAULT
          DemEventFailureCycleCounterThreshold = 0
          DemAgingCycleRef = IgnitionCycle
          DemEnableConditionGroupRef = EnableConditionGroup_f0773a88
          DemOperationCycleRef = IgnitionCycle
          DemDebounceAlgorithmClass
            DemDebounceCounterBased: DemDebounceCounterDecrementStepSize=128, DemDebounceCounterIncrementStepSize=127, DemDebounceCounterJumpDown=false, DemDebounceCounterJumpUp=false
      DTCClass_DtcClass_Front_Sensors_PS_VltgeAboveThreshold_B212A17 (DemDTCClass): DemDTCSeverity=DEM_DTC_SEV_NO_SEVERITY, DemUdsDTC=10562071, DemDTCAttributesRef=DtcAttributes_41914fb7
      Front_Sensors_PS_VltgeAboveThreshold_B212A17 (DemEventParameter):
        DemEventKind = DEM_EVENT_KIND_SWC
        DemMaxNumberFreezeFrameRecords = 2
        DemDTCClassRef = DTCClass_DtcClass_Front_Sensors_PS_VltgeAboveThreshold_B212A17
        DemExtendedDataClassRef = ExtendedDataClass_240799f9
        DemFreezeFrameClassRef = FreezeFrame_a2168519
        DemEventClass:
          DemAgingAllowed = true
          DemAgingCycleCounterThreshold = 40
          DemEventPriority = 2
          DemEventSignificance = DEM_EVENT_SIGNIFICANCE_FAULT
          DemEventFailureCycleCounterThreshold = 0
          DemAgingCycleRef = IgnitionCycle
          DemEnableConditionGroupRef = EnableConditionGroup_f0773a88
          DemOperationCycleRef = IgnitionCycle
          DemDebounceAlgorithmClass
            DemDebounceCounterBased: DemDebounceCounterDecrementStepSize=128, DemDebounceCounterIncrementStepSize=127, DemDebounceCounterJumpDown=false, DemDebounceCounterJumpUp=false
      DTCClass_DtcClass_Rear_Sensors_PS_Bus_Sig_Msg_Failures_B212B08 (DemDTCClass): DemDTCSeverity=DEM_DTC_SEV_NO_SEVERITY, DemUdsDTC=10562312, DemDTCAttributesRef=DtcAttributes_41914fb7
      Rear_Sensors_PS_Bus_Sig_Msg_Failures_B212B08 (DemEventParameter):
        DemEventKind = DEM_EVENT_KIND_SWC
        DemMaxNumberFreezeFrameRecords = 2
        DemDTCClassRef = DTCClass_DtcClass_Rear_Sensors_PS_Bus_Sig_Msg_Failures_B212B08
        DemExtendedDataClassRef = ExtendedDataClass_240799f9
        DemFreezeFrameClassRef = FreezeFrame_a2168519
        DemEventClass:
          DemAgingAllowed = true
          DemAgingCycleCounterThreshold = 40
          DemEventPriority = 2
          DemEventSignificance = DEM_EVENT_SIGNIFICANCE_FAULT
          DemEventFailureCycleCounterThreshold = 0
          DemAgingCycleRef = IgnitionCycle
          DemEnableConditionGroupRef = EnableConditionGroup_f0773a88
          DemOperationCycleRef = IgnitionCycle
          DemDebounceAlgorithmClass
            DemDebounceCounterBased: DemDebounceCounterDecrementStepSize=128, DemDebounceCounterIncrementStepSize=127, DemDebounceCounterJumpDown=false, DemDebounceCounterJumpUp=false
      DTCClass_DtcClass_Rear_Sensors_PS_VltgeBelowThreshold_B212B16 (DemDTCClass): DemDTCSeverity=DEM_DTC_SEV_NO_SEVERITY, DemUdsDTC=10562326, DemDTCAttributesRef=DtcAttributes_41914fb7
      Rear_Sensors_PS_VltgeBelowThreshold_B212B16 (DemEventParameter):
        DemEventKind = DEM_EVENT_KIND_SWC
        DemMaxNumberFreezeFrameRecords = 2
        DemDTCClassRef = DTCClass_DtcClass_Rear_Sensors_PS_VltgeBelowThreshold_B212B16
        DemExtendedDataClassRef = ExtendedDataClass_240799f9
        DemFreezeFrameClassRef = FreezeFrame_a2168519
        DemEventClass:
          DemAgingAllowed = true
          DemAgingCycleCounterThreshold = 40
          DemEventPriority = 2
          DemEventSignificance = DEM_EVENT_SIGNIFICANCE_FAULT
          DemEventFailureCycleCounterThreshold = 0
          DemAgingCycleRef = IgnitionCycle
          DemEnableConditionGroupRef = EnableConditionGroup_f0773a88
          DemOperationCycleRef = IgnitionCycle
          DemDebounceAlgorithmClass
            DemDebounceCounterBased: DemDebounceCounterDecrementStepSize=128, DemDebounceCounterIncrementStepSize=127, DemDebounceCounterJumpDown=false, DemDebounceCounterJumpUp=false
      DTCClass_DtcClass_Rear_Sensors_PS_VltgeAboveThreshold_B212B17 (DemDTCClass): DemDTCSeverity=DEM_DTC_SEV_NO_SEVERITY, DemUdsDTC=10562327, DemDTCAttributesRef=DtcAttributes_41914fb7
      Rear_Sensors_PS_VltgeAboveThreshold_B212B17 (DemEventParameter):
        DemEventKind = DEM_EVENT_KIND_SWC
        DemMaxNumberFreezeFrameRecords = 2
        DemDTCClassRef = DTCClass_DtcClass_Rear_Sensors_PS_VltgeAboveThreshold_B212B17
        DemExtendedDataClassRef = ExtendedDataClass_240799f9
        DemFreezeFrameClassRef = FreezeFrame_a2168519
        DemEventClass:
          DemAgingAllowed = true
          DemAgingCycleCounterThreshold = 40
          DemEventPriority = 2
          DemEventSignificance = DEM_EVENT_SIGNIFICANCE_FAULT
          DemEventFailureCycleCounterThreshold = 0
          DemAgingCycleRef = IgnitionCycle
          DemEnableConditionGroupRef = EnableConditionGroup_f0773a88
          DemOperationCycleRef = IgnitionCycle
          DemDebounceAlgorithmClass
            DemDebounceCounterBased: DemDebounceCounterDecrementStepSize=128, DemDebounceCounterIncrementStepSize=127, DemDebounceCounterJumpDown=false, DemDebounceCounterJumpUp=false
      DTCClass_DtcClass_Rear_Camera_Circuit_Voltage_Out_of_Range_B217A1C (DemDTCClass): DemDTCSeverity=DEM_DTC_SEV_NO_SEVERITY, DemUdsDTC=10582556, DemDTCAttributesRef=DtcAttributes_41914fb7
      Rear_Camera_Circuit_Voltage_Out_of_Range_B217A1C (DemEventParameter):
        DemEventKind = DEM_EVENT_KIND_SWC
        DemMaxNumberFreezeFrameRecords = 2
        DemDTCClassRef = DTCClass_DtcClass_Rear_Camera_Circuit_Voltage_Out_of_Range_B217A1C
        DemExtendedDataClassRef = ExtendedDataClass_240799f9
        DemFreezeFrameClassRef = FreezeFrame_a2168519
        DemEventClass:
          DemAgingAllowed = true
          DemAgingCycleCounterThreshold = 40
          DemEventPriority = 2
          DemEventSignificance = DEM_EVENT_SIGNIFICANCE_FAULT
          DemEventFailureCycleCounterThreshold = 0
          DemAgingCycleRef = IgnitionCycle
          DemEnableConditionGroupRef = EnableConditionGroup_dc41854c
          DemOperationCycleRef = IgnitionCycle
          DemDebounceAlgorithmClass
            DemDebounceCounterBased: DemDebounceCounterDecrementStepSize=128, DemDebounceCounterIncrementStepSize=127, DemDebounceCounterJumpDown=false, DemDebounceCounterJumpUp=false
      DTCClass_DtcClass_Rear_Camera_Performance_or_Incorrect_Operation_B217A92 (DemDTCClass): DemDTCSeverity=DEM_DTC_SEV_NO_SEVERITY, DemUdsDTC=10582674, DemDTCAttributesRef=DtcAttributes_41914fb7
      Rear_Camera_Performance_or_Incorrect_Operation_B217A92 (DemEventParameter):
        DemEventKind = DEM_EVENT_KIND_SWC
        DemMaxNumberFreezeFrameRecords = 2
        DemDTCClassRef = DTCClass_DtcClass_Rear_Camera_Performance_or_Incorrect_Operation_B217A92
        DemExtendedDataClassRef = ExtendedDataClass_240799f9
        DemFreezeFrameClassRef = FreezeFrame_a2168519
        DemEventClass:
          DemAgingAllowed = true
          DemAgingCycleCounterThreshold = 40
          DemEventPriority = 2
          DemEventSignificance = DEM_EVENT_SIGNIFICANCE_FAULT
          DemEventFailureCycleCounterThreshold = 0
          DemAgingCycleRef = IgnitionCycle
          DemEnableConditionGroupRef = EnableConditionGroup_dc41854c
          DemOperationCycleRef = IgnitionCycle
          DemDebounceAlgorithmClass
            DemDebounceCounterBased: DemDebounceCounterDecrementStepSize=128, DemDebounceCounterIncrementStepSize=127, DemDebounceCounterJumpDown=false, DemDebounceCounterJumpUp=false
      DTCClass_DtcClass_Vehicle_Configuration_Mismatch_B223B00 (DemDTCClass): DemDTCSeverity=DEM_DTC_SEV_NO_SEVERITY, DemUdsDTC=10631936, DemDTCAttributesRef=DtcAttributes_41914fb7
      Vehicle_Configuration_Mismatch_B223B00 (DemEventParameter):
        DemEventKind = DEM_EVENT_KIND_SWC
        DemMaxNumberFreezeFrameRecords = 2
        DemDTCClassRef = DTCClass_DtcClass_Vehicle_Configuration_Mismatch_B223B00
        DemExtendedDataClassRef = ExtendedDataClass_240799f9
        DemFreezeFrameClassRef = FreezeFrame_a2168519
        DemEventClass:
          DemAgingAllowed = true
          DemAgingCycleCounterThreshold = 40
          DemEventPriority = 2
          DemEventSignificance = DEM_EVENT_SIGNIFICANCE_FAULT
          DemEventFailureCycleCounterThreshold = 0
          DemAgingCycleRef = IgnitionCycle
          DemEnableConditionGroupRef = EnableConditionGroup_5090bf01
          DemOperationCycleRef = IgnitionCycle
          DemDebounceAlgorithmClass
            DemDebounceCounterBased: DemDebounceCounterDecrementStepSize=128, DemDebounceCounterIncrementStepSize=127, DemDebounceCounterJumpDown=false, DemDebounceCounterJumpUp=false
      DTCClass_DtcClass_Calibration_Not_Learned_Lost_Calibration_B228600 (DemDTCClass): DemDTCSeverity=DEM_DTC_SEV_NO_SEVERITY, DemUdsDTC=10651136, DemDTCAttributesRef=DtcAttributes_41914fb7
      Calibration_Not_Learned_Lost_Calibration_B228600 (DemEventParameter):
        DemEventKind = DEM_EVENT_KIND_SWC
        DemMaxNumberFreezeFrameRecords = 2
        DemDTCClassRef = DTCClass_DtcClass_Calibration_Not_Learned_Lost_Calibration_B228600
        DemExtendedDataClassRef = ExtendedDataClass_240799f9
        DemFreezeFrameClassRef = FreezeFrame_a2168519
        DemEventClass:
          DemAgingAllowed = true
          DemAgingCycleCounterThreshold = 40
          DemEventPriority = 2
          DemEventSignificance = DEM_EVENT_SIGNIFICANCE_FAULT
          DemEventFailureCycleCounterThreshold = 0
          DemAgingCycleRef = IgnitionCycle
          DemEnableConditionGroupRef = EnableConditionGroup_dc41854c
          DemOperationCycleRef = IgnitionCycle
          DemDebounceAlgorithmClass
            DemDebounceCounterBased: DemDebounceCounterDecrementStepSize=128, DemDebounceCounterIncrementStepSize=127, DemDebounceCounterJumpDown=false, DemDebounceCounterJumpUp=false
      DTCClass_DtcClass_ECU_Internal_Performance_B22A900 (DemDTCClass): DemDTCSeverity=DEM_DTC_SEV_NO_SEVERITY, DemUdsDTC=10660096, DemDTCAttributesRef=DtcAttributes_41914fb7
      ECU_Internal_Performance_B22A900 (DemEventParameter):
        DemEventKind = DEM_EVENT_KIND_SWC
        DemMaxNumberFreezeFrameRecords = 2
        DemDTCClassRef = DTCClass_DtcClass_ECU_Internal_Performance_B22A900
        DemExtendedDataClassRef = ExtendedDataClass_240799f9
        DemFreezeFrameClassRef = FreezeFrame_a2168519
        DemEventClass:
          DemAgingAllowed = true
          DemAgingCycleCounterThreshold = 40
          DemEventPriority = 2
          DemEventSignificance = DEM_EVENT_SIGNIFICANCE_FAULT
          DemEventFailureCycleCounterThreshold = 0
          DemAgingCycleRef = IgnitionCycle
          DemEnableConditionGroupRef = EnableConditionGroup_EC2
          DemOperationCycleRef = IgnitionCycle
          DemDebounceAlgorithmClass
            DemDebounceCounterBased: DemDebounceCounterDecrementStepSize=128, DemDebounceCounterIncrementStepSize=127, DemDebounceCounterJumpDown=false, DemDebounceCounterJumpUp=false
      DTCClass_DtcClass_Front_Camera_Circuit_Voltage_Out_of_Range_B23C51C (DemDTCClass): DemDTCSeverity=DEM_DTC_SEV_NO_SEVERITY, DemUdsDTC=10732828, DemDTCAttributesRef=DtcAttributes_41914fb7
      Front_Camera_Circuit_Voltage_Out_of_Range_B23C51C (DemEventParameter):
        DemEventKind = DEM_EVENT_KIND_SWC
        DemMaxNumberFreezeFrameRecords = 2
        DemDTCClassRef = DTCClass_DtcClass_Front_Camera_Circuit_Voltage_Out_of_Range_B23C51C
        DemExtendedDataClassRef = ExtendedDataClass_240799f9
        DemFreezeFrameClassRef = FreezeFrame_a2168519
        DemEventClass:
          DemAgingAllowed = true
          DemAgingCycleCounterThreshold = 40
          DemEventPriority = 2
          DemEventSignificance = DEM_EVENT_SIGNIFICANCE_FAULT
          DemEventFailureCycleCounterThreshold = 0
          DemAgingCycleRef = IgnitionCycle
          DemEnableConditionGroupRef = EnableConditionGroup_a3268155
          DemOperationCycleRef = IgnitionCycle
          DemDebounceAlgorithmClass
            DemDebounceCounterBased: DemDebounceCounterDecrementStepSize=128, DemDebounceCounterIncrementStepSize=127, DemDebounceCounterJumpDown=false, DemDebounceCounterJumpUp=false
      DTCClass_DtcClass_Front_Camera_Performance_or_Incorrect_Operation_B23C592 (DemDTCClass): DemDTCSeverity=DEM_DTC_SEV_NO_SEVERITY, DemUdsDTC=10732946, DemDTCAttributesRef=DtcAttributes_41914fb7
      Front_Camera_Performance_or_Incorrect_Operation_B23C592 (DemEventParameter):
        DemEventKind = DEM_EVENT_KIND_SWC
        DemMaxNumberFreezeFrameRecords = 2
        DemDTCClassRef = DTCClass_DtcClass_Front_Camera_Performance_or_Incorrect_Operation_B23C592
        DemExtendedDataClassRef = ExtendedDataClass_240799f9
        DemFreezeFrameClassRef = FreezeFrame_a2168519
        DemEventClass:
          DemAgingAllowed = true
          DemAgingCycleCounterThreshold = 40
          DemEventPriority = 2
          DemEventSignificance = DEM_EVENT_SIGNIFICANCE_FAULT
          DemEventFailureCycleCounterThreshold = 0
          DemAgingCycleRef = IgnitionCycle
          DemEnableConditionGroupRef = EnableConditionGroup_a3268155
          DemOperationCycleRef = IgnitionCycle
          DemDebounceAlgorithmClass
            DemDebounceCounterBased: DemDebounceCounterDecrementStepSize=128, DemDebounceCounterIncrementStepSize=127, DemDebounceCounterJumpDown=false, DemDebounceCounterJumpUp=false
      DTCClass_DtcClass_Left_Camera_Circuit_Voltage_Out_of_Range_B23C61C (DemDTCClass): DemDTCSeverity=DEM_DTC_SEV_NO_SEVERITY, DemUdsDTC=10733084, DemDTCAttributesRef=DtcAttributes_41914fb7
      Left_Camera_Circuit_Voltage_Out_of_Range_B23C61C (DemEventParameter):
        DemEventKind = DEM_EVENT_KIND_SWC
        DemMaxNumberFreezeFrameRecords = 2
        DemDTCClassRef = DTCClass_DtcClass_Left_Camera_Circuit_Voltage_Out_of_Range_B23C61C
        DemExtendedDataClassRef = ExtendedDataClass_240799f9
        DemFreezeFrameClassRef = FreezeFrame_a2168519
        DemEventClass:
          DemAgingAllowed = true
          DemAgingCycleCounterThreshold = 40
          DemEventPriority = 2
          DemEventSignificance = DEM_EVENT_SIGNIFICANCE_FAULT
          DemEventFailureCycleCounterThreshold = 0
          DemAgingCycleRef = IgnitionCycle
          DemEnableConditionGroupRef = EnableConditionGroup_a3268155
          DemOperationCycleRef = IgnitionCycle
          DemDebounceAlgorithmClass
            DemDebounceCounterBased: DemDebounceCounterDecrementStepSize=128, DemDebounceCounterIncrementStepSize=127, DemDebounceCounterJumpDown=false, DemDebounceCounterJumpUp=false
      DTCClass_DtcClass_Left_Camera_Performance_or_Incorrect_Operation_B23C692 (DemDTCClass): DemDTCSeverity=DEM_DTC_SEV_NO_SEVERITY, DemUdsDTC=10733202, DemDTCAttributesRef=DtcAttributes_41914fb7
      Left_Camera_Performance_or_Incorrect_Operation_B23C692 (DemEventParameter):
        DemEventKind = DEM_EVENT_KIND_SWC
        DemMaxNumberFreezeFrameRecords = 2
        DemDTCClassRef = DTCClass_DtcClass_Left_Camera_Performance_or_Incorrect_Operation_B23C692
        DemExtendedDataClassRef = ExtendedDataClass_240799f9
        DemFreezeFrameClassRef = FreezeFrame_a2168519
        DemEventClass:
          DemAgingAllowed = true
          DemAgingCycleCounterThreshold = 40
          DemEventPriority = 2
          DemEventSignificance = DEM_EVENT_SIGNIFICANCE_FAULT
          DemEventFailureCycleCounterThreshold = 0
          DemAgingCycleRef = IgnitionCycle
          DemEnableConditionGroupRef = EnableConditionGroup_a3268155
          DemOperationCycleRef = IgnitionCycle
          DemDebounceAlgorithmClass
            DemDebounceCounterBased: DemDebounceCounterDecrementStepSize=128, DemDebounceCounterIncrementStepSize=127, DemDebounceCounterJumpDown=false, DemDebounceCounterJumpUp=false
      DTCClass_DtcClass_Right_Camera_Circuit_Voltage_Out_of_Range_B23C71C (DemDTCClass): DemDTCSeverity=DEM_DTC_SEV_NO_SEVERITY, DemUdsDTC=10733340, DemDTCAttributesRef=DtcAttributes_41914fb7
      Right_Camera_Circuit_Voltage_Out_of_Range_B23C71C (DemEventParameter):
        DemEventKind = DEM_EVENT_KIND_SWC
        DemMaxNumberFreezeFrameRecords = 2
        DemDTCClassRef = DTCClass_DtcClass_Right_Camera_Circuit_Voltage_Out_of_Range_B23C71C
        DemExtendedDataClassRef = ExtendedDataClass_240799f9
        DemFreezeFrameClassRef = FreezeFrame_a2168519
        DemEventClass:
          DemAgingAllowed = true
          DemAgingCycleCounterThreshold = 40
          DemEventPriority = 2
          DemEventSignificance = DEM_EVENT_SIGNIFICANCE_FAULT
          DemEventFailureCycleCounterThreshold = 0
          DemAgingCycleRef = IgnitionCycle
          DemEnableConditionGroupRef = EnableConditionGroup_a3268155
          DemOperationCycleRef = IgnitionCycle
          DemDebounceAlgorithmClass
            DemDebounceCounterBased: DemDebounceCounterDecrementStepSize=128, DemDebounceCounterIncrementStepSize=127, DemDebounceCounterJumpDown=false, DemDebounceCounterJumpUp=false
      DTCClass_DtcClass_Right_Camera_Performance_or_Incorrect_Operation_B23C792 (DemDTCClass): DemDTCSeverity=DEM_DTC_SEV_NO_SEVERITY, DemUdsDTC=10733458, DemDTCAttributesRef=DtcAttributes_41914fb7
      Right_Camera_Performance_or_Incorrect_Operation_B23C792 (DemEventParameter):
        DemEventKind = DEM_EVENT_KIND_SWC
        DemMaxNumberFreezeFrameRecords = 2
        DemDTCClassRef = DTCClass_DtcClass_Right_Camera_Performance_or_Incorrect_Operation_B23C792
        DemExtendedDataClassRef = ExtendedDataClass_240799f9
        DemFreezeFrameClassRef = FreezeFrame_a2168519
        DemEventClass:
          DemAgingAllowed = true
          DemAgingCycleCounterThreshold = 40
          DemEventPriority = 2
          DemEventSignificance = DEM_EVENT_SIGNIFICANCE_FAULT
          DemEventFailureCycleCounterThreshold = 0
          DemAgingCycleRef = IgnitionCycle
          DemEnableConditionGroupRef = EnableConditionGroup_a3268155
          DemOperationCycleRef = IgnitionCycle
          DemDebounceAlgorithmClass
            DemDebounceCounterBased: DemDebounceCounterDecrementStepSize=128, DemDebounceCounterIncrementStepSize=127, DemDebounceCounterJumpDown=false, DemDebounceCounterJumpUp=false
      DTCClass_DtcClass_Loss_of_Comm_With_Engine_Control_Module_U010000 (DemDTCClass): DemDTCSeverity=DEM_DTC_SEV_NO_SEVERITY, DemUdsDTC=12648448, DemDTCAttributesRef=DtcAttributes_41914fb7
      Loss_of_Comm_With_Engine_Control_Module_U010000 (DemEventParameter):
        DemEventKind = DEM_EVENT_KIND_SWC
        DemMaxNumberFreezeFrameRecords = 2
        DemDTCClassRef = DTCClass_DtcClass_Loss_of_Comm_With_Engine_Control_Module_U010000
        DemExtendedDataClassRef = ExtendedDataClass_240799f9
        DemFreezeFrameClassRef = FreezeFrame_a2168519
        DemEventClass:
          DemAgingAllowed = true
          DemAgingCycleCounterThreshold = 40
          DemEventPriority = 2
          DemEventSignificance = DEM_EVENT_SIGNIFICANCE_FAULT
          DemEventFailureCycleCounterThreshold = 0
          DemAgingCycleRef = IgnitionCycle
          DemEnableConditionGroupRef = EnableConditionGroup_58fca5ad
          DemOperationCycleRef = IgnitionCycle
          DemDebounceAlgorithmClass
            DemDebounceCounterBased: DemDebounceCounterDecrementStepSize=128, DemDebounceCounterIncrementStepSize=127, DemDebounceCounterJumpDown=false, DemDebounceCounterJumpUp=false
      DTCClass_DtcClass_Lost_Communication_With_BSC_module_1_U012900 (DemDTCClass): DemDTCSeverity=DEM_DTC_SEV_NO_SEVERITY, DemUdsDTC=12658944, DemDTCAttributesRef=DtcAttributes_41914fb7
      Lost_Communication_With_BSC_module_1_U012900 (DemEventParameter):
        DemEventKind = DEM_EVENT_KIND_SWC
        DemMaxNumberFreezeFrameRecords = 2
        DemDTCClassRef = DTCClass_DtcClass_Lost_Communication_With_BSC_module_1_U012900
        DemExtendedDataClassRef = ExtendedDataClass_240799f9
        DemFreezeFrameClassRef = FreezeFrame_a2168519
        DemEventClass:
          DemAgingAllowed = true
          DemAgingCycleCounterThreshold = 40
          DemEventPriority = 2
          DemEventSignificance = DEM_EVENT_SIGNIFICANCE_FAULT
          DemEventFailureCycleCounterThreshold = 0
          DemAgingCycleRef = IgnitionCycle
          DemEnableConditionGroupRef = EnableConditionGroup_58fca5ad
          DemOperationCycleRef = IgnitionCycle
          DemDebounceAlgorithmClass
            DemDebounceCounterBased: DemDebounceCounterDecrementStepSize=128, DemDebounceCounterIncrementStepSize=127, DemDebounceCounterJumpDown=false, DemDebounceCounterJumpUp=false
      DTCClass_DtcClass_Lost_Communication_With_PSC_Module_A_U013100 (DemDTCClass): DemDTCSeverity=DEM_DTC_SEV_NO_SEVERITY, DemUdsDTC=12660992, DemDTCAttributesRef=DtcAttributes_41914fb7
      Lost_Communication_With_PSC_Module_A_U013100 (DemEventParameter):
        DemEventKind = DEM_EVENT_KIND_SWC
        DemMaxNumberFreezeFrameRecords = 2
        DemDTCClassRef = DTCClass_DtcClass_Lost_Communication_With_PSC_Module_A_U013100
        DemExtendedDataClassRef = ExtendedDataClass_240799f9
        DemFreezeFrameClassRef = FreezeFrame_a2168519
        DemEventClass:
          DemAgingAllowed = true
          DemAgingCycleCounterThreshold = 40
          DemEventPriority = 2
          DemEventSignificance = DEM_EVENT_SIGNIFICANCE_FAULT
          DemEventFailureCycleCounterThreshold = 0
          DemAgingCycleRef = IgnitionCycle
          DemEnableConditionGroupRef = EnableConditionGroup_58fca5ad
          DemOperationCycleRef = IgnitionCycle
          DemDebounceAlgorithmClass
            DemDebounceCounterBased: DemDebounceCounterDecrementStepSize=128, DemDebounceCounterIncrementStepSize=127, DemDebounceCounterJumpDown=false, DemDebounceCounterJumpUp=false
      DTCClass_DtcClass_Lost_Communication_With_BCM_U014000 (DemDTCClass): DemDTCSeverity=DEM_DTC_SEV_NO_SEVERITY, DemUdsDTC=12664832, DemDTCAttributesRef=DtcAttributes_41914fb7
      Lost_Communication_With_BCM_U014000 (DemEventParameter):
        DemEventKind = DEM_EVENT_KIND_SWC
        DemMaxNumberFreezeFrameRecords = 2
        DemDTCClassRef = DTCClass_DtcClass_Lost_Communication_With_BCM_U014000
        DemExtendedDataClassRef = ExtendedDataClass_240799f9
        DemFreezeFrameClassRef = FreezeFrame_a2168519
        DemEventClass:
          DemAgingAllowed = true
          DemAgingCycleCounterThreshold = 40
          DemEventPriority = 2
          DemEventSignificance = DEM_EVENT_SIGNIFICANCE_FAULT
          DemEventFailureCycleCounterThreshold = 0
          DemAgingCycleRef = IgnitionCycle
          DemEnableConditionGroupRef = EnableConditionGroup_eab14353
          DemOperationCycleRef = IgnitionCycle
          DemDebounceAlgorithmClass
            DemDebounceCounterBased: DemDebounceCounterDecrementStepSize=128, DemDebounceCounterIncrementStepSize=127, DemDebounceCounterJumpDown=false, DemDebounceCounterJumpUp=false
      DTCClass_DtcClass_Lost_Communication_with_ORC_U015100 (DemDTCClass): DemDTCSeverity=DEM_DTC_SEV_NO_SEVERITY, DemUdsDTC=12669184, DemDTCAttributesRef=DtcAttributes_41914fb7
      Lost_Communication_with_ORC_U015100 (DemEventParameter):
        DemEventKind = DEM_EVENT_KIND_SWC
        DemMaxNumberFreezeFrameRecords = 2
        DemDTCClassRef = DTCClass_DtcClass_Lost_Communication_with_ORC_U015100
        DemExtendedDataClassRef = ExtendedDataClass_240799f9
        DemFreezeFrameClassRef = FreezeFrame_a2168519
        DemEventClass:
          DemAgingAllowed = true
          DemAgingCycleCounterThreshold = 40
          DemEventPriority = 2
          DemEventSignificance = DEM_EVENT_SIGNIFICANCE_FAULT
          DemEventFailureCycleCounterThreshold = 0
          DemAgingCycleRef = IgnitionCycle
          DemEnableConditionGroupRef = EnableConditionGroup_58fca5ad
          DemOperationCycleRef = IgnitionCycle
          DemDebounceAlgorithmClass
            DemDebounceCounterBased: DemDebounceCounterDecrementStepSize=128, DemDebounceCounterIncrementStepSize=127, DemDebounceCounterJumpDown=false, DemDebounceCounterJumpUp=false
      DTCClass_DtcClass_Lost_Communication_With_Radio_U018400 (DemDTCClass): DemDTCSeverity=DEM_DTC_SEV_NO_SEVERITY, DemUdsDTC=12682240, DemDTCAttributesRef=DtcAttributes_41914fb7
      Lost_Communication_With_Radio_U018400 (DemEventParameter):
        DemEventKind = DEM_EVENT_KIND_SWC
        DemMaxNumberFreezeFrameRecords = 2
        DemDTCClassRef = DTCClass_DtcClass_Lost_Communication_With_Radio_U018400
        DemExtendedDataClassRef = ExtendedDataClass_240799f9
        DemFreezeFrameClassRef = FreezeFrame_a2168519
        DemEventClass:
          DemAgingAllowed = true
          DemAgingCycleCounterThreshold = 40
          DemEventPriority = 2
          DemEventSignificance = DEM_EVENT_SIGNIFICANCE_FAULT
          DemEventFailureCycleCounterThreshold = 0
          DemAgingCycleRef = IgnitionCycle
          DemEnableConditionGroupRef = EnableConditionGroup_58fca5ad
          DemOperationCycleRef = IgnitionCycle
          DemDebounceAlgorithmClass
            DemDebounceCounterBased: DemDebounceCounterDecrementStepSize=128, DemDebounceCounterIncrementStepSize=127, DemDebounceCounterJumpDown=false, DemDebounceCounterJumpUp=false
      DTCClass_DtcClass_Lost_Communication_with_Rear_Camera_U026400 (DemDTCClass): DemDTCSeverity=DEM_DTC_SEV_NO_SEVERITY, DemUdsDTC=12739584, DemDTCAttributesRef=DtcAttributes_41914fb7
      Lost_Communication_with_Rear_Camera_U026400 (DemEventParameter):
        DemEventKind = DEM_EVENT_KIND_SWC
        DemMaxNumberFreezeFrameRecords = 2
        DemDTCClassRef = DTCClass_DtcClass_Lost_Communication_with_Rear_Camera_U026400
        DemExtendedDataClassRef = ExtendedDataClass_240799f9
        DemFreezeFrameClassRef = FreezeFrame_a2168519
        DemEventClass:
          DemAgingAllowed = true
          DemAgingCycleCounterThreshold = 40
          DemEventPriority = 2
          DemEventSignificance = DEM_EVENT_SIGNIFICANCE_FAULT
          DemEventFailureCycleCounterThreshold = 0
          DemAgingCycleRef = IgnitionCycle
          DemEnableConditionGroupRef = EnableConditionGroup_dc41854c
          DemOperationCycleRef = IgnitionCycle
          DemDebounceAlgorithmClass
            DemDebounceCounterBased: DemDebounceCounterDecrementStepSize=128, DemDebounceCounterIncrementStepSize=127, DemDebounceCounterJumpDown=false, DemDebounceCounterJumpUp=false
      DTCClass_DtcClass_Lost_Communication_with_Front_Camera_U026500 (DemDTCClass): DemDTCSeverity=DEM_DTC_SEV_NO_SEVERITY, DemUdsDTC=12739840, DemDTCAttributesRef=DtcAttributes_41914fb7
      Lost_Communication_with_Front_Camera_U026500 (DemEventParameter):
        DemEventKind = DEM_EVENT_KIND_SWC
        DemMaxNumberFreezeFrameRecords = 2
        DemDTCClassRef = DTCClass_DtcClass_Lost_Communication_with_Front_Camera_U026500
        DemExtendedDataClassRef = ExtendedDataClass_240799f9
        DemFreezeFrameClassRef = FreezeFrame_a2168519
        DemEventClass:
          DemAgingAllowed = true
          DemAgingCycleCounterThreshold = 40
          DemEventPriority = 2
          DemEventSignificance = DEM_EVENT_SIGNIFICANCE_FAULT
          DemEventFailureCycleCounterThreshold = 0
          DemAgingCycleRef = IgnitionCycle
          DemEnableConditionGroupRef = EnableConditionGroup_a3268155
          DemOperationCycleRef = IgnitionCycle
          DemDebounceAlgorithmClass
            DemDebounceCounterBased: DemDebounceCounterDecrementStepSize=128, DemDebounceCounterIncrementStepSize=127, DemDebounceCounterJumpDown=false, DemDebounceCounterJumpUp=false
      DTCClass_DtcClass_Lost_Communication_with_Left_Camera_U026600 (DemDTCClass): DemDTCSeverity=DEM_DTC_SEV_NO_SEVERITY, DemUdsDTC=12740096, DemDTCAttributesRef=DtcAttributes_41914fb7
      Lost_Communication_with_Left_Camera_U026600 (DemEventParameter):
        DemEventKind = DEM_EVENT_KIND_SWC
        DemMaxNumberFreezeFrameRecords = 2
        DemDTCClassRef = DTCClass_DtcClass_Lost_Communication_with_Left_Camera_U026600
        DemExtendedDataClassRef = ExtendedDataClass_240799f9
        DemFreezeFrameClassRef = FreezeFrame_a2168519
        DemEventClass:
          DemAgingAllowed = true
          DemAgingCycleCounterThreshold = 40
          DemEventPriority = 2
          DemEventSignificance = DEM_EVENT_SIGNIFICANCE_FAULT
          DemEventFailureCycleCounterThreshold = 0
          DemAgingCycleRef = IgnitionCycle
          DemEnableConditionGroupRef = EnableConditionGroup_a3268155
          DemOperationCycleRef = IgnitionCycle
          DemDebounceAlgorithmClass
            DemDebounceCounterBased: DemDebounceCounterDecrementStepSize=128, DemDebounceCounterIncrementStepSize=127, DemDebounceCounterJumpDown=false, DemDebounceCounterJumpUp=false
      DTCClass_DtcClass_Lost_Communication_with_Right_Camera_U026700 (DemDTCClass): DemDTCSeverity=DEM_DTC_SEV_NO_SEVERITY, DemUdsDTC=12740352, DemDTCAttributesRef=DtcAttributes_41914fb7
      Lost_Communication_with_Right_Camera_U026700 (DemEventParameter):
        DemEventKind = DEM_EVENT_KIND_SWC
        DemMaxNumberFreezeFrameRecords = 2
        DemDTCClassRef = DTCClass_DtcClass_Lost_Communication_with_Right_Camera_U026700
        DemExtendedDataClassRef = ExtendedDataClass_240799f9
        DemFreezeFrameClassRef = FreezeFrame_a2168519
        DemEventClass:
          DemAgingAllowed = true
          DemAgingCycleCounterThreshold = 40
          DemEventPriority = 2
          DemEventSignificance = DEM_EVENT_SIGNIFICANCE_FAULT
          DemEventFailureCycleCounterThreshold = 0
          DemAgingCycleRef = IgnitionCycle
          DemEnableConditionGroupRef = EnableConditionGroup_a3268155
          DemOperationCycleRef = IgnitionCycle
          DemDebounceAlgorithmClass
            DemDebounceCounterBased: DemDebounceCounterDecrementStepSize=128, DemDebounceCounterIncrementStepSize=127, DemDebounceCounterJumpDown=false, DemDebounceCounterJumpUp=false
      DTCClass_DtcClass_Implausible_data_received_from_ECM_U040100 (DemDTCClass): DemDTCSeverity=DEM_DTC_SEV_NO_SEVERITY, DemUdsDTC=12845312, DemDTCAttributesRef=DtcAttributes_41914fb7
      Implausible_data_received_from_ECM_U040100 (DemEventParameter):
        DemEventKind = DEM_EVENT_KIND_SWC
        DemMaxNumberFreezeFrameRecords = 2
        DemDTCClassRef = DTCClass_DtcClass_Implausible_data_received_from_ECM_U040100
        DemExtendedDataClassRef = ExtendedDataClass_240799f9
        DemFreezeFrameClassRef = FreezeFrame_a2168519
        DemEventClass:
          DemAgingAllowed = true
          DemAgingCycleCounterThreshold = 40
          DemEventPriority = 2
          DemEventSignificance = DEM_EVENT_SIGNIFICANCE_FAULT
          DemEventFailureCycleCounterThreshold = 0
          DemAgingCycleRef = IgnitionCycle
          DemEnableConditionGroupRef = EnableConditionGroup_58fca5ad
          DemOperationCycleRef = IgnitionCycle
          DemDebounceAlgorithmClass
            DemDebounceCounterBased: DemDebounceCounterDecrementStepSize=128, DemDebounceCounterIncrementStepSize=127, DemDebounceCounterJumpDown=false, DemDebounceCounterJumpUp=false
      DTCClass_DtcClass_Implausible_Data_From_BSC_Module_1_U041800 (DemDTCClass): DemDTCSeverity=DEM_DTC_SEV_NO_SEVERITY, DemUdsDTC=12851200, DemDTCAttributesRef=DtcAttributes_41914fb7
      Implausible_Data_From_BSC_Module_1_U041800 (DemEventParameter):
        DemEventKind = DEM_EVENT_KIND_SWC
        DemMaxNumberFreezeFrameRecords = 2
        DemDTCClassRef = DTCClass_DtcClass_Implausible_Data_From_BSC_Module_1_U041800
        DemExtendedDataClassRef = ExtendedDataClass_240799f9
        DemFreezeFrameClassRef = FreezeFrame_a2168519
        DemEventClass:
          DemAgingAllowed = true
          DemAgingCycleCounterThreshold = 40
          DemEventPriority = 2
          DemEventSignificance = DEM_EVENT_SIGNIFICANCE_FAULT
          DemEventFailureCycleCounterThreshold = 0
          DemAgingCycleRef = IgnitionCycle
          DemEnableConditionGroupRef = EnableConditionGroup_58fca5ad
          DemOperationCycleRef = IgnitionCycle
          DemDebounceAlgorithmClass
            DemDebounceCounterBased: DemDebounceCounterDecrementStepSize=128, DemDebounceCounterIncrementStepSize=127, DemDebounceCounterJumpDown=false, DemDebounceCounterJumpUp=false
      DTCClass_DtcClass_Invalid_Data_Received_From_Power_Steering_Control_Module_U042000 (DemDTCClass): DemDTCSeverity=DEM_DTC_SEV_NO_SEVERITY, DemUdsDTC=12853248, DemDTCAttributesRef=DtcAttributes_41914fb7
      Invalid_Data_Received_From_Power_Steering_Control_Module_U042000 (DemEventParameter):
        DemEventKind = DEM_EVENT_KIND_SWC
        DemMaxNumberFreezeFrameRecords = 2
        DemDTCClassRef = DTCClass_DtcClass_Invalid_Data_Received_From_Power_Steering_Control_Module_U042000
        DemExtendedDataClassRef = ExtendedDataClass_240799f9
        DemFreezeFrameClassRef = FreezeFrame_a2168519
        DemEventClass:
          DemAgingAllowed = true
          DemAgingCycleCounterThreshold = 40
          DemEventPriority = 2
          DemEventSignificance = DEM_EVENT_SIGNIFICANCE_FAULT
          DemEventFailureCycleCounterThreshold = 0
          DemAgingCycleRef = IgnitionCycle
          DemEnableConditionGroupRef = EnableConditionGroup_58fca5ad
          DemOperationCycleRef = IgnitionCycle
          DemDebounceAlgorithmClass
            DemDebounceCounterBased: DemDebounceCounterDecrementStepSize=128, DemDebounceCounterIncrementStepSize=127, DemDebounceCounterJumpDown=false, DemDebounceCounterJumpUp=false
      DTCClass_DtcClass_Implausible_Data_Received_From_Body_Control_Module_U042200 (DemDTCClass): DemDTCSeverity=DEM_DTC_SEV_NO_SEVERITY, DemUdsDTC=12853760, DemDTCAttributesRef=DtcAttributes_41914fb7
      Implausible_Data_Received_From_Body_Control_Module_U042200 (DemEventParameter):
        DemEventKind = DEM_EVENT_KIND_SWC
        DemMaxNumberFreezeFrameRecords = 2
        DemDTCClassRef = DTCClass_DtcClass_Implausible_Data_Received_From_Body_Control_Module_U042200
        DemExtendedDataClassRef = ExtendedDataClass_240799f9
        DemFreezeFrameClassRef = FreezeFrame_a2168519
        DemEventClass:
          DemAgingAllowed = true
          DemAgingCycleCounterThreshold = 40
          DemEventPriority = 2
          DemEventSignificance = DEM_EVENT_SIGNIFICANCE_FAULT
          DemEventFailureCycleCounterThreshold = 0
          DemAgingCycleRef = IgnitionCycle
          DemEnableConditionGroupRef = EnableConditionGroup_9fd149a3
          DemOperationCycleRef = IgnitionCycle
          DemDebounceAlgorithmClass
            DemDebounceCounterBased: DemDebounceCounterDecrementStepSize=128, DemDebounceCounterIncrementStepSize=127, DemDebounceCounterJumpDown=false, DemDebounceCounterJumpUp=false
      DTCClass_DtcClass_Implausible_Data_from_ORC_module_U045500 (DemDTCClass): DemDTCSeverity=DEM_DTC_SEV_NO_SEVERITY, DemUdsDTC=12866816, DemDTCAttributesRef=DtcAttributes_41914fb7
      Implausible_Data_from_ORC_module_U045500 (DemEventParameter):
        DemEventKind = DEM_EVENT_KIND_SWC
        DemMaxNumberFreezeFrameRecords = 2
        DemDTCClassRef = DTCClass_DtcClass_Implausible_Data_from_ORC_module_U045500
        DemExtendedDataClassRef = ExtendedDataClass_240799f9
        DemFreezeFrameClassRef = FreezeFrame_a2168519
        DemEventClass:
          DemAgingAllowed = true
          DemAgingCycleCounterThreshold = 40
          DemEventPriority = 2
          DemEventSignificance = DEM_EVENT_SIGNIFICANCE_FAULT
          DemEventFailureCycleCounterThreshold = 0
          DemAgingCycleRef = IgnitionCycle
          DemEnableConditionGroupRef = EnableConditionGroup_58fca5ad
          DemOperationCycleRef = IgnitionCycle
          DemDebounceAlgorithmClass
            DemDebounceCounterBased: DemDebounceCounterDecrementStepSize=128, DemDebounceCounterIncrementStepSize=127, DemDebounceCounterJumpDown=false, DemDebounceCounterJumpUp=false
      DTCClass_DtcClass_Implausible_Data_Received_from_Radio_U048500 (DemDTCClass): DemDTCSeverity=DEM_DTC_SEV_NO_SEVERITY, DemUdsDTC=12879104, DemDTCAttributesRef=DtcAttributes_41914fb7
      Implausible_Data_Received_from_Radio_U048500 (DemEventParameter):
        DemEventKind = DEM_EVENT_KIND_SWC
        DemMaxNumberFreezeFrameRecords = 2
        DemDTCClassRef = DTCClass_DtcClass_Implausible_Data_Received_from_Radio_U048500
        DemExtendedDataClassRef = ExtendedDataClass_240799f9
        DemFreezeFrameClassRef = FreezeFrame_a2168519
        DemEventClass:
          DemAgingAllowed = true
          DemAgingCycleCounterThreshold = 40
          DemEventPriority = 2
          DemEventSignificance = DEM_EVENT_SIGNIFICANCE_FAULT
          DemEventFailureCycleCounterThreshold = 0
          DemAgingCycleRef = IgnitionCycle
          DemEnableConditionGroupRef = EnableConditionGroup_58fca5ad
          DemOperationCycleRef = IgnitionCycle
          DemDebounceAlgorithmClass
            DemDebounceCounterBased: DemDebounceCounterDecrementStepSize=128, DemDebounceCounterIncrementStepSize=127, DemDebounceCounterJumpDown=false, DemDebounceCounterJumpUp=false
      DTCClass_DtcClass_HS_FD_CANR_Comm_Bus_Performance_U100B00 (DemDTCClass): DemDTCSeverity=DEM_DTC_SEV_NO_SEVERITY, DemUdsDTC=13634304, DemDTCAttributesRef=DtcAttributes_41914fb7
      HS_FD_CANR_Comm_Bus_Performance_U100B00 (DemEventParameter):
        DemEventKind = DEM_EVENT_KIND_SWC
        DemMaxNumberFreezeFrameRecords = 2
        DemDTCClassRef = DTCClass_DtcClass_HS_FD_CANR_Comm_Bus_Performance_U100B00
        DemExtendedDataClassRef = ExtendedDataClass_240799f9
        DemFreezeFrameClassRef = FreezeFrame_a2168519
        DemEventClass:
          DemAgingAllowed = true
          DemAgingCycleCounterThreshold = 40
          DemEventPriority = 2
          DemEventSignificance = DEM_EVENT_SIGNIFICANCE_FAULT
          DemEventFailureCycleCounterThreshold = 0
          DemAgingCycleRef = IgnitionCycle
          DemEnableConditionGroupRef = EnableConditionGroup_5926f32a
          DemOperationCycleRef = IgnitionCycle
          DemDebounceAlgorithmClass
            DemDebounceCounterBased: DemDebounceCounterDecrementStepSize=128, DemDebounceCounterIncrementStepSize=127, DemDebounceCounterJumpDown=false, DemDebounceCounterJumpUp=false
      DTCClass_DtcClass_HS_FD_CAN2_Comm_Bus_Performance_U104E00 (DemDTCClass): DemDTCSeverity=DEM_DTC_SEV_NO_SEVERITY, DemUdsDTC=13651456, DemDTCAttributesRef=DtcAttributes_41914fb7
      HS_FD_CAN2_Comm_Bus_Performance_U104E00 (DemEventParameter):
        DemEventKind = DEM_EVENT_KIND_SWC
        DemMaxNumberFreezeFrameRecords = 2
        DemDTCClassRef = DTCClass_DtcClass_HS_FD_CAN2_Comm_Bus_Performance_U104E00
        DemExtendedDataClassRef = ExtendedDataClass_240799f9
        DemFreezeFrameClassRef = FreezeFrame_a2168519
        DemEventClass:
          DemAgingAllowed = true
          DemAgingCycleCounterThreshold = 40
          DemEventPriority = 2
          DemEventSignificance = DEM_EVENT_SIGNIFICANCE_FAULT
          DemEventFailureCycleCounterThreshold = 0
          DemAgingCycleRef = IgnitionCycle
          DemEnableConditionGroupRef = EnableConditionGroup_5926f32a
          DemOperationCycleRef = IgnitionCycle
          DemDebounceAlgorithmClass
            DemDebounceCounterBased: DemDebounceCounterDecrementStepSize=128, DemDebounceCounterIncrementStepSize=127, DemDebounceCounterJumpDown=false, DemDebounceCounterJumpUp=false
      DTCClass_DtcClass_Loss_Communication_with_TRS_Knob_Module_U12B900 (DemDTCClass): DemDTCSeverity=DEM_DTC_SEV_NO_SEVERITY, DemUdsDTC=13809920, DemDTCAttributesRef=DtcAttributes_41914fb7
      Loss_Communication_with_TRS_Knob_Module_U12B900 (DemEventParameter):
        DemEventKind = DEM_EVENT_KIND_SWC
        DemMaxNumberFreezeFrameRecords = 2
        DemDTCClassRef = DTCClass_DtcClass_Loss_Communication_with_TRS_Knob_Module_U12B900
        DemExtendedDataClassRef = ExtendedDataClass_240799f9
        DemFreezeFrameClassRef = FreezeFrame_a2168519
        DemEventClass:
          DemAgingAllowed = true
          DemAgingCycleCounterThreshold = 40
          DemEventPriority = 2
          DemEventSignificance = DEM_EVENT_SIGNIFICANCE_FAULT
          DemEventFailureCycleCounterThreshold = 0
          DemAgingCycleRef = IgnitionCycle
          DemEnableConditionGroupRef = EnableConditionGroup_58fca5ad
          DemOperationCycleRef = IgnitionCycle
          DemDebounceAlgorithmClass
            DemDebounceCounterBased: DemDebounceCounterDecrementStepSize=128, DemDebounceCounterIncrementStepSize=127, DemDebounceCounterJumpDown=false, DemDebounceCounterJumpUp=false
      DTCClass_DtcClass_Implausible_Data_received_from_TRSKM_module_U14A000 (DemDTCClass): DemDTCSeverity=DEM_DTC_SEV_NO_SEVERITY, DemUdsDTC=13934592, DemDTCAttributesRef=DtcAttributes_41914fb7
      Implausible_Data_received_from_TRSKM_module_U14A000 (DemEventParameter):
        DemEventKind = DEM_EVENT_KIND_SWC
        DemMaxNumberFreezeFrameRecords = 2
        DemDTCClassRef = DTCClass_DtcClass_Implausible_Data_received_from_TRSKM_module_U14A000
        DemExtendedDataClassRef = ExtendedDataClass_240799f9
        DemFreezeFrameClassRef = FreezeFrame_a2168519
        DemEventClass:
          DemAgingAllowed = true
          DemAgingCycleCounterThreshold = 40
          DemEventPriority = 2
          DemEventSignificance = DEM_EVENT_SIGNIFICANCE_FAULT
          DemEventFailureCycleCounterThreshold = 0
          DemAgingCycleRef = IgnitionCycle
          DemEnableConditionGroupRef = EnableConditionGroup_58fca5ad
          DemOperationCycleRef = IgnitionCycle
          DemDebounceAlgorithmClass
            DemDebounceCounterBased: DemDebounceCounterDecrementStepSize=128, DemDebounceCounterIncrementStepSize=127, DemDebounceCounterJumpDown=false, DemDebounceCounterJumpUp=false
    DemGeneral:
      DemAgingCycleCounterProcessing = DEM_PROCESS_AGINGCTR_INTERN
      DemDebounceCounterBasedSupport = true
      DemEnableConditionSupport = true
      DemPTOSupport = false
      DemDtcStatusAvailabilityMask = 127
      DemEventMemorySet
        PrimaryMemory (DemPrimaryMemory): DemTypeOfFreezeFrameRecordNumeration=DEM_FF_RECNUM_CALCULATED
      7 x DemDidClass:
        DID_221002_Vehicle_Speed_0x1002: DemDidIdentifier=4098, DemDidDataClassRef=Data_DID_0x1002_Vehicle_Speed_24
        DID_221004_Battery_Voltage_0x1004: DemDidIdentifier=4100, DemDidDataClassRef=Data_DID_0x1004_Battery_Voltage_24
        DID_221008_ECU_Life_Time_0x1008: DemDidIdentifier=4104, DemDidDataClassRef=Data_DID_0x1008_ECU_Life_Time_24
        DID_221009_ECU_Time_Since_Ignition_ON_0x1009: DemDidIdentifier=4105, DemDidDataClassRef=Data_DID_0x1009_ECU_Time_Since_Ignition_ON
        DID_221921_Operational_Mode_Status_0x1921: DemDidIdentifier=6433, DemDidDataClassRef=Data_DID_0x1921_CombinedSignal
        DID_222001_Odometer_0x2001: DemDidIdentifier=8193, DemDidDataClassRef=Data_DID_0x2001_Odometer_24
        DID_22200A_Ignition_ON_Counter_0x200a: DemDidIdentifier=8202, DemDidDataClassRef=Data_DID_0x200a_Ignition_ON_Counter_24
      9 x DemEnableCondition:
        EC2
        EC1
        EC4
        EC5
        EC1_EC4_EC8
        EC7
        EC1_EC8
        EC10
        EC9
      ExtendedDataClass_240799f9 (DemExtendedDataClass): DemExtendedDataRecordClassRef=ExtendedDataRecord_OccurrenceCounter
      14 x DemEnableConditionGroup:
        EnableConditionGroup_EC1: DemEnableConditionRef=EC1
        EnableConditionGroup_35222079: DemEnableConditionRef=EC1, DemEnableConditionRef=EC4
        EnableConditionGroup_a3268155: DemEnableConditionRef=EC1, DemEnableConditionRef=EC10, DemEnableConditionRef=EC2
        EnableConditionGroup_5090bf01: DemEnableConditionRef=EC2, DemEnableConditionRef=EC5
        EnableConditionGroup_2b31122d: DemEnableConditionRef=EC1_EC4_EC8, DemEnableConditionRef=EC2
        EnableConditionGroup_58fca5ad: DemEnableConditionRef=EC1, DemEnableConditionRef=EC2, DemEnableConditionRef=EC4, DemEnableConditionRef=EC5, DemEnableConditionRef=EC9
        EnableConditionGroup_5926f32a: DemEnableConditionRef=EC2, DemEnableConditionRef=EC9
        EnableConditionGroup_eab14353: DemEnableConditionRef=EC2, DemEnableConditionRef=EC4, DemEnableConditionRef=EC5, DemEnableConditionRef=EC9
        EnableConditionGroup_EC2: DemEnableConditionRef=EC2
        EnableConditionGroup_9fd149a3: DemEnableConditionRef=EC2, DemEnableConditionRef=EC5, DemEnableConditionRef=EC9
        EnableConditionGroup_f0773a88: DemEnableConditionRef=EC1_EC8, DemEnableConditionRef=EC2
        EnableConditionGroup_bf4488aa: DemEnableConditionRef=EC1, DemEnableConditionRef=EC2, DemEnableConditionRef=EC4, DemEnableConditionRef=EC5, DemEnableConditionRef=EC7
        EnableConditionGroup_d35ce624: DemEnableConditionRef=EC1, DemEnableConditionRef=EC2, DemEnableConditionRef=EC4, DemEnableConditionRef=EC5
        EnableConditionGroup_dc41854c: DemEnableConditionRef=EC1, DemEnableConditionRef=EC2
      ExtendedDataRecord_OccurrenceCounter (DemExtendedDataRecordClass):
        DemExtendedDataRecordNumber = 1
        DemExtendedDataRecordTrigger = DEM_RECORD_TRIGGER_TESTFAILED
        DemExtendedDataRecordUpdate = DEM_UPDATE_RECORD_NO
        DemDataClassRef = Data_OccurrenceCounter_Aging_Counter_ID
        DemDataClassRef = Data_OccurrenceCounter_Aging_Counter
        DemDataClassRef = Data_OccurrenceCounter_Frequency_Counter_ID
        DemDataClassRef = Data_OccurrenceCounter_DID_DataObject
        DemDataClassRef = Data_OccurrenceCounter_Cycles_to_Switch_off_the_Warning_Indication_ID
        DemDataClassRef = Data_OccurrenceCounter_Reserved
        DemDataClassRef = Data_OccurrenceCounter_Supplier_Internal_Code
        DemDataClassRef = Data_OccurrenceCounter_Current_Gear
        DemDataClassRef = Data_OccurrenceCounter_Vehicle_Speed
        DemDataClassRef = Data_OccurrenceCounter_External_Temperature
        DemDataClassRef = Data_OccurrenceCounter_Odometer_Value
        DemDataClassRef = Data_OccurrenceCounter_Reserved_2
        DemDataClassRef = Data_OccurrenceCounter_ECU_Voltage
        DemDataClassRef = Data_OccurrenceCounter_Steering_Wheel_Angle
        DemDataClassRef = Data_OccurrenceCounter_Reserved_1
        DemDataClassRef = Data_OccurrenceCounter_Door_Status
        DemDataClassRef = Data_OccurrenceCounter_LiftgateAjar
        DemDataClassRef = Data_OccurrenceCounter_Touch_Screen_Status
        DemDataClassRef = Data_OccurrenceCounter_Touch_Screen_X_Coordinate
        DemDataClassRef = Data_OccurrenceCounter_Touch_Screen_Y_Coordinate
        DemDataClassRef = Data_OccurrenceCounter_Radio_Display_Status
        DemDataClassRef = Data_OccurrenceCounter_TRSKM_and_USS_status
        DemDataClassRef = Data_OccurrenceCounter_TRSC_Stat
        DemDataClassRef = Data_OccurrenceCounter_Camera_Occlusion
        DemDataClassRef = Data_OccurrenceCounter_THA_state
        DemDataClassRef = Data_OccurrenceCounter_DisplayStatus
        DemDataClassRef = Data_OccurrenceCounter_TireLines
        DemDataClassRef = Data_OccurrenceCounter_Calibration_Not_Started
        DemDataClassRef = Data_OccurrenceCounter_Calibration_Pending
        DemDataClassRef = Data_OccurrenceCounter_Calibration_Running
        DemDataClassRef = Data_OccurrenceCounter_Calibrated_Successfully
        DemDataClassRef = Data_OccurrenceCounter_Calibration_Aborted_Failed
        DemDataClassRef = Data_OccurrenceCounter_New_Bit_Field
      FreezeFrame_a2168519 (DemFreezeFrameClass):
        DemDidClassRef = DID_221008_ECU_Life_Time_0x1008
        DemDidClassRef = DID_221009_ECU_Time_Since_Ignition_ON_0x1009
        DemDidClassRef = DID_22200A_Ignition_ON_Counter_0x200a
        DemDidClassRef = DID_222001_Odometer_0x2001
        DemDidClassRef = DID_221004_Battery_Voltage_0x1004
        DemDidClassRef = DID_221921_Operational_Mode_Status_0x1921
        DemDidClassRef = DID_221002_Vehicle_Speed_0x1002
      IgnitionCycle (DemOperationCycle): DemOperationCycleType=DEM_OPCYC_IGNITION
      40 x DemDataClass:
        Data_OccurrenceCounter_Calibrated_Successfully: DemDataElementDataSize=1, DemDataElementDataType=UINT8, DemDataElementUsePort=USE_DATA_CLIENT_SERVER_PORT, DemDataElementStoreNonVolatile=true
        Data_OccurrenceCounter_Calibration_Aborted_Failed: DemDataElementDataSize=1, DemDataElementDataType=UINT8, DemDataElementUsePort=USE_DATA_CLIENT_SERVER_PORT, DemDataElementStoreNonVolatile=true
        Data_OccurrenceCounter_Calibration_Not_Started: DemDataElementDataSize=1, DemDataElementDataType=UINT8, DemDataElementUsePort=USE_DATA_CLIENT_SERVER_PORT, DemDataElementStoreNonVolatile=true
        Data_OccurrenceCounter_Calibration_Pending: DemDataElementDataSize=1, DemDataElementDataType=UINT8, DemDataElementUsePort=USE_DATA_CLIENT_SERVER_PORT, DemDataElementStoreNonVolatile=true
        Data_OccurrenceCounter_Calibration_Running: DemDataElementDataSize=1, DemDataElementDataType=UINT8, DemDataElementUsePort=USE_DATA_CLIENT_SERVER_PORT, DemDataElementStoreNonVolatile=true
        Data_OccurrenceCounter_Camera_Occlusion: DemDataElementDataSize=1, DemDataElementDataType=UINT8, DemDataElementUsePort=USE_DATA_CLIENT_SERVER_PORT, DemDataElementStoreNonVolatile=true
        Data_OccurrenceCounter_Current_Gear: DemDataElementDataSize=1, DemDataElementDataType=UINT8, DemDataElementUsePort=USE_DATA_CLIENT_SERVER_PORT, DemDataElementStoreNonVolatile=true
        Data_OccurrenceCounter_DisplayStatus: DemDataElementDataSize=1, DemDataElementDataType=UINT8, DemDataElementUsePort=USE_DATA_CLIENT_SERVER_PORT, DemDataElementStoreNonVolatile=true
        Data_OccurrenceCounter_Door_Status: DemDataElementDataSize=1, DemDataElementDataType=UINT8, DemDataElementUsePort=USE_DATA_CLIENT_SERVER_PORT, DemDataElementStoreNonVolatile=true
        Data_OccurrenceCounter_ECU_Voltage: DemDataElementDataSize=1, DemDataElementDataType=UINT8, DemDataElementUsePort=USE_DATA_CLIENT_SERVER_PORT, DemDataElementStoreNonVolatile=true
        Data_OccurrenceCounter_LiftgateAjar: DemDataElementDataSize=1, DemDataElementDataType=UINT8, DemDataElementUsePort=USE_DATA_CLIENT_SERVER_PORT, DemDataElementStoreNonVolatile=true
        Data_OccurrenceCounter_New_Bit_Field: DemDataElementDataSize=1, DemDataElementDataType=UINT8, DemDataElementUsePort=USE_DATA_CLIENT_SERVER_PORT, DemDataElementStoreNonVolatile=true
        Data_OccurrenceCounter_Radio_Display_Status: DemDataElementDataSize=1, DemDataElementDataType=UINT8, DemDataElementUsePort=USE_DATA_CLIENT_SERVER_PORT, DemDataElementStoreNonVolatile=true
        Data_OccurrenceCounter_THA_state: DemDataElementDataSize=1, DemDataElementDataType=UINT8, DemDataElementUsePort=USE_DATA_CLIENT_SERVER_PORT, DemDataElementStoreNonVolatile=true
        Data_OccurrenceCounter_TRSC_Stat: DemDataElementDataSize=1, DemDataElementDataType=UINT8, DemDataElementUsePort=USE_DATA_CLIENT_SERVER_PORT, DemDataElementStoreNonVolatile=true
        Data_OccurrenceCounter_TRSKM_and_USS_status: DemDataElementDataSize=1, DemDataElementDataType=UINT8, DemDataElementUsePort=USE_DATA_CLIENT_SERVER_PORT, DemDataElementStoreNonVolatile=true
        Data_OccurrenceCounter_TireLines: DemDataElementDataSize=1, DemDataElementDataType=UINT8, DemDataElementUsePort=USE_DATA_CLIENT_SERVER_PORT, DemDataElementStoreNonVolatile=true
        Data_OccurrenceCounter_Touch_Screen_Status: DemDataElementDataSize=1, DemDataElementDataType=UINT8, DemDataElementUsePort=USE_DATA_CLIENT_SERVER_PORT, DemDataElementStoreNonVolatile=true
        Data_OccurrenceCounter_Aging_Counter_ID: DemDataElementDataSize=2, DemDataElementDataType=UINT16, DemDataElementEndianness=BIG_ENDIAN, DemDataElementUsePort=USE_DATA_CLIENT_SERVER_PORT, DemDataElementStoreNonVolatile=true
        Data_OccurrenceCounter_Cycles_to_Switch_off_the_Warning_Indication_ID: DemDataElementDataSize=2, DemDataElementDataType=UINT16, DemDataElementEndianness=BIG_ENDIAN, DemDataElementUsePort=USE_DATA_CLIENT_SERVER_PORT, DemDataElementStoreNonVolatile=true
        Data_OccurrenceCounter_External_Temperature: DemDataElementDataSize=2, DemDataElementDataType=UINT16, DemDataElementEndianness=BIG_ENDIAN, DemDataElementUsePort=USE_DATA_CLIENT_SERVER_PORT, DemDataElementStoreNonVolatile=true
        Data_OccurrenceCounter_Frequency_Counter_ID: DemDataElementDataSize=2, DemDataElementDataType=UINT16, DemDataElementEndianness=BIG_ENDIAN, DemDataElementUsePort=USE_DATA_CLIENT_SERVER_PORT, DemDataElementStoreNonVolatile=true
        Data_OccurrenceCounter_Steering_Wheel_Angle: DemDataElementDataSize=2, DemDataElementDataType=UINT16, DemDataElementEndianness=BIG_ENDIAN, DemDataElementUsePort=USE_DATA_CLIENT_SERVER_PORT, DemDataElementStoreNonVolatile=true
        Data_OccurrenceCounter_Touch_Screen_X_Coordinate: DemDataElementDataSize=2, DemDataElementDataType=UINT16, DemDataElementEndianness=BIG_ENDIAN, DemDataElementUsePort=USE_DATA_CLIENT_SERVER_PORT, DemDataElementStoreNonVolatile=true
        Data_OccurrenceCounter_Touch_Screen_Y_Coordinate: DemDataElementDataSize=2, DemDataElementDataType=UINT16, DemDataElementEndianness=BIG_ENDIAN, DemDataElementUsePort=USE_DATA_CLIENT_SERVER_PORT, DemDataElementStoreNonVolatile=true
        Data_OccurrenceCounter_Vehicle_Speed: DemDataElementDataSize=2, DemDataElementDataType=UINT16, DemDataElementEndianness=BIG_ENDIAN, DemDataElementUsePort=USE_DATA_CLIENT_SERVER_PORT, DemDataElementStoreNonVolatile=true
        Data_OccurrenceCounter_Odometer_Value: DemDataElementDataSize=3, DemDataElementDataType=UINT8_N, DemDataElementEndianness=opaque, DemDataElementUsePort=USE_DATA_CLIENT_SERVER_PORT, DemDataElementStoreNonVolatile=true
        Data_OccurrenceCounter_Supplier_Internal_Code: DemDataElementDataSize=9, DemDataElementDataType=UINT8_N, DemDataElementEndianness=opaque, DemDataElementUsePort=USE_DATA_CLIENT_SERVER_PORT, DemDataElementStoreNonVolatile=true
        Data_DID_0x1004_Battery_Voltage_24: DemDataElementDataSize=1, DemDataElementDataType=UINT8_N, DemDataElementEndianness=opaque, DemDataElementUsePort=USE_DATA_CLIENT_SERVER_PORT, DemDataElementStoreNonVolatile=true
        Data_DID_0x1009_ECU_Time_Since_Ignition_ON: DemDataElementDataSize=2, DemDataElementDataType=UINT8_N, DemDataElementEndianness=opaque, DemDataElementUsePort=USE_DATA_CLIENT_SERVER_PORT, DemDataElementStoreNonVolatile=true
        Data_DID_0x200a_Ignition_ON_Counter_24: DemDataElementDataSize=2, DemDataElementDataType=UINT8_N, DemDataElementEndianness=opaque, DemDataElementUsePort=USE_DATA_CLIENT_SERVER_PORT, DemDataElementStoreNonVolatile=true
        Data_DID_0x2001_Odometer_24: DemDataElementDataSize=2, DemDataElementDataType=UINT8_N, DemDataElementEndianness=opaque, DemDataElementUsePort=USE_DATA_CLIENT_SERVER_PORT, DemDataElementStoreNonVolatile=true
        Data_DID_0x1002_Vehicle_Speed_24: DemDataElementDataSize=2, DemDataElementDataType=UINT8_N, DemDataElementEndianness=opaque, DemDataElementUsePort=USE_DATA_CLIENT_SERVER_PORT, DemDataElementStoreNonVolatile=true
        Data_DID_0x1008_ECU_Life_Time_24: DemDataElementDataSize=3, DemDataElementDataType=UINT8_N, DemDataElementEndianness=opaque, DemDataElementUsePort=USE_DATA_CLIENT_SERVER_PORT, DemDataElementStoreNonVolatile=true
        Data_DID_0x1921_CombinedSignal: DemDataElementDataSize=9, DemDataElementDataType=UINT8_N, DemDataElementEndianness=opaque, DemDataElementUsePort=USE_DATA_CLIENT_SERVER_PORT, DemDataElementStoreNonVolatile=true
        Data_OccurrenceCounter_Reserved: DemDataElementDataSize=1, DemDataElementUsePort=USE_DATA_CLIENT_SERVER_PORT, DemDataElementStoreNonVolatile=true
        Data_OccurrenceCounter_Reserved_1: DemDataElementDataSize=1, DemDataElementUsePort=USE_DATA_CLIENT_SERVER_PORT, DemDataElementStoreNonVolatile=true
        Data_OccurrenceCounter_Reserved_2: DemDataElementDataSize=1, DemDataElementUsePort=USE_DATA_CLIENT_SERVER_PORT, DemDataElementStoreNonVolatile=true
        Data_OccurrenceCounter_DID_DataObject: DemDataElementDataSize=1, DemDataElementInternalData=DEM_OCCCTR, DemDataElementUsePort=USE_DATA_INTERNAL
        Data_OccurrenceCounter_Aging_Counter: DemDataElementDataSize=1, DemDataElementInternalData=DEM_AGINGCTR_UPCNT, DemDataElementUsePort=USE_DATA_INTERNAL
