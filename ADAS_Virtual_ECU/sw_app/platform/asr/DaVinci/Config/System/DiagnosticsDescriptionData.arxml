[part 1 of 2: package /InitialEcuC]
AUTOSAR XML (schema 00048)
package /InitialEcuC
  ecuc value collection InitialEcuC: ecuc-values=[Dcm, Dem]
  module config Dcm: module-description=Dcm_Impl
    DcmConfigSet
      DcmGeneral: DcmResetToFblAfterSessionFinalResponseEnabled=false
      DcmDsd
        DcmDsdServiceTable
          15 x DcmDsdService:
            DiagSessionControl: DcmDsdSidTabServiceId=16, DcmDsdSidTabSubfuncAvail=true
              3 x DcmDsdSubService:
                Default: DcmDsdSubServiceId=1
                Programming: DcmDsdSubServiceId=2
                Extended: DcmDsdSubServiceId=3
            EcuReset: DcmDsdSidTabServiceId=17, DcmDsdSidTabSubfuncAvail=true
              Hard (DcmDsdSubService): DcmDsdSubServiceId=1
            ClearDiagInfo: DcmDsdSidTabServiceId=20, DcmDsdSidTabSubfuncAvail=false, DcmDsdSidTabSessionLevelRef=Default_Session, DcmDsdSidTabSessionLevelRef=Extended_Diagnostic_Session
            ReadDtcInfo: DcmDsdSidTabServiceId=25, DcmDsdSidTabSubfuncAvail=true
              10 x DcmDsdSubService:
                RNODTCBSM: DcmDsdSubServiceId=1, DcmDsdSubServiceSessionLevelRef=Default_Session, DcmDsdSubServiceSessionLevelRef=Extended_Diagnostic_Session
                RDTCBSM: DcmDsdSubServiceId=2
                RDTCSSBDTC: DcmDsdSubServiceId=4, DcmDsdSubServiceSessionLevelRef=Default_Session, DcmDsdSubServiceSessionLevelRef=Extended_Diagnostic_Session
                RDTCEDRBDN: DcmDsdSubServiceId=6, DcmDsdSubServiceSessionLevelRef=Default_Session, DcmDsdSubServiceSessionLevelRef=Extended_Diagnostic_Session
                RNODTCBSMR: DcmDsdSubServiceId=7, DcmDsdSubServiceSessionLevelRef=Default_Session, DcmDsdSubServiceSessionLevelRef=Extended_Diagnostic_Session
                RDTCBSMR: DcmDsdSubServiceId=8, DcmDsdSubServiceSessionLevelRef=Default_Session, DcmDsdSubServiceSessionLevelRef=Extended_Diagnostic_Session
                RSIODTC: DcmDsdSubServiceId=9, DcmDsdSubServiceSessionLevelRef=Default_Session, DcmDsdSubServiceSessionLevelRef=Extended_Diagnostic_Session
                RSUPDTC: DcmDsdSubServiceId=10, DcmDsdSubServiceSessionLevelRef=Default_Session, DcmDsdSubServiceSessionLevelRef=Extended_Diagnostic_Session
                RFCDTC: DcmDsdSubServiceId=12, DcmDsdSubServiceSessionLevelRef=Default_Session, DcmDsdSubServiceSessionLevelRef=Extended_Diagnostic_Session
                RMRCDTC: DcmDsdSubServiceId=14, DcmDsdSubServiceSessionLevelRef=Default_Session, DcmDsdSubServiceSessionLevelRef=Extended_Diagnostic_Session
            ReadDataById: DcmDsdSidTabServiceId=34, DcmDsdSidTabSubfuncAvail=false
            SecurityAccess: DcmDsdSidTabServiceId=39, DcmDsdSidTabSubfuncAvail=true, DcmDsdSidTabSessionLevelRef=Programming_Session, DcmDsdSidTabSessionLevelRef=Extended_Diagnostic_Session
              Authenticated_Diagnostics_Access_Request_Challenge_Request (DcmDsdSubService): DcmDsdSubServiceId=17, DcmDsdSubServiceSessionLevelRef=Programming_Session, DcmDsdSubServiceSessionLevelRef=Extended_Diagnostic_Session
              Authenticated_Diagnostics_Access_Send_Signed_Challenge_Send (DcmDsdSubService): DcmDsdSubServiceId=18, DcmDsdSubServiceSessionLevelRef=Programming_Session, DcmDsdSubServiceSessionLevelRef=Extended_Diagnostic_Session
            CommunicationControl: DcmDsdSidTabServiceId=40, DcmDsdSidTabSubfuncAvail=true, DcmDsdSidTabSessionLevelRef=Extended_Diagnostic_Session
              EnableRxAndTx (DcmDsdSubService): DcmDsdSubServiceId=0, DcmDsdSubServiceSessionLevelRef=Extended_Diagnostic_Session
              EnableRxAndDisableTx (DcmDsdSubService): DcmDsdSubServiceId=1, DcmDsdSubServiceSessionLevelRef=Extended_Diagnostic_Session
            WriteDataById: DcmDsdSidTabServiceId=46, DcmDsdSidTabSubfuncAvail=false
            IoControlById: DcmDsdSidTabServiceId=47, DcmDsdSidTabSubfuncAvail=false, DcmDsdSidTabSessionLevelRef=Extended_Diagnostic_Session, DcmDsdSidTabSecurityLevelRef=Authenticated_Diagnostic_Access
            RoutineControl: DcmDsdSidTabServiceId=49, DcmDsdSidTabSubfuncAvail=true
            RequestDownload: DcmDsdSidTabServiceId=52, DcmDsdSidTabSubfuncAvail=false, DcmDsdSidTabSessionLevelRef=Programming_Session, DcmDsdSidTabSecurityLevelRef=Authenticated_Diagnostic_Access
            TransferData: DcmDsdSidTabServiceId=54, DcmDsdSidTabSubfuncAvail=false, DcmDsdSidTabSessionLevelRef=Programming_Session
            RequestTransferExit: DcmDsdSidTabServiceId=55, DcmDsdSidTabSubfuncAvail=false, DcmDsdSidTabSessionLevelRef=Programming_Session
            TesterPresent: DcmDsdSidTabServiceId=62, DcmDsdSidTabSubfuncAvail=true
              TesterPresent (DcmDsdSubService): DcmDsdSubServiceId=0
            ControlDtcSetting: DcmDsdSidTabServiceId=133, DcmDsdSidTabSubfuncAvail=true, DcmDsdSidTabSessionLevelRef=Extended_Diagnostic_Session
              Enable (DcmDsdSubService): DcmDsdSubServiceId=1, DcmDsdSubServiceSessionLevelRef=Extended_Diagnostic_Session
              Disable (DcmDsdSubService): DcmDsdSubServiceId=2, DcmDsdSubServiceSessionLevelRef=Extended_Diagnostic_Session
      DcmDsp: DcmDspMaxDidToRead=10
        Data_220103_VIN_Lock_Status (DcmDspData): DcmDspDataSize=16, DcmDspDataType=UINT8_N, DcmDspDataInfoRef=DataInfo_DataInfo_220103_VIN_Lock_Status
        DataInfo_DataInfo_220103_VIN_Lock_Status (DcmDspDataInfo): DcmDspDataFixedLength=true
        Data_220107_RoE_Activation_State (DcmDspData): DcmDspDataSize=8, DcmDspDataType=UINT8_N, DcmDspDataInfoRef=DataInfo_DataInfo_220107_RoE_Activation_State
        DataInfo_DataInfo_220107_RoE_Activation_State (DcmDspDataInfo): DcmDspDataFixedLength=true
        Data_220108_Authenticated_Diagnostics_Active_Role_Read (DcmDspData): DcmDspDataSize=32, DcmDspDataType=UINT8_N, DcmDspDataInfoRef=DataInfo_DataInfo_220108_Authenticated_Diagnostics_Active_Role_Read
        DataInfo_DataInfo_220108_Authenticated_Diagnostics_Active_Role_Read (DcmDspDataInfo): DcmDspDataFixedLength=true
        Data_221002_Vehicle_Speed (DcmDspData): DcmDspDataSize=16, DcmDspDataType=UINT8_N, DcmDspDataInfoRef=DataInfo_DataInfo_221002_Vehicle_Speed
        DataInfo_DataInfo_221002_Vehicle_Speed (DcmDspDataInfo): DcmDspDataFixedLength=true
        Data_221004_Battery_Voltage (DcmDspData): DcmDspDataSize=8, DcmDspDataType=UINT8_N, DcmDspDataInfoRef=DataInfo_DataInfo_221004_Battery_Voltage
        DataInfo_DataInfo_221004_Battery_Voltage (DcmDspDataInfo): DcmDspDataFixedLength=true
        Data_221008_ECU_Life_Time (DcmDspData): DcmDspDataSize=24, DcmDspDataType=UINT8_N, DcmDspDataInfoRef=DataInfo_DataInfo_221008_ECU_Life_Time
        DataInfo_DataInfo_221008_ECU_Life_Time (DcmDspDataInfo): DcmDspDataFixedLength=true
        Data_221009_ECU_Time_Since_Ignition_ON (DcmDspData): DcmDspDataSize=16, DcmDspDataType=UINT8_N, DcmDspDataInfoRef=DataInfo_DataInfo_221009_ECU_Time_Since_Ignition_ON
        DataInfo_DataInfo_221009_ECU_Time_Since_Ignition_ON (DcmDspDataInfo): DcmDspDataFixedLength=true
        Data_22100B_Diagnostic_Tool_and_Session_Status (DcmDspData): DcmDspDataSize=8, DcmDspDataType=UINT8_N, DcmDspDataInfoRef=DataInfo_DataInfo_22100B_Diagnostic_Tool_and_Session_Status
        DataInfo_DataInfo_22100B_Diagnostic_Tool_and_Session_Status (DcmDspDataInfo): DcmDspDataFixedLength=true
        Data_22100C_Security_Status_Read (DcmDspData): DcmDspDataSize=40, DcmDspDataType=UINT8_N, DcmDspDataInfoRef=DataInfo_DataInfo_22100C_Security_Status_Read
        DataInfo_DataInfo_22100C_Security_Status_Read (DcmDspDataInfo): DcmDspDataFixedLength=true
        Data_22102A_Check_EOL_Configuration_Data (DcmDspData): DcmDspDataSize=72, DcmDspDataType=UINT8_N, DcmDspDataInfoRef=DataInfo_DataInfo_22102A_Check_EOL_Configuration_Data
        DataInfo_DataInfo_22102A_Check_EOL_Configuration_Data (DcmDspDataInfo): DcmDspDataFixedLength=true
        Data_22191D_Time_of_Power_Latch (DcmDspData): DcmDspDataSize=8, DcmDspDataType=UINT8_N, DcmDspDataInfoRef=DataInfo_DataInfo_22191D_Time_of_Power_Latch
        DataInfo_DataInfo_22191D_Time_of_Power_Latch (DcmDspDataInfo): DcmDspDataFixedLength=true
        Data_221921_Operational_Mode_Status (DcmDspData): DcmDspDataSize=72, DcmDspDataType=UINT8_N, DcmDspDataInfoRef=DataInfo_DataInfo_221921_Operational_Mode_Status
        DataInfo_DataInfo_221921_Operational_Mode_Status (DcmDspDataInfo): DcmDspDataFixedLength=true
        Data_222001_Odometer (DcmDspData): DcmDspDataSize=16, DcmDspDataType=UINT8_N, DcmDspDataInfoRef=DataInfo_DataInfo_222001_Odometer
        DataInfo_DataInfo_222001_Odometer (DcmDspDataInfo): DcmDspDataFixedLength=true
        Data_222002_Odometer_at_last_Flash_programming (DcmDspData): DcmDspDataSize=16, DcmDspDataType=UINT8_N, DcmDspDataInfoRef=DataInfo_DataInfo_222002_Odometer_at_last_Flash_programming
        DataInfo_DataInfo_222002_Odometer_at_last_Flash_programming (DcmDspDataInfo): DcmDspDataFixedLength=true
        Data_222003_Boot_Software_Programming_Attempt_Counter (DcmDspData): DcmDspDataSize=32, DcmDspDataType=UINT8_N, DcmDspDataInfoRef=DataInfo_DataInfo_222003_Boot_Software_Programming_Attempt_Counter
        DataInfo_DataInfo_222003_Boot_Software_Programming_Attempt_Counter (DcmDspDataInfo): DcmDspDataFixedLength=true
        Data_222008_ECU_Life_Time_Not_Volatile_Memory (DcmDspData): DcmDspDataSize=24, DcmDspDataType=UINT8_N, DcmDspDataInfoRef=DataInfo_DataInfo_222008_ECU_Life_Time_Not_Volatile_Memory
        DataInfo_DataInfo_222008_ECU_Life_Time_Not_Volatile_Memory (DcmDspDataInfo): DcmDspDataFixedLength=true
        Data_22200A_Ignition_ON_Counter (DcmDspData): DcmDspDataSize=16, DcmDspDataType=UINT8_N, DcmDspDataInfoRef=DataInfo_DataInfo_22200A_Ignition_ON_Counter
        DataInfo_DataInfo_22200A_Ignition_ON_Counter (DcmDspDataInfo): DcmDspDataFixedLength=true
        Data_22200B_Time_First_DTC_Detection (DcmDspData): DcmDspDataSize=24, DcmDspDataType=UINT8_N, DcmDspDataInfoRef=DataInfo_DataInfo_22200B_Time_First_DTC_Detection
        DataInfo_DataInfo_22200B_Time_First_DTC_Detection (DcmDspDataInfo): DcmDspDataFixedLength=true
        Data_22200C_Time_Since_Ignition_ON_of_first_DTC_Detection (DcmDspData): DcmDspDataSize=16, DcmDspDataType=UINT8_N, DcmDspDataInfoRef=DataInfo_DataInfo_22200C_Time_Since_Ignition_ON_of_first_DTC_Detection
        DataInfo_DataInfo_22200C_Time_Since_Ignition_ON_of_first_DTC_Detection (DcmDspDataInfo): DcmDspDataFixedLength=true
        Data_22200D_Odometer_Last_Clear_Data_Trouble_Code_DTC (DcmDspData): DcmDspDataSize=16, DcmDspDataType=UINT8_N, DcmDspDataInfoRef=DataInfo_DataInfo_22200D_Odometer_Last_Clear_Data_Trouble_Code_DTC
        DataInfo_DataInfo_22200D_Odometer_Last_Clear_Data_Trouble_Code_DTC (DcmDspDataInfo): DcmDspDataFixedLength=true
        Data_222010_Programming_Status (DcmDspData): DcmDspDataSize=16, DcmDspDataType=UINT8_N, DcmDspDataInfoRef=DataInfo_DataInfo_222010_Programming_Status
        DataInfo_DataInfo_222010_Programming_Status (DcmDspDataInfo): DcmDspDataFixedLength=true
        Data_222013_VIN_Lock_State_Read (DcmDspData): DcmDspDataSize=8, DcmDspDataType=UINT8_N, DcmDspDataInfoRef=DataInfo_DataInfo_222013_VIN_Lock_State_Read
        DataInfo_DataInfo_222013_VIN_Lock_State_Read (DcmDspDataInfo): DcmDspDataFixedLength=true
        Data_22201A_Application_Software_Programming_Attempt_Counter (DcmDspData): DcmDspDataSize=160, DcmDspDataType=UINT8_N, DcmDspDataInfoRef=DataInfo_DataInfo_22201A_Application_Software_Programming_Attempt_Counter
        DataInfo_DataInfo_22201A_Application_Software_Programming_Attempt_Counter (DcmDspDataInfo): DcmDspDataFixedLength=true
        Data_22201B_Application_Data_Software_Programming_Attempt_Counter (DcmDspData): DcmDspDataSize=96, DcmDspDataType=UINT8_N, DcmDspDataInfoRef=DataInfo_DataInfo_22201B_Application_Data_Software_Programming_Attempt_Counter
        DataInfo_DataInfo_22201B_Application_Data_Software_Programming_Attempt_Counter (DcmDspDataInfo): DcmDspDataFixedLength=true
        Data_22201F_Boot_Failure_Reason_Read (DcmDspData): DcmDspDataSize=16, DcmDspDataType=UINT8_N, DcmDspDataInfoRef=DataInfo_DataInfo_22201F_Boot_Failure_Reason_Read
        DataInfo_DataInfo_22201F_Boot_Failure_Reason_Read (DcmDspDataInfo): DcmDspDataFixedLength=true
        Data_2E2023_PROXI_Data (DcmDspData): DcmDspDataSize=2040, DcmDspDataType=UINT8_N, DcmDspDataInfoRef=DataInfo_DataInfo_2E2023_PROXI_Data
        DataInfo_DataInfo_2E2023_PROXI_Data (DcmDspDataInfo): DcmDspDataFixedLength=false
        Data_222024_Read_ECU_PROXI_Data (DcmDspData): DcmDspDataSize=2040, DcmDspDataType=UINT8_N, DcmDspDataInfoRef=DataInfo_DataInfo_222024_Read_ECU_PROXI_Data
        DataInfo_DataInfo_222024_Read_ECU_PROXI_Data (DcmDspDataInfo): DcmDspDataFixedLength=false
        Data_222026_CAN_Overrun_Counters (DcmDspData): DcmDspDataSize=64, DcmDspDataType=UINT8_N, DcmDspDataInfoRef=DataInfo_DataInfo_222026_CAN_Overrun_Counters
        DataInfo_DataInfo_222026_CAN_Overrun_Counters (DcmDspDataInfo): DcmDspDataFixedLength=true
        Data_222030_Authenticated_Diagnostic_Previous_Access_Read (DcmDspData): DcmDspDataSize=7680, DcmDspDataType=UINT8_N, DcmDspDataInfoRef=DataInfo_DataInfo_222030_Authenticated_Diagnostic_Previous_Access_Read
        DataInfo_DataInfo_222030_Authenticated_Diagnostic_Previous_Access_Read (DcmDspDataInfo): DcmDspDataFixedLength=true
        Data_222031_Disallowed_Certificate_List_Read (DcmDspData): DcmDspDataSize=24576, DcmDspDataType=UINT8_N, DcmDspDataInfoRef=DataInfo_DataInfo_222031_Disallowed_Certificate_List_Read
        DataInfo_DataInfo_222031_Disallowed_Certificate_List_Read (DcmDspDataInfo): DcmDspDataFixedLength=true
        Data_222032_Secure_Log_Read (DcmDspData): DcmDspDataSize=10368, DcmDspDataType=UINT8_N, DcmDspDataInfoRef=DataInfo_DataInfo_222032_Secure_Log_Read
        DataInfo_DataInfo_222032_Secure_Log_Read (DcmDspDataInfo): DcmDspDataFixedLength=true
        Data_22292E_PROXI_Write_Counter (DcmDspData): DcmDspDataSize=8, DcmDspDataType=UINT8_N, DcmDspDataInfoRef=DataInfo_DataInfo_22292E_PROXI_Write_Counter
        DataInfo_DataInfo_22292E_PROXI_Write_Counter (DcmDspDataInfo): DcmDspDataFixedLength=true
        Data_222939_FDCAN2_BUS_Network_WakeUp_Reason (DcmDspData): DcmDspDataSize=192, DcmDspDataType=UINT8_N, DcmDspDataInfoRef=DataInfo_DataInfo_222939_FDCAN2_BUS_Network_WakeUp_Reason
        DataInfo_DataInfo_222939_FDCAN2_BUS_Network_WakeUp_Reason (DcmDspDataInfo): DcmDspDataFixedLength=true
        Data_222945_Flow_Control_Test (DcmDspData): DcmDspDataSize=1600, DcmDspDataType=UINT8_N, DcmDspDataInfoRef=DataInfo_DataInfo_222945_Flow_Control_Test
        DataInfo_DataInfo_222945_Flow_Control_Test (DcmDspDataInfo): DcmDspDataFixedLength=true
        Data_222951_Certificate_Store_UUID_Read (DcmDspData): DcmDspDataSize=128, DcmDspDataType=UINT8_N, DcmDspDataInfoRef=DataInfo_DataInfo_222951_Certificate_Store_UUID_Read
        DataInfo_DataInfo_222951_Certificate_Store_UUID_Read (DcmDspDataInfo): DcmDspDataFixedLength=true
        Data_222954_Policy_Type_Read (DcmDspData): DcmDspDataSize=8, DcmDspDataType=UINT8_N, DcmDspDataInfoRef=DataInfo_DataInfo_222954_Policy_Type_Read
        DataInfo_DataInfo_222954_Policy_Type_Read (DcmDspDataInfo): DcmDspDataFixedLength=true
        Data_222957_Hosted_App_Firmware_Header_Info_Read (DcmDspData): DcmDspDataSize=8448, DcmDspDataType=UINT8_N, DcmDspDataInfoRef=DataInfo_DataInfo_222957_Hosted_App_Firmware_Header_Info_Read
        DataInfo_DataInfo_222957_Hosted_App_Firmware_Header_Info_Read (DcmDspDataInfo): DcmDspDataFixedLength=true
        Data_222958_Hosted_App_firmware_Header_UUID_Read (DcmDspData): DcmDspDataSize=768, DcmDspDataType=UINT8_N, DcmDspDataInfoRef=DataInfo_DataInfo_222958_Hosted_App_firmware_Header_UUID_Read
        DataInfo_DataInfo_222958_Hosted_App_firmware_Header_UUID_Read (DcmDspDataInfo): DcmDspDataFixedLength=true
        Data_222959_Hosted_App_Firmware_Cal_Config_Data_Header_Info_Read (DcmDspData): DcmDspDataSize=2816, DcmDspDataType=UINT8_N, DcmDspDataInfoRef=DataInfo_DataInfo_222959_Hosted_App_Firmware_Cal_Config_Data_Header_Info_Read
        DataInfo_DataInfo_222959_Hosted_App_Firmware_Cal_Config_Data_Header_Info_Read (DcmDspDataInfo): DcmDspDataFixedLength=true
        Data_22295A_Hosted_App_Firmware_Cal_Config_Data_Header_UUID_Read (DcmDspData): DcmDspDataSize=256, DcmDspDataType=UINT8_N, DcmDspDataInfoRef=DataInfo_DataInfo_22295A_Hosted_App_Firmware_Cal_Config_Data_Header_UUID_Read
        DataInfo_DataInfo_22295A_Hosted_App_Firmware_Cal_Config_Data_Header_UUID_Read (DcmDspDataInfo): DcmDspDataFixedLength=true
        Data_22295B_HTA_Header_Info_Read (DcmDspData): DcmDspDataSize=1408, DcmDspDataType=UINT8_N, DcmDspDataInfoRef=DataInfo_DataInfo_22295B_HTA_Header_Info_Read
        DataInfo_DataInfo_22295B_HTA_Header_Info_Read (DcmDspDataInfo): DcmDspDataFixedLength=true
        Data_22295C_HTA_Header_UUID_Read (DcmDspData): DcmDspDataSize=128, DcmDspDataType=UINT8_N, DcmDspDataInfoRef=DataInfo_DataInfo_22295C_HTA_Header_UUID_Read
        DataInfo_DataInfo_22295C_HTA_Header_UUID_Read (DcmDspDataInfo): DcmDspDataFixedLength=true
        Data_22295E_DCL_Header_UUID_Read (DcmDspData): DcmDspDataSize=128, DcmDspDataType=UINT8_N, DcmDspDataInfoRef=DataInfo_DataInfo_22295E_DCL_Header_UUID_Read
        DataInfo_DataInfo_22295E_DCL_Header_UUID_Read (DcmDspDataInfo): DcmDspDataFixedLength=true
        Data_22295F_DCL_and_Cerstore_Header_Info_Read (DcmDspData): DcmDspDataSize=1408, DcmDspDataType=UINT8_N, DcmDspDataInfoRef=DataInfo_DataInfo_22295F_DCL_and_Cerstore_Header_Info_Read
        DataInfo_DataInfo_22295F_DCL_and_Cerstore_Header_Info_Read (DcmDspDataInfo): DcmDspDataFixedLength=true
        Data_224421_USS_Sensor_1_Part_Number_Read (DcmDspData): DcmDspDataSize=104, DcmDspDataType=UINT8_N, DcmDspDataInfoRef=DataInfo_DataInfo_224421_USS_Sensor_1_Part_Number_Read
        DataInfo_DataInfo_224421_USS_Sensor_1_Part_Number_Read (DcmDspDataInfo): DcmDspDataFixedLength=true
        Data_224422_USS_Sensor2_Part_Number_Read (DcmDspData): DcmDspDataSize=104, DcmDspDataType=UINT8_N, DcmDspDataInfoRef=DataInfo_DataInfo_224422_USS_Sensor2_Part_Number_Read
        DataInfo_DataInfo_224422_USS_Sensor2_Part_Number_Read (DcmDspDataInfo): DcmDspDataFixedLength=true
        Data_224423_USS_Sensor_3_Part_Number_Read (DcmDspData): DcmDspDataSize=104, DcmDspDataType=UINT8_N, DcmDspDataInfoRef=DataInfo_DataInfo_224423_USS_Sensor_3_Part_Number_Read
        DataInfo_DataInfo_224423_USS_Sensor_3_Part_Number_Read (DcmDspDataInfo): DcmDspDataFixedLength=true
        Data_224424_USS_Sensor_4_Part_Number_Read (DcmDspData): DcmDspDataSize=104, DcmDspDataType=UINT8_N, DcmDspDataInfoRef=DataInfo_DataInfo_224424_USS_Sensor_4_Part_Number_Read
        DataInfo_DataInfo_224424_USS_Sensor_4_Part_Number_Read (DcmDspDataInfo): DcmDspDataFixedLength=true
        Data_224425_USS_Sensor_5_Part_Number_Read (DcmDspData): DcmDspDataSize=104, DcmDspDataType=UINT8_N, DcmDspDataInfoRef=DataInfo_DataInfo_224425_USS_Sensor_5_Part_Number_Read
        DataInfo_DataInfo_224425_USS_Sensor_5_Part_Number_Read (DcmDspDataInfo): DcmDspDataFixedLength=true
        Data_224426_USS_Sensor_6_Part_Number_Read (DcmDspData): DcmDspDataSize=104, DcmDspDataType=UINT8_N, DcmDspDataInfoRef=DataInfo_DataInfo_224426_USS_Sensor_6_Part_Number_Read
        DataInfo_DataInfo_224426_USS_Sensor_6_Part_Number_Read (DcmDspDataInfo): DcmDspDataFixedLength=true
        Data_224427_USS_Sensor_7_Part_Number_Read (DcmDspData): DcmDspDataSize=104, DcmDspDataType=UINT8_N, DcmDspDataInfoRef=DataInfo_DataInfo_224427_USS_Sensor_7_Part_Number_Read
        DataInfo_DataInfo_224427_USS_Sensor_7_Part_Number_Read (DcmDspDataInfo): DcmDspDataFixedLength=true
        Data_224428_USS_Sensor_8_Part_Number_Read (DcmDspData): DcmDspDataSize=104, DcmDspDataType=UINT8_N, DcmDspDataInfoRef=DataInfo_DataInfo_224428_USS_Sensor_8_Part_Number_Read
        DataInfo_DataInfo_224428_USS_Sensor_8_Part_Number_Read (DcmDspDataInfo): DcmDspDataFixedLength=true
        Data_224429_USS_Sensor_9_Part_Number_Read (DcmDspData): DcmDspDataSize=104, DcmDspDataType=UINT8_N, DcmDspDataInfoRef=DataInfo_DataInfo_224429_USS_Sensor_9_Part_Number_Read
        DataInfo_DataInfo_224429_USS_Sensor_9_Part_Number_Read (DcmDspDataInfo): DcmDspDataFixedLength=true
        Data_22442A_USS_Sensor_10_Part_Number_Read (DcmDspData): DcmDspDataSize=104, DcmDspDataType=UINT8_N, DcmDspDataInfoRef=DataInfo_DataInfo_22442A_USS_Sensor_10_Part_Number_Read
        DataInfo_DataInfo_22442A_USS_Sensor_10_Part_Number_Read (DcmDspDataInfo): DcmDspDataFixedLength=true
        Data_22442B_USS_Sensor_11_Part_Number_Read (DcmDspData): DcmDspDataSize=104, DcmDspDataType=UINT8_N, DcmDspDataInfoRef=DataInfo_DataInfo_22442B_USS_Sensor_11_Part_Number_Read
        DataInfo_DataInfo_22442B_USS_Sensor_11_Part_Number_Read (DcmDspDataInfo): DcmDspDataFixedLength=true
        Data_22442C_USS_Sensor_12_Part_Number_Read (DcmDspData): DcmDspDataSize=104, DcmDspDataType=UINT8_N, DcmDspDataInfoRef=DataInfo_DataInfo_22442C_USS_Sensor_12_Part_Number_Read
        DataInfo_DataInfo_22442C_USS_Sensor_12_Part_Number_Read (DcmDspDataInfo): DcmDspDataFixedLength=true
        Data_224451_EOL_Calibration_State_Read (DcmDspData): DcmDspDataSize=352, DcmDspDataType=UINT8_N, DcmDspDataInfoRef=DataInfo_DataInfo_224451_EOL_Calibration_State_Read
        DataInfo_DataInfo_224451_EOL_Calibration_State_Read (DcmDspDataInfo): DcmDspDataFixedLength=true
        Data_2F5001_Gear_Position_Read (DcmDspData): DcmDspDataConditionCheckReadFncUsed=false, DcmDspDataSize=8, DcmDspDataType=UINT8_N, DcmDspDataInfoRef=DataInfo_DataInfo_2F5001_Gear_Position_Read
        DataInfo_DataInfo_2F5001_Gear_Position_Read (DcmDspDataInfo): DcmDspDataFixedLength=true
        Data_225100_SPM_status_Read (DcmDspData): DcmDspDataSize=32, DcmDspDataType=UINT8_N, DcmDspDataInfoRef=DataInfo_DataInfo_225100_SPM_status_Read
        DataInfo_DataInfo_225100_SPM_status_Read (DcmDspDataInfo): DcmDspDataFixedLength=true
        Data_225102_FD_CAN14_Rx_Signals_Read (DcmDspData): DcmDspDataSize=272, DcmDspDataType=UINT8_N, DcmDspDataInfoRef=DataInfo_DataInfo_225102_FD_CAN14_Rx_Signals_Read
        DataInfo_DataInfo_225102_FD_CAN14_Rx_Signals_Read (DcmDspDataInfo): DcmDspDataFixedLength=true
        Data_225103_FD_CAN2_Rx_Signals_Read (DcmDspData): DcmDspDataSize=328, DcmDspDataType=UINT8_N, DcmDspDataInfoRef=DataInfo_DataInfo_225103_FD_CAN2_Rx_Signals_Read
        DataInfo_DataInfo_225103_FD_CAN2_Rx_Signals_Read (DcmDspDataInfo): DcmDspDataFixedLength=true
        Data_225104_FD_CAN14_Tx_Signals_Read (DcmDspData): DcmDspDataSize=40, DcmDspDataType=UINT8_N, DcmDspDataInfoRef=DataInfo_DataInfo_225104_FD_CAN14_Tx_Signals_Read
        DataInfo_DataInfo_225104_FD_CAN14_Tx_Signals_Read (DcmDspDataInfo): DcmDspDataFixedLength=true
        Data_225105_FD_CAN2_Tx_Signals_Read (DcmDspData): DcmDspDataSize=152, DcmDspDataType=UINT8_N, DcmDspDataInfoRef=DataInfo_DataInfo_225105_FD_CAN2_Tx_Signals_Read
        DataInfo_DataInfo_225105_FD_CAN2_Tx_Signals_Read (DcmDspDataInfo): DcmDspDataFixedLength=true
        Data_225107_Front_Sensor_HealthBlockage_LiveDetection_Check_Read (DcmDspData): DcmDspDataSize=120, DcmDspDataType=UINT8_N, DcmDspDataInfoRef=DataInfo_DataInfo_225107_Front_Sensor_HealthBlockage_LiveDetection_Check_Read
        DataInfo_DataInfo_225107_Front_Sensor_HealthBlockage_LiveDetection_Check_Read (DcmDspDataInfo): DcmDspDataFixedLength=true
        Data_225109_Rear_Sensor_HealthBlockage_LiveDetection_Check_Read (DcmDspData): DcmDspDataSize=120, DcmDspDataType=UINT8_N, DcmDspDataInfoRef=DataInfo_DataInfo_225109_Rear_Sensor_HealthBlockage_LiveDetection_Check_Read
        DataInfo_DataInfo_225109_Rear_Sensor_HealthBlockage_LiveDetection_Check_Read (DcmDspDataInfo): DcmDspDataFixedLength=true
        Data_225201_Plant_Mode_Status_Read (DcmDspData): DcmDspDataSize=8, DcmDspDataType=UINT8_N, DcmDspDataInfoRef=DataInfo_DataInfo_225201_Plant_Mode_Status_Read
        DataInfo_DataInfo_225201_Plant_Mode_Status_Read (DcmDspDataInfo): DcmDspDataFixedLength=true
        Data_225300_Rear_Braking_Event_1_Read (DcmDspData): DcmDspDataSize=112, DcmDspDataType=UINT8_N, DcmDspDataInfoRef=DataInfo_DataInfo_225300_Rear_Braking_Event_1_Read
        DataInfo_DataInfo_225300_Rear_Braking_Event_1_Read (DcmDspDataInfo): DcmDspDataFixedLength=true
        Data_225301_Rear_Braking_Event_2_Read (DcmDspData): DcmDspDataSize=112, DcmDspDataType=UINT8_N, DcmDspDataInfoRef=DataInfo_DataInfo_225301_Rear_Braking_Event_2_Read
        DataInfo_DataInfo_225301_Rear_Braking_Event_2_Read (DcmDspDataInfo): DcmDspDataFixedLength=true
        Data_225302_Rear_Braking_Event_3_Read (DcmDspData): DcmDspDataSize=112, DcmDspDataType=UINT8_N, DcmDspDataInfoRef=DataInfo_DataInfo_225302_Rear_Braking_Event_3_Read
        DataInfo_DataInfo_225302_Rear_Braking_Event_3_Read (DcmDspDataInfo): DcmDspDataFixedLength=true
        Data_225303_SPM_Event_Abort_1_Read (DcmDspData): DcmDspDataSize=96, DcmDspDataType=UINT8_N, DcmDspDataInfoRef=DataInfo_DataInfo_225303_SPM_Event_Abort_1_Read
        DataInfo_DataInfo_225303_SPM_Event_Abort_1_Read (DcmDspDataInfo): DcmDspDataFixedLength=true
        Data_225304_SPM_Event_Abort_2_Read (DcmDspData): DcmDspDataSize=96, DcmDspDataType=UINT8_N, DcmDspDataInfoRef=DataInfo_DataInfo_225304_SPM_Event_Abort_2_Read
        DataInfo_DataInfo_225304_SPM_Event_Abort_2_Read (DcmDspDataInfo): DcmDspDataFixedLength=true
        Data_225305_SPM_Event_Abort_3_Read (DcmDspData): DcmDspDataSize=96, DcmDspDataType=UINT8_N, DcmDspDataInfoRef=DataInfo_DataInfo_225305_SPM_Event_Abort_3_Read
        DataInfo_DataInfo_225305_SPM_Event_Abort_3_Read (DcmDspDataInfo): DcmDspDataFixedLength=true
        Data_225500_Trailer_Sense_and_Drive_Function_Data_Read (DcmDspData): DcmDspDataSize=336, DcmDspDataType=UINT8_N, DcmDspDataInfoRef=DataInfo_DataInfo_225500_Trailer_Sense_and_Drive_Function_Data_Read
        DataInfo_DataInfo_225500_Trailer_Sense_and_Drive_Function_Data_Read (DcmDspDataInfo): DcmDspDataFixedLength=true
        Data_225501_Trailer_coupler_sense_detection_Function_Data_Read (DcmDspData): DcmDspDataSize=384, DcmDspDataType=UINT8_N, DcmDspDataInfoRef=DataInfo_DataInfo_225501_Trailer_coupler_sense_detection_Function_Data_Read
        DataInfo_DataInfo_225501_Trailer_coupler_sense_detection_Function_Data_Read (DcmDspDataInfo): DcmDspDataFixedLength=true
        Data_22F10B_ECU_Qualification (DcmDspData): DcmDspDataSize=16, DcmDspDataType=UINT8_N, DcmDspDataInfoRef=DataInfo_DataInfo_22F10B_ECU_Qualification
        DataInfo_DataInfo_22F10B_ECU_Qualification (DcmDspDataInfo): DcmDspDataFixedLength=true
        Data_22F10D_Diagnostic_Specification_Information (DcmDspData): DcmDspDataSize=32, DcmDspDataType=UINT8_N, DcmDspDataInfoRef=DataInfo_DataInfo_22F10D_Diagnostic_Specification_Information
        DataInfo_DataInfo_22F10D_Diagnostic_Specification_Information (DcmDspDataInfo): DcmDspDataFixedLength=true
        Data_22F110_ECU_Diagnostic_Identification (DcmDspData): DcmDspDataSize=80, DcmDspDataType=UINT8_N, DcmDspDataInfoRef=DataInfo_DataInfo_22F110_ECU_Diagnostic_Identification
        DataInfo_DataInfo_22F110_ECU_Diagnostic_Identification (DcmDspDataInfo): DcmDspDataFixedLength=true
        Data_22F111_Public_Certificates_Regional_Support_Read (DcmDspData): DcmDspDataSize=8, DcmDspDataType=UINT8_N, DcmDspDataInfoRef=DataInfo_DataInfo_22F111_Public_Certificates_Regional_Support_Read
        DataInfo_DataInfo_22F111_Public_Certificates_Regional_Support_Read (DcmDspDataInfo): DcmDspDataFixedLength=true
        Data_22F112_PTESLM_Hardware_Number (DcmDspData): DcmDspDataSize=80, DcmDspDataType=UINT8_N, DcmDspDataInfoRef=DataInfo_DataInfo_22F112_PTESLM_Hardware_Number
        DataInfo_DataInfo_22F112_PTESLM_Hardware_Number (DcmDspDataInfo): DcmDspDataFixedLength=true
        Data_22F122_Software_EBOM_Part_Number (DcmDspData): DcmDspDataSize=720, DcmDspDataType=UINT8_N, DcmDspDataInfoRef=DataInfo_DataInfo_22F122_Software_EBOM_Part_Number
        DataInfo_DataInfo_22F122_Software_EBOM_Part_Number (DcmDspDataInfo): DcmDspDataFixedLength=true
        Data_22F132_EBOM_ECU_Part_Number (DcmDspData): DcmDspDataSize=80, DcmDspDataType=UINT8_N, DcmDspDataInfoRef=DataInfo_DataInfo_22F132_EBOM_ECU_Part_Number
        DataInfo_DataInfo_22F132_EBOM_ECU_Part_Number (DcmDspDataInfo): DcmDspDataFixedLength=true
        Data_22F133_EBOM_Assembly_Part_Number (DcmDspData): DcmDspDataSize=80, DcmDspDataType=UINT8_N, DcmDspDataInfoRef=DataInfo_DataInfo_22F133_EBOM_Assembly_Part_Number
        DataInfo_DataInfo_22F133_EBOM_Assembly_Part_Number (DcmDspDataInfo): DcmDspDataFixedLength=true
        Data_22F134_CODEP_assembly_part_number (DcmDspData): DcmDspDataSize=88, DcmDspDataType=UINT8_N, DcmDspDataInfoRef=DataInfo_DataInfo_22F134_CODEP_assembly_part_number
        DataInfo_DataInfo_22F134_CODEP_assembly_part_number (DcmDspDataInfo): DcmDspDataFixedLength=true
        Data_22F154_Hardware_Supplier_Identification (DcmDspData): DcmDspDataSize=16, DcmDspDataType=UINT8_N, DcmDspDataInfoRef=DataInfo_DataInfo_22F154_Hardware_Supplier_Identification
        DataInfo_DataInfo_22F154_Hardware_Supplier_Identification (DcmDspDataInfo): DcmDspDataFixedLength=true
        Data_22F155_Software_Supplier_Identification (DcmDspData): DcmDspDataSize=16, DcmDspDataType=UINT8_N, DcmDspDataInfoRef=DataInfo_DataInfo_22F155_Software_Supplier_Identification
        DataInfo_DataInfo_22F155_Software_Supplier_Identification (DcmDspDataInfo): DcmDspDataFixedLength=true
        Data_22F180_Boot_Software_Version_Information (DcmDspData): DcmDspDataSize=112, DcmDspDataType=UINT8_N, DcmDspDataInfoRef=DataInfo_DataInfo_22F180_Boot_Software_Version_Information
        DataInfo_DataInfo_22F180_Boot_Software_Version_Information (DcmDspDataInfo): DcmDspDataFixedLength=true
        Data_22F181_Application_Software_Identification (DcmDspData): DcmDspDataSize=528, DcmDspDataType=UINT8_N, DcmDspDataInfoRef=DataInfo_DataInfo_22F181_Application_Software_Identification
        DataInfo_DataInfo_22F181_Application_Software_Identification (DcmDspDataInfo): DcmDspDataFixedLength=true
        Data_22F182_Application_Data_Identification (DcmDspData): DcmDspDataSize=320, DcmDspDataType=UINT8_N, DcmDspDataInfoRef=DataInfo_DataInfo_22F182_Application_Data_Identification
        DataInfo_DataInfo_22F182_Application_Data_Identification (DcmDspDataInfo): DcmDspDataFixedLength=true
        Data_2EF184_Application_Software_Fingerprint_writing_information (DcmDspData): DcmDspDataSize=112, DcmDspDataType=UINT8_N, DcmDspDataInfoRef=DataInfo_DataInfo_2EF184_Application_Software_Fingerprint_writing_information
        DataInfo_DataInfo_2EF184_Application_Software_Fingerprint_writing_information (DcmDspDataInfo): DcmDspDataFixedLength=true
        Data_2EF185_Application_Data_Software_Fingerprint_Writing_Information (DcmDspData): DcmDspDataSize=112, DcmDspDataType=UINT8_N, DcmDspDataInfoRef=DataInfo_DataInfo_2EF185_Application_Data_Software_Fingerprint_Writing_Information
        DataInfo_DataInfo_2EF185_Application_Data_Software_Fingerprint_Writing_Information (DcmDspDataInfo): DcmDspDataFixedLength=true
        Data_22F186_Active_Diagnostic_Session (DcmDspData): DcmDspDataSize=24, DcmDspDataType=UINT8_N, DcmDspDataInfoRef=DataInfo_DataInfo_22F186_Active_Diagnostic_Session
        DataInfo_DataInfo_22F186_Active_Diagnostic_Session (DcmDspDataInfo): DcmDspDataFixedLength=true
        Data_22F187_CODEP_ECU_Part_Number (DcmDspData): DcmDspDataSize=88, DcmDspDataType=UINT8_N, DcmDspDataInfoRef=DataInfo_DataInfo_22F187_CODEP_ECU_Part_Number
        DataInfo_DataInfo_22F187_CODEP_ECU_Part_Number (DcmDspDataInfo): DcmDspDataFixedLength=true
        Data_22F188_FCA_ESLM_ECU_Software_Number (DcmDspData): DcmDspDataSize=88, DcmDspDataType=UINT8_N, DcmDspDataInfoRef=DataInfo_DataInfo_22F188_FCA_ESLM_ECU_Software_Number
        DataInfo_DataInfo_22F188_FCA_ESLM_ECU_Software_Number (DcmDspDataInfo): DcmDspDataFixedLength=true
        Data_22F18A_FCA_ESLM_ECU_Software_Calibration_Number (DcmDspData): DcmDspDataSize=80, DcmDspDataType=UINT8_N, DcmDspDataInfoRef=DataInfo_DataInfo_22F18A_FCA_ESLM_ECU_Software_Calibration_Number
        DataInfo_DataInfo_22F18A_FCA_ESLM_ECU_Software_Calibration_Number (DcmDspDataInfo): DcmDspDataFixedLength=true
        Data_22F18B_FCA_ESLM_ECU_Software_Application_Number (DcmDspData): DcmDspDataSize=80, DcmDspDataType=UINT8_N, DcmDspDataInfoRef=DataInfo_DataInfo_22F18B_FCA_ESLM_ECU_Software_Application_Number
        DataInfo_DataInfo_22F18B_FCA_ESLM_ECU_Software_Application_Number (DcmDspDataInfo): DcmDspDataFixedLength=true
        Data_22F18C_ECU_Serial_Number (DcmDspData): DcmDspDataSize=120, DcmDspDataType=UINT8_N, DcmDspDataInfoRef=DataInfo_DataInfo_22F18C_ECU_Serial_Number
        DataInfo_DataInfo_22F18C_ECU_Serial_Number (DcmDspDataInfo): DcmDspDataFixedLength=true
        Data_22F190_VIN_Original (DcmDspData): DcmDspDataSize=136, DcmDspDataType=UINT8_N, DcmDspDataInfoRef=DataInfo_DataInfo_22F190_VIN_Original
        DataInfo_DataInfo_22F190_VIN_Original (DcmDspDataInfo): DcmDspDataFixedLength=true
        Data_22F191_FCA_ESLM_ECU_Hardware_Number (DcmDspData): DcmDspDataSize=88, DcmDspDataType=UINT8_N, DcmDspDataInfoRef=DataInfo_DataInfo_22F191_FCA_ESLM_ECU_Hardware_Number
        DataInfo_DataInfo_22F191_FCA_ESLM_ECU_Hardware_Number (DcmDspDataInfo): DcmDspDataFixedLength=true
        Data_22F192_Supplier_ECU_Hardware_Part_Number (DcmDspData): DcmDspDataSize=88, DcmDspDataType=UINT8_N, DcmDspDataInfoRef=DataInfo_DataInfo_22F192_Supplier_ECU_Hardware_Part_Number
        DataInfo_DataInfo_22F192_Supplier_ECU_Hardware_Part_Number (DcmDspDataInfo): DcmDspDataFixedLength=true
        Data_22F193_Supplier_ECU_Hardware_Version_Number (DcmDspData): DcmDspDataSize=8, DcmDspDataType=UINT8_N, DcmDspDataInfoRef=DataInfo_DataInfo_22F193_Supplier_ECU_Hardware_Version_Number
        DataInfo_DataInfo_22F193_Supplier_ECU_Hardware_Version_Number (DcmDspDataInfo): DcmDspDataFixedLength=true
        Data_22F194_Supplier_ECU_Software_Part_Number (DcmDspData): DcmDspDataSize=88, DcmDspDataType=UINT8_N, DcmDspDataInfoRef=DataInfo_DataInfo_22F194_Supplier_ECU_Software_Part_Number
        DataInfo_DataInfo_22F194_Supplier_ECU_Software_Part_Number (DcmDspDataInfo): DcmDspDataFixedLength=true
        Data_22F195_Supplier_ECU_Software_Version_Number (DcmDspData): DcmDspDataSize=16, DcmDspDataType=UINT8_N, DcmDspDataInfoRef=DataInfo_DataInfo_22F195_Supplier_ECU_Software_Version_Number
        DataInfo_DataInfo_22F195_Supplier_ECU_Software_Version_Number (DcmDspDataInfo): DcmDspDataFixedLength=true
        Data_22F1A0_System_Identification_Data (DcmDspData): DcmDspDataSize=720, DcmDspDataType=UINT8_N, DcmDspDataInfoRef=DataInfo_DataInfo_22F1A0_System_Identification_Data
        DataInfo_DataInfo_22F1A0_System_Identification_Data (DcmDspDataInfo): DcmDspDataFixedLength=true
        Data_22F1A1_Configuration_Code (DcmDspData): DcmDspDataSize=88, DcmDspDataType=UINT8_N, DcmDspDataInfoRef=DataInfo_DataInfo_22F1A1_Configuration_Code
        DataInfo_DataInfo_22F1A1_Configuration_Code (DcmDspDataInfo): DcmDspDataFixedLength=true
        Data_22F1A2_Vector_Delivery_ID (DcmDspData): DcmDspDataSize=80, DcmDspDataType=UINT8_N, DcmDspDataInfoRef=DataInfo_DataInfo_22F1A2_Vector_Delivery_ID
        DataInfo_DataInfo_22F1A2_Vector_Delivery_ID (DcmDspDataInfo): DcmDspDataFixedLength=true
        Data_22F1A6_Message_Matrix (DcmDspData): DcmDspDataSize=24, DcmDspDataType=UINT8_N, DcmDspDataInfoRef=DataInfo_DataInfo_22F1A6_Message_Matrix
        DataInfo_DataInfo_22F1A6_Message_Matrix (DcmDspDataInfo): DcmDspDataFixedLength=true
        Data_22F1B0_VIN_Current (DcmDspData): DcmDspDataSize=136, DcmDspDataType=UINT8_N, DcmDspDataInfoRef=DataInfo_DataInfo_22F1B0_VIN_Current
        DataInfo_DataInfo_22F1B0_VIN_Current (DcmDspDataInfo): DcmDspDataFixedLength=true
        Data_22F1B3_Boot_Software_Fingerprint_Reading_Information (DcmDspData): DcmDspDataSize=120, DcmDspDataType=UINT8_N, DcmDspDataInfoRef=DataInfo_DataInfo_22F1B3_Boot_Software_Fingerprint_Reading_Information
        DataInfo_DataInfo_22F1B3_Boot_Software_Fingerprint_Reading_Information (DcmDspDataInfo): DcmDspDataFixedLength=true
        Data_22F1B4_Application_Software_Fingerprint_Reading_Information (DcmDspData): DcmDspDataSize=568, DcmDspDataType=UINT8_N, DcmDspDataInfoRef=DataInfo_DataInfo_22F1B4_Application_Software_Fingerprint_Reading_Information
        DataInfo_DataInfo_22F1B4_Application_Software_Fingerprint_Reading_Information (DcmDspDataInfo): DcmDspDataFixedLength=true
        Data_22F1B5_Application_Data_Software_Fingerprint_Reading_Information (DcmDspData): DcmDspDataSize=344, DcmDspDataType=UINT8_N, DcmDspDataInfoRef=DataInfo_DataInfo_22F1B5_Application_Data_Software_Fingerprint_Reading_Information
        DataInfo_DataInfo_22F1B5_Application_Data_Software_Fingerprint_Reading_Information (DcmDspDataInfo): DcmDspDataFixedLength=true
        Data_22FD00_Plant_Camera_Calibration_Data (DcmDspData): DcmDspDataSize=432, DcmDspDataType=UINT8_N, DcmDspDataInfoRef=DataInfo_DataInfo_22FD00_Plant_Camera_Calibration_Data
        DataInfo_DataInfo_22FD00_Plant_Camera_Calibration_Data (DcmDspDataInfo): DcmDspDataFixedLength=true
        Data_22FD01_Previous_Camera_Calibration_Data (DcmDspData): DcmDspDataSize=400, DcmDspDataType=UINT8_N, DcmDspDataInfoRef=DataInfo_DataInfo_22FD01_Previous_Camera_Calibration_Data
        DataInfo_DataInfo_22FD01_Previous_Camera_Calibration_Data (DcmDspDataInfo): DcmDspDataFixedLength=true
        Data_22FD04_USS_Sensor_tuning_values_Read (DcmDspData): DcmDspDataSize=24576, DcmDspDataType=UINT8_N, DcmDspDataInfoRef=DataInfo_DataInfo_22FD04_USS_Sensor_tuning_values_Read
        DataInfo_DataInfo_22FD04_USS_Sensor_tuning_values_Read (DcmDspDataInfo): DcmDspDataFixedLength=false
        Data_22FD07_OC_Result_Read (DcmDspData): DcmDspDataSize=64, DcmDspDataType=UINT8_N, DcmDspDataInfoRef=DataInfo_DataInfo_22FD07_OC_Result_Read
        DataInfo_DataInfo_22FD07_OC_Result_Read (DcmDspDataInfo): DcmDspDataFixedLength=true
        Data_22FD08_OC_Data_Read (DcmDspData): DcmDspDataSize=224, DcmDspDataType=UINT8_N, DcmDspDataInfoRef=DataInfo_DataInfo_22FD08_OC_Data_Read
        DataInfo_DataInfo_22FD08_OC_Data_Read (DcmDspDataInfo): DcmDspDataFixedLength=true
        Data_22FD0A_SC_Data_Read (DcmDspData): DcmDspDataSize=224, DcmDspDataType=UINT8_N, DcmDspDataInfoRef=DataInfo_DataInfo_22FD0A_SC_Data_Read
        DataInfo_DataInfo_22FD0A_SC_Data_Read (DcmDspDataInfo): DcmDspDataFixedLength=true
        Data_22FD0C_Front_Camera_Data_EEPROM_Read (DcmDspData): DcmDspDataSize=2048, DcmDspDataType=UINT8_N, DcmDspDataInfoRef=DataInfo_DataInfo_22FD0C_Front_Camera_Data_EEPROM_Read
        DataInfo_DataInfo_22FD0C_Front_Camera_Data_EEPROM_Read (DcmDspDataInfo): DcmDspDataFixedLength=true
        Data_22FD0D_Left_Camera_Data_EEPROM_Read (DcmDspData): DcmDspDataSize=2048, DcmDspDataType=UINT8_N, DcmDspDataInfoRef=DataInfo_DataInfo_22FD0D_Left_Camera_Data_EEPROM_Read
        DataInfo_DataInfo_22FD0D_Left_Camera_Data_EEPROM_Read (DcmDspDataInfo): DcmDspDataFixedLength=true
        Data_22FD0E_Rear_Camera_Data_EEPROM_Read (DcmDspData): DcmDspDataSize=2048, DcmDspDataType=UINT8_N, DcmDspDataInfoRef=DataInfo_DataInfo_22FD0E_Rear_Camera_Data_EEPROM_Read
        DataInfo_DataInfo_22FD0E_Rear_Camera_Data_EEPROM_Read (DcmDspDataInfo): DcmDspDataFixedLength=true
        Data_22FD0F_Right_Camera_Data_EEPROM_Read (DcmDspData): DcmDspDataSize=2048, DcmDspDataType=UINT8_N, DcmDspDataInfoRef=DataInfo_DataInfo_22FD0F_Right_Camera_Data_EEPROM_Read
        DataInfo_DataInfo_22FD0F_Right_Camera_Data_EEPROM_Read (DcmDspDataInfo): DcmDspDataFixedLength=true
        Data_22FD13_Magna_Software_Version (DcmDspData): DcmDspDataSize=256, DcmDspDataType=UINT8_N, DcmDspDataInfoRef=DataInfo_DataInfo_22FD13_Magna_Software_Version
        DataInfo_DataInfo_22FD13_Magna_Software_Version (DcmDspDataInfo): DcmDspDataFixedLength=true
        Data_22FD14_FD14_Magna_Production_Date_Read (DcmDspData): DcmDspDataSize=40, DcmDspDataType=UINT8_N, DcmDspDataInfoRef=DataInfo_DataInfo_22FD14_FD14_Magna_Production_Date_Read
        DataInfo_DataInfo_22FD14_FD14_Magna_Production_Date_Read (DcmDspDataInfo): DcmDspDataFixedLength=true
        Data_22FD15_Magna_Production_HW_Number_Read (DcmDspData): DcmDspDataSize=104, DcmDspDataType=UINT8_N, DcmDspDataInfoRef=DataInfo_DataInfo_22FD15_Magna_Production_HW_Number_Read
        DataInfo_DataInfo_22FD15_Magna_Production_HW_Number_Read (DcmDspDataInfo): DcmDspDataFixedLength=true
        Data_22FD16_Magna_Production_ICT_Data_Read (DcmDspData): DcmDspDataSize=512, DcmDspDataType=UINT8_N, DcmDspDataInfoRef=DataInfo_DataInfo_22FD16_Magna_Production_ICT_Data_Read
        DataInfo_DataInfo_22FD16_Magna_Production_ICT_Data_Read (DcmDspDataInfo): DcmDspDataFixedLength=true
        Data_22FD17_Magna_Production_HW_Version_information_Read (DcmDspData): DcmDspDataSize=24, DcmDspDataType=UINT8_N, DcmDspDataInfoRef=DataInfo_DataInfo_22FD17_Magna_Production_HW_Version_information_Read
        DataInfo_DataInfo_22FD17_Magna_Production_HW_Version_information_Read (DcmDspDataInfo): DcmDspDataFixedLength=true
        Data_22FD1C_Current_Camera_Calibration_Data_Read (DcmDspData): DcmDspDataSize=416, DcmDspDataType=UINT8_N, DcmDspDataInfoRef=DataInfo_DataInfo_22FD1C_Current_Camera_Calibration_Data_Read
        DataInfo_DataInfo_22FD1C_Current_Camera_Calibration_Data_Read (DcmDspDataInfo): DcmDspDataFixedLength=true
        Data_22FD1D_PCB_Serial_Number (DcmDspData): DcmDspDataSize=112, DcmDspDataType=UINT8_N, DcmDspDataInfoRef=DataInfo_DataInfo_22FD1D_PCB_Serial_Number
        DataInfo_DataInfo_22FD1D_PCB_Serial_Number (DcmDspDataInfo): DcmDspDataFixedLength=true
        Data_22FD1E_Calibration_Status_Read (DcmDspData): DcmDspDataSize=168, DcmDspDataType=UINT8_N, DcmDspDataInfoRef=DataInfo_DataInfo_22FD1E_Calibration_Status_Read
        DataInfo_DataInfo_22FD1E_Calibration_Status_Read (DcmDspDataInfo): DcmDspDataFixedLength=true
        Data_22FD20_ECU_PinStates_Read (DcmDspData): DcmDspDataSize=16, DcmDspDataType=UINT8_N, DcmDspDataInfoRef=DataInfo_DataInfo_22FD20_ECU_PinStates_Read
        DataInfo_DataInfo_22FD20_ECU_PinStates_Read (DcmDspDataInfo): DcmDspDataFixedLength=true
        Data_22FD28_USS_Ringing_Frequency_Read (DcmDspData): DcmDspDataSize=192, DcmDspDataType=UINT8_N, DcmDspDataInfoRef=DataInfo_DataInfo_22FD28_USS_Ringing_Frequency_Read
        DataInfo_DataInfo_22FD28_USS_Ringing_Frequency_Read (DcmDspDataInfo): DcmDspDataFixedLength=true
        Data_22FD29_USS_Driving_Frequency_Read (DcmDspData): DcmDspDataSize=192, DcmDspDataType=UINT8_N, DcmDspDataInfoRef=DataInfo_DataInfo_22FD29_USS_Driving_Frequency_Read
        DataInfo_DataInfo_22FD29_USS_Driving_Frequency_Read (DcmDspDataInfo): DcmDspDataFixedLength=true
        Data_22FD2A_USS_Ringing_Time_Read (DcmDspData): DcmDspDataSize=192, DcmDspDataType=UINT8_N, DcmDspDataInfoRef=DataInfo_DataInfo_22FD2A_USS_Ringing_Time_Read
        DataInfo_DataInfo_22FD2A_USS_Ringing_Time_Read (DcmDspDataInfo): DcmDspDataFixedLength=true
        Data_22FD2B_USS_Direct_Distance_0xFD2B_Read (DcmDspData): DcmDspDataSize=192, DcmDspDataType=UINT8_N, DcmDspDataInfoRef=DataInfo_DataInfo_22FD2B_USS_Direct_Distance_0xFD2B_Read
        DataInfo_DataInfo_22FD2B_USS_Direct_Distance_0xFD2B_Read (DcmDspDataInfo): DcmDspDataFixedLength=true
        Data_22FD2C_USS_Temperature_Read (DcmDspData): DcmDspDataSize=192, DcmDspDataType=UINT8_N, DcmDspDataInfoRef=DataInfo_DataInfo_22FD2C_USS_Temperature_Read
        DataInfo_DataInfo_22FD2C_USS_Temperature_Read (DcmDspDataInfo): DcmDspDataFixedLength=true
        Data_22FD2D_USS_Sensor_ID_IME_SN_Read (DcmDspData): DcmDspDataSize=384, DcmDspDataType=UINT8_N, DcmDspDataInfoRef=DataInfo_DataInfo_22FD2D_USS_Sensor_ID_IME_SN_Read
        DataInfo_DataInfo_22FD2D_USS_Sensor_ID_IME_SN_Read (DcmDspDataInfo): DcmDspDataFixedLength=true
        Data_22FD2E_USS_Sensor_ID_Murata_SN_Read (DcmDspData): DcmDspDataSize=384, DcmDspDataType=UINT8_N, DcmDspDataInfoRef=DataInfo_DataInfo_22FD2E_USS_Sensor_ID_Murata_SN_Read
        DataInfo_DataInfo_22FD2E_USS_Sensor_ID_Murata_SN_Read (DcmDspDataInfo): DcmDspDataFixedLength=true
        Data_22FD31_Magna_EOL_Coding_State_Read (DcmDspData): DcmDspDataSize=32, DcmDspDataType=UINT8_N, DcmDspDataInfoRef=DataInfo_DataInfo_22FD31_Magna_EOL_Coding_State_Read
        DataInfo_DataInfo_22FD31_Magna_EOL_Coding_State_Read (DcmDspDataInfo): DcmDspDataFixedLength=true
        Data_22FD33_Magna_Testing_2_Read (DcmDspData): DcmDspDataSize=80, DcmDspDataType=UINT8_N, DcmDspDataInfoRef=DataInfo_DataInfo_22FD33_Magna_Testing_2_Read
        DataInfo_DataInfo_22FD33_Magna_Testing_2_Read (DcmDspDataInfo): DcmDspDataFixedLength=true
        Data_22FD38_Programmed_Assembly (DcmDspData): DcmDspDataSize=128, DcmDspDataType=UINT8_N, DcmDspDataInfoRef=DataInfo_DataInfo_22FD38_Programmed_Assembly
        DataInfo_DataInfo_22FD38_Programmed_Assembly (DcmDspDataInfo): DcmDspDataFixedLength=true
        Data_22FD42_Failsafe_Behaviour_Read (DcmDspData): DcmDspDataSize=8, DcmDspDataType=UINT8_N, DcmDspDataInfoRef=DataInfo_DataInfo_22FD42_Failsafe_Behaviour_Read
        DataInfo_DataInfo_22FD42_Failsafe_Behaviour_Read (DcmDspDataInfo): DcmDspDataFixedLength=true
        Data_22FD43_Active_Safe_State_Read (DcmDspData): DcmDspDataSize=112, DcmDspDataType=UINT8_N, DcmDspDataInfoRef=DataInfo_DataInfo_22FD43_Active_Safe_State_Read
        DataInfo_DataInfo_22FD43_Active_Safe_State_Read (DcmDspDataInfo): DcmDspDataFixedLength=true
        Data_22FD44_Error_Flags_Read (DcmDspData): DcmDspDataSize=32, DcmDspDataType=UINT8_N, DcmDspDataInfoRef=DataInfo_DataInfo_22FD44_Error_Flags_Read
        DataInfo_DataInfo_22FD44_Error_Flags_Read (DcmDspDataInfo): DcmDspDataFixedLength=true
        Data_22FD46_Camera_Power_Supply_Read (DcmDspData): DcmDspDataSize=64, DcmDspDataType=UINT8_N, DcmDspDataInfoRef=DataInfo_DataInfo_22FD46_Camera_Power_Supply_Read
        DataInfo_DataInfo_22FD46_Camera_Power_Supply_Read (DcmDspDataInfo): DcmDspDataFixedLength=true
        Data_22FD47_SoC_Temperature_0xFD47_Read (DcmDspData): DcmDspDataSize=80, DcmDspDataType=UINT8_N, DcmDspDataInfoRef=DataInfo_DataInfo_22FD47_SoC_Temperature_0xFD47_Read
        DataInfo_DataInfo_22FD47_SoC_Temperature_0xFD47_Read (DcmDspDataInfo): DcmDspDataFixedLength=true
        Data_22FD48_PCBA_Temperature_Read (DcmDspData): DcmDspDataSize=32, DcmDspDataType=UINT8_N, DcmDspDataInfoRef=DataInfo_DataInfo_22FD48_PCBA_Temperature_Read
        DataInfo_DataInfo_22FD48_PCBA_Temperature_Read (DcmDspDataInfo): DcmDspDataFixedLength=true
        Data_22FD49_SoC_Die_Temperature_ID_0xFD49_Read (DcmDspData): DcmDspDataSize=128, DcmDspDataType=UINT8_N, DcmDspDataInfoRef=DataInfo_DataInfo_22FD49_SoC_Die_Temperature_ID_0xFD49_Read
        DataInfo_DataInfo_22FD49_SoC_Die_Temperature_ID_0xFD49_Read (DcmDspDataInfo): DcmDspDataFixedLength=true
        Data_22FD4A_Ultrasonic_Sensors_Power_supply_and_Current_Level_Read (DcmDspData): DcmDspDataSize=72, DcmDspDataType=UINT8_N, DcmDspDataInfoRef=DataInfo_DataInfo_22FD4A_Ultrasonic_Sensors_Power_supply_and_Current_Level_Read
        DataInfo_DataInfo_22FD4A_Ultrasonic_Sensors_Power_supply_and_Current_Level_Read (DcmDspDataInfo): DcmDspDataFixedLength=true
        Data_2EFD4E_Reset_NVM_Write (DcmDspData): DcmDspDataSize=8, DcmDspDataType=UINT8_N, DcmDspDataInfoRef=DataInfo_DataInfo_2EFD4E_Reset_NVM_Write
        DataInfo_DataInfo_2EFD4E_Reset_NVM_Write (DcmDspDataInfo): DcmDspDataFixedLength=true
        Data_22FD60_ECU_Software_Status_Read (DcmDspData): DcmDspDataSize=112, DcmDspDataType=UINT8_N, DcmDspDataInfoRef=DataInfo_DataInfo_22FD60_ECU_Software_Status_Read
        DataInfo_DataInfo_22FD60_ECU_Software_Status_Read (DcmDspDataInfo): DcmDspDataFixedLength=true
        Data_22FD61_Vehicle_Variant_Coding_Data_Read (DcmDspData): DcmDspDataSize=96, DcmDspDataType=UINT8_N, DcmDspDataInfoRef=DataInfo_DataInfo_22FD61_Vehicle_Variant_Coding_Data_Read
        DataInfo_DataInfo_22FD61_Vehicle_Variant_Coding_Data_Read (DcmDspDataInfo): DcmDspDataFixedLength=true
        Data_22FD62_ASIL_QM_Fault_Status_Read (DcmDspData): DcmDspDataSize=16, DcmDspDataType=UINT8_N, DcmDspDataInfoRef=DataInfo_DataInfo_22FD62_ASIL_QM_Fault_Status_Read
        DataInfo_DataInfo_22FD62_ASIL_QM_Fault_Status_Read (DcmDspDataInfo): DcmDspDataFixedLength=true
        Data_22FD64_ASIL_B_Fault_Status_Read (DcmDspData): DcmDspDataSize=1104, DcmDspDataType=UINT8_N, DcmDspDataInfoRef=DataInfo_DataInfo_22FD64_ASIL_B_Fault_Status_Read
        DataInfo_DataInfo_22FD64_ASIL_B_Fault_Status_Read (DcmDspDataInfo): DcmDspDataFixedLength=true
        Data_22FD65_FuSa_Module_Status_Read (DcmDspData): DcmDspDataSize=224, DcmDspDataType=UINT8_N, DcmDspDataInfoRef=DataInfo_DataInfo_22FD65_FuSa_Module_Status_Read
        DataInfo_DataInfo_22FD65_FuSa_Module_Status_Read (DcmDspDataInfo): DcmDspDataFixedLength=true
        Data_22FD66_Camera_occlusion_and_low_light_status_Read (DcmDspData): DcmDspDataSize=72, DcmDspDataType=UINT8_N, DcmDspDataInfoRef=DataInfo_DataInfo_22FD66_Camera_occlusion_and_low_light_status_Read
        DataInfo_DataInfo_22FD66_Camera_occlusion_and_low_light_status_Read (DcmDspDataInfo): DcmDspDataFixedLength=true
        Data_22FD67_Camera_DLD_Status_Read (DcmDspData): DcmDspDataSize=32, DcmDspDataType=UINT8_N, DcmDspDataInfoRef=DataInfo_DataInfo_22FD67_Camera_DLD_Status_Read
        DataInfo_DataInfo_22FD67_Camera_DLD_Status_Read (DcmDspDataInfo): DcmDspDataFixedLength=true
        Data_22FD74_PHY_Tunning_Error_And_Buffer_Mark_Error_Read (DcmDspData): DcmDspDataSize=32, DcmDspDataType=UINT8_N, DcmDspDataInfoRef=DataInfo_DataInfo_22FD74_PHY_Tunning_Error_And_Buffer_Mark_Error_Read
        DataInfo_DataInfo_22FD74_PHY_Tunning_Error_And_Buffer_Mark_Error_Read (DcmDspDataInfo): DcmDspDataFixedLength=true
        Data_22FD86_Functional_Settings_Read (DcmDspData): DcmDspDataSize=48, DcmDspDataType=UINT8_N, DcmDspDataInfoRef=DataInfo_DataInfo_22FD86_Functional_Settings_Read
        DataInfo_DataInfo_22FD86_Functional_Settings_Read (DcmDspDataInfo): DcmDspDataFixedLength=true
        Data_22FDF0_ECU_shutdown_process_Read (DcmDspData): DcmDspDataSize=8, DcmDspDataType=UINT8_N, DcmDspDataInfoRef=DataInfo_DataInfo_22FDF0_ECU_shutdown_process_Read
        DataInfo_DataInfo_22FDF0_ECU_shutdown_process_Read (DcmDspDataInfo): DcmDspDataFixedLength=true
        Data_22FDF1_CPU_Load_Read (DcmDspData): DcmDspDataSize=40, DcmDspDataType=UINT8_N, DcmDspDataInfoRef=DataInfo_DataInfo_22FDF1_CPU_Load_Read
        DataInfo_DataInfo_22FDF1_CPU_Load_Read (DcmDspDataInfo): DcmDspDataFixedLength=true
        Data_22FDF2_Reset_Reason_Read (DcmDspData): DcmDspDataSize=16, DcmDspDataType=UINT8_N, DcmDspDataInfoRef=DataInfo_DataInfo_22FDF2_Reset_Reason_Read
        DataInfo_DataInfo_22FDF2_Reset_Reason_Read (DcmDspDataInfo): DcmDspDataFixedLength=true
        Data_22FDF5_PerformanceStatEnable_Read (DcmDspData): DcmDspDataSize=16, DcmDspDataType=UINT8_N, DcmDspDataInfoRef=DataInfo_DataInfo_22FDF5_PerformanceStatEnable_Read
        DataInfo_DataInfo_22FDF5_PerformanceStatEnable_Read (DcmDspDataInfo): DcmDspDataFixedLength=true
        Data_22FDF6_RunTimeStatsData_Read (DcmDspData): DcmDspDataSize=2448, DcmDspDataType=UINT8_N, DcmDspDataInfoRef=DataInfo_DataInfo_22FDF6_RunTimeStatsData_Read
        DataInfo_DataInfo_22FDF6_RunTimeStatsData_Read (DcmDspDataInfo): DcmDspDataFixedLength=true
        Data_22FDF7_Intrinsic_Camera_NvM_Data_Read (DcmDspData): DcmDspDataSize=352, DcmDspDataType=UINT8_N, DcmDspDataInfoRef=DataInfo_DataInfo_22FDF7_Intrinsic_Camera_NvM_Data_Read
        DataInfo_DataInfo_22FDF7_Intrinsic_Camera_NvM_Data_Read (DcmDspDataInfo): DcmDspDataFixedLength=true
        Data_22FDF8_StackUsage_Read (DcmDspData): DcmDspDataSize=296, DcmDspDataType=UINT8_N, DcmDspDataInfoRef=DataInfo_DataInfo_22FDF8_StackUsage_Read
        DataInfo_DataInfo_22FDF8_StackUsage_Read (DcmDspDataInfo): DcmDspDataFixedLength=true
        164 x DcmDspDid:
          DID_220103_VIN_Lock_Status: DcmDspDidIdentifier=259, DcmDspDidInfoRef=DidInfo_DidInfo_220103_VIN_Lock_Status
            DcmDspDidSignal: DcmDspDidDataPos=0, DcmDspDidDataRef=Data_220103_VIN_Lock_Status
          DID_220107_RoE_Activation_State: DcmDspDidIdentifier=263, DcmDspDidInfoRef=DidInfo_DidInfo_220107_RoE_Activation_State
            DcmDspDidSignal: DcmDspDidDataPos=0, DcmDspDidDataRef=Data_220107_RoE_Activation_State
          DID_220108_Authenticated_Diagnostics_Active_Role_Read: DcmDspDidIdentifier=264, DcmDspDidInfoRef=DidInfo_DidInfo_220108_Authenticated_Diagnostics_Active_Role_Read
            DcmDspDidSignal: DcmDspDidDataPos=0, DcmDspDidDataRef=Data_220108_Authenticated_Diagnostics_Active_Role_Read
          DID_221002_Vehicle_Speed: DcmDspDidIdentifier=4098, DcmDspDidInfoRef=DidInfo_DidInfo_221002_Vehicle_Speed
            DcmDspDidSignal: DcmDspDidDataPos=0, DcmDspDidDataRef=Data_221002_Vehicle_Speed
          DID_221004_Battery_Voltage: DcmDspDidIdentifier=4100, DcmDspDidInfoRef=DidInfo_DidInfo_221004_Battery_Voltage
            DcmDspDidSignal: DcmDspDidDataPos=0, DcmDspDidDataRef=Data_221004_Battery_Voltage
          DID_221008_ECU_Life_Time: DcmDspDidIdentifier=4104, DcmDspDidInfoRef=DidInfo_DidInfo_221008_ECU_Life_Time
            DcmDspDidSignal: DcmDspDidDataPos=0, DcmDspDidDataRef=Data_221008_ECU_Life_Time
          DID_221009_ECU_Time_Since_Ignition_ON: DcmDspDidIdentifier=4105, DcmDspDidInfoRef=DidInfo_DidInfo_221009_ECU_Time_Since_Ignition_ON
            DcmDspDidSignal: DcmDspDidDataPos=0, DcmDspDidDataRef=Data_221009_ECU_Time_Since_Ignition_ON
          DID_22100B_Diagnostic_Tool_and_Session_Status: DcmDspDidIdentifier=4107, DcmDspDidInfoRef=DidInfo_DidInfo_22100B_Diagnostic_Tool_and_Session_Status
            DcmDspDidSignal: DcmDspDidDataPos=0, DcmDspDidDataRef=Data_22100B_Diagnostic_Tool_and_Session_Status
          DID_22100C_Security_Status_Read: DcmDspDidIdentifier=4108, DcmDspDidInfoRef=DidInfo_DidInfo_22100C_Security_Status_Read
            DcmDspDidSignal: DcmDspDidDataPos=0, DcmDspDidDataRef=Data_22100C_Security_Status_Read
          DID_22102A_Check_EOL_Configuration_Data: DcmDspDidIdentifier=4138, DcmDspDidInfoRef=DidInfo_DidInfo_22102A_Check_EOL_Configuration_Data
            DcmDspDidSignal: DcmDspDidDataPos=0, DcmDspDidDataRef=Data_22102A_Check_EOL_Configuration_Data
          DID_22191D_Time_of_Power_Latch: DcmDspDidIdentifier=6429, DcmDspDidInfoRef=DidInfo_DidInfo_22191D_Time_of_Power_Latch
            DcmDspDidSignal: DcmDspDidDataPos=0, DcmDspDidDataRef=Data_22191D_Time_of_Power_Latch
          DID_221921_Operational_Mode_Status: DcmDspDidIdentifier=6433, DcmDspDidInfoRef=DidInfo_DidInfo_221921_Operational_Mode_Status
            DcmDspDidSignal: DcmDspDidDataPos=0, DcmDspDidDataRef=Data_221921_Operational_Mode_Status
          DID_222001_Odometer: DcmDspDidIdentifier=8193, DcmDspDidInfoRef=DidInfo_DidInfo_222001_Odometer
            DcmDspDidSignal: DcmDspDidDataPos=0, DcmDspDidDataRef=Data_222001_Odometer
          DID_222002_Odometer_at_last_Flash_programming: DcmDspDidIdentifier=8194, DcmDspDidInfoRef=DidInfo_DidInfo_222002_Odometer_at_last_Flash_programming
            DcmDspDidSignal: DcmDspDidDataPos=0, DcmDspDidDataRef=Data_222002_Odometer_at_last_Flash_programming
          DID_222003_Boot_Software_Programming_Attempt_Counter: DcmDspDidIdentifier=8195, DcmDspDidInfoRef=DidInfo_DidInfo_222003_Boot_Software_Programming_Attempt_Counter
            DcmDspDidSignal: DcmDspDidDataPos=0, DcmDspDidDataRef=Data_222003_Boot_Software_Programming_Attempt_Counter
          DID_222008_ECU_Life_Time_Not_Volatile_Memory: DcmDspDidIdentifier=8200, DcmDspDidInfoRef=DidInfo_DidInfo_222008_ECU_Life_Time_Not_Volatile_Memory
            DcmDspDidSignal: DcmDspDidDataPos=0, DcmDspDidDataRef=Data_222008_ECU_Life_Time_Not_Volatile_Memory
          DID_22200A_Ignition_ON_Counter: DcmDspDidIdentifier=8202, DcmDspDidInfoRef=DidInfo_DidInfo_22200A_Ignition_ON_Counter
            DcmDspDidSignal: DcmDspDidDataPos=0, DcmDspDidDataRef=Data_22200A_Ignition_ON_Counter
          DID_22200B_Time_First_DTC_Detection: DcmDspDidIdentifier=8203, DcmDspDidInfoRef=DidInfo_DidInfo_22200B_Time_First_DTC_Detection
            DcmDspDidSignal: DcmDspDidDataPos=0, DcmDspDidDataRef=Data_22200B_Time_First_DTC_Detection
          DID_22200C_Time_Since_Ignition_ON_of_first_DTC_Detection: DcmDspDidIdentifier=8204, DcmDspDidInfoRef=DidInfo_DidInfo_22200C_Time_Since_Ignition_ON_of_first_DTC_Detection
            DcmDspDidSignal: DcmDspDidDataPos=0, DcmDspDidDataRef=Data_22200C_Time_Since_Ignition_ON_of_first_DTC_Detection
          DID_22200D_Odometer_Last_Clear_Data_Trouble_Code_DTC: DcmDspDidIdentifier=8205, DcmDspDidInfoRef=DidInfo_DidInfo_22200D_Odometer_Last_Clear_Data_Trouble_Code_DTC
            DcmDspDidSignal: DcmDspDidDataPos=0, DcmDspDidDataRef=Data_22200D_Odometer_Last_Clear_Data_Trouble_Code_DTC
          DID_222010_Programming_Status: DcmDspDidIdentifier=8208, DcmDspDidInfoRef=DidInfo_DidInfo_222010_Programming_Status
            DcmDspDidSignal: DcmDspDidDataPos=0, DcmDspDidDataRef=Data_222010_Programming_Status
          DID_222013_VIN_Lock_State_Read: DcmDspDidIdentifier=8211, DcmDspDidInfoRef=DidInfo_DidInfo_222013_VIN_Lock_State_Read
            DcmDspDidSignal: DcmDspDidDataPos=0, DcmDspDidDataRef=Data_222013_VIN_Lock_State_Read
          DID_22201A_Application_Software_Programming_Attempt_Counter: DcmDspDidIdentifier=8218, DcmDspDidInfoRef=DidInfo_DidInfo_22201A_Application_Software_Programming_Attempt_Counter
            DcmDspDidSignal: DcmDspDidDataPos=0, DcmDspDidDataRef=Data_22201A_Application_Software_Programming_Attempt_Counter
          DID_22201B_Application_Data_Software_Programming_Attempt_Counter: DcmDspDidIdentifier=8219, DcmDspDidInfoRef=DidInfo_DidInfo_22201B_Application_Data_Software_Programming_Attempt_Counter
            DcmDspDidSignal: DcmDspDidDataPos=0, DcmDspDidDataRef=Data_22201B_Application_Data_Software_Programming_Attempt_Counter
          DID_22201F_Boot_Failure_Reason_Read: DcmDspDidIdentifier=8223, DcmDspDidInfoRef=DidInfo_DidInfo_22201F_Boot_Failure_Reason_Read
            DcmDspDidSignal: DcmDspDidDataPos=0, DcmDspDidDataRef=Data_22201F_Boot_Failure_Reason_Read
          DID_2E2023_PROXI_Data: DcmDspDidIdentifier=8227, DcmDspDidInfoRef=DidInfo_DidInfo_2E2023_PROXI_Data
            DcmDspDidSignal: DcmDspDidDataPos=0, DcmDspDidDataRef=Data_2E2023_PROXI_Data
          DID_222024_Read_ECU_PROXI_Data: DcmDspDidIdentifier=8228, DcmDspDidInfoRef=DidInfo_DidInfo_222024_Read_ECU_PROXI_Data
            DcmDspDidSignal: DcmDspDidDataPos=0, DcmDspDidDataRef=Data_222024_Read_ECU_PROXI_Data
          DID_222026_CAN_Overrun_Counters: DcmDspDidIdentifier=8230, DcmDspDidInfoRef=DidInfo_DidInfo_222026_CAN_Overrun_Counters
            DcmDspDidSignal: DcmDspDidDataPos=0, DcmDspDidDataRef=Data_222026_CAN_Overrun_Counters
          DID_222030_Authenticated_Diagnostic_Previous_Access_Read: DcmDspDidIdentifier=8240, DcmDspDidInfoRef=DidInfo_DidInfo_222030_Authenticated_Diagnostic_Previous_Access_Read
            DcmDspDidSignal: DcmDspDidDataPos=0, DcmDspDidDataRef=Data_222030_Authenticated_Diagnostic_Previous_Access_Read
          DID_222031_Disallowed_Certificate_List_Read: DcmDspDidIdentifier=8241, DcmDspDidInfoRef=DidInfo_DidInfo_222031_Disallowed_Certificate_List_Read
            DcmDspDidSignal: DcmDspDidDataPos=0, DcmDspDidDataRef=Data_222031_Disallowed_Certificate_List_Read
          DID_222032_Secure_Log_Read: DcmDspDidIdentifier=8242, DcmDspDidInfoRef=DidInfo_DidInfo_222032_Secure_Log_Read
            DcmDspDidSignal: DcmDspDidDataPos=0, DcmDspDidDataRef=Data_222032_Secure_Log_Read
          DID_22292E_PROXI_Write_Counter: DcmDspDidIdentifier=10542, DcmDspDidInfoRef=DidInfo_DidInfo_22292E_PROXI_Write_Counter
            DcmDspDidSignal: DcmDspDidDataPos=0, DcmDspDidDataRef=Data_22292E_PROXI_Write_Counter
          DID_222939_FDCAN2_BUS_Network_WakeUp_Reason: DcmDspDidIdentifier=10553, DcmDspDidInfoRef=DidInfo_DidInfo_222939_FDCAN2_BUS_Network_WakeUp_Reason
            DcmDspDidSignal: DcmDspDidDataPos=0, DcmDspDidDataRef=Data_222939_FDCAN2_BUS_Network_WakeUp_Reason
          DID_222945_Flow_Control_Test: DcmDspDidIdentifier=10565, DcmDspDidInfoRef=DidInfo_DidInfo_222945_Flow_Control_Test
            DcmDspDidSignal: DcmDspDidDataPos=0, DcmDspDidDataRef=Data_222945_Flow_Control_Test
          DID_222951_Certificate_Store_UUID_Read: DcmDspDidIdentifier=10577, DcmDspDidInfoRef=DidInfo_DidInfo_222951_Certificate_Store_UUID_Read
            DcmDspDidSignal: DcmDspDidDataPos=0, DcmDspDidDataRef=Data_222951_Certificate_Store_UUID_Read
          DID_222954_Policy_Type_Read: DcmDspDidIdentifier=10580, DcmDspDidInfoRef=DidInfo_DidInfo_222954_Policy_Type_Read
            DcmDspDidSignal: DcmDspDidDataPos=0, DcmDspDidDataRef=Data_222954_Policy_Type_Read
          DID_222957_Hosted_App_Firmware_Header_Info_Read: DcmDspDidIdentifier=10583, DcmDspDidInfoRef=DidInfo_DidInfo_222957_Hosted_App_Firmware_Header_Info_Read
            DcmDspDidSignal: DcmDspDidDataPos=0, DcmDspDidDataRef=Data_222957_Hosted_App_Firmware_Header_Info_Read
          DID_222958_Hosted_App_firmware_Header_UUID_Read: DcmDspDidIdentifier=10584, DcmDspDidInfoRef=DidInfo_DidInfo_222958_Hosted_App_firmware_Header_UUID_Read
            DcmDspDidSignal: DcmDspDidDataPos=0, DcmDspDidDataRef=Data_222958_Hosted_App_firmware_Header_UUID_Read
          DID_222959_Hosted_App_Firmware_Cal_Config_Data_Header_Info_Read: DcmDspDidIdentifier=10585, DcmDspDidInfoRef=DidInfo_DidInfo_222959_Hosted_App_Firmware_Cal_Config_Data_Header_Info_Read
            DcmDspDidSignal: DcmDspDidDataPos=0, DcmDspDidDataRef=Data_222959_Hosted_App_Firmware_Cal_Config_Data_Header_Info_Read
          DID_22295A_Hosted_App_Firmware_Cal_Config_Data_Header_UUID_Read: DcmDspDidIdentifier=10586, DcmDspDidInfoRef=DidInfo_DidInfo_22295A_Hosted_App_Firmware_Cal_Config_Data_Header_UUID_Read
            DcmDspDidSignal: DcmDspDidDataPos=0, DcmDspDidDataRef=Data_22295A_Hosted_App_Firmware_Cal_Config_Data_Header_UUID_Read
          DID_22295B_HTA_Header_Info_Read: DcmDspDidIdentifier=10587, DcmDspDidInfoRef=DidInfo_DidInfo_22295B_HTA_Header_Info_Read
            DcmDspDidSignal: DcmDspDidDataPos=0, DcmDspDidDataRef=Data_22295B_HTA_Header_Info_Read
          DID_22295C_HTA_Header_UUID_Read: DcmDspDidIdentifier=10588, DcmDspDidInfoRef=DidInfo_DidInfo_22295C_HTA_Header_UUID_Read
            DcmDspDidSignal: DcmDspDidDataPos=0, DcmDspDidDataRef=Data_22295C_HTA_Header_UUID_Read
          DID_22295E_DCL_Header_UUID_Read: DcmDspDidIdentifier=10590, DcmDspDidInfoRef=DidInfo_DidInfo_22295E_DCL_Header_UUID_Read
            DcmDspDidSignal: DcmDspDidDataPos=0, DcmDspDidDataRef=Data_22295E_DCL_Header_UUID_Read
          DID_22295F_DCL_and_Cerstore_Header_Info_Read: DcmDspDidIdentifier=10591, DcmDspDidInfoRef=DidInfo_DidInfo_22295F_DCL_and_Cerstore_Header_Info_Read
            DcmDspDidSignal: DcmDspDidDataPos=0, DcmDspDidDataRef=Data_22295F_DCL_and_Cerstore_Header_Info_Read
          DID_224421_USS_Sensor_1_Part_Number_Read: DcmDspDidIdentifier=17441, DcmDspDidInfoRef=DidInfo_DidInfo_224421_USS_Sensor_1_Part_Number_Read
            DcmDspDidSignal: DcmDspDidDataPos=0, DcmDspDidDataRef=Data_224421_USS_Sensor_1_Part_Number_Read
          DID_224422_USS_Sensor2_Part_Number_Read: DcmDspDidIdentifier=17442, DcmDspDidInfoRef=DidInfo_DidInfo_224422_USS_Sensor2_Part_Number_Read
            DcmDspDidSignal: DcmDspDidDataPos=0, DcmDspDidDataRef=Data_224422_USS_Sensor2_Part_Number_Read
          DID_224423_USS_Sensor_3_Part_Number_Read: DcmDspDidIdentifier=17443, DcmDspDidInfoRef=DidInfo_DidInfo_224423_USS_Sensor_3_Part_Number_Read
            DcmDspDidSignal: DcmDspDidDataPos=0, DcmDspDidDataRef=Data_224423_USS_Sensor_3_Part_Number_Read
          DID_224424_USS_Sensor_4_Part_Number_Read: DcmDspDidIdentifier=17444, DcmDspDidInfoRef=DidInfo_DidInfo_224424_USS_Sensor_4_Part_Number_Read
            DcmDspDidSignal: DcmDspDidDataPos=0, DcmDspDidDataRef=Data_224424_USS_Sensor_4_Part_Number_Read
          DID_224425_USS_Sensor_5_Part_Number_Read: DcmDspDidIdentifier=17445, DcmDspDidInfoRef=DidInfo_DidInfo_224425_USS_Sensor_5_Part_Number_Read
            DcmDspDidSignal: DcmDspDidDataPos=0, DcmDspDidDataRef=Data_224425_USS_Sensor_5_Part_Number_Read
          DID_224426_USS_Sensor_6_Part_Number_Read: DcmDspDidIdentifier=17446, DcmDspDidInfoRef=DidInfo_DidInfo_224426_USS_Sensor_6_Part_Number_Read
            DcmDspDidSignal: DcmDspDidDataPos=0, DcmDspDidDataRef=Data_224426_USS_Sensor_6_Part_Number_Read
          DID_224427_USS_Sensor_7_Part_Number_Read: DcmDspDidIdentifier=17447, DcmDspDidInfoRef=DidInfo_DidInfo_224427_USS_Sensor_7_Part_Number_Read
            DcmDspDidSignal: DcmDspDidDataPos=0, DcmDspDidDataRef=Data_224427_USS_Sensor_7_Part_Number_Read
          DID_224428_USS_Sensor_8_Part_Number_Read: DcmDspDidIdentifier=17448, DcmDspDidInfoRef=DidInfo_DidInfo_224428_USS_Sensor_8_Part_Number_Read
            DcmDspDidSignal: DcmDspDidDataPos=0, DcmDspDidDataRef=Data_224428_USS_Sensor_8_Part_Number_Read
          DID_224429_USS_Sensor_9_Part_Number_Read: DcmDspDidIdentifier=17449, DcmDspDidInfoRef=DidInfo_DidInfo_224429_USS_Sensor_9_Part_Number_Read
            DcmDspDidSignal: DcmDspDidDataPos=0, DcmDspDidDataRef=Data_224429_USS_Sensor_9_Part_Number_Read
          DID_22442A_USS_Sensor_10_Part_Number_Read: DcmDspDidIdentifier=17450, DcmDspDidInfoRef=DidInfo_DidInfo_22442A_USS_Sensor_10_Part_Number_Read
            DcmDspDidSignal: DcmDspDidDataPos=0, DcmDspDidDataRef=Data_22442A_USS_Sensor_10_Part_Number_Read
          DID_22442B_USS_Sensor_11_Part_Number_Read: DcmDspDidIdentifier=17451, DcmDspDidInfoRef=DidInfo_DidInfo_22442B_USS_Sensor_11_Part_Number_Read
            DcmDspDidSignal: DcmDspDidDataPos=0, DcmDspDidDataRef=Data_22442B_USS_Sensor_11_Part_Number_Read
          DID_22442C_USS_Sensor_12_Part_Number_Read: DcmDspDidIdentifier=17452, DcmDspDidInfoRef=DidInfo_DidInfo_22442C_USS_Sensor_12_Part_Number_Read
            DcmDspDidSignal: DcmDspDidDataPos=0, DcmDspDidDataRef=Data_22442C_USS_Sensor_12_Part_Number_Read
          DID_224451_EOL_Calibration_State_Read: DcmDspDidIdentifier=17489, DcmDspDidInfoRef=DidInfo_DidInfo_224451_EOL_Calibration_State_Read
            DcmDspDidSignal: DcmDspDidDataPos=0, DcmDspDidDataRef=Data_224451_EOL_Calibration_State_Read
          DID_2F5001_Gear_Position_Read: DcmDspDidIdentifier=20481, DcmDspDidInfoRef=DidInfo_DidInfo_2F5001_Gear_Position_Read
            DcmDspDidSignal: DcmDspDidDataPos=0, DcmDspDidDataRef=Data_2F5001_Gear_Position_Read
          DID_225100_SPM_status_Read: DcmDspDidIdentifier=20736, DcmDspDidInfoRef=DidInfo_DidInfo_225100_SPM_status_Read
            DcmDspDidSignal: DcmDspDidDataPos=0, DcmDspDidDataRef=Data_225100_SPM_status_Read
          DID_225102_FD_CAN14_Rx_Signals_Read: DcmDspDidIdentifier=20738, DcmDspDidInfoRef=DidInfo_DidInfo_225102_FD_CAN14_Rx_Signals_Read
            DcmDspDidSignal: DcmDspDidDataPos=0, DcmDspDidDataRef=Data_225102_FD_CAN14_Rx_Signals_Read
          DID_225103_FD_CAN2_Rx_Signals_Read: DcmDspDidIdentifier=20739, DcmDspDidInfoRef=DidInfo_DidInfo_225103_FD_CAN2_Rx_Signals_Read
            DcmDspDidSignal: DcmDspDidDataPos=0, DcmDspDidDataRef=Data_225103_FD_CAN2_Rx_Signals_Read
          DID_225104_FD_CAN14_Tx_Signals_Read: DcmDspDidIdentifier=20740, DcmDspDidInfoRef=DidInfo_DidInfo_225104_FD_CAN14_Tx_Signals_Read
            DcmDspDidSignal: DcmDspDidDataPos=0, DcmDspDidDataRef=Data_225104_FD_CAN14_Tx_Signals_Read
          DID_225105_FD_CAN2_Tx_Signals_Read: DcmDspDidIdentifier=20741, DcmDspDidInfoRef=DidInfo_DidInfo_225105_FD_CAN2_Tx_Signals_Read
            DcmDspDidSignal: DcmDspDidDataPos=0, DcmDspDidDataRef=Data_225105_FD_CAN2_Tx_Signals_Read
          DID_225107_Front_Sensor_HealthBlockage_LiveDetection_Check_Read: DcmDspDidIdentifier=20743, DcmDspDidInfoRef=DidInfo_DidInfo_225107_Front_Sensor_HealthBlockage_LiveDetection_Check_Read
            DcmDspDidSignal: DcmDspDidDataPos=0, DcmDspDidDataRef=Data_225107_Front_Sensor_HealthBlockage_LiveDetection_Check_Read
          DID_225109_Rear_Sensor_HealthBlockage_LiveDetection_Check_Read: DcmDspDidIdentifier=20745, DcmDspDidInfoRef=DidInfo_DidInfo_225109_Rear_Sensor_HealthBlockage_LiveDetection_Check_Read
            DcmDspDidSignal: DcmDspDidDataPos=0, DcmDspDidDataRef=Data_225109_Rear_Sensor_HealthBlockage_LiveDetection_Check_Read
          DID_225201_Plant_Mode_Status_Read: DcmDspDidIdentifier=20993, DcmDspDidInfoRef=DidInfo_DidInfo_225201_Plant_Mode_Status_Read
            DcmDspDidSignal: DcmDspDidDataPos=0, DcmDspDidDataRef=Data_225201_Plant_Mode_Status_Read
          DID_225300_Rear_Braking_Event_1_Read: DcmDspDidIdentifier=21248, DcmDspDidInfoRef=DidInfo_DidInfo_225300_Rear_Braking_Event_1_Read
            DcmDspDidSignal: DcmDspDidDataPos=0, DcmDspDidDataRef=Data_225300_Rear_Braking_Event_1_Read
          DID_225301_Rear_Braking_Event_2_Read: DcmDspDidIdentifier=21249, DcmDspDidInfoRef=DidInfo_DidInfo_225301_Rear_Braking_Event_2_Read
            DcmDspDidSignal: DcmDspDidDataPos=0, DcmDspDidDataRef=Data_225301_Rear_Braking_Event_2_Read
          DID_225302_Rear_Braking_Event_3_Read: DcmDspDidIdentifier=21250, DcmDspDidInfoRef=DidInfo_DidInfo_225302_Rear_Braking_Event_3_Read
            DcmDspDidSignal: DcmDspDidDataPos=0, DcmDspDidDataRef=Data_225302_Rear_Braking_Event_3_Read
          DID_225303_SPM_Event_Abort_1_Read: DcmDspDidIdentifier=21251, DcmDspDidInfoRef=DidInfo_DidInfo_225303_SPM_Event_Abort_1_Read
            DcmDspDidSignal: DcmDspDidDataPos=0, DcmDspDidDataRef=Data_225303_SPM_Event_Abort_1_Read
          DID_225304_SPM_Event_Abort_2_Read: DcmDspDidIdentifier=21252, DcmDspDidInfoRef=DidInfo_DidInfo_225304_SPM_Event_Abort_2_Read
            DcmDspDidSignal: DcmDspDidDataPos=0, DcmDspDidDataRef=Data_225304_SPM_Event_Abort_2_Read
          DID_225305_SPM_Event_Abort_3_Read: DcmDspDidIdentifier=21253, DcmDspDidInfoRef=DidInfo_DidInfo_225305_SPM_Event_Abort_3_Read
            DcmDspDidSignal: DcmDspDidDataPos=0, DcmDspDidDataRef=Data_225305_SPM_Event_Abort_3_Read
          DID_225500_Trailer_Sense_and_Drive_Function_Data_Read: DcmDspDidIdentifier=21760, DcmDspDidInfoRef=DidInfo_DidInfo_225500_Trailer_Sense_and_Drive_Function_Data_Read
            DcmDspDidSignal: DcmDspDidDataPos=0, DcmDspDidDataRef=Data_225500_Trailer_Sense_and_Drive_Function_Data_Read
          DID_225501_Trailer_coupler_sense_detection_Function_Data_Read: DcmDspDidIdentifier=21761, DcmDspDidInfoRef=DidInfo_DidInfo_225501_Trailer_coupler_sense_detection_Function_Data_Read
            DcmDspDidSignal: DcmDspDidDataPos=0, DcmDspDidDataRef=Data_225501_Trailer_coupler_sense_detection_Function_Data_Read
          DID_22F10B_ECU_Qualification: DcmDspDidIdentifier=61707, DcmDspDidInfoRef=DidInfo_DidInfo_22F10B_ECU_Qualification
            DcmDspDidSignal: DcmDspDidDataPos=0, DcmDspDidDataRef=Data_22F10B_ECU_Qualification
          DID_22F10D_Diagnostic_Specification_Information: DcmDspDidIdentifier=61709, DcmDspDidInfoRef=DidInfo_DidInfo_22F10D_Diagnostic_Specification_Information
            DcmDspDidSignal: DcmDspDidDataPos=0, DcmDspDidDataRef=Data_22F10D_Diagnostic_Specification_Information
          DID_22F110_ECU_Diagnostic_Identification: DcmDspDidIdentifier=61712, DcmDspDidInfoRef=DidInfo_DidInfo_22F110_ECU_Diagnostic_Identification
            DcmDspDidSignal: DcmDspDidDataPos=0, DcmDspDidDataRef=Data_22F110_ECU_Diagnostic_Identification
          DID_22F111_Public_Certificates_Regional_Support_Read: DcmDspDidIdentifier=61713, DcmDspDidInfoRef=DidInfo_DidInfo_22F111_Public_Certificates_Regional_Support_Read
            DcmDspDidSignal: DcmDspDidDataPos=0, DcmDspDidDataRef=Data_22F111_Public_Certificates_Regional_Support_Read
          DID_22F112_PTESLM_Hardware_Number: DcmDspDidIdentifier=61714, DcmDspDidInfoRef=DidInfo_DidInfo_22F112_PTESLM_Hardware_Number
            DcmDspDidSignal: DcmDspDidDataPos=0, DcmDspDidDataRef=Data_22F112_PTESLM_Hardware_Number
          DID_22F122_Software_EBOM_Part_Number: DcmDspDidIdentifier=61730, DcmDspDidInfoRef=DidInfo_DidInfo_22F122_Software_EBOM_Part_Number
            DcmDspDidSignal: DcmDspDidDataPos=0, DcmDspDidDataRef=Data_22F122_Software_EBOM_Part_Number
          DID_22F132_EBOM_ECU_Part_Number: DcmDspDidIdentifier=61746, DcmDspDidInfoRef=DidInfo_DidInfo_22F132_EBOM_ECU_Part_Number
            DcmDspDidSignal: DcmDspDidDataPos=0, DcmDspDidDataRef=Data_22F132_EBOM_ECU_Part_Number
          DID_22F133_EBOM_Assembly_Part_Number: DcmDspDidIdentifier=61747, DcmDspDidInfoRef=DidInfo_DidInfo_22F133_EBOM_Assembly_Part_Number
            DcmDspDidSignal: DcmDspDidDataPos=0, DcmDspDidDataRef=Data_22F133_EBOM_Assembly_Part_Number
          DID_22F134_CODEP_assembly_part_number: DcmDspDidIdentifier=61748, DcmDspDidInfoRef=DidInfo_DidInfo_22F134_CODEP_assembly_part_number
            DcmDspDidSignal: DcmDspDidDataPos=0, DcmDspDidDataRef=Data_22F134_CODEP_assembly_part_number
          DID_22F154_Hardware_Supplier_Identification: DcmDspDidIdentifier=61780, DcmDspDidInfoRef=DidInfo_DidInfo_22F154_Hardware_Supplier_Identification
            DcmDspDidSignal: DcmDspDidDataPos=0, DcmDspDidDataRef=Data_22F154_Hardware_Supplier_Identification
          DID_22F155_Software_Supplier_Identification: DcmDspDidIdentifier=61781, DcmDspDidInfoRef=DidInfo_DidInfo_22F155_Software_Supplier_Identification
            DcmDspDidSignal: DcmDspDidDataPos=0, DcmDspDidDataRef=Data_22F155_Software_Supplier_Identification
          DID_22F180_Boot_Software_Version_Information: DcmDspDidIdentifier=61824, DcmDspDidInfoRef=DidInfo_DidInfo_22F180_Boot_Software_Version_Information
            DcmDspDidSignal: DcmDspDidDataPos=0, DcmDspDidDataRef=Data_22F180_Boot_Software_Version_Information
          DID_22F181_Application_Software_Identification: DcmDspDidIdentifier=61825, DcmDspDidInfoRef=DidInfo_DidInfo_22F181_Application_Software_Identification
            DcmDspDidSignal: DcmDspDidDataPos=0, DcmDspDidDataRef=Data_22F181_Application_Software_Identification
          DID_22F182_Application_Data_Identification: DcmDspDidIdentifier=61826, DcmDspDidInfoRef=DidInfo_DidInfo_22F182_Application_Data_Identification
            DcmDspDidSignal: DcmDspDidDataPos=0, DcmDspDidDataRef=Data_22F182_Application_Data_Identification
          DID_2EF184_Application_Software_Fingerprint_writing_information: DcmDspDidIdentifier=61828, DcmDspDidInfoRef=DidInfo_DidInfo_2EF184_Application_Software_Fingerprint_writing_information
            DcmDspDidSignal: DcmDspDidDataPos=0, DcmDspDidDataRef=Data_2EF184_Application_Software_Fingerprint_writing_information
          DID_2EF185_Application_Data_Software_Fingerprint_Writing_Information: DcmDspDidIdentifier=61829, DcmDspDidInfoRef=DidInfo_DidInfo_2EF185_Application_Data_Software_Fingerprint_Writing_Information
            DcmDspDidSignal: DcmDspDidDataPos=0, DcmDspDidDataRef=Data_2EF185_Application_Data_Software_Fingerprint_Writing_Information
          DID_22F186_Active_Diagnostic_Session: DcmDspDidIdentifier=61830, DcmDspDidInfoRef=DidInfo_DidInfo_22F186_Active_Diagnostic_Session
            DcmDspDidSignal: DcmDspDidDataPos=0, DcmDspDidDataRef=Data_22F186_Active_Diagnostic_Session
          DID_22F187_CODEP_ECU_Part_Number: DcmDspDidIdentifier=61831, DcmDspDidInfoRef=DidInfo_DidInfo_22F187_CODEP_ECU_Part_Number
            DcmDspDidSignal: DcmDspDidDataPos=0, DcmDspDidDataRef=Data_22F187_CODEP_ECU_Part_Number
          DID_22F188_FCA_ESLM_ECU_Software_Number: DcmDspDidIdentifier=61832, DcmDspDidInfoRef=DidInfo_DidInfo_22F188_FCA_ESLM_ECU_Software_Number
            DcmDspDidSignal: DcmDspDidDataPos=0, DcmDspDidDataRef=Data_22F188_FCA_ESLM_ECU_Software_Number
          DID_22F18A_FCA_ESLM_ECU_Software_Calibration_Number: DcmDspDidIdentifier=61834, DcmDspDidInfoRef=DidInfo_DidInfo_22F18A_FCA_ESLM_ECU_Software_Calibration_Number
            DcmDspDidSignal: DcmDspDidDataPos=0, DcmDspDidDataRef=Data_22F18A_FCA_ESLM_ECU_Software_Calibration_Number
          DID_22F18B_FCA_ESLM_ECU_Software_Application_Number: DcmDspDidIdentifier=61835, DcmDspDidInfoRef=DidInfo_DidInfo_22F18B_FCA_ESLM_ECU_Software_Application_Number
            DcmDspDidSignal: DcmDspDidDataPos=0, DcmDspDidDataRef=Data_22F18B_FCA_ESLM_ECU_Software_Application_Number
          DID_22F18C_ECU_Serial_Number: DcmDspDidIdentifier=61836, DcmDspDidInfoRef=DidInfo_DidInfo_22F18C_ECU_Serial_Number
            DcmDspDidSignal: DcmDspDidDataPos=0, DcmDspDidDataRef=Data_22F18C_ECU_Serial_Number
          DID_22F190_VIN_Original: DcmDspDidIdentifier=61840, DcmDspDidInfoRef=DidInfo_DidInfo_22F190_VIN_Original
            DcmDspDidSignal: DcmDspDidDataPos=0, DcmDspDidDataRef=Data_22F190_VIN_Original
          DID_22F191_FCA_ESLM_ECU_Hardware_Number: DcmDspDidIdentifier=61841, DcmDspDidInfoRef=DidInfo_DidInfo_22F191_FCA_ESLM_ECU_Hardware_Number
            DcmDspDidSignal: DcmDspDidDataPos=0, DcmDspDidDataRef=Data_22F191_FCA_ESLM_ECU_Hardware_Number
          DID_22F192_Supplier_ECU_Hardware_Part_Number: DcmDspDidIdentifier=61842, DcmDspDidInfoRef=DidInfo_DidInfo_22F192_Supplier_ECU_Hardware_Part_Number
            DcmDspDidSignal: DcmDspDidDataPos=0, DcmDspDidDataRef=Data_22F192_Supplier_ECU_Hardware_Part_Number
          DID_22F193_Supplier_ECU_Hardware_Version_Number: DcmDspDidIdentifier=61843, DcmDspDidInfoRef=DidInfo_DidInfo_22F193_Supplier_ECU_Hardware_Version_Number
            DcmDspDidSignal: DcmDspDidDataPos=0, DcmDspDidDataRef=Data_22F193_Supplier_ECU_Hardware_Version_Number
          DID_22F194_Supplier_ECU_Software_Part_Number: DcmDspDidIdentifier=61844, DcmDspDidInfoRef=DidInfo_DidInfo_22F194_Supplier_ECU_Software_Part_Number
            DcmDspDidSignal: DcmDspDidDataPos=0, DcmDspDidDataRef=Data_22F194_Supplier_ECU_Software_Part_Number
          DID_22F195_Supplier_ECU_Software_Version_Number: DcmDspDidIdentifier=61845, DcmDspDidInfoRef=DidInfo_DidInfo_22F195_Supplier_ECU_Software_Version_Number
            DcmDspDidSignal: DcmDspDidDataPos=0, DcmDspDidDataRef=Data_22F195_Supplier_ECU_Software_Version_Number
          DID_22F1A0_System_Identification_Data: DcmDspDidIdentifier=61856, DcmDspDidInfoRef=DidInfo_DidInfo_22F1A0_System_Identification_Data
            DcmDspDidSignal: DcmDspDidDataPos=0, DcmDspDidDataRef=Data_22F1A0_System_Identification_Data
          DID_22F1A1_Configuration_Code: DcmDspDidIdentifier=61857, DcmDspDidInfoRef=DidInfo_DidInfo_22F1A1_Configuration_Code
            DcmDspDidSignal: DcmDspDidDataPos=0, DcmDspDidDataRef=Data_22F1A1_Configuration_Code
          DID_22F1A2_Vector_Delivery_ID: DcmDspDidIdentifier=61858, DcmDspDidInfoRef=DidInfo_DidInfo_22F1A2_Vector_Delivery_ID
            DcmDspDidSignal: DcmDspDidDataPos=0, DcmDspDidDataRef=Data_22F1A2_Vector_Delivery_ID
          DID_22F1A6_Message_Matrix: DcmDspDidIdentifier=61862, DcmDspDidInfoRef=DidInfo_DidInfo_22F1A6_Message_Matrix
            DcmDspDidSignal: DcmDspDidDataPos=0, DcmDspDidDataRef=Data_22F1A6_Message_Matrix
          DID_22F1B0_VIN_Current: DcmDspDidIdentifier=61872, DcmDspDidInfoRef=DidInfo_DidInfo_22F1B0_VIN_Current
            DcmDspDidSignal: DcmDspDidDataPos=0, DcmDspDidDataRef=Data_22F1B0_VIN_Current
          DID_22F1B3_Boot_Software_Fingerprint_Reading_Information: DcmDspDidIdentifier=61875, DcmDspDidInfoRef=DidInfo_DidInfo_22F1B3_Boot_Software_Fingerprint_Reading_Information
            DcmDspDidSignal: DcmDspDidDataPos=0, DcmDspDidDataRef=Data_22F1B3_Boot_Software_Fingerprint_Reading_Information
          DID_22F1B4_Application_Software_Fingerprint_Reading_Information: DcmDspDidIdentifier=61876, DcmDspDidInfoRef=DidInfo_DidInfo_22F1B4_Application_Software_Fingerprint_Reading_Information
            DcmDspDidSignal: DcmDspDidDataPos=0, DcmDspDidDataRef=Data_22F1B4_Application_Software_Fingerprint_Reading_Information
          DID_22F1B5_Application_Data_Software_Fingerprint_Reading_Information: DcmDspDidIdentifier=61877, DcmDspDidInfoRef=DidInfo_DidInfo_22F1B5_Application_Data_Software_Fingerprint_Reading_Information
            DcmDspDidSignal: DcmDspDidDataPos=0, DcmDspDidDataRef=Data_22F1B5_Application_Data_Software_Fingerprint_Reading_Information
          DID_22FD00_Plant_Camera_Calibration_Data: DcmDspDidIdentifier=64768, DcmDspDidInfoRef=DidInfo_DidInfo_22FD00_Plant_Camera_Calibration_Data
            DcmDspDidSignal: DcmDspDidDataPos=0, DcmDspDidDataRef=Data_22FD00_Plant_Camera_Calibration_Data
          DID_22FD01_Previous_Camera_Calibration_Data: DcmDspDidIdentifier=64769, DcmDspDidInfoRef=DidInfo_DidInfo_22FD01_Previous_Camera_Calibration_Data
            DcmDspDidSignal: DcmDspDidDataPos=0, DcmDspDidDataRef=Data_22FD01_Previous_Camera_Calibration_Data
          DID_22FD04_USS_Sensor_tuning_values_Read: DcmDspDidIdentifier=64772, DcmDspDidInfoRef=DidInfo_DidInfo_22FD04_USS_Sensor_tuning_values_Read
            DcmDspDidSignal: DcmDspDidDataPos=0, DcmDspDidDataRef=Data_22FD04_USS_Sensor_tuning_values_Read
          DID_22FD07_OC_Result_Read: DcmDspDidIdentifier=64775, DcmDspDidInfoRef=DidInfo_DidInfo_22FD07_OC_Result_Read
            DcmDspDidSignal: DcmDspDidDataPos=0, DcmDspDidDataRef=Data_22FD07_OC_Result_Read
          DID_22FD08_OC_Data_Read: DcmDspDidIdentifier=64776, DcmDspDidInfoRef=DidInfo_DidInfo_22FD08_OC_Data_Read
            DcmDspDidSignal: DcmDspDidDataPos=0, DcmDspDidDataRef=Data_22FD08_OC_Data_Read
          DID_22FD0A_SC_Data_Read: DcmDspDidIdentifier=64778, DcmDspDidInfoRef=DidInfo_DidInfo_22FD0A_SC_Data_Read
            DcmDspDidSignal: DcmDspDidDataPos=0, DcmDspDidDataRef=Data_22FD0A_SC_Data_Read
          DID_22FD0C_Front_Camera_Data_EEPROM_Read: DcmDspDidIdentifier=64780, DcmDspDidInfoRef=DidInfo_DidInfo_22FD0C_Front_Camera_Data_EEPROM_Read
            DcmDspDidSignal: DcmDspDidDataPos=0, DcmDspDidDataRef=Data_22FD0C_Front_Camera_Data_EEPROM_Read
          DID_22FD0D_Left_Camera_Data_EEPROM_Read: DcmDspDidIdentifier=64781, DcmDspDidInfoRef=DidInfo_DidInfo_22FD0D_Left_Camera_Data_EEPROM_Read
            DcmDspDidSignal: DcmDspDidDataPos=0, DcmDspDidDataRef=Data_22FD0D_Left_Camera_Data_EEPROM_Read
          DID_22FD0E_Rear_Camera_Data_EEPROM_Read: DcmDspDidIdentifier=64782, DcmDspDidInfoRef=DidInfo_DidInfo_22FD0E_Rear_Camera_Data_EEPROM_Read
            DcmDspDidSignal: DcmDspDidDataPos=0, DcmDspDidDataRef=Data_22FD0E_Rear_Camera_Data_EEPROM_Read
          DID_22FD0F_Right_Camera_Data_EEPROM_Read: DcmDspDidIdentifier=64783, DcmDspDidInfoRef=DidInfo_DidInfo_22FD0F_Right_Camera_Data_EEPROM_Read
            DcmDspDidSignal: DcmDspDidDataPos=0, DcmDspDidDataRef=Data_22FD0F_Right_Camera_Data_EEPROM_Read
          DID_22FD13_Magna_Software_Version: DcmDspDidIdentifier=64787, DcmDspDidInfoRef=DidInfo_DidInfo_22FD13_Magna_Software_Version
            DcmDspDidSignal: DcmDspDidDataPos=0, DcmDspDidDataRef=Data_22FD13_Magna_Software_Version
          DID_22FD14_FD14_Magna_Production_Date_Read: DcmDspDidIdentifier=64788, DcmDspDidInfoRef=DidInfo_DidInfo_22FD14_FD14_Magna_Production_Date_Read
            DcmDspDidSignal: DcmDspDidDataPos=0, DcmDspDidDataRef=Data_22FD14_FD14_Magna_Production_Date_Read
          DID_22FD15_Magna_Production_HW_Number_Read: DcmDspDidIdentifier=64789, DcmDspDidInfoRef=DidInfo_DidInfo_22FD15_Magna_Production_HW_Number_Read
            DcmDspDidSignal: DcmDspDidDataPos=0, DcmDspDidDataRef=Data_22FD15_Magna_Production_HW_Number_Read
          DID_22FD16_Magna_Production_ICT_Data_Read: DcmDspDidIdentifier=64790, DcmDspDidInfoRef=DidInfo_DidInfo_22FD16_Magna_Production_ICT_Data_Read
            DcmDspDidSignal: DcmDspDidDataPos=0, DcmDspDidDataRef=Data_22FD16_Magna_Production_ICT_Data_Read
          DID_22FD17_Magna_Production_HW_Version_information_Read: DcmDspDidIdentifier=64791, DcmDspDidInfoRef=DidInfo_DidInfo_22FD17_Magna_Production_HW_Version_information_Read
            DcmDspDidSignal: DcmDspDidDataPos=0, DcmDspDidDataRef=Data_22FD17_Magna_Production_HW_Version_information_Read
          DID_22FD1C_Current_Camera_Calibration_Data_Read: DcmDspDidIdentifier=64796, DcmDspDidInfoRef=DidInfo_DidInfo_22FD1C_Current_Camera_Calibration_Data_Read
            DcmDspDidSignal: DcmDspDidDataPos=0, DcmDspDidDataRef=Data_22FD1C_Current_Camera_Calibration_Data_Read
          DID_22FD1D_PCB_Serial_Number: DcmDspDidIdentifier=64797, DcmDspDidInfoRef=DidInfo_DidInfo_22FD1D_PCB_Serial_Number
            DcmDspDidSignal: DcmDspDidDataPos=0, DcmDspDidDataRef=Data_22FD1D_PCB_Serial_Number
          DID_22FD1E_Calibration_Status_Read: DcmDspDidIdentifier=64798, DcmDspDidInfoRef=DidInfo_DidInfo_22FD1E_Calibration_Status_Read
            DcmDspDidSignal: DcmDspDidDataPos=0, DcmDspDidDataRef=Data_22FD1E_Calibration_Status_Read
          DID_22FD20_ECU_PinStates_Read: DcmDspDidIdentifier=64800, DcmDspDidInfoRef=DidInfo_DidInfo_22FD20_ECU_PinStates_Read
            DcmDspDidSignal: DcmDspDidDataPos=0, DcmDspDidDataRef=Data_22FD20_ECU_PinStates_Read
          DID_22FD28_USS_Ringing_Frequency_Read: DcmDspDidIdentifier=64808, DcmDspDidInfoRef=DidInfo_DidInfo_22FD28_USS_Ringing_Frequency_Read
            DcmDspDidSignal: DcmDspDidDataPos=0, DcmDspDidDataRef=Data_22FD28_USS_Ringing_Frequency_Read
          DID_22FD29_USS_Driving_Frequency_Read: DcmDspDidIdentifier=64809, DcmDspDidInfoRef=DidInfo_DidInfo_22FD29_USS_Driving_Frequency_Read
            DcmDspDidSignal: DcmDspDidDataPos=0, DcmDspDidDataRef=Data_22FD29_USS_Driving_Frequency_Read
          DID_22FD2A_USS_Ringing_Time_Read: DcmDspDidIdentifier=64810, DcmDspDidInfoRef=DidInfo_DidInfo_22FD2A_USS_Ringing_Time_Read
            DcmDspDidSignal: DcmDspDidDataPos=0, DcmDspDidDataRef=Data_22FD2A_USS_Ringing_Time_Read
          DID_22FD2B_USS_Direct_Distance_0xFD2B_Read: DcmDspDidIdentifier=64811, DcmDspDidInfoRef=DidInfo_DidInfo_22FD2B_USS_Direct_Distance_0xFD2B_Read
            DcmDspDidSignal: DcmDspDidDataPos=0, DcmDspDidDataRef=Data_22FD2B_USS_Direct_Distance_0xFD2B_Read
          DID_22FD2C_USS_Temperature_Read: DcmDspDidIdentifier=64812, DcmDspDidInfoRef=DidInfo_DidInfo_22FD2C_USS_Temperature_Read
            DcmDspDidSignal: DcmDspDidDataPos=0, DcmDspDidDataRef=Data_22FD2C_USS_Temperature_Read
          DID_22FD2D_USS_Sensor_ID_IME_SN_Read: DcmDspDidIdentifier=64813, DcmDspDidInfoRef=DidInfo_DidInfo_22FD2D_USS_Sensor_ID_IME_SN_Read
            DcmDspDidSignal: DcmDspDidDataPos=0, DcmDspDidDataRef=Data_22FD2D_USS_Sensor_ID_IME_SN_Read
          DID_22FD2E_USS_Sensor_ID_Murata_SN_Read: DcmDspDidIdentifier=64814, DcmDspDidInfoRef=DidInfo_DidInfo_22FD2E_USS_Sensor_ID_Murata_SN_Read
            DcmDspDidSignal: DcmDspDidDataPos=0, DcmDspDidDataRef=Data_22FD2E_USS_Sensor_ID_Murata_SN_Read
          DID_22FD31_Magna_EOL_Coding_State_Read: DcmDspDidIdentifier=64817, DcmDspDidInfoRef=DidInfo_DidInfo_22FD31_Magna_EOL_Coding_State_Read
            DcmDspDidSignal: DcmDspDidDataPos=0, DcmDspDidDataRef=Data_22FD31_Magna_EOL_Coding_State_Read
          DID_22FD33_Magna_Testing_2_Read: DcmDspDidIdentifier=64819, DcmDspDidInfoRef=DidInfo_DidInfo_22FD33_Magna_Testing_2_Read
            DcmDspDidSignal: DcmDspDidDataPos=0, DcmDspDidDataRef=Data_22FD33_Magna_Testing_2_Read
          DID_22FD38_Programmed_Assembly: DcmDspDidIdentifier=64824, DcmDspDidInfoRef=DidInfo_DidInfo_22FD38_Programmed_Assembly
            DcmDspDidSignal: DcmDspDidDataPos=0, DcmDspDidDataRef=Data_22FD38_Programmed_Assembly
          DID_22FD42_Failsafe_Behaviour_Read: DcmDspDidIdentifier=64834, DcmDspDidInfoRef=DidInfo_DidInfo_22FD42_Failsafe_Behaviour_Read
            DcmDspDidSignal: DcmDspDidDataPos=0, DcmDspDidDataRef=Data_22FD42_Failsafe_Behaviour_Read
          DID_22FD43_Active_Safe_State_Read: DcmDspDidIdentifier=64835, DcmDspDidInfoRef=DidInfo_DidInfo_22FD43_Active_Safe_State_Read
            DcmDspDidSignal: DcmDspDidDataPos=0, DcmDspDidDataRef=Data_22FD43_Active_Safe_State_Read
          DID_22FD44_Error_Flags_Read: DcmDspDidIdentifier=64836, DcmDspDidInfoRef=DidInfo_DidInfo_22FD44_Error_Flags_Read
            DcmDspDidSignal: DcmDspDidDataPos=0, DcmDspDidDataRef=Data_22FD44_Error_Flags_Read
          DID_22FD46_Camera_Power_Supply_Read: DcmDspDidIdentifier=64838, DcmDspDidInfoRef=DidInfo_DidInfo_22FD46_Camera_Power_Supply_Read
            DcmDspDidSignal: DcmDspDidDataPos=0, DcmDspDidDataRef=Data_22FD46_Camera_Power_Supply_Read
          DID_22FD47_SoC_Temperature_0xFD47_Read: DcmDspDidIdentifier=64839, DcmDspDidInfoRef=DidInfo_DidInfo_22FD47_SoC_Temperature_0xFD47_Read
            DcmDspDidSignal: DcmDspDidDataPos=0, DcmDspDidDataRef=Data_22FD47_SoC_Temperature_0xFD47_Read
          DID_22FD48_PCBA_Temperature_Read: DcmDspDidIdentifier=64840, DcmDspDidInfoRef=DidInfo_DidInfo_22FD48_PCBA_Temperature_Read
            DcmDspDidSignal: DcmDspDidDataPos=0, DcmDspDidDataRef=Data_22FD48_PCBA_Temperature_Read
          DID_22FD49_SoC_Die_Temperature_ID_0xFD49_Read: DcmDspDidIdentifier=64841, DcmDspDidInfoRef=DidInfo_DidInfo_22FD49_SoC_Die_Temperature_ID_0xFD49_Read
            DcmDspDidSignal: DcmDspDidDataPos=0, DcmDspDidDataRef=Data_22FD49_SoC_Die_Temperature_ID_0xFD49_Read
          DID_22FD4A_Ultrasonic_Sensors_Power_supply_and_Current_Level_Read: DcmDspDidIdentifier=64842, DcmDspDidInfoRef=DidInfo_DidInfo_22FD4A_Ultrasonic_Sensors_Power_supply_and_Current_Level_Read
            DcmDspDidSignal: DcmDspDidDataPos=0, DcmDspDidDataRef=Data_22FD4A_Ultrasonic_Sensors_Power_supply_and_Current_Level_Read
          DID_2EFD4E_Reset_NVM_Write: DcmDspDidIdentifier=64846, DcmDspDidInfoRef=DidInfo_DidInfo_2EFD4E_Reset_NVM_Write
            DcmDspDidSignal: DcmDspDidDataPos=0, DcmDspDidDataRef=Data_2EFD4E_Reset_NVM_Write
          DID_22FD60_ECU_Software_Status_Read: DcmDspDidIdentifier=64864, DcmDspDidInfoRef=DidInfo_DidInfo_22FD60_ECU_Software_Status_Read
            DcmDspDidSignal: DcmDspDidDataPos=0, DcmDspDidDataRef=Data_22FD60_ECU_Software_Status_Read
          DID_22FD61_Vehicle_Variant_Coding_Data_Read: DcmDspDidIdentifier=64865, DcmDspDidInfoRef=DidInfo_DidInfo_22FD61_Vehicle_Variant_Coding_Data_Read
            DcmDspDidSignal: DcmDspDidDataPos=0, DcmDspDidDataRef=Data_22FD61_Vehicle_Variant_Coding_Data_Read
          DID_22FD62_ASIL_QM_Fault_Status_Read: DcmDspDidIdentifier=64866, DcmDspDidInfoRef=DidInfo_DidInfo_22FD62_ASIL_QM_Fault_Status_Read
            DcmDspDidSignal: DcmDspDidDataPos=0, DcmDspDidDataRef=Data_22FD62_ASIL_QM_Fault_Status_Read
          DID_22FD64_ASIL_B_Fault_Status_Read: DcmDspDidIdentifier=64868, DcmDspDidInfoRef=DidInfo_DidInfo_22FD64_ASIL_B_Fault_Status_Read
            DcmDspDidSignal: DcmDspDidDataPos=0, DcmDspDidDataRef=Data_22FD64_ASIL_B_Fault_Status_Read
          DID_22FD65_FuSa_Module_Status_Read: DcmDspDidIdentifier=64869, DcmDspDidInfoRef=DidInfo_DidInfo_22FD65_FuSa_Module_Status_Read
            DcmDspDidSignal: DcmDspDidDataPos=0, DcmDspDidDataRef=Data_22FD65_FuSa_Module_Status_Read
          DID_22FD66_Camera_occlusion_and_low_light_status_Read: DcmDspDidIdentifier=64870, DcmDspDidInfoRef=DidInfo_DidInfo_22FD66_Camera_occlusion_and_low_light_status_Read
            DcmDspDidSignal: DcmDspDidDataPos=0, DcmDspDidDataRef=Data_22FD66_Camera_occlusion_and_low_light_status_Read
          DID_22FD67_Camera_DLD_Status_Read: DcmDspDidIdentifier=64871, DcmDspDidInfoRef=DidInfo_DidInfo_22FD67_Camera_DLD_Status_Read
            DcmDspDidSignal: DcmDspDidDataPos=0, DcmDspDidDataRef=Data_22FD67_Camera_DLD_Status_Read
          DID_22FD74_PHY_Tunning_Error_And_Buffer_Mark_Error_Read: DcmDspDidIdentifier=64884, DcmDspDidInfoRef=DidInfo_DidInfo_22FD74_PHY_Tunning_Error_And_Buffer_Mark_Error_Read
            DcmDspDidSignal: DcmDspDidDataPos=0, DcmDspDidDataRef=Data_22FD74_PHY_Tunning_Error_And_Buffer_Mark_Error_Read
          DID_22FD86_Functional_Settings_Read: DcmDspDidIdentifier=64902, DcmDspDidInfoRef=DidInfo_DidInfo_22FD86_Functional_Settings_Read
            DcmDspDidSignal: DcmDspDidDataPos=0, DcmDspDidDataRef=Data_22FD86_Functional_Settings_Read
          DID_22FDF0_ECU_shutdown_process_Read: DcmDspDidIdentifier=65008, DcmDspDidInfoRef=DidInfo_DidInfo_22FDF0_ECU_shutdown_process_Read
            DcmDspDidSignal: DcmDspDidDataPos=0, DcmDspDidDataRef=Data_22FDF0_ECU_shutdown_process_Read
          DID_22FDF1_CPU_Load_Read: DcmDspDidIdentifier=65009, DcmDspDidInfoRef=DidInfo_DidInfo_22FDF1_CPU_Load_Read
            DcmDspDidSignal: DcmDspDidDataPos=0, DcmDspDidDataRef=Data_22FDF1_CPU_Load_Read
          DID_22FDF2_Reset_Reason_Read: DcmDspDidIdentifier=65010, DcmDspDidInfoRef=DidInfo_DidInfo_22FDF2_Reset_Reason_Read
            DcmDspDidSignal: DcmDspDidDataPos=0, DcmDspDidDataRef=Data_22FDF2_Reset_Reason_Read
          DID_22FDF5_PerformanceStatEnable_Read: DcmDspDidIdentifier=65013, DcmDspDidInfoRef=DidInfo_DidInfo_22FDF5_PerformanceStatEnable_Read
            DcmDspDidSignal: DcmDspDidDataPos=0, DcmDspDidDataRef=Data_22FDF5_PerformanceStatEnable_Read
          DID_22FDF6_RunTimeStatsData_Read: DcmDspDidIdentifier=65014, DcmDspDidInfoRef=DidInfo_DidInfo_22FDF6_RunTimeStatsData_Read
            DcmDspDidSignal: DcmDspDidDataPos=0, DcmDspDidDataRef=Data_22FDF6_RunTimeStatsData_Read
          DID_22FDF7_Intrinsic_Camera_NvM_Data_Read: DcmDspDidIdentifier=65015, DcmDspDidInfoRef=DidInfo_DidInfo_22FDF7_Intrinsic_Camera_NvM_Data_Read
            DcmDspDidSignal: DcmDspDidDataPos=0, DcmDspDidDataRef=Data_22FDF7_Intrinsic_Camera_NvM_Data_Read
          DID_22FDF8_StackUsage_Read: DcmDspDidIdentifier=65016, DcmDspDidInfoRef=DidInfo_DidInfo_22FDF8_StackUsage_Read
            DcmDspDidSignal: DcmDspDidDataPos=0, DcmDspDidDataRef=Data_22FDF8_StackUsage_Read
        164 x DcmDspDidInfo:
          DidInfo_DidInfo_220103_VIN_Lock_Status
            DcmDspDidAccess
              DcmDspDidRead: DcmDspDidReadSessionRef=Default_Session, DcmDspDidReadSessionRef=Extended_Diagnostic_Session
          DidInfo_DidInfo_220107_RoE_Activation_State
            DcmDspDidAccess
              DcmDspDidRead: DcmDspDidReadSessionRef=Default_Session, DcmDspDidReadSessionRef=Extended_Diagnostic_Session
              DcmDspDidWrite: DcmDspDidWriteSessionRef=Extended_Diagnostic_Session, DcmDspDidWriteSecurityLevelRef=Authenticated_Diagnostic_Access
          DidInfo_DidInfo_220108_Authenticated_Diagnostics_Active_Role_Read
            DcmDspDidAccess
              DcmDspDidRead
          DidInfo_DidInfo_221002_Vehicle_Speed
            DcmDspDidAccess
              DcmDspDidRead: DcmDspDidReadSessionRef=Default_Session, DcmDspDidReadSessionRef=Extended_Diagnostic_Session
          DidInfo_DidInfo_221004_Battery_Voltage
            DcmDspDidAccess
              DcmDspDidRead: DcmDspDidReadSessionRef=Default_Session, DcmDspDidReadSessionRef=Extended_Diagnostic_Session
          DidInfo_DidInfo_221008_ECU_Life_Time
            DcmDspDidAccess
              DcmDspDidRead: DcmDspDidReadSessionRef=Default_Session, DcmDspDidReadSessionRef=Extended_Diagnostic_Session
          DidInfo_DidInfo_221009_ECU_Time_Since_Ignition_ON
            DcmDspDidAccess
              DcmDspDidRead: DcmDspDidReadSessionRef=Default_Session, DcmDspDidReadSessionRef=Extended_Diagnostic_Session
          DidInfo_DidInfo_22100B_Diagnostic_Tool_and_Session_Status
            DcmDspDidAccess
              DcmDspDidRead
          DidInfo_DidInfo_22100C_Security_Status_Read
            DcmDspDidAccess
              DcmDspDidRead
          DidInfo_DidInfo_22102A_Check_EOL_Configuration_Data
            DcmDspDidAccess
              DcmDspDidRead: DcmDspDidReadSessionRef=Default_Session, DcmDspDidReadSessionRef=Extended_Diagnostic_Session
          DidInfo_DidInfo_22191D_Time_of_Power_Latch
            DcmDspDidAccess
              DcmDspDidRead: DcmDspDidReadSessionRef=Default_Session, DcmDspDidReadSessionRef=Extended_Diagnostic_Session
          DidInfo_DidInfo_221921_Operational_Mode_Status
            DcmDspDidAccess
              DcmDspDidRead: DcmDspDidReadSessionRef=Default_Session, DcmDspDidReadSessionRef=Extended_Diagnostic_Session
          DidInfo_DidInfo_222001_Odometer
            DcmDspDidAccess
              DcmDspDidRead: DcmDspDidReadSessionRef=Default_Session, DcmDspDidReadSessionRef=Extended_Diagnostic_Session
          DidInfo_DidInfo_222002_Odometer_at_last_Flash_programming
            DcmDspDidAccess
              DcmDspDidRead
          DidInfo_DidInfo_222003_Boot_Software_Programming_Attempt_Counter
            DcmDspDidAccess
              DcmDspDidRead
          DidInfo_DidInfo_222008_ECU_Life_Time_Not_Volatile_Memory
            DcmDspDidAccess
              DcmDspDidRead: DcmDspDidReadSessionRef=Default_Session, DcmDspDidReadSessionRef=Extended_Diagnostic_Session
          DidInfo_DidInfo_22200A_Ignition_ON_Counter
            DcmDspDidAccess
              DcmDspDidRead: DcmDspDidReadSessionRef=Default_Session, DcmDspDidReadSessionRef=Extended_Diagnostic_Session
          DidInfo_DidInfo_22200B_Time_First_DTC_Detection
            DcmDspDidAccess
              DcmDspDidRead: DcmDspDidReadSessionRef=Default_Session, DcmDspDidReadSessionRef=Extended_Diagnostic_Session
          DidInfo_DidInfo_22200C_Time_Since_Ignition_ON_of_first_DTC_Detection
            DcmDspDidAccess
              DcmDspDidRead: DcmDspDidReadSessionRef=Default_Session, DcmDspDidReadSessionRef=Extended_Diagnostic_Session
          DidInfo_DidInfo_22200D_Odometer_Last_Clear_Data_Trouble_Code_DTC
            DcmDspDidAccess
              DcmDspDidRead: DcmDspDidReadSessionRef=Default_Session, DcmDspDidReadSessionRef=Extended_Diagnostic_Session
          DidInfo_DidInfo_222010_Programming_Status
            DcmDspDidAccess
              DcmDspDidRead
          DidInfo_DidInfo_222013_VIN_Lock_State_Read
            DcmDspDidAccess
              DcmDspDidRead: DcmDspDidReadSessionRef=Default_Session, DcmDspDidReadSessionRef=Extended_Diagnostic_Session
          DidInfo_DidInfo_22201A_Application_Software_Programming_Attempt_Counter
            DcmDspDidAccess
              DcmDspDidRead
          DidInfo_DidInfo_22201B_Application_Data_Software_Programming_Attempt_Counter
            DcmDspDidAccess
              DcmDspDidRead
          DidInfo_DidInfo_22201F_Boot_Failure_Reason_Read
            DcmDspDidAccess
              DcmDspDidRead
          DidInfo_DidInfo_2E2023_PROXI_Data
            DcmDspDidAccess
              DcmDspDidWrite: DcmDspDidWriteSessionRef=Default_Session, DcmDspDidWriteSessionRef=Extended_Diagnostic_Session
          DidInfo_DidInfo_222024_Read_ECU_PROXI_Data
            DcmDspDidAccess
              DcmDspDidRead: DcmDspDidReadSessionRef=Default_Session, DcmDspDidReadSessionRef=Extended_Diagnostic_Session
          DidInfo_DidInfo_222026_CAN_Overrun_Counters
            DcmDspDidAccess
              DcmDspDidRead: DcmDspDidReadSessionRef=Default_Session, DcmDspDidReadSessionRef=Extended_Diagnostic_Session
          DidInfo_DidInfo_222030_Authenticated_Diagnostic_Previous_Access_Read
            DcmDspDidAccess
              DcmDspDidRead:
                DcmDspDidReadSessionRef = Programming_Session
                DcmDspDidReadSessionRef = Extended_Diagnostic_Session
                DcmDspDidReadSecurityLevelRef = Authenticated_Diagnostic_Access
          DidInfo_DidInfo_222031_Disallowed_Certificate_List_Read
            DcmDspDidAccess
              DcmDspDidRead:
                DcmDspDidReadSessionRef = Programming_Session
                DcmDspDidReadSessionRef = Extended_Diagnostic_Session
                DcmDspDidReadSecurityLevelRef = Authenticated_Diagnostic_Access
          DidInfo_DidInfo_222032_Secure_Log_Read
            DcmDspDidAccess
              DcmDspDidRead:
                DcmDspDidReadSessionRef = Programming_Session
                DcmDspDidReadSessionRef = Extended_Diagnostic_Session
                DcmDspDidReadSecurityLevelRef = Authenticated_Diagnostic_Access
          DidInfo_DidInfo_22292E_PROXI_Write_Counter
            DcmDspDidAccess
              DcmDspDidRead: DcmDspDidReadSessionRef=Default_Session, DcmDspDidReadSessionRef=Extended_Diagnostic_Session
          DidInfo_DidInfo_222939_FDCAN2_BUS_Network_WakeUp_Reason
            DcmDspDidAccess
              DcmDspDidRead: DcmDspDidReadSessionRef=Default_Session, DcmDspDidReadSessionRef=Extended_Diagnostic_Session
          DidInfo_DidInfo_222945_Flow_Control_Test
            DcmDspDidAccess
              DcmDspDidRead: DcmDspDidReadSessionRef=Default_Session, DcmDspDidReadSessionRef=Extended_Diagnostic_Session
              DcmDspDidWrite: DcmDspDidWriteSessionRef=Default_Session, DcmDspDidWriteSessionRef=Extended_Diagnostic_Session
          DidInfo_DidInfo_222951_Certificate_Store_UUID_Read
            DcmDspDidAccess
              DcmDspDidRead
          DidInfo_DidInfo_222954_Policy_Type_Read
            DcmDspDidAccess
              DcmDspDidRead
          DidInfo_DidInfo_222957_Hosted_App_Firmware_Header_Info_Read
            DcmDspDidAccess
              DcmDspDidRead:
                DcmDspDidReadSessionRef = Programming_Session
                DcmDspDidReadSessionRef = Extended_Diagnostic_Session
                DcmDspDidReadSecurityLevelRef = Authenticated_Diagnostic_Access
          DidInfo_DidInfo_222958_Hosted_App_firmware_Header_UUID_Read
            DcmDspDidAccess
              DcmDspDidRead:
                DcmDspDidReadSessionRef = Programming_Session
                DcmDspDidReadSessionRef = Extended_Diagnostic_Session
                DcmDspDidReadSecurityLevelRef = Authenticated_Diagnostic_Access
          DidInfo_DidInfo_222959_Hosted_App_Firmware_Cal_Config_Data_Header_Info_Read
            DcmDspDidAccess
              DcmDspDidRead:
                DcmDspDidReadSessionRef = Programming_Session
                DcmDspDidReadSessionRef = Extended_Diagnostic_Session
                DcmDspDidReadSecurityLevelRef = Authenticated_Diagnostic_Access
          DidInfo_DidInfo_22295A_Hosted_App_Firmware_Cal_Config_Data_Header_UUID_Read
            DcmDspDidAccess
              DcmDspDidRead:
                DcmDspDidReadSessionRef = Programming_Session
                DcmDspDidReadSessionRef = Extended_Diagnostic_Session
                DcmDspDidReadSecurityLevelRef = Authenticated_Diagnostic_Access
          DidInfo_DidInfo_22295B_HTA_Header_Info_Read
            DcmDspDidAccess
              DcmDspDidRead:
                DcmDspDidReadSessionRef = Programming_Session
                DcmDspDidReadSessionRef = Extended_Diagnostic_Session
                DcmDspDidReadSecurityLevelRef = Authenticated_Diagnostic_Access
          DidInfo_DidInfo_22295C_HTA_Header_UUID_Read
            DcmDspDidAccess
              DcmDspDidRead:
                DcmDspDidReadSessionRef = Programming_Session
                DcmDspDidReadSessionRef = Extended_Diagnostic_Session
                DcmDspDidReadSecurityLevelRef = Authenticated_Diagnostic_Access
          DidInfo_DidInfo_22295E_DCL_Header_UUID_Read
            DcmDspDidAccess
              DcmDspDidRead:
                DcmDspDidReadSessionRef = Programming_Session
                DcmDspDidReadSessionRef = Extended_Diagnostic_Session
                DcmDspDidReadSecurityLevelRef = Authenticated_Diagnostic_Access
          DidInfo_DidInfo_22295F_DCL_and_Cerstore_Header_Info_Read
            DcmDspDidAccess
              DcmDspDidRead:
                DcmDspDidReadSessionRef = Programming_Session
                DcmDspDidReadSessionRef = Extended_Diagnostic_Session
                DcmDspDidReadSecurityLevelRef = Authenticated_Diagnostic_Access
          DidInfo_DidInfo_224421_USS_Sensor_1_Part_Number_Read
            DcmDspDidAccess
              DcmDspDidRead: DcmDspDidReadSessionRef=Default_Session, DcmDspDidReadSessionRef=Extended_Diagnostic_Session
          DidInfo_DidInfo_224422_USS_Sensor2_Part_Number_Read
            DcmDspDidAccess
              DcmDspDidRead: DcmDspDidReadSessionRef=Default_Session, DcmDspDidReadSessionRef=Extended_Diagnostic_Session
          DidInfo_DidInfo_224423_USS_Sensor_3_Part_Number_Read
            DcmDspDidAccess
              DcmDspDidRead: DcmDspDidReadSessionRef=Default_Session, DcmDspDidReadSessionRef=Extended_Diagnostic_Session
          DidInfo_DidInfo_224424_USS_Sensor_4_Part_Number_Read
            DcmDspDidAccess
              DcmDspDidRead: DcmDspDidReadSessionRef=Default_Session, DcmDspDidReadSessionRef=Extended_Diagnostic_Session
          DidInfo_DidInfo_224425_USS_Sensor_5_Part_Number_Read
            DcmDspDidAccess
              DcmDspDidRead: DcmDspDidReadSessionRef=Default_Session, DcmDspDidReadSessionRef=Extended_Diagnostic_Session
          DidInfo_DidInfo_224426_USS_Sensor_6_Part_Number_Read
            DcmDspDidAccess
              DcmDspDidRead: DcmDspDidReadSessionRef=Default_Session, DcmDspDidReadSessionRef=Extended_Diagnostic_Session
          DidInfo_DidInfo_224427_USS_Sensor_7_Part_Number_Read
            DcmDspDidAccess
              DcmDspDidRead: DcmDspDidReadSessionRef=Default_Session, DcmDspDidReadSessionRef=Extended_Diagnostic_Session
          DidInfo_DidInfo_224428_USS_Sensor_8_Part_Number_Read
            DcmDspDidAccess
              DcmDspDidRead: DcmDspDidReadSessionRef=Default_Session, DcmDspDidReadSessionRef=Extended_Diagnostic_Session
          DidInfo_DidInfo_224429_USS_Sensor_9_Part_Number_Read
            DcmDspDidAccess
              DcmDspDidRead: DcmDspDidReadSessionRef=Default_Session, DcmDspDidReadSessionRef=Extended_Diagnostic_Session
          DidInfo_DidInfo_22442A_USS_Sensor_10_Part_Number_Read
            DcmDspDidAccess
              DcmDspDidRead: DcmDspDidReadSessionRef=Default_Session, DcmDspDidReadSessionRef=Extended_Diagnostic_Session
          DidInfo_DidInfo_22442B_USS_Sensor_11_Part_Number_Read
            DcmDspDidAccess
              DcmDspDidRead: DcmDspDidReadSessionRef=Default_Session, DcmDspDidReadSessionRef=Extended_Diagnostic_Session
          DidInfo_DidInfo_22442C_USS_Sensor_12_Part_Number_Read
            DcmDspDidAccess
              DcmDspDidRead: DcmDspDidReadSessionRef=Default_Session, DcmDspDidReadSessionRef=Extended_Diagnostic_Session
          DidInfo_DidInfo_224451_EOL_Calibration_State_Read
            DcmDspDidAccess
              DcmDspDidRead: DcmDspDidReadSessionRef=Default_Session, DcmDspDidReadSessionRef=Extended_Diagnostic_Session
          DidInfo_DidInfo_2F5001_Gear_Position_Read
            DcmDspDidAccess
              DcmDspDidControl:
                DcmDspDidFreezeCurrentState = false
                DcmDspDidResetToDefault = false
                DcmDspDidReturnControlToEcu = true
                DcmDspDidShortTermAdjustment = true
                DcmDspDidControlSessionRef = Extended_Diagnostic_Session
                DcmDspDidControlSecurityLevelRef = Authenticated_Diagnostic_Access
              DcmDspDidRead: DcmDspDidReadSessionRef=Extended_Diagnostic_Session
          DidInfo_DidInfo_225100_SPM_status_Read
            DcmDspDidAccess
              DcmDspDidRead: DcmDspDidReadSessionRef=Default_Session, DcmDspDidReadSessionRef=Extended_Diagnostic_Session
          DidInfo_DidInfo_225102_FD_CAN14_Rx_Signals_Read
            DcmDspDidAccess
              DcmDspDidRead: DcmDspDidReadSessionRef=Extended_Diagnostic_Session, DcmDspDidReadSecurityLevelRef=Authenticated_Diagnostic_Access
          DidInfo_DidInfo_225103_FD_CAN2_Rx_Signals_Read
            DcmDspDidAccess
              DcmDspDidRead: DcmDspDidReadSessionRef=Extended_Diagnostic_Session, DcmDspDidReadSecurityLevelRef=Authenticated_Diagnostic_Access
          DidInfo_DidInfo_225104_FD_CAN14_Tx_Signals_Read
            DcmDspDidAccess
              DcmDspDidRead: DcmDspDidReadSessionRef=Extended_Diagnostic_Session, DcmDspDidReadSecurityLevelRef=Authenticated_Diagnostic_Access
          DidInfo_DidInfo_225105_FD_CAN2_Tx_Signals_Read
            DcmDspDidAccess
              DcmDspDidRead: DcmDspDidReadSessionRef=Extended_Diagnostic_Session, DcmDspDidReadSecurityLevelRef=Authenticated_Diagnostic_Access
          DidInfo_DidInfo_225107_Front_Sensor_HealthBlockage_LiveDetection_Check_Read
            DcmDspDidAccess
              DcmDspDidRead: DcmDspDidReadSessionRef=Extended_Diagnostic_Session, DcmDspDidReadSecurityLevelRef=Authenticated_Diagnostic_Access
          DidInfo_DidInfo_225109_Rear_Sensor_HealthBlockage_LiveDetection_Check_Read
            DcmDspDidAccess
              DcmDspDidRead: DcmDspDidReadSessionRef=Extended_Diagnostic_Session, DcmDspDidReadSecurityLevelRef=Authenticated_Diagnostic_Access
          DidInfo_DidInfo_225201_Plant_Mode_Status_Read
            DcmDspDidAccess
              DcmDspDidRead: DcmDspDidReadSessionRef=Default_Session, DcmDspDidReadSessionRef=Extended_Diagnostic_Session
          DidInfo_DidInfo_225300_Rear_Braking_Event_1_Read
            DcmDspDidAccess
              DcmDspDidRead: DcmDspDidReadSessionRef=Default_Session, DcmDspDidReadSessionRef=Extended_Diagnostic_Session
          DidInfo_DidInfo_225301_Rear_Braking_Event_2_Read
            DcmDspDidAccess
              DcmDspDidRead: DcmDspDidReadSessionRef=Default_Session, DcmDspDidReadSessionRef=Extended_Diagnostic_Session
          DidInfo_DidInfo_225302_Rear_Braking_Event_3_Read
            DcmDspDidAccess
              DcmDspDidRead: DcmDspDidReadSessionRef=Default_Session, DcmDspDidReadSessionRef=Extended_Diagnostic_Session
          DidInfo_DidInfo_225303_SPM_Event_Abort_1_Read
            DcmDspDidAccess
              DcmDspDidRead: DcmDspDidReadSessionRef=Default_Session, DcmDspDidReadSessionRef=Extended_Diagnostic_Session
          DidInfo_DidInfo_225304_SPM_Event_Abort_2_Read
            DcmDspDidAccess
              DcmDspDidRead: DcmDspDidReadSessionRef=Default_Session, DcmDspDidReadSessionRef=Extended_Diagnostic_Session
          DidInfo_DidInfo_225305_SPM_Event_Abort_3_Read
            DcmDspDidAccess
              DcmDspDidRead: DcmDspDidReadSessionRef=Default_Session, DcmDspDidReadSessionRef=Extended_Diagnostic_Session
          DidInfo_DidInfo_225500_Trailer_Sense_and_Drive_Function_Data_Read
            DcmDspDidAccess
              DcmDspDidRead: DcmDspDidReadSessionRef=Extended_Diagnostic_Session, DcmDspDidReadSecurityLevelRef=Authenticated_Diagnostic_Access
          DidInfo_DidInfo_225501_Trailer_coupler_sense_detection_Function_Data_Read
            DcmDspDidAccess
              DcmDspDidRead: DcmDspDidReadSessionRef=Extended_Diagnostic_Session, DcmDspDidReadSecurityLevelRef=Authenticated_Diagnostic_Access
          DidInfo_DidInfo_22F10B_ECU_Qualification
            DcmDspDidAccess
              DcmDspDidRead: DcmDspDidReadSessionRef=Default_Session, DcmDspDidReadSessionRef=Extended_Diagnostic_Session
          DidInfo_DidInfo_22F10D_Diagnostic_Specification_Information
            DcmDspDidAccess
              DcmDspDidRead
          DidInfo_DidInfo_22F110_ECU_Diagnostic_Identification
            DcmDspDidAccess
              DcmDspDidRead
          DidInfo_DidInfo_22F111_Public_Certificates_Regional_Support_Read
            DcmDspDidAccess
              DcmDspDidRead:
                DcmDspDidReadSessionRef = Programming_Session
                DcmDspDidReadSessionRef = Extended_Diagnostic_Session
                DcmDspDidReadSecurityLevelRef = Authenticated_Diagnostic_Access
          DidInfo_DidInfo_22F112_PTESLM_Hardware_Number
            DcmDspDidAccess
              DcmDspDidRead
          DidInfo_DidInfo_22F122_Software_EBOM_Part_Number
            DcmDspDidAccess
              DcmDspDidRead
          DidInfo_DidInfo_22F132_EBOM_ECU_Part_Number
            DcmDspDidAccess
              DcmDspDidRead
          DidInfo_DidInfo_22F133_EBOM_Assembly_Part_Number
            DcmDspDidAccess
              DcmDspDidRead
          DidInfo_DidInfo_22F134_CODEP_assembly_part_number
            DcmDspDidAccess
              DcmDspDidRead
          DidInfo_DidInfo_22F154_Hardware_Supplier_Identification
            DcmDspDidAccess
              DcmDspDidRead
          DidInfo_DidInfo_22F155_Software_Supplier_Identification
            DcmDspDidAccess
              DcmDspDidRead
          DidInfo_DidInfo_22F180_Boot_Software_Version_Information
            DcmDspDidAccess
              DcmDspDidRead
          DidInfo_DidInfo_22F181_Application_Software_Identification
            DcmDspDidAccess
              DcmDspDidRead: DcmDspDidReadSessionRef=Default_Session, DcmDspDidReadSessionRef=Extended_Diagnostic_Session
          DidInfo_DidInfo_22F182_Application_Data_Identification
            DcmDspDidAccess
              DcmDspDidRead: DcmDspDidReadSessionRef=Default_Session, DcmDspDidReadSessionRef=Extended_Diagnostic_Session
          DidInfo_DidInfo_2EF184_Application_Software_Fingerprint_writing_information
            DcmDspDidAccess
              DcmDspDidWrite: DcmDspDidWriteSessionRef=Programming_Session, DcmDspDidWriteSecurityLevelRef=Authenticated_Diagnostic_Access
          DidInfo_DidInfo_2EF185_Application_Data_Software_Fingerprint_Writing_Information
            DcmDspDidAccess
              DcmDspDidWrite: DcmDspDidWriteSessionRef=Programming_Session, DcmDspDidWriteSecurityLevelRef=Authenticated_Diagnostic_Access
          DidInfo_DidInfo_22F186_Active_Diagnostic_Session
            DcmDspDidAccess
              DcmDspDidRead
          DidInfo_DidInfo_22F187_CODEP_ECU_Part_Number
            DcmDspDidAccess
              DcmDspDidRead
          DidInfo_DidInfo_22F188_FCA_ESLM_ECU_Software_Number
            DcmDspDidAccess
              DcmDspDidRead
          DidInfo_DidInfo_22F18A_FCA_ESLM_ECU_Software_Calibration_Number
            DcmDspDidAccess
              DcmDspDidRead
          DidInfo_DidInfo_22F18B_FCA_ESLM_ECU_Software_Application_Number
            DcmDspDidAccess
              DcmDspDidRead
          DidInfo_DidInfo_22F18C_ECU_Serial_Number
            DcmDspDidAccess
              DcmDspDidRead
          DidInfo_DidInfo_22F190_VIN_Original
            DcmDspDidAccess
              DcmDspDidRead: DcmDspDidReadSessionRef=Default_Session, DcmDspDidReadSessionRef=Extended_Diagnostic_Session
          DidInfo_DidInfo_22F191_FCA_ESLM_ECU_Hardware_Number
            DcmDspDidAccess
              DcmDspDidRead
          DidInfo_DidInfo_22F192_Supplier_ECU_Hardware_Part_Number
            DcmDspDidAccess
              DcmDspDidRead
          DidInfo_DidInfo_22F193_Supplier_ECU_Hardware_Version_Number
            DcmDspDidAccess
              DcmDspDidRead
          DidInfo_DidInfo_22F194_Supplier_ECU_Software_Part_Number
            DcmDspDidAccess
              DcmDspDidRead
          DidInfo_DidInfo_22F195_Supplier_ECU_Software_Version_Number
            DcmDspDidAccess
              DcmDspDidRead
          DidInfo_DidInfo_22F1A0_System_Identification_Data
            DcmDspDidAccess
              DcmDspDidRead
          DidInfo_DidInfo_22F1A1_Configuration_Code
            DcmDspDidAccess
              DcmDspDidRead: DcmDspDidReadSessionRef=Default_Session, DcmDspDidReadSessionRef=Extended_Diagnostic_Session
          DidInfo_DidInfo_22F1A2_Vector_Delivery_ID
            DcmDspDidAccess
              DcmDspDidRead
          DidInfo_DidInfo_22F1A6_Message_Matrix
            DcmDspDidAccess
              DcmDspDidRead: DcmDspDidReadSessionRef=Default_Session, DcmDspDidReadSessionRef=Extended_Diagnostic_Session
          DidInfo_DidInfo_22F1B0_VIN_Current
            DcmDspDidAccess
              DcmDspDidRead: DcmDspDidReadSessionRef=Default_Session, DcmDspDidReadSessionRef=Extended_Diagnostic_Session
          DidInfo_DidInfo_22F1B3_Boot_Software_Fingerprint_Reading_Information
            DcmDspDidAccess
              DcmDspDidRead
          DidInfo_DidInfo_22F1B4_Application_Software_Fingerprint_Reading_Information
            DcmDspDidAccess
              DcmDspDidRead
          DidInfo_DidInfo_22F1B5_Application_Data_Software_Fingerprint_Reading_Information
            DcmDspDidAccess
              DcmDspDidRead
          DidInfo_DidInfo_22FD00_Plant_Camera_Calibration_Data
            DcmDspDidAccess
              DcmDspDidRead: DcmDspDidReadSessionRef=Default_Session, DcmDspDidReadSessionRef=Extended_Diagnostic_Session
              DcmDspDidWrite: DcmDspDidWriteSessionRef=Extended_Diagnostic_Session
          DidInfo_DidInfo_22FD01_Previous_Camera_Calibration_Data
            DcmDspDidAccess
              DcmDspDidRead: DcmDspDidReadSessionRef=Default_Session, DcmDspDidReadSessionRef=Extended_Diagnostic_Session
          DidInfo_DidInfo_22FD04_USS_Sensor_tuning_values_Read
            DcmDspDidAccess
              DcmDspDidRead: DcmDspDidReadSessionRef=Extended_Diagnostic_Session, DcmDspDidReadSecurityLevelRef=Authenticated_Diagnostic_Access
              DcmDspDidWrite: DcmDspDidWriteSessionRef=Extended_Diagnostic_Session, DcmDspDidWriteSecurityLevelRef=Authenticated_Diagnostic_Access
          DidInfo_DidInfo_22FD07_OC_Result_Read
            DcmDspDidAccess
              DcmDspDidRead: DcmDspDidReadSessionRef=Default_Session, DcmDspDidReadSessionRef=Extended_Diagnostic_Session
          DidInfo_DidInfo_22FD08_OC_Data_Read
            DcmDspDidAccess
              DcmDspDidRead: DcmDspDidReadSessionRef=Default_Session, DcmDspDidReadSessionRef=Extended_Diagnostic_Session
              DcmDspDidWrite: DcmDspDidWriteSessionRef=Extended_Diagnostic_Session
          DidInfo_DidInfo_22FD0A_SC_Data_Read
            DcmDspDidAccess
              DcmDspDidRead: DcmDspDidReadSessionRef=Default_Session, DcmDspDidReadSessionRef=Extended_Diagnostic_Session
              DcmDspDidWrite: DcmDspDidWriteSessionRef=Extended_Diagnostic_Session
          DidInfo_DidInfo_22FD0C_Front_Camera_Data_EEPROM_Read
            DcmDspDidAccess
              DcmDspDidRead: DcmDspDidReadSessionRef=Default_Session, DcmDspDidReadSessionRef=Extended_Diagnostic_Session
          DidInfo_DidInfo_22FD0D_Left_Camera_Data_EEPROM_Read
            DcmDspDidAccess
              DcmDspDidRead: DcmDspDidReadSessionRef=Default_Session, DcmDspDidReadSessionRef=Extended_Diagnostic_Session
          DidInfo_DidInfo_22FD0E_Rear_Camera_Data_EEPROM_Read
            DcmDspDidAccess
              DcmDspDidRead: DcmDspDidReadSessionRef=Default_Session, DcmDspDidReadSessionRef=Extended_Diagnostic_Session
          DidInfo_DidInfo_22FD0F_Right_Camera_Data_EEPROM_Read
            DcmDspDidAccess
              DcmDspDidRead: DcmDspDidReadSessionRef=Default_Session, DcmDspDidReadSessionRef=Extended_Diagnostic_Session
          DidInfo_DidInfo_22FD13_Magna_Software_Version
            DcmDspDidAccess
              DcmDspDidRead: DcmDspDidReadSessionRef=Default_Session, DcmDspDidReadSessionRef=Extended_Diagnostic_Session
          DidInfo_DidInfo_22FD14_FD14_Magna_Production_Date_Read
            DcmDspDidAccess
              DcmDspDidRead: DcmDspDidReadSessionRef=Default_Session, DcmDspDidReadSessionRef=Extended_Diagnostic_Session
          DidInfo_DidInfo_22FD15_Magna_Production_HW_Number_Read
            DcmDspDidAccess
              DcmDspDidRead: DcmDspDidReadSessionRef=Default_Session, DcmDspDidReadSessionRef=Extended_Diagnostic_Session
          DidInfo_DidInfo_22FD16_Magna_Production_ICT_Data_Read
            DcmDspDidAccess
              DcmDspDidRead: DcmDspDidReadSessionRef=Default_Session, DcmDspDidReadSessionRef=Extended_Diagnostic_Session
          DidInfo_DidInfo_22FD17_Magna_Production_HW_Version_information_Read
            DcmDspDidAccess
              DcmDspDidRead: DcmDspDidReadSessionRef=Default_Session, DcmDspDidReadSessionRef=Extended_Diagnostic_Session
          DidInfo_DidInfo_22FD1C_Current_Camera_Calibration_Data_Read
            DcmDspDidAccess
              DcmDspDidRead: DcmDspDidReadSessionRef=Default_Session, DcmDspDidReadSessionRef=Extended_Diagnostic_Session
          DidInfo_DidInfo_22FD1D_PCB_Serial_Number
            DcmDspDidAccess
              DcmDspDidRead: DcmDspDidReadSessionRef=Default_Session, DcmDspDidReadSessionRef=Extended_Diagnostic_Session
          DidInfo_DidInfo_22FD1E_Calibration_Status_Read
            DcmDspDidAccess
              DcmDspDidRead: DcmDspDidReadSessionRef=Default_Session, DcmDspDidReadSessionRef=Extended_Diagnostic_Session
          DidInfo_DidInfo_22FD20_ECU_PinStates_Read
            DcmDspDidAccess
              DcmDspDidRead: DcmDspDidReadSessionRef=Default_Session, DcmDspDidReadSessionRef=Extended_Diagnostic_Session
          DidInfo_DidInfo_22FD28_USS_Ringing_Frequency_Read
            DcmDspDidAccess
              DcmDspDidRead: DcmDspDidReadSessionRef=Default_Session, DcmDspDidReadSessionRef=Extended_Diagnostic_Session
          DidInfo_DidInfo_22FD29_USS_Driving_Frequency_Read
            DcmDspDidAccess
              DcmDspDidRead: DcmDspDidReadSessionRef=Default_Session, DcmDspDidReadSessionRef=Extended_Diagnostic_Session
          DidInfo_DidInfo_22FD2A_USS_Ringing_Time_Read
            DcmDspDidAccess
              DcmDspDidRead: DcmDspDidReadSessionRef=Default_Session, DcmDspDidReadSessionRef=Extended_Diagnostic_Session
          DidInfo_DidInfo_22FD2B_USS_Direct_Distance_0xFD2B_Read
            DcmDspDidAccess
              DcmDspDidRead: DcmDspDidReadSessionRef=Default_Session, DcmDspDidReadSessionRef=Extended_Diagnostic_Session
          DidInfo_DidInfo_22FD2C_USS_Temperature_Read
            DcmDspDidAccess
              DcmDspDidRead: DcmDspDidReadSessionRef=Default_Session, DcmDspDidReadSessionRef=Extended_Diagnostic_Session
          DidInfo_DidInfo_22FD2D_USS_Sensor_ID_IME_SN_Read
            DcmDspDidAccess
              DcmDspDidRead: DcmDspDidReadSessionRef=Default_Session, DcmDspDidReadSessionRef=Extended_Diagnostic_Session
          DidInfo_DidInfo_22FD2E_USS_Sensor_ID_Murata_SN_Read
            DcmDspDidAccess
              DcmDspDidRead: DcmDspDidReadSessionRef=Default_Session, DcmDspDidReadSessionRef=Extended_Diagnostic_Session
          DidInfo_DidInfo_22FD31_Magna_EOL_Coding_State_Read
            DcmDspDidAccess
              DcmDspDidRead: DcmDspDidReadSessionRef=Default_Session, DcmDspDidReadSessionRef=Extended_Diagnostic_Session
              DcmDspDidWrite: DcmDspDidWriteSessionRef=Extended_Diagnostic_Session
          DidInfo_DidInfo_22FD33_Magna_Testing_2_Read
            DcmDspDidAccess
              DcmDspDidRead: DcmDspDidReadSessionRef=Default_Session, DcmDspDidReadSessionRef=Extended_Diagnostic_Session
              DcmDspDidWrite: DcmDspDidWriteSessionRef=Extended_Diagnostic_Session
          DidInfo_DidInfo_22FD38_Programmed_Assembly
            DcmDspDidAccess
              DcmDspDidRead
          DidInfo_DidInfo_22FD42_Failsafe_Behaviour_Read
            DcmDspDidAccess
              DcmDspDidRead: DcmDspDidReadSessionRef=Default_Session, DcmDspDidReadSessionRef=Extended_Diagnostic_Session
              DcmDspDidWrite: DcmDspDidWriteSessionRef=Extended_Diagnostic_Session
          DidInfo_DidInfo_22FD43_Active_Safe_State_Read
            DcmDspDidAccess
              DcmDspDidRead: DcmDspDidReadSessionRef=Default_Session, DcmDspDidReadSessionRef=Extended_Diagnostic_Session
          DidInfo_DidInfo_22FD44_Error_Flags_Read
            DcmDspDidAccess
              DcmDspDidRead: DcmDspDidReadSessionRef=Default_Session, DcmDspDidReadSessionRef=Extended_Diagnostic_Session
          DidInfo_DidInfo_22FD46_Camera_Power_Supply_Read
            DcmDspDidAccess
              DcmDspDidRead: DcmDspDidReadSessionRef=Default_Session, DcmDspDidReadSessionRef=Extended_Diagnostic_Session
          DidInfo_DidInfo_22FD47_SoC_Temperature_0xFD47_Read
            DcmDspDidAccess
              DcmDspDidRead: DcmDspDidReadSessionRef=Default_Session, DcmDspDidReadSessionRef=Extended_Diagnostic_Session
          DidInfo_DidInfo_22FD48_PCBA_Temperature_Read
            DcmDspDidAccess
              DcmDspDidRead: DcmDspDidReadSessionRef=Default_Session, DcmDspDidReadSessionRef=Extended_Diagnostic_Session
          DidInfo_DidInfo_22FD49_SoC_Die_Temperature_ID_0xFD49_Read
            DcmDspDidAccess
              DcmDspDidRead: DcmDspDidReadSessionRef=Default_Session, DcmDspDidReadSessionRef=Extended_Diagnostic_Session
          DidInfo_DidInfo_22FD4A_Ultrasonic_Sensors_Power_supply_and_Current_Level_Read
            DcmDspDidAccess
              DcmDspDidRead: DcmDspDidReadSessionRef=Default_Session, DcmDspDidReadSessionRef=Extended_Diagnostic_Session
          DidInfo_DidInfo_2EFD4E_Reset_NVM_Write
            DcmDspDidAccess
              DcmDspDidWrite: DcmDspDidWriteSessionRef=Extended_Diagnostic_Session
          DidInfo_DidInfo_22FD60_ECU_Software_Status_Read
            DcmDspDidAccess
              DcmDspDidRead: DcmDspDidReadSessionRef=Default_Session, DcmDspDidReadSessionRef=Extended_Diagnostic_Session
          DidInfo_DidInfo_22FD61_Vehicle_Variant_Coding_Data_Read
            DcmDspDidAccess
              DcmDspDidRead: DcmDspDidReadSessionRef=Default_Session, DcmDspDidReadSessionRef=Extended_Diagnostic_Session
          DidInfo_DidInfo_22FD62_ASIL_QM_Fault_Status_Read
            DcmDspDidAccess
              DcmDspDidRead: DcmDspDidReadSessionRef=Default_Session, DcmDspDidReadSessionRef=Extended_Diagnostic_Session
          DidInfo_DidInfo_22FD64_ASIL_B_Fault_Status_Read
            DcmDspDidAccess
              DcmDspDidRead: DcmDspDidReadSessionRef=Default_Session, DcmDspDidReadSessionRef=Extended_Diagnostic_Session
          DidInfo_DidInfo_22FD65_FuSa_Module_Status_Read
            DcmDspDidAccess
              DcmDspDidRead: DcmDspDidReadSessionRef=Default_Session, DcmDspDidReadSessionRef=Extended_Diagnostic_Session
          DidInfo_DidInfo_22FD66_Camera_occlusion_and_low_light_status_Read
            DcmDspDidAccess
              DcmDspDidRead: DcmDspDidReadSessionRef=Default_Session, DcmDspDidReadSessionRef=Extended_Diagnostic_Session
          DidInfo_DidInfo_22FD67_Camera_DLD_Status_Read
            DcmDspDidAccess
              DcmDspDidRead: DcmDspDidReadSessionRef=Default_Session, DcmDspDidReadSessionRef=Extended_Diagnostic_Session
          DidInfo_DidInfo_22FD74_PHY_Tunning_Error_And_Buffer_Mark_Error_Read
            DcmDspDidAccess
              DcmDspDidRead: DcmDspDidReadSessionRef=Default_Session, DcmDspDidReadSessionRef=Extended_Diagnostic_Session
          DidInfo_DidInfo_22FD86_Functional_Settings_Read
            DcmDspDidAccess
              DcmDspDidRead: DcmDspDidReadSessionRef=Default_Session, DcmDspDidReadSessionRef=Extended_Diagnostic_Session
              DcmDspDidWrite: DcmDspDidWriteSessionRef=Extended_Diagnostic_Session
          DidInfo_DidInfo_22FDF0_ECU_shutdown_process_Read
            DcmDspDidAccess
              DcmDspDidRead: DcmDspDidReadSessionRef=Default_Session, DcmDspDidReadSessionRef=Extended_Diagnostic_Session
              DcmDspDidWrite: DcmDspDidWriteSessionRef=Default_Session, DcmDspDidWriteSessionRef=Extended_Diagnostic_Session
          DidInfo_DidInfo_22FDF1_CPU_Load_Read
            DcmDspDidAccess
              DcmDspDidRead: DcmDspDidReadSessionRef=Default_Session, DcmDspDidReadSessionRef=Extended_Diagnostic_Session
          DidInfo_DidInfo_22FDF2_Reset_Reason_Read
            DcmDspDidAccess
              DcmDspDidRead: DcmDspDidReadSessionRef=Default_Session, DcmDspDidReadSessionRef=Extended_Diagnostic_Session
          DidInfo_DidInfo_22FDF5_PerformanceStatEnable_Read
            DcmDspDidAccess
              DcmDspDidRead: DcmDspDidReadSessionRef=Default_Session, DcmDspDidReadSessionRef=Extended_Diagnostic_Session
              DcmDspDidWrite: DcmDspDidWriteSessionRef=Default_Session, DcmDspDidWriteSessionRef=Extended_Diagnostic_Session
          DidInfo_DidInfo_22FDF6_RunTimeStatsData_Read
            DcmDspDidAccess
              DcmDspDidRead: DcmDspDidReadSessionRef=Default_Session, DcmDspDidReadSessionRef=Extended_Diagnostic_Session
          DidInfo_DidInfo_22FDF7_Intrinsic_Camera_NvM_Data_Read
            DcmDspDidAccess
              DcmDspDidRead: DcmDspDidReadSessionRef=Default_Session, DcmDspDidReadSessionRef=Extended_Diagnostic_Session
          DidInfo_DidInfo_22FDF8_StackUsage_Read
            DcmDspDidAccess
              DcmDspDidRead: DcmDspDidReadSessionRef=Default_Session, DcmDspDidReadSessionRef=Extended_Diagnostic_Session
        20 x DcmDspRoutine:
          Routine_31011000_USS_Debug_Signals_Enable_Disable_Start: DcmDspRequestResultsRoutineSupported=false, DcmDspStopRoutineSupported=false, DcmDspRoutineIdentifier=4096, DcmDspRoutineInfoRef=RoutineInfo_RoutineInfo_31011000_USS_Debug_Signals_Enable_Disable_Start
          Routine_31012000_Original_VIN_Lock: DcmDspRequestResultsRoutineSupported=false, DcmDspStopRoutineSupported=false, DcmDspRoutineIdentifier=8192, DcmDspRoutineInfoRef=RoutineInfo_RoutineInfo_31012000_Original_VIN_Lock
          Routine_31012001_Original_VIN_Unlock: DcmDspRequestResultsRoutineSupported=false, DcmDspStopRoutineSupported=false, DcmDspRoutineIdentifier=8193, DcmDspRoutineInfoRef=RoutineInfo_RoutineInfo_31012001_Original_VIN_Unlock
          Routine_31013000_XCP_Enable_Disable_Start: DcmDspRequestResultsRoutineSupported=false, DcmDspStopRoutineSupported=false, DcmDspRoutineIdentifier=12288, DcmDspRoutineInfoRef=RoutineInfo_RoutineInfo_31013000_XCP_Enable_Disable_Start
          Routine_31015000_Park_Assist_ON_OFF_State_Start: DcmDspRequestResultsRoutineSupported=false, DcmDspStopRoutineSupported=false, DcmDspRoutineIdentifier=20480, DcmDspRoutineInfoRef=RoutineInfo_RoutineInfo_31015000_Park_Assist_ON_OFF_State_Start
          Routine_31015101_Sensor_Functional_Test_Start: DcmDspRequestResultsRoutineSupported=false, DcmDspStopRoutineSupported=false, DcmDspRoutineIdentifier=20737, DcmDspRoutineInfoRef=RoutineInfo_RoutineInfo_31015101_Sensor_Functional_Test_Start
          Routine_31015200_Plant_Mode_Routine_Start: DcmDspRequestResultsRoutineSupported=true, DcmDspStopRoutineSupported=false, DcmDspRoutineIdentifier=20992, DcmDspRoutineInfoRef=RoutineInfo_RoutineInfo_31015200_Plant_Mode_Routine_Start
          Routine_31015400_Camera_EOL_Calibration_Start: DcmDspRequestResultsRoutineSupported=true, DcmDspStopRoutineSupported=false, DcmDspRoutineIdentifier=21504, DcmDspRoutineInfoRef=RoutineInfo_RoutineInfo_31015400_Camera_EOL_Calibration_Start
          Routine_31015401_Camera_Service_Calibration_Start: DcmDspRequestResultsRoutineSupported=true, DcmDspStopRoutineSupported=false, DcmDspRoutineIdentifier=21505, DcmDspRoutineInfoRef=RoutineInfo_RoutineInfo_31015401_Camera_Service_Calibration_Start
          Routine_31015502_TRSC_Trailer_Calibration_Memory_Clear_Start: DcmDspRequestResultsRoutineSupported=true, DcmDspStopRoutineSupported=false, DcmDspRoutineIdentifier=21762, DcmDspRoutineInfoRef=RoutineInfo_RoutineInfo_31015502_TRSC_Trailer_Calibration_Memory_Clear_Start
          Routine_3101D001_Disable_Fail_safe_reaction_Start: DcmDspRequestResultsRoutineSupported=false, DcmDspStopRoutineSupported=true, DcmDspRoutineIdentifier=53249, DcmDspRoutineInfoRef=RoutineInfo_RoutineInfo_3101D001_Disable_Fail_safe_reaction_Start
          Routine_3101D002_Check_Programming_Preconditions_Start: DcmDspRequestResultsRoutineSupported=false, DcmDspStopRoutineSupported=false, DcmDspRoutineIdentifier=53250, DcmDspRoutineInfoRef=RoutineInfo_RoutineInfo_3101D002_Check_Programming_Preconditions_Start
          Routine_3101D003_Application_Logical_Block_Hash: DcmDspRequestResultsRoutineSupported=false, DcmDspStopRoutineSupported=false, DcmDspRoutineIdentifier=53251, DcmDspRoutineInfoRef=RoutineInfo_RoutineInfo_3101D003_Application_Logical_Block_Hash
          Routine_3101F000_Check_Program_Start: DcmDspRequestResultsRoutineSupported=false, DcmDspStopRoutineSupported=false, DcmDspRoutineIdentifier=61440, DcmDspRoutineInfoRef=RoutineInfo_RoutineInfo_3101F000_Check_Program_Start
          Routine_3101FE01_Calibration_Data_Reset_Start: DcmDspRequestResultsRoutineSupported=false, DcmDspStopRoutineSupported=false, DcmDspRoutineIdentifier=65025, DcmDspRoutineInfoRef=RoutineInfo_RoutineInfo_3101FE01_Calibration_Data_Reset_Start
          Routine_3101FE02_Test_Write_PMIC_Register_Start: DcmDspRequestResultsRoutineSupported=false, DcmDspStopRoutineSupported=false, DcmDspRoutineIdentifier=65026, DcmDspRoutineInfoRef=RoutineInfo_RoutineInfo_3101FE02_Test_Write_PMIC_Register_Start
          Routine_3101FE0E_Test_Pattern_Control_Start: DcmDspRequestResultsRoutineSupported=false, DcmDspStopRoutineSupported=true, DcmDspRoutineIdentifier=65038, DcmDspRoutineInfoRef=RoutineInfo_RoutineInfo_3101FE0E_Test_Pattern_Control_Start
          Routine_3101FF00_FlashErase_Start: DcmDspRequestResultsRoutineSupported=false, DcmDspStopRoutineSupported=false, DcmDspRoutineIdentifier=65280, DcmDspRoutineInfoRef=RoutineInfo_RoutineInfo_3101FF00_FlashErase_Start
          Routine_3101FF01_checkProgrammingDependencies_FlashChecksum_Start: DcmDspRequestResultsRoutineSupported=false, DcmDspStopRoutineSupported=false, DcmDspRoutineIdentifier=65281, DcmDspRoutineInfoRef=RoutineInfo_RoutineInfo_3101FF01_checkProgrammingDependencies_FlashChecksum_Start
          Routine_3101FF03_Test_Read_PMIC_Register_Start: DcmDspRequestResultsRoutineSupported=false, DcmDspStopRoutineSupported=false, DcmDspRoutineIdentifier=65283, DcmDspRoutineInfoRef=RoutineInfo_RoutineInfo_3101FF03_Test_Read_PMIC_Register_Start
        20 x DcmDspRoutineInfo:
          RoutineInfo_RoutineInfo_31011000_USS_Debug_Signals_Enable_Disable_Start
            DcmDspRoutineAuthorization: DcmDspRoutineSessionRef=Extended_Diagnostic_Session
            DcmDspStartRoutineIn
              In_ReqData (DcmDspStartRoutineInSignal): DcmDspRoutineSignalLength=8, DcmDspRoutineSignalType=UINT8_N, DcmDspRoutineSignalEndianness=opaque, DcmDspRoutineSignalPos=0
            DcmDspStartRoutineOut
              Out_ResData (DcmDspStartRoutineOutSignal): DcmDspRoutineSignalLength=8, DcmDspRoutineSignalType=UINT8_N, DcmDspRoutineSignalEndianness=opaque, DcmDspRoutineSignalPos=0
          RoutineInfo_RoutineInfo_31012000_Original_VIN_Lock
            DcmDspRoutineAuthorization: DcmDspRoutineSessionRef=Extended_Diagnostic_Session, DcmDspRoutineSecurityLevelRef=Authenticated_Diagnostic_Access
          RoutineInfo_RoutineInfo_31012001_Original_VIN_Unlock
            DcmDspRoutineAuthorization: DcmDspRoutineSessionRef=Extended_Diagnostic_Session, DcmDspRoutineSecurityLevelRef=Authenticated_Diagnostic_Access
          RoutineInfo_RoutineInfo_31013000_XCP_Enable_Disable_Start
            DcmDspRoutineAuthorization: DcmDspRoutineSessionRef=Extended_Diagnostic_Session
            DcmDspStartRoutineIn
              In_ReqData (DcmDspStartRoutineInSignal): DcmDspRoutineSignalLength=8, DcmDspRoutineSignalType=UINT8_N, DcmDspRoutineSignalEndianness=opaque, DcmDspRoutineSignalPos=0
            DcmDspStartRoutineOut
              Out_ResData (DcmDspStartRoutineOutSignal): DcmDspRoutineSignalLength=8, DcmDspRoutineSignalType=UINT8_N, DcmDspRoutineSignalEndianness=opaque, DcmDspRoutineSignalPos=0
          RoutineInfo_RoutineInfo_31015000_Park_Assist_ON_OFF_State_Start
            DcmDspRoutineAuthorization: DcmDspRoutineSessionRef=Extended_Diagnostic_Session, DcmDspRoutineSecurityLevelRef=Authenticated_Diagnostic_Access
            DcmDspStartRoutineIn
              In_ReqData (DcmDspStartRoutineInSignal): DcmDspRoutineSignalLength=8, DcmDspRoutineSignalType=UINT8_N, DcmDspRoutineSignalEndianness=opaque, DcmDspRoutineSignalPos=0
          RoutineInfo_RoutineInfo_31015101_Sensor_Functional_Test_Start
            DcmDspRoutineAuthorization: DcmDspRoutineSessionRef=Extended_Diagnostic_Session
          RoutineInfo_RoutineInfo_31015200_Plant_Mode_Routine_Start
            DcmDspRoutineAuthorization: DcmDspRoutineSessionRef=Extended_Diagnostic_Session
            DcmDspStartRoutineIn
              In_ReqData (DcmDspStartRoutineInSignal): DcmDspRoutineSignalLength=8, DcmDspRoutineSignalType=UINT8_N, DcmDspRoutineSignalEndianness=opaque, DcmDspRoutineSignalPos=0
            DcmDspRoutineRequestResOut
              Out_ResData (DcmDspRoutineRequestResOutSignal): DcmDspRoutineSignalLength=8, DcmDspRoutineSignalType=UINT8_N, DcmDspRoutineSignalEndianness=opaque, DcmDspRoutineSignalPos=0
          RoutineInfo_RoutineInfo_31015400_Camera_EOL_Calibration_Start
            DcmDspRoutineAuthorization: DcmDspRoutineSessionRef=Extended_Diagnostic_Session
            DcmDspStartRoutineIn
              In_ReqData (DcmDspStartRoutineInSignal): DcmDspRoutineSignalLength=8, DcmDspRoutineSignalType=UINT8_N, DcmDspRoutineSignalEndianness=opaque, DcmDspRoutineSignalPos=0
            DcmDspStartRoutineOut
              Out_ResData (DcmDspStartRoutineOutSignal): DcmDspRoutineSignalLength=8, DcmDspRoutineSignalType=UINT8_N, DcmDspRoutineSignalEndianness=opaque, DcmDspRoutineSignalPos=0
            DcmDspRoutineRequestResOut
              Out_ResData (DcmDspRoutineRequestResOutSignal): DcmDspRoutineSignalLength=64, DcmDspRoutineSignalType=UINT8_N, DcmDspRoutineSignalEndianness=opaque, DcmDspRoutineSignalPos=0
          RoutineInfo_RoutineInfo_31015401_Camera_Service_Calibration_Start
            DcmDspRoutineAuthorization: DcmDspRoutineSessionRef=Extended_Diagnostic_Session
            DcmDspStartRoutineIn
              In_ReqData (DcmDspStartRoutineInSignal): DcmDspRoutineSignalLength=8, DcmDspRoutineSignalType=UINT8_N, DcmDspRoutineSignalEndianness=opaque, DcmDspRoutineSignalPos=0
            DcmDspStartRoutineOut
              Out_ResData (DcmDspStartRoutineOutSignal): DcmDspRoutineSignalLength=8, DcmDspRoutineSignalType=UINT8_N, DcmDspRoutineSignalEndianness=opaque, DcmDspRoutineSignalPos=0
            DcmDspRoutineRequestResOut
              Out_ResData (DcmDspRoutineRequestResOutSignal): DcmDspRoutineSignalLength=72, DcmDspRoutineSignalType=UINT8_N, DcmDspRoutineSignalEndianness=opaque, DcmDspRoutineSignalPos=0
          RoutineInfo_RoutineInfo_31015502_TRSC_Trailer_Calibration_Memory_Clear_Start
            DcmDspRoutineAuthorization: DcmDspRoutineSessionRef=Extended_Diagnostic_Session
            DcmDspStartRoutineOut
              Out_ResData (DcmDspStartRoutineOutSignal): DcmDspRoutineSignalLength=8, DcmDspRoutineSignalType=UINT8_N, DcmDspRoutineSignalEndianness=opaque, DcmDspRoutineSignalPos=0
            DcmDspRoutineRequestResOut
              Out_ResData (DcmDspRoutineRequestResOutSignal): DcmDspRoutineSignalLength=16, DcmDspRoutineSignalType=UINT8_N, DcmDspRoutineSignalEndianness=opaque, DcmDspRoutineSignalPos=0
          RoutineInfo_RoutineInfo_3101D001_Disable_Fail_safe_reaction_Start
            DcmDspRoutineAuthorization: DcmDspRoutineSessionRef=Extended_Diagnostic_Session, DcmDspRoutineSecurityLevelRef=Authenticated_Diagnostic_Access
          RoutineInfo_RoutineInfo_3101D002_Check_Programming_Preconditions_Start
            DcmDspRoutineAuthorization
            DcmDspStartRoutineOut
              Out_ResData (DcmDspStartRoutineOutSignal): DcmDspRoutineSignalLength=2048, DcmDspRoutineSignalType=VARIABLE_LENGTH, DcmDspRoutineSignalEndianness=opaque, DcmDspRoutineSignalPos=0
          RoutineInfo_RoutineInfo_3101D003_Application_Logical_Block_Hash
            DcmDspRoutineAuthorization: DcmDspRoutineSessionRef=Programming_Session, DcmDspRoutineSecurityLevelRef=Authenticated_Diagnostic_Access
            DcmDspStartRoutineIn
              In_ReqData (DcmDspStartRoutineInSignal): DcmDspRoutineSignalLength=8, DcmDspRoutineSignalType=UINT8_N, DcmDspRoutineSignalEndianness=opaque, DcmDspRoutineSignalPos=0
            DcmDspStartRoutineOut
              Out_ResData (DcmDspStartRoutineOutSignal): DcmDspRoutineSignalLength=256, DcmDspRoutineSignalType=UINT8_N, DcmDspRoutineSignalEndianness=opaque, DcmDspRoutineSignalPos=0
          RoutineInfo_RoutineInfo_3101F000_Check_Program_Start
            DcmDspRoutineAuthorization: DcmDspRoutineSessionRef=Programming_Session, DcmDspRoutineSecurityLevelRef=Authenticated_Diagnostic_Access
            DcmDspStartRoutineOut
              Out_ResData (DcmDspStartRoutineOutSignal): DcmDspRoutineSignalLength=8, DcmDspRoutineSignalType=UINT8_N, DcmDspRoutineSignalEndianness=opaque, DcmDspRoutineSignalPos=0
          RoutineInfo_RoutineInfo_3101FE01_Calibration_Data_Reset_Start
            DcmDspRoutineAuthorization: DcmDspRoutineSessionRef=Extended_Diagnostic_Session, DcmDspRoutineSecurityLevelRef=Authenticated_Diagnostic_Access
            DcmDspStartRoutineIn
              In_ReqData (DcmDspStartRoutineInSignal): DcmDspRoutineSignalLength=16, DcmDspRoutineSignalType=UINT8_N, DcmDspRoutineSignalEndianness=opaque, DcmDspRoutineSignalPos=0
            DcmDspStartRoutineOut
              Out_ResData (DcmDspStartRoutineOutSignal): DcmDspRoutineSignalLength=16, DcmDspRoutineSignalType=UINT8_N, DcmDspRoutineSignalEndianness=opaque, DcmDspRoutineSignalPos=0
          RoutineInfo_RoutineInfo_3101FE02_Test_Write_PMIC_Register_Start
            DcmDspRoutineAuthorization: DcmDspRoutineSessionRef=Extended_Diagnostic_Session
            DcmDspStartRoutineIn
              In_ReqData (DcmDspStartRoutineInSignal): DcmDspRoutineSignalLength=40, DcmDspRoutineSignalType=UINT8_N, DcmDspRoutineSignalEndianness=opaque, DcmDspRoutineSignalPos=0
          RoutineInfo_RoutineInfo_3101FE0E_Test_Pattern_Control_Start
            DcmDspRoutineAuthorization: DcmDspRoutineSessionRef=Extended_Diagnostic_Session, DcmDspRoutineSecurityLevelRef=Authenticated_Diagnostic_Access
            DcmDspStartRoutineIn
              In_ReqData (DcmDspStartRoutineInSignal): DcmDspRoutineSignalLength=16, DcmDspRoutineSignalType=UINT8_N, DcmDspRoutineSignalEndianness=opaque, DcmDspRoutineSignalPos=0
            DcmDspStartRoutineOut
              Out_ResData (DcmDspStartRoutineOutSignal): DcmDspRoutineSignalLength=16, DcmDspRoutineSignalType=UINT8_N, DcmDspRoutineSignalEndianness=opaque, DcmDspRoutineSignalPos=0
          RoutineInfo_RoutineInfo_3101FF00_FlashErase_Start
            DcmDspRoutineAuthorization: DcmDspRoutineSessionRef=Programming_Session, DcmDspRoutineSecurityLevelRef=Authenticated_Diagnostic_Access
            DcmDspStartRoutineOut
              Out_ResData (DcmDspStartRoutineOutSignal): DcmDspRoutineSignalLength=72, DcmDspRoutineSignalType=UINT8_N, DcmDspRoutineSignalEndianness=opaque, DcmDspRoutineSignalPos=0
          RoutineInfo_RoutineInfo_3101FF01_checkProgrammingDependencies_FlashChecksum_Start
            DcmDspRoutineAuthorization: DcmDspRoutineSessionRef=Programming_Session, DcmDspRoutineSecurityLevelRef=Authenticated_Diagnostic_Access
            DcmDspStartRoutineOut
              Out_ResData (DcmDspStartRoutineOutSignal): DcmDspRoutineSignalLength=8, DcmDspRoutineSignalType=UINT8_N, DcmDspRoutineSignalEndianness=opaque, DcmDspRoutineSignalPos=0
          RoutineInfo_RoutineInfo_3101FF03_Test_Read_PMIC_Register_Start
            DcmDspRoutineAuthorization: DcmDspRoutineSessionRef=Extended_Diagnostic_Session
            DcmDspStartRoutineIn
              In_ReqData (DcmDspStartRoutineInSignal): DcmDspRoutineSignalLength=24, DcmDspRoutineSignalType=UINT8_N, DcmDspRoutineSignalEndianness=opaque, DcmDspRoutineSignalPos=0
            DcmDspStartRoutineOut
              Out_ResData (DcmDspStartRoutineOutSignal): DcmDspRoutineSignalLength=16, DcmDspRoutineSignalType=UINT8_N, DcmDspRoutineSignalEndianness=opaque, DcmDspRoutineSignalPos=0
        DcmDspSecurity
          Authenticated_Diagnostic_Access (DcmDspSecurityRow):
            DcmDspSecurityADRSize = 1536
            DcmDspSecurityDelayTime = 10
            DcmDspSecurityDelayTimeOnBoot = 0
            DcmDspSecurityKeySize = 288
            DcmDspSecurityLevel = 9
            DcmDspSecurityNumAttDelay = 2
            DcmDspSecuritySeedSize = 32
        DcmDspSession
          3 x DcmDspSessionRow, all with DcmDspSessionP2ServerMax=0.05, DcmDspSessionP2StarServerMax=5:
            Default_Session: DcmDspSessionLevel=1, DcmDspSessionForBoot=DCM_NO_BOOT
            Programming_Session: DcmDspSessionLevel=2
            Extended_Diagnostic_Session: DcmDspSessionLevel=3, DcmDspSessionForBoot=DCM_NO_BOOT
        ComControl (DcmDspComControl)
          DspComContolAllChannel (DcmDspComControlAllChannel)
