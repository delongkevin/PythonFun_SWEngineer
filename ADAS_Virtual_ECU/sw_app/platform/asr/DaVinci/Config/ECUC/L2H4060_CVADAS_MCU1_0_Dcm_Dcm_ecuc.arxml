AUTOSAR XML (schema 00048)
package /ActiveEcuC
  module config Dcm: implementation-config-variant=VARIANT-PRE-COMPILE, module-description=Dcm_Impl
    DcmConfigSet
      DcmGeneral:
        DcmResetToFblAfterSessionFinalResponseEnabled = false
        DcmDevErrorDetect = true
        DcmRequestManufacturerNotificationEnabled = true
        DcmRequestSupplierNotificationEnabled = false
        DcmRespondAllRequest = false
        DcmTaskTime = 0.01
        DcmVersionInfoApi = false
        DcmDspDataDefaultEndianness = LITTLE_ENDIAN
        DcmSafeBswChecks = true
        DcmSupportedIDCalculationSuppressionEnabled = false
        DcmDtrDataProvisionViaDemEnabled = true
        DcmForeignDiagnosticRequestDetectionEnabled = false
        DcmSuppressResponseOnCanTpFuncMixedAddrRequests = false
        DcmSenderReceiverPRPortsEnabled = false
        DcmAutosarVersion = AUTOSAR_4_02_01
        DcmFinalResponseToFblEnabled = true
        DcmKeepAliveTime = 5
      DcmDsd
        DcmDsdServiceTable
          15 x DcmDsdService:
            RequestDownload: DcmDsdSidTabServiceId=52, DcmDsdSidTabSubfuncAvail=false, DcmDsdSidTabSessionLevelRef=Programming_Session, DcmDsdSidTabSecurityLevelRef=Authenticated_Diagnostic_Access
            ClearDiagInfo: DcmDsdSidTabServiceId=20, DcmDsdSidTabSubfuncAvail=false, DcmDsdSidTabSessionLevelRef=Default_Session, DcmDsdSidTabSessionLevelRef=Extended_Diagnostic_Session
            EcuReset: DcmDsdSidTabServiceId=17, DcmDsdSidTabSubfuncAvail=true
              Hard (DcmDsdSubService): DcmDsdSubServiceId=1
            TransferData: DcmDsdSidTabServiceId=54, DcmDsdSidTabSubfuncAvail=false, DcmDsdSidTabSessionLevelRef=Programming_Session
            ControlDtcSetting: DcmDsdSidTabServiceId=133, DcmDsdSidTabSubfuncAvail=true, DcmDsdSidTabSessionLevelRef=Extended_Diagnostic_Session
              Disable (DcmDsdSubService): DcmDsdSubServiceId=2, DcmDsdSubServiceSessionLevelRef=Extended_Diagnostic_Session
              Enable (DcmDsdSubService): DcmDsdSubServiceId=1, DcmDsdSubServiceSessionLevelRef=Extended_Diagnostic_Session
            WriteDataById: DcmDsdSidTabServiceId=46, DcmDsdSidTabSubfuncAvail=false
            ReadDataById: DcmDsdSidTabServiceId=34, DcmDsdSidTabSubfuncAvail=false
            SecurityAccess: DcmDsdSidTabServiceId=39, DcmDsdSidTabSubfuncAvail=true, DcmDsdSidTabSessionLevelRef=Programming_Session, DcmDsdSidTabSessionLevelRef=Extended_Diagnostic_Session
              Authenticated_Diagnostics_Access_Send_Signed_Challenge_Send (DcmDsdSubService): DcmDsdSubServiceId=18, DcmDsdSubServiceSessionLevelRef=Programming_Session, DcmDsdSubServiceSessionLevelRef=Extended_Diagnostic_Session
              Authenticated_Diagnostics_Access_Request_Challenge_Request (DcmDsdSubService): DcmDsdSubServiceId=17, DcmDsdSubServiceSessionLevelRef=Programming_Session, DcmDsdSubServiceSessionLevelRef=Extended_Diagnostic_Session
            RequestTransferExit: DcmDsdSidTabServiceId=55, DcmDsdSidTabSubfuncAvail=false, DcmDsdSidTabSessionLevelRef=Programming_Session
            ReadDtcInfo: DcmDsdSidTabServiceId=25, DcmDsdSidTabSubfuncAvail=true
              10 x DcmDsdSubService:
                RNODTCBSMR: DcmDsdSubServiceId=7, DcmDsdSubServiceSessionLevelRef=Default_Session, DcmDsdSubServiceSessionLevelRef=Extended_Diagnostic_Session
                RFCDTC: DcmDsdSubServiceId=12, DcmDsdSubServiceSessionLevelRef=Default_Session, DcmDsdSubServiceSessionLevelRef=Extended_Diagnostic_Session
                RMRCDTC: DcmDsdSubServiceId=14, DcmDsdSubServiceSessionLevelRef=Default_Session, DcmDsdSubServiceSessionLevelRef=Extended_Diagnostic_Session
                RDTCEDRBDN: DcmDsdSubServiceId=6, DcmDsdSubServiceSessionLevelRef=Default_Session, DcmDsdSubServiceSessionLevelRef=Extended_Diagnostic_Session
                RSUPDTC: DcmDsdSubServiceId=10, DcmDsdSubServiceSessionLevelRef=Default_Session, DcmDsdSubServiceSessionLevelRef=Extended_Diagnostic_Session
                RDTCBSM: DcmDsdSubServiceId=2
                RDTCBSMR: DcmDsdSubServiceId=8, DcmDsdSubServiceSessionLevelRef=Default_Session, DcmDsdSubServiceSessionLevelRef=Extended_Diagnostic_Session
                RNODTCBSM: DcmDsdSubServiceId=1, DcmDsdSubServiceSessionLevelRef=Default_Session, DcmDsdSubServiceSessionLevelRef=Extended_Diagnostic_Session
                RDTCSSBDTC: DcmDsdSubServiceId=4, DcmDsdSubServiceSessionLevelRef=Default_Session, DcmDsdSubServiceSessionLevelRef=Extended_Diagnostic_Session
                RSIODTC: DcmDsdSubServiceId=9, DcmDsdSubServiceSessionLevelRef=Default_Session, DcmDsdSubServiceSessionLevelRef=Extended_Diagnostic_Session
            TesterPresent: DcmDsdSidTabServiceId=62, DcmDsdSidTabSubfuncAvail=true
              TesterPresent (DcmDsdSubService): DcmDsdSubServiceId=0
            CommunicationControl: DcmDsdSidTabServiceId=40, DcmDsdSidTabSubfuncAvail=true, DcmDsdSidTabSessionLevelRef=Extended_Diagnostic_Session
              EnableRxAndDisableTx (DcmDsdSubService): DcmDsdSubServiceId=1, DcmDsdSubServiceSessionLevelRef=Extended_Diagnostic_Session
              EnableRxAndTx (DcmDsdSubService): DcmDsdSubServiceId=0, DcmDsdSubServiceSessionLevelRef=Extended_Diagnostic_Session
            RoutineControl: DcmDsdSidTabServiceId=49, DcmDsdSidTabSubfuncAvail=true
            IoControlById: DcmDsdSidTabServiceId=47, DcmDsdSidTabSubfuncAvail=false, DcmDsdSidTabSessionLevelRef=Extended_Diagnostic_Session, DcmDsdSidTabSecurityLevelRef=Authenticated_Diagnostic_Access
            DiagSessionControl: DcmDsdSidTabServiceId=16, DcmDsdSidTabSubfuncAvail=true
              3 x DcmDsdSubService:
                Programming: DcmDsdSubServiceId=2, DcmDsdSubServiceModeRuleRef=ProgrammingPreconditionCheckRule
                Default: DcmDsdSubServiceId=1
                Extended: DcmDsdSubServiceId=3
      DcmDsl
        DcmDslBuffer: DcmDslBufferSize=5003
        DcmDslDiagResp: DcmDslDiagRespMaxNumRespPend=20, DcmDslDiagRespOnSecondDeclinedRequest=false, DcmDslDiagRespMaxNumOfDeclinedRequests=3
        DcmDslProtocol
          DcmDslProtocolRow_29812fbf (DcmDslProtocolRow):
            DcmDslProtocolID = DCM_UDS_ON_CAN
            DcmDslProtocolEndiannessConvEnabled = false
            DcmDslProtocolPreemptTimeout = 0
            DcmDslProtocolPriority = 0
            DcmSendRespPendOnTransToBoot = false
            DcmTimStrP2ServerAdjust = 0
            DcmTimStrP2StarServerAdjust = 0
            DcmSendRespPendOnRestart = true
            DcmDslProtocolMaximumResponseSize = 4095
            DcmDslProtocolRxBufferID = DcmDslBuffer
            DcmDslProtocolSIDTable = DcmDsdServiceTable
            DcmDslProtocolTxBufferID = DcmDslBuffer
            DcmDemClientRef = DemClient
            3 x DcmDslConnection:
              DC_0xF2A0_oCVADAS_oFDCAN2_c62f54b0
                DC_0xF2A0_oCVADAS_oFDCAN2_c62f54b0 (DcmDslMainConnection): DcmDslProtocolRxTesterSourceAddr=242, DcmDslProtocolRxConnectionId=2
                  DIAGNOSTIC_REQUEST_FD_PAM_oFDCAN2_20_534676a2_Rx_98ec1b4e (DcmDslProtocolRx):
                    DcmDslProtocolRxAddrType = DCM_PHYSICAL_TYPE
                    DcmDslProtocolRxPduId = 5
                    DcmDslProtocolRxChannelId = 0
                    DcmDslProtocolRxComMChannelRef = CN_FDCAN2_28a8fc44
                    DcmDslProtocolRxPduRef = DIAGNOSTIC_REQUEST_FD_PAM_oFDCAN2_20_534676a2_Rx
                  DIAGNOSTIC_RESPONSE_FD_PAM_oFDCAN2_20_4032c583_Tx_ea30d771 (DcmDslProtocolTx): DcmDslTxConfirmationPduId=2, DcmDslProtocolTxPduRef=DIAGNOSTIC_RESPONSE_FD_PAM_oFDCAN2_20_4032c583_Tx
                  DIAGNOSTIC_REQUEST_FD_FUNCTIONAL_oFDCAN2_20_4dd8a3fb_Rx_d491c59b (DcmDslProtocolRx):
                    DcmDslProtocolRxAddrType = DCM_FUNCTIONAL_TYPE
                    DcmDslProtocolRxPduId = 4
                    DcmDslProtocolRxChannelId = 0
                    DcmDslProtocolRxComMChannelRef = CN_FDCAN2_28a8fc44
                    DcmDslProtocolRxPduRef = DIAGNOSTIC_REQUEST_FD_FUNCTIONAL_oFDCAN2_20_4dd8a3fb_Rx
              DC_0xF1A0_oCVADAS_oFDCAN2_6579d219
                DC_0xF1A0_oCVADAS_oFDCAN2_6579d219 (DcmDslMainConnection): DcmDslProtocolRxTesterSourceAddr=241, DcmDslProtocolRxConnectionId=1
                  DIAGNOSTIC_REQUEST_FUNCTIONAL_oFDCAN2_4ccc9554_Rx_5f5efb1a (DcmDslProtocolRx):
                    DcmDslProtocolRxAddrType = DCM_FUNCTIONAL_TYPE
                    DcmDslProtocolRxPduId = 0
                    DcmDslProtocolRxChannelId = 0
                    DcmDslProtocolRxComMChannelRef = CN_FDCAN2_28a8fc44
                    DcmDslProtocolRxPduRef = DIAGNOSTIC_REQUEST_FUNCTIONAL_oFDCAN2_4ccc9554_Rx
                  DIAGNOSTIC_RESPONSE_PAM_oFDCAN2_5ac3c1c1_Tx_8f8f40dc (DcmDslProtocolTx): DcmDslTxConfirmationPduId=0, DcmDslProtocolTxPduRef=DIAGNOSTIC_RESPONSE_PAM_oFDCAN2_5ac3c1c1_Tx
                  DIAGNOSTIC_REQUEST_PAM_oFDCAN2_7b4c614e_Rx_05577ce6 (DcmDslProtocolRx):
                    DcmDslProtocolRxAddrType = DCM_PHYSICAL_TYPE
                    DcmDslProtocolRxPduId = 1
                    DcmDslProtocolRxChannelId = 0
                    DcmDslProtocolRxComMChannelRef = CN_FDCAN2_28a8fc44
                    DcmDslProtocolRxPduRef = DIAGNOSTIC_REQUEST_PAM_oFDCAN2_7b4c614e_Rx
              DC_0xF2A0_oCVADAS_oFDCAN2_FD_ff6b864a
                DC_0xF2A0_oCVADAS_oFDCAN2_FD_ff6b864a (DcmDslMainConnection): DcmDslProtocolRxTesterSourceAddr=242, DcmDslProtocolRxConnectionId=0
                  DIAGNOSTIC_REQUEST_FD_PAM_oFDCAN2_df0385a5_Rx_71a78412 (DcmDslProtocolRx):
                    DcmDslProtocolRxAddrType = DCM_PHYSICAL_TYPE
                    DcmDslProtocolRxPduId = 3
                    DcmDslProtocolRxChannelId = 0
                    DcmDslProtocolRxComMChannelRef = CN_FDCAN2_28a8fc44
                    DcmDslProtocolRxPduRef = DIAGNOSTIC_REQUEST_FD_PAM_oFDCAN2_df0385a5_Rx
                  DIAGNOSTIC_REQUEST_FD_FUNCTIONAL_oFDCAN2_d8147fe7_Rx_d005fae9 (DcmDslProtocolRx):
                    DcmDslProtocolRxAddrType = DCM_FUNCTIONAL_TYPE
                    DcmDslProtocolRxPduId = 2
                    DcmDslProtocolRxChannelId = 0
                    DcmDslProtocolRxComMChannelRef = CN_FDCAN2_28a8fc44
                    DcmDslProtocolRxPduRef = DIAGNOSTIC_REQUEST_FD_FUNCTIONAL_oFDCAN2_d8147fe7_Rx
                  DIAGNOSTIC_RESPONSE_FD_PAM_oFDCAN2_e66afb61_Tx_bab4d3c2 (DcmDslProtocolTx): DcmDslTxConfirmationPduId=1, DcmDslProtocolTxPduRef=DIAGNOSTIC_RESPONSE_FD_PAM_oFDCAN2_e66afb61_Tx
        DcmDslServiceRequestManufacturerNotification:
          DcmDslServiceRequestManufacturerNotificationUsePort = false
          DcmDslServiceRequestManufacturerNotificationConfirmationFnc = DcmDslServiceRequestManufacturer_Confirmtion
          DcmDslServiceRequestManufacturerNotificationIndicationFnc = DcmDslServiceRequestManufacturer_Indication
      DcmDsp: DcmDspMaxDidToRead=10, DcmDspReadDIDReportsNODIByte=false
        DcmDspSecurity
          Authenticated_Diagnostic_Access (DcmDspSecurityRow):
            DcmDspSecurityADRSize = 1536
            DcmDspSecurityDelayTime = 10
            DcmDspSecurityDelayTimeOnBoot = 0
            DcmDspSecurityKeySize = 288
            DcmDspSecurityLevel = 9
            DcmDspSecurityNumAttDelay = 0
            DcmDspSecuritySeedSize = 32
            DcmDspSecurityAttemptCounterEnabled = false
            DcmDspSecurityUsePort = USE_ASYNCH_FNC
            DcmDspSecurityCompareKeyFnc = Os_Call_DcmCalloutStub_CompareKey
            DcmDspSecurityGetAttemptCounterFnc = 
            DcmDspSecurityGetSeedFnc = Os_Call_DcmCalloutStub_GetSeed
            DcmDspSecuritySetAttemptCounterFnc = 
        DcmDspSession: DcmSessionTimerS3Enabled=true
          3 x DcmDspSessionRow, all with DcmDspSessionP2ServerMax=0.05, DcmDspSessionP2StarServerMax=5:
            Default_Session: DcmDspSessionLevel=1, DcmDspSessionForBoot=DCM_NO_BOOT
            Programming_Session: DcmDspSessionLevel=2, DcmDspSessionForBoot=DCM_OEM_BOOT
            Extended_Diagnostic_Session: DcmDspSessionLevel=3, DcmDspSessionForBoot=DCM_NO_BOOT
          DcmDspSessionCallback: DcmDspSessionCallbackFnc=Os_Call_DcmCalloutStub_SessionCallback
        DidInfo_DidInfo_22442B_USS_Sensor_11_Part_Number_Read (DcmDspDidInfo)
          DcmDspDidAccess
            DcmDspDidRead: DcmDspDidReadSessionRef=Default_Session, DcmDspDidReadSessionRef=Extended_Diagnostic_Session
        Data_22200A_Ignition_ON_Counter (DcmDspData):
          DcmDspDataSize = 16
          DcmDspDataType = UINT8_N
          DcmDspDataUsePort = USE_DATA_ASYNCH_CLIENT_SERVER
          DcmDspDataConditionCheckReadFncUsed = false
          DcmDspDataInfoRef = DataInfo_DataInfo_22200A_Ignition_ON_Counter
        DidInfo_DidInfo_224426_USS_Sensor_6_Part_Number_Read (DcmDspDidInfo)
          DcmDspDidAccess
            DcmDspDidRead: DcmDspDidReadSessionRef=Default_Session, DcmDspDidReadSessionRef=Extended_Diagnostic_Session
        Data_22F1A2_Vector_Delivery_ID (DcmDspData):
          DcmDspDataSize = 80
          DcmDspDataType = UINT8_N
          DcmDspDataUsePort = USE_DATA_ASYNCH_CLIENT_SERVER
          DcmDspDataConditionCheckReadFncUsed = false
          DcmDspDataInfoRef = DataInfo_DataInfo_22F1A2_Vector_Delivery_ID
        DID_225103_FD_CAN2_Rx_Signals_Read (DcmDspDid):
          DcmDspDidIdentifier = 20739
          DcmDspDidUsed = true
          DcmDspDidUsePort = USE_DATA_ELEMENT_SPECIFIC_INTERFACES
          DcmDspDidInfoRef = DidInfo_DidInfo_225103_FD_CAN2_Rx_Signals_Read
          DcmDspDidSignal: DcmDspDidDataPos=0, DcmDspDidDataRef=Data_225103_FD_CAN2_Rx_Signals_Read
        DID_22FD1E_Calibration_Status_Read (DcmDspDid):
          DcmDspDidIdentifier = 64798
          DcmDspDidUsed = true
          DcmDspDidUsePort = USE_DATA_ELEMENT_SPECIFIC_INTERFACES
          DcmDspDidInfoRef = DidInfo_DidInfo_22FD1E_Calibration_Status_Read
          DcmDspDidSignal: DcmDspDidDataPos=0, DcmDspDidDataRef=Data_22FD1E_Calibration_Status_Read
        Data_225300_Rear_Braking_Event_1_Read (DcmDspData):
          DcmDspDataSize = 112
          DcmDspDataType = UINT8_N
          DcmDspDataUsePort = USE_DATA_ASYNCH_CLIENT_SERVER
          DcmDspDataConditionCheckReadFncUsed = false
          DcmDspDataInfoRef = DataInfo_DataInfo_225300_Rear_Braking_Event_1_Read
        Data_225103_FD_CAN2_Rx_Signals_Read (DcmDspData):
          DcmDspDataSize = 328
          DcmDspDataType = UINT8_N
          DcmDspDataUsePort = USE_DATA_ASYNCH_CLIENT_SERVER
          DcmDspDataConditionCheckReadFncUsed = false
          DcmDspDataInfoRef = DataInfo_DataInfo_225103_FD_CAN2_Rx_Signals_Read
        3 x DcmDspDidInfo:
          DidInfo_DidInfo_22F194_Supplier_ECU_Software_Part_Number
            DcmDspDidAccess
              DcmDspDidRead
          DidInfo_DidInfo_22F192_Supplier_ECU_Hardware_Part_Number
            DcmDspDidAccess
              DcmDspDidRead
          DidInfo_DidInfo_22F134_CODEP_assembly_part_number
            DcmDspDidAccess
              DcmDspDidRead
        Data_225201_Plant_Mode_Status_Read (DcmDspData):
          DcmDspDataSize = 8
          DcmDspDataType = UINT8_N
          DcmDspDataUsePort = USE_DATA_ASYNCH_CLIENT_SERVER
          DcmDspDataConditionCheckReadFncUsed = false
          DcmDspDataInfoRef = DataInfo_DataInfo_225201_Plant_Mode_Status_Read
        Data_22FD1E_Calibration_Status_Read (DcmDspData):
          DcmDspDataSize = 168
          DcmDspDataType = UINT8_N
          DcmDspDataUsePort = USE_DATA_ASYNCH_CLIENT_SERVER
          DcmDspDataConditionCheckReadFncUsed = false
          DcmDspDataInfoRef = DataInfo_DataInfo_22FD1E_Calibration_Status_Read
        DID_220107_RoE_Activation_State (DcmDspDid):
          DcmDspDidIdentifier = 263
          DcmDspDidUsed = true
          DcmDspDidUsePort = USE_DATA_ELEMENT_SPECIFIC_INTERFACES
          DcmDspDidInfoRef = DidInfo_DidInfo_220107_RoE_Activation_State
          DcmDspDidSignal: DcmDspDidDataPos=0, DcmDspDidDataRef=Data_220107_RoE_Activation_State
        Data_22F18A_FCA_ESLM_ECU_Software_Calibration_Number (DcmDspData):
          DcmDspDataSize = 80
          DcmDspDataType = UINT8_N
          DcmDspDataUsePort = USE_DATA_ASYNCH_CLIENT_SERVER
          DcmDspDataConditionCheckReadFncUsed = false
          DcmDspDataInfoRef = DataInfo_DataInfo_22F18A_FCA_ESLM_ECU_Software_Calibration_Number
        DataInfo_DataInfo_221921_Operational_Mode_Status (DcmDspDataInfo): DcmDspDataFixedLength=true
        DID_22FD1C_Current_Camera_Calibration_Data_Read (DcmDspDid):
          DcmDspDidIdentifier = 64796
          DcmDspDidUsed = true
          DcmDspDidUsePort = USE_DATA_ELEMENT_SPECIFIC_INTERFACES
          DcmDspDidInfoRef = DidInfo_DidInfo_22FD1C_Current_Camera_Calibration_Data_Read
          DcmDspDidSignal: DcmDspDidDataPos=0, DcmDspDidDataRef=Data_22FD1C_Current_Camera_Calibration_Data_Read
        Data_22201F_Boot_Failure_Reason_Read (DcmDspData):
          DcmDspDataSize = 16
          DcmDspDataType = UINT8_N
          DcmDspDataUsePort = USE_DATA_ASYNCH_CLIENT_SERVER
          DcmDspDataConditionCheckReadFncUsed = false
          DcmDspDataInfoRef = DataInfo_DataInfo_22201F_Boot_Failure_Reason_Read
        DID_22102A_Check_EOL_Configuration_Data (DcmDspDid):
          DcmDspDidIdentifier = 4138
          DcmDspDidUsed = true
          DcmDspDidUsePort = USE_DATA_ELEMENT_SPECIFIC_INTERFACES
          DcmDspDidInfoRef = DidInfo_DidInfo_22102A_Check_EOL_Configuration_Data
          DcmDspDidSignal: DcmDspDidDataPos=0, DcmDspDidDataRef=Data_22102A_Check_EOL_Configuration_Data
        DataInfo_DataInfo_22F1B3_Boot_Software_Fingerprint_Reading_Information (DcmDspDataInfo): DcmDspDataFixedLength=true
        DID_2EF185_Application_Data_Software_Fingerprint_Writing_Information (DcmDspDid):
          DcmDspDidIdentifier = 61829
          DcmDspDidUsed = true
          DcmDspDidUsePort = USE_DATA_ELEMENT_SPECIFIC_INTERFACES
          DcmDspDidInfoRef = DidInfo_DidInfo_2EF185_Application_Data_Software_Fingerprint_Writing_Information
          DcmDspDidSignal: DcmDspDidDataPos=0, DcmDspDidDataRef=Data_2EF185_Application_Data_Software_Fingerprint_Writing_Information
        Data_22FD15_Magna_Production_HW_Number_Read (DcmDspData):
          DcmDspDataSize = 104
          DcmDspDataType = UINT8_N
          DcmDspDataUsePort = USE_DATA_ASYNCH_CLIENT_SERVER
          DcmDspDataConditionCheckReadFncUsed = false
          DcmDspDataInfoRef = DataInfo_DataInfo_22FD15_Magna_Production_HW_Number_Read
        DataInfo_DataInfo_22F194_Supplier_ECU_Software_Part_Number (DcmDspDataInfo): DcmDspDataFixedLength=true
        DataInfo_DataInfo_22F192_Supplier_ECU_Hardware_Part_Number (DcmDspDataInfo): DcmDspDataFixedLength=true
        DID_222001_Odometer (DcmDspDid):
          DcmDspDidIdentifier = 8193
          DcmDspDidUsed = true
          DcmDspDidUsePort = USE_DATA_ELEMENT_SPECIFIC_INTERFACES
          DcmDspDidInfoRef = DidInfo_DidInfo_222001_Odometer
          DcmDspDidSignal: DcmDspDidDataPos=0, DcmDspDidDataRef=Data_222001_Odometer
        Routine_31015101_Sensor_Functional_Test_Start (DcmDspRoutine):
          DcmDspRequestResultsRoutineSupported = false
          DcmDspStopRoutineSupported = false
          DcmDspRoutineIdentifier = 20737
          DcmDspRoutineFixedLength = false
          DcmDspRoutineUsePort = true
          DcmDspRoutineUsed = true
          DcmDspRoutineInfoRef = RoutineInfo_RoutineInfo_31015101_Sensor_Functional_Test_Start
        DID_22F191_FCA_ESLM_ECU_Hardware_Number (DcmDspDid):
          DcmDspDidIdentifier = 61841
          DcmDspDidUsed = true
          DcmDspDidUsePort = USE_DATA_ELEMENT_SPECIFIC_INTERFACES
          DcmDspDidInfoRef = DidInfo_DidInfo_22F191_FCA_ESLM_ECU_Hardware_Number
          DcmDspDidSignal: DcmDspDidDataPos=0, DcmDspDidDataRef=Data_22F191_FCA_ESLM_ECU_Hardware_Number
        DataInfo_DataInfo_22FD17_Magna_Production_HW_Version_information_Read (DcmDspDataInfo): DcmDspDataFixedLength=true
        DataInfo_DataInfo_222945_Flow_Control_Test (DcmDspDataInfo): DcmDspDataFixedLength=true
        Data_222026_CAN_Overrun_Counters (DcmDspData):
          DcmDspDataSize = 64
          DcmDspDataType = UINT8_N
          DcmDspDataUsePort = USE_DATA_ASYNCH_CLIENT_SERVER
          DcmDspDataConditionCheckReadFncUsed = false
          DcmDspDataInfoRef = DataInfo_DataInfo_222026_CAN_Overrun_Counters
        Routine_3101D002_Check_Programming_Preconditions_Start (DcmDspRoutine):
          DcmDspRequestResultsRoutineSupported = false
          DcmDspStopRoutineSupported = false
          DcmDspRoutineIdentifier = 53250
          DcmDspRoutineFixedLength = false
          DcmDspRoutineUsePort = true
          DcmDspRoutineUsed = true
          DcmDspRoutineInfoRef = RoutineInfo_RoutineInfo_3101D002_Check_Programming_Preconditions_Start
        DataInfo_DataInfo_22FD0A_SC_Data_Read (DcmDspDataInfo): DcmDspDataFixedLength=true
        DID_225303_SPM_Event_Abort_1_Read (DcmDspDid):
          DcmDspDidIdentifier = 21251
          DcmDspDidUsed = true
          DcmDspDidUsePort = USE_DATA_ELEMENT_SPECIFIC_INTERFACES
          DcmDspDidInfoRef = DidInfo_DidInfo_225303_SPM_Event_Abort_1_Read
          DcmDspDidSignal: DcmDspDidDataPos=0, DcmDspDidDataRef=Data_225303_SPM_Event_Abort_1_Read
        DidInfo_DidInfo_22FD28_USS_Ringing_Frequency_Read (DcmDspDidInfo)
          DcmDspDidAccess
            DcmDspDidRead: DcmDspDidReadSessionRef=Default_Session, DcmDspDidReadSessionRef=Extended_Diagnostic_Session
        4 x DcmDspDataInfo, all with DcmDspDataFixedLength=true:
          DataInfo_DataInfo_22F122_Software_EBOM_Part_Number
          DataInfo_DataInfo_22F10D_Diagnostic_Specification_Information
          DataInfo_DataInfo_22F132_EBOM_ECU_Part_Number
          DataInfo_DataInfo_222010_Programming_Status
        DidInfo_DidInfo_221004_Battery_Voltage (DcmDspDidInfo)
          DcmDspDidAccess
            DcmDspDidRead: DcmDspDidReadSessionRef=Default_Session, DcmDspDidReadSessionRef=Extended_Diagnostic_Session
        DID_22100B_Diagnostic_Tool_and_Session_Status (DcmDspDid):
          DcmDspDidIdentifier = 4107
          DcmDspDidUsed = true
          DcmDspDidUsePort = USE_DATA_ELEMENT_SPECIFIC_INTERFACES
          DcmDspDidInfoRef = DidInfo_DidInfo_22100B_Diagnostic_Tool_and_Session_Status
          DcmDspDidSignal: DcmDspDidDataPos=0, DcmDspDidDataRef=Data_22100B_Diagnostic_Tool_and_Session_Status
        Data_224424_USS_Sensor_4_Part_Number_Read (DcmDspData):
          DcmDspDataSize = 104
          DcmDspDataType = UINT8_N
          DcmDspDataUsePort = USE_DATA_ASYNCH_CLIENT_SERVER
          DcmDspDataConditionCheckReadFncUsed = false
          DcmDspDataInfoRef = DataInfo_DataInfo_224424_USS_Sensor_4_Part_Number_Read
        Data_222024_Read_ECU_PROXI_Data (DcmDspData):
          DcmDspDataSize = 2040
          DcmDspDataType = UINT8_N
          DcmDspDataUsePort = USE_DATA_ASYNCH_CLIENT_SERVER
          DcmDspDataConditionCheckReadFncUsed = false
          DcmDspDataInfoRef = DataInfo_DataInfo_222024_Read_ECU_PROXI_Data
        DID_222002_Odometer_at_last_Flash_programming (DcmDspDid):
          DcmDspDidIdentifier = 8194
          DcmDspDidUsed = true
          DcmDspDidUsePort = USE_DATA_ELEMENT_SPECIFIC_INTERFACES
          DcmDspDidInfoRef = DidInfo_DidInfo_222002_Odometer_at_last_Flash_programming
          DcmDspDidSignal: DcmDspDidDataPos=0, DcmDspDidDataRef=Data_222002_Odometer_at_last_Flash_programming
        DidInfo_DidInfo_22F133_EBOM_Assembly_Part_Number (DcmDspDidInfo)
          DcmDspDidAccess
            DcmDspDidRead
        Data_22FD61_Vehicle_Variant_Coding_Data_Read (DcmDspData):
          DcmDspDataSize = 96
          DcmDspDataType = UINT8_N
          DcmDspDataUsePort = USE_DATA_ASYNCH_CLIENT_SERVER
          DcmDspDataConditionCheckReadFncUsed = false
          DcmDspDataInfoRef = DataInfo_DataInfo_22FD61_Vehicle_Variant_Coding_Data_Read
        DID_22FD48_PCBA_Temperature_Read (DcmDspDid):
          DcmDspDidIdentifier = 64840
          DcmDspDidUsed = true
          DcmDspDidUsePort = USE_DATA_ELEMENT_SPECIFIC_INTERFACES
          DcmDspDidInfoRef = DidInfo_DidInfo_22FD48_PCBA_Temperature_Read
          DcmDspDidSignal: DcmDspDidDataPos=0, DcmDspDidDataRef=Data_22FD48_PCBA_Temperature_Read
        DID_22FD0E_Rear_Camera_Data_EEPROM_Read (DcmDspDid):
          DcmDspDidIdentifier = 64782
          DcmDspDidUsed = true
          DcmDspDidUsePort = USE_DATA_ELEMENT_SPECIFIC_INTERFACES
          DcmDspDidInfoRef = DidInfo_DidInfo_22FD0E_Rear_Camera_Data_EEPROM_Read
          DcmDspDidSignal: DcmDspDidDataPos=0, DcmDspDidDataRef=Data_22FD0E_Rear_Camera_Data_EEPROM_Read
        DidInfo_DidInfo_22F10D_Diagnostic_Specification_Information (DcmDspDidInfo)
          DcmDspDidAccess
            DcmDspDidRead
        3 x DcmDspDid, all with DcmDspDidUsed=true, DcmDspDidUsePort=USE_DATA_ELEMENT_SPECIFIC_INTERFACES:
          DID_22FDF2_Reset_Reason_Read: DcmDspDidIdentifier=65010, DcmDspDidInfoRef=DidInfo_DidInfo_22FDF2_Reset_Reason_Read
            DcmDspDidSignal: DcmDspDidDataPos=0, DcmDspDidDataRef=Data_22FDF2_Reset_Reason_Read
          DID_224422_USS_Sensor2_Part_Number_Read: DcmDspDidIdentifier=17442, DcmDspDidInfoRef=DidInfo_DidInfo_224422_USS_Sensor2_Part_Number_Read
            DcmDspDidSignal: DcmDspDidDataPos=0, DcmDspDidDataRef=Data_224422_USS_Sensor2_Part_Number_Read
          DID_22F1B5_Application_Data_Software_Fingerprint_Reading_Information: DcmDspDidIdentifier=61877, DcmDspDidInfoRef=DidInfo_DidInfo_22F1B5_Application_Data_Software_Fingerprint_Reading_Information
            DcmDspDidSignal: DcmDspDidDataPos=0, DcmDspDidDataRef=Data_22F1B5_Application_Data_Software_Fingerprint_Reading_Information
        DataInfo_DataInfo_22FD47_SoC_Temperature_0xFD47_Read (DcmDspDataInfo): DcmDspDataFixedLength=true
        DataInfo_DataInfo_22FD08_OC_Data_Read (DcmDspDataInfo): DcmDspDataFixedLength=true
        Routine_31015400_Camera_EOL_Calibration_Start (DcmDspRoutine):
          DcmDspRequestResultsRoutineSupported = true
          DcmDspStopRoutineSupported = false
          DcmDspRoutineIdentifier = 21504
          DcmDspRoutineFixedLength = false
          DcmDspRoutineUsePort = true
          DcmDspRoutineUsed = true
          DcmDspRoutineInfoRef = RoutineInfo_RoutineInfo_31015400_Camera_EOL_Calibration_Start
        DID_224428_USS_Sensor_8_Part_Number_Read (DcmDspDid):
          DcmDspDidIdentifier = 17448
          DcmDspDidUsed = true
          DcmDspDidUsePort = USE_DATA_ELEMENT_SPECIFIC_INTERFACES
          DcmDspDidInfoRef = DidInfo_DidInfo_224428_USS_Sensor_8_Part_Number_Read
          DcmDspDidSignal: DcmDspDidDataPos=0, DcmDspDidDataRef=Data_224428_USS_Sensor_8_Part_Number_Read
        Data_22FD42_Failsafe_Behaviour_Read (DcmDspData):
          DcmDspDataSize = 8
          DcmDspDataType = UINT8_N
          DcmDspDataUsePort = USE_DATA_ASYNCH_CLIENT_SERVER
          DcmDspDataConditionCheckReadFncUsed = false
          DcmDspDataInfoRef = DataInfo_DataInfo_22FD42_Failsafe_Behaviour_Read
        DID_221004_Battery_Voltage (DcmDspDid):
          DcmDspDidIdentifier = 4100
          DcmDspDidUsed = true
          DcmDspDidUsePort = USE_DATA_ELEMENT_SPECIFIC_INTERFACES
          DcmDspDidInfoRef = DidInfo_DidInfo_221004_Battery_Voltage
          DcmDspDidSignal: DcmDspDidDataPos=0, DcmDspDidDataRef=Data_221004_Battery_Voltage
        3 x DcmDspData, all with DcmDspDataType=UINT8_N, DcmDspDataUsePort=USE_DATA_ASYNCH_CLIENT_SERVER, DcmDspDataConditionCheckReadFncUsed=false:
          Data_22FD46_Camera_Power_Supply_Read: DcmDspDataSize=64, DcmDspDataInfoRef=DataInfo_DataInfo_22FD46_Camera_Power_Supply_Read
          Data_22FD17_Magna_Production_HW_Version_information_Read: DcmDspDataSize=24, DcmDspDataInfoRef=DataInfo_DataInfo_22FD17_Magna_Production_HW_Version_information_Read
          Data_225304_SPM_Event_Abort_2_Read: DcmDspDataSize=96, DcmDspDataInfoRef=DataInfo_DataInfo_225304_SPM_Event_Abort_2_Read
        DID_22200B_Time_First_DTC_Detection (DcmDspDid):
          DcmDspDidIdentifier = 8203
          DcmDspDidUsed = true
          DcmDspDidUsePort = USE_DATA_ELEMENT_SPECIFIC_INTERFACES
          DcmDspDidInfoRef = DidInfo_DidInfo_22200B_Time_First_DTC_Detection
          DcmDspDidSignal: DcmDspDidDataPos=0, DcmDspDidDataRef=Data_22200B_Time_First_DTC_Detection
        DidInfo_DidInfo_22F1A2_Vector_Delivery_ID (DcmDspDidInfo)
          DcmDspDidAccess
            DcmDspDidRead
        DidInfo_DidInfo_22F154_Hardware_Supplier_Identification (DcmDspDidInfo)
          DcmDspDidAccess
            DcmDspDidRead
        Data_225104_FD_CAN14_Tx_Signals_Read (DcmDspData):
          DcmDspDataSize = 40
          DcmDspDataType = UINT8_N
          DcmDspDataUsePort = USE_DATA_ASYNCH_CLIENT_SERVER
          DcmDspDataConditionCheckReadFncUsed = false
          DcmDspDataInfoRef = DataInfo_DataInfo_225104_FD_CAN14_Tx_Signals_Read
        DidInfo_DidInfo_22FD08_OC_Data_Read (DcmDspDidInfo)
          DcmDspDidAccess
            DcmDspDidWrite: DcmDspDidWriteSessionRef=Extended_Diagnostic_Session
            DcmDspDidRead: DcmDspDidReadSessionRef=Default_Session, DcmDspDidReadSessionRef=Extended_Diagnostic_Session
        DID_22F133_EBOM_Assembly_Part_Number (DcmDspDid):
          DcmDspDidIdentifier = 61747
          DcmDspDidUsed = true
          DcmDspDidUsePort = USE_DATA_ELEMENT_SPECIFIC_INTERFACES
          DcmDspDidInfoRef = DidInfo_DidInfo_22F133_EBOM_Assembly_Part_Number
          DcmDspDidSignal: DcmDspDidDataPos=0, DcmDspDidDataRef=Data_22F133_EBOM_Assembly_Part_Number
        DID_22FD20_ECU_PinStates_Read (DcmDspDid):
          DcmDspDidIdentifier = 64800
          DcmDspDidUsed = true
          DcmDspDidUsePort = USE_DATA_ELEMENT_SPECIFIC_INTERFACES
          DcmDspDidInfoRef = DidInfo_DidInfo_22FD20_ECU_PinStates_Read
          DcmDspDidSignal: DcmDspDidDataPos=0, DcmDspDidDataRef=Data_22FD20_ECU_PinStates_Read
        Data_22F133_EBOM_Assembly_Part_Number (DcmDspData):
          DcmDspDataSize = 80
          DcmDspDataType = UINT8_N
          DcmDspDataUsePort = USE_DATA_ASYNCH_CLIENT_SERVER
          DcmDspDataConditionCheckReadFncUsed = false
          DcmDspDataInfoRef = DataInfo_DataInfo_22F133_EBOM_Assembly_Part_Number
        DID_22F112_PTESLM_Hardware_Number (DcmDspDid):
          DcmDspDidIdentifier = 61714
          DcmDspDidUsed = true
          DcmDspDidUsePort = USE_DATA_ELEMENT_SPECIFIC_INTERFACES
          DcmDspDidInfoRef = DidInfo_DidInfo_22F112_PTESLM_Hardware_Number
          DcmDspDidSignal: DcmDspDidDataPos=0, DcmDspDidDataRef=Data_22F112_PTESLM_Hardware_Number
        DataInfo_DataInfo_22FD29_USS_Driving_Frequency_Read (DcmDspDataInfo): DcmDspDataFixedLength=true
        DidInfo_DidInfo_225201_Plant_Mode_Status_Read (DcmDspDidInfo)
          DcmDspDidAccess
            DcmDspDidRead: DcmDspDidReadSessionRef=Default_Session, DcmDspDidReadSessionRef=Extended_Diagnostic_Session
        Data_22FDF1_CPU_Load_Read (DcmDspData):
          DcmDspDataSize = 40
          DcmDspDataType = UINT8_N
          DcmDspDataUsePort = USE_DATA_ASYNCH_CLIENT_SERVER
          DcmDspDataConditionCheckReadFncUsed = false
          DcmDspDataInfoRef = DataInfo_DataInfo_22FDF1_CPU_Load_Read
        DataInfo_DataInfo_22102A_Check_EOL_Configuration_Data (DcmDspDataInfo): DcmDspDataFixedLength=true
        DidInfo_DidInfo_22F193_Supplier_ECU_Hardware_Version_Number (DcmDspDidInfo)
          DcmDspDidAccess
            DcmDspDidRead
        Data_22FD0C_Front_Camera_Data_EEPROM_Read (DcmDspData):
          DcmDspDataSize = 2048
          DcmDspDataType = UINT8_N
          DcmDspDataUsePort = USE_DATA_ASYNCH_CLIENT_SERVER
          DcmDspDataConditionCheckReadFncUsed = false
          DcmDspDataInfoRef = DataInfo_DataInfo_22FD0C_Front_Camera_Data_EEPROM_Read
        DataInfo_DataInfo_22FD49_SoC_Die_Temperature_ID_0xFD49_Read (DcmDspDataInfo): DcmDspDataFixedLength=true
        DidInfo_DidInfo_22F187_CODEP_ECU_Part_Number (DcmDspDidInfo)
          DcmDspDidAccess
            DcmDspDidRead
        DataInfo_DataInfo_225102_FD_CAN14_Rx_Signals_Read (DcmDspDataInfo): DcmDspDataFixedLength=true
        DataInfo_DataInfo_22FDF0_ECU_shutdown_process_Read (DcmDspDataInfo): DcmDspDataFixedLength=true
        Data_22FD29_USS_Driving_Frequency_Read (DcmDspData):
          DcmDspDataSize = 192
          DcmDspDataType = UINT8_N
          DcmDspDataUsePort = USE_DATA_ASYNCH_CLIENT_SERVER
          DcmDspDataConditionCheckReadFncUsed = false
          DcmDspDataInfoRef = DataInfo_DataInfo_22FD29_USS_Driving_Frequency_Read
        Data_22F10B_ECU_Qualification (DcmDspData):
          DcmDspDataSize = 16
          DcmDspDataType = UINT8_N
          DcmDspDataUsePort = USE_DATA_ASYNCH_CLIENT_SERVER
          DcmDspDataConditionCheckReadFncUsed = false
          DcmDspDataInfoRef = DataInfo_DataInfo_22F10B_ECU_Qualification
        DidInfo_DidInfo_22F10B_ECU_Qualification (DcmDspDidInfo)
          DcmDspDidAccess
            DcmDspDidRead: DcmDspDidReadSessionRef=Default_Session, DcmDspDidReadSessionRef=Extended_Diagnostic_Session
        RoutineInfo_RoutineInfo_3101FE02_Test_Write_PMIC_Register_Start (DcmDspRoutineInfo)
          DcmDspStartRoutineIn
            In_ReqData (DcmDspStartRoutineInSignal): DcmDspRoutineSignalLength=40, DcmDspRoutineSignalType=UINT8_N, DcmDspRoutineSignalEndianness=opaque, DcmDspRoutineSignalPos=0
          DcmDspRoutineAuthorization: DcmDspRoutineSessionRef=Extended_Diagnostic_Session
        Routine_31015000_Park_Assist_ON_OFF_State_Start (DcmDspRoutine):
          DcmDspRequestResultsRoutineSupported = false
          DcmDspStopRoutineSupported = false
          DcmDspRoutineIdentifier = 20480
          DcmDspRoutineFixedLength = false
          DcmDspRoutineUsePort = true
          DcmDspRoutineUsed = true
          DcmDspRoutineInfoRef = RoutineInfo_RoutineInfo_31015000_Park_Assist_ON_OFF_State_Start
        DidInfo_DidInfo_22F132_EBOM_ECU_Part_Number (DcmDspDidInfo)
          DcmDspDidAccess
            DcmDspDidRead
        Data_22FDF2_Reset_Reason_Read (DcmDspData):
          DcmDspDataSize = 16
          DcmDspDataType = UINT8_N
          DcmDspDataUsePort = USE_DATA_ASYNCH_CLIENT_SERVER
          DcmDspDataConditionCheckReadFncUsed = false
          DcmDspDataInfoRef = DataInfo_DataInfo_22FDF2_Reset_Reason_Read
        Data_22FD16_Magna_Production_ICT_Data_Read (DcmDspData):
          DcmDspDataSize = 512
          DcmDspDataType = UINT8_N
          DcmDspDataUsePort = USE_DATA_ASYNCH_CLIENT_SERVER
          DcmDspDataConditionCheckReadFncUsed = false
          DcmDspDataInfoRef = DataInfo_DataInfo_22FD16_Magna_Production_ICT_Data_Read
        DataInfo_DataInfo_22FD0E_Rear_Camera_Data_EEPROM_Read (DcmDspDataInfo): DcmDspDataFixedLength=true
        DID_222939_FDCAN2_BUS_Network_WakeUp_Reason (DcmDspDid):
          DcmDspDidIdentifier = 10553
          DcmDspDidUsed = true
          DcmDspDidUsePort = USE_DATA_ELEMENT_SPECIFIC_INTERFACES
          DcmDspDidInfoRef = DidInfo_DidInfo_222939_FDCAN2_BUS_Network_WakeUp_Reason
          DcmDspDidSignal: DcmDspDidDataPos=0, DcmDspDidDataRef=Data_222939_FDCAN2_BUS_Network_WakeUp_Reason
        DID_22FD0A_SC_Data_Read (DcmDspDid):
          DcmDspDidIdentifier = 64778
          DcmDspDidUsed = true
          DcmDspDidUsePort = USE_DATA_ELEMENT_SPECIFIC_INTERFACES
          DcmDspDidInfoRef = DidInfo_DidInfo_22FD0A_SC_Data_Read
          DcmDspDidSignal: DcmDspDidDataPos=0, DcmDspDidDataRef=Data_22FD0A_SC_Data_Read
        DidInfo_DidInfo_22F182_Application_Data_Identification (DcmDspDidInfo)
          DcmDspDidAccess
            DcmDspDidRead: DcmDspDidReadSessionRef=Default_Session, DcmDspDidReadSessionRef=Extended_Diagnostic_Session
        DidInfo_DidInfo_22292E_PROXI_Write_Counter (DcmDspDidInfo)
          DcmDspDidAccess
            DcmDspDidRead: DcmDspDidReadSessionRef=Default_Session, DcmDspDidReadSessionRef=Extended_Diagnostic_Session
        DID_221009_ECU_Time_Since_Ignition_ON (DcmDspDid):
          DcmDspDidIdentifier = 4105
          DcmDspDidUsed = true
          DcmDspDidUsePort = USE_DATA_ELEMENT_SPECIFIC_INTERFACES
          DcmDspDidInfoRef = DidInfo_DidInfo_221009_ECU_Time_Since_Ignition_ON
          DcmDspDidSignal: DcmDspDidDataPos=0, DcmDspDidDataRef=Data_221009_ECU_Time_Since_Ignition_ON
        DataInfo_DataInfo_22FD31_Magna_EOL_Coding_State_Read (DcmDspDataInfo): DcmDspDataFixedLength=true
        DataInfo_DataInfo_225304_SPM_Event_Abort_2_Read (DcmDspDataInfo): DcmDspDataFixedLength=true
        DID_22FD2B_USS_Direct_Distance_0xFD2B_Read (DcmDspDid):
          DcmDspDidIdentifier = 64811
          DcmDspDidUsed = true
          DcmDspDidUsePort = USE_DATA_ELEMENT_SPECIFIC_INTERFACES
          DcmDspDidInfoRef = DidInfo_DidInfo_22FD2B_USS_Direct_Distance_0xFD2B_Read
          DcmDspDidSignal: DcmDspDidDataPos=0, DcmDspDidDataRef=Data_22FD2B_USS_Direct_Distance_0xFD2B_Read
        DataInfo_DataInfo_22F110_ECU_Diagnostic_Identification (DcmDspDataInfo): DcmDspDataFixedLength=true
        DataInfo_DataInfo_222013_VIN_Lock_State_Read (DcmDspDataInfo): DcmDspDataFixedLength=true
        Data_22FD47_SoC_Temperature_0xFD47_Read (DcmDspData):
          DcmDspDataSize = 80
          DcmDspDataType = UINT8_N
          DcmDspDataUsePort = USE_DATA_ASYNCH_CLIENT_SERVER
          DcmDspDataConditionCheckReadFncUsed = false
          DcmDspDataInfoRef = DataInfo_DataInfo_22FD47_SoC_Temperature_0xFD47_Read
        DataInfo_DataInfo_22F193_Supplier_ECU_Hardware_Version_Number (DcmDspDataInfo): DcmDspDataFixedLength=true
        DidInfo_DidInfo_22201A_Application_Software_Programming_Attempt_Counter (DcmDspDidInfo)
          DcmDspDidAccess
            DcmDspDidRead
        DID_22292E_PROXI_Write_Counter (DcmDspDid):
          DcmDspDidIdentifier = 10542
          DcmDspDidUsed = true
          DcmDspDidUsePort = USE_DATA_ELEMENT_SPECIFIC_INTERFACES
          DcmDspDidInfoRef = DidInfo_DidInfo_22292E_PROXI_Write_Counter
          DcmDspDidSignal: DcmDspDidDataPos=0, DcmDspDidDataRef=Data_22292E_PROXI_Write_Counter
        DID_221002_Vehicle_Speed (DcmDspDid):
          DcmDspDidIdentifier = 4098
          DcmDspDidUsed = true
          DcmDspDidUsePort = USE_DATA_ELEMENT_SPECIFIC_INTERFACES
          DcmDspDidInfoRef = DidInfo_DidInfo_221002_Vehicle_Speed
          DcmDspDidSignal: DcmDspDidDataPos=0, DcmDspDidDataRef=Data_221002_Vehicle_Speed
        DataInfo_DataInfo_22FD15_Magna_Production_HW_Number_Read (DcmDspDataInfo): DcmDspDataFixedLength=true
        DidInfo_DidInfo_225103_FD_CAN2_Rx_Signals_Read (DcmDspDidInfo)
          DcmDspDidAccess
            DcmDspDidRead: DcmDspDidReadSessionRef=Extended_Diagnostic_Session, DcmDspDidReadSecurityLevelRef=Authenticated_Diagnostic_Access
        DID_225500_Trailer_Sense_and_Drive_Function_Data_Read (DcmDspDid):
          DcmDspDidIdentifier = 21760
          DcmDspDidUsed = true
          DcmDspDidUsePort = USE_DATA_ELEMENT_SPECIFIC_INTERFACES
          DcmDspDidInfoRef = DidInfo_DidInfo_225500_Trailer_Sense_and_Drive_Function_Data_Read
          DcmDspDidSignal: DcmDspDidDataPos=0, DcmDspDidDataRef=Data_225500_Trailer_Sense_and_Drive_Function_Data_Read
        Data_22FD33_Magna_Testing_2_Read (DcmDspData):
          DcmDspDataSize = 80
          DcmDspDataType = UINT8_N
          DcmDspDataUsePort = USE_DATA_ASYNCH_CLIENT_SERVER
          DcmDspDataConditionCheckReadFncUsed = false
          DcmDspDataInfoRef = DataInfo_DataInfo_22FD33_Magna_Testing_2_Read
        Data_225500_Trailer_Sense_and_Drive_Function_Data_Read (DcmDspData):
          DcmDspDataSize = 336
          DcmDspDataType = UINT8_N
          DcmDspDataUsePort = USE_DATA_ASYNCH_CLIENT_SERVER
          DcmDspDataConditionCheckReadFncUsed = false
          DcmDspDataInfoRef = DataInfo_DataInfo_225500_Trailer_Sense_and_Drive_Function_Data_Read
        DID_22F190_VIN_Original (DcmDspDid):
          DcmDspDidIdentifier = 61840
          DcmDspDidUsed = true
          DcmDspDidUsePort = USE_DATA_ELEMENT_SPECIFIC_INTERFACES
          DcmDspDidInfoRef = DidInfo_DidInfo_22F190_VIN_Original
          DcmDspDidSignal: DcmDspDidDataPos=0, DcmDspDidDataRef=Data_22F190_VIN_Original
        Data_22FD49_SoC_Die_Temperature_ID_0xFD49_Read (DcmDspData):
          DcmDspDataSize = 128
          DcmDspDataType = UINT8_N
          DcmDspDataUsePort = USE_DATA_ASYNCH_CLIENT_SERVER
          DcmDspDataConditionCheckReadFncUsed = false
          DcmDspDataInfoRef = DataInfo_DataInfo_22FD49_SoC_Die_Temperature_ID_0xFD49_Read
        DataInfo_DataInfo_22FD2C_USS_Temperature_Read (DcmDspDataInfo): DcmDspDataFixedLength=true
        Data_22F1B3_Boot_Software_Fingerprint_Reading_Information (DcmDspData):
          DcmDspDataSize = 120
          DcmDspDataType = UINT8_N
          DcmDspDataUsePort = USE_DATA_ASYNCH_CLIENT_SERVER
          DcmDspDataConditionCheckReadFncUsed = false
          DcmDspDataInfoRef = DataInfo_DataInfo_22F1B3_Boot_Software_Fingerprint_Reading_Information
        DID_22FD42_Failsafe_Behaviour_Read (DcmDspDid):
          DcmDspDidIdentifier = 64834
          DcmDspDidUsed = true
          DcmDspDidUsePort = USE_DATA_ELEMENT_SPECIFIC_INTERFACES
          DcmDspDidInfoRef = DidInfo_DidInfo_22FD42_Failsafe_Behaviour_Read
          DcmDspDidSignal: DcmDspDidDataPos=0, DcmDspDidDataRef=Data_22FD42_Failsafe_Behaviour_Read
        3 x DcmDspData, all with DcmDspDataType=UINT8_N, DcmDspDataUsePort=USE_DATA_ASYNCH_CLIENT_SERVER, DcmDspDataConditionCheckReadFncUsed=false:
          Data_224429_USS_Sensor_9_Part_Number_Read: DcmDspDataSize=104, DcmDspDataInfoRef=DataInfo_DataInfo_224429_USS_Sensor_9_Part_Number_Read
          Data_22442C_USS_Sensor_12_Part_Number_Read: DcmDspDataSize=104, DcmDspDataInfoRef=DataInfo_DataInfo_22442C_USS_Sensor_12_Part_Number_Read
          Data_222939_FDCAN2_BUS_Network_WakeUp_Reason: DcmDspDataSize=192, DcmDspDataInfoRef=DataInfo_DataInfo_222939_FDCAN2_BUS_Network_WakeUp_Reason
        DataInfo_DataInfo_221002_Vehicle_Speed (DcmDspDataInfo): DcmDspDataFixedLength=true
        DataInfo_DataInfo_224425_USS_Sensor_5_Part_Number_Read (DcmDspDataInfo): DcmDspDataFixedLength=true
        DID_225302_Rear_Braking_Event_3_Read (DcmDspDid):
          DcmDspDidIdentifier = 21250
          DcmDspDidUsed = true
          DcmDspDidUsePort = USE_DATA_ELEMENT_SPECIFIC_INTERFACES
          DcmDspDidInfoRef = DidInfo_DidInfo_225302_Rear_Braking_Event_3_Read
          DcmDspDidSignal: DcmDspDidDataPos=0, DcmDspDidDataRef=Data_225302_Rear_Braking_Event_3_Read
        DidInfo_DidInfo_22FD49_SoC_Die_Temperature_ID_0xFD49_Read (DcmDspDidInfo)
          DcmDspDidAccess
            DcmDspDidRead: DcmDspDidReadSessionRef=Default_Session, DcmDspDidReadSessionRef=Extended_Diagnostic_Session
        3 x DcmDspData, all with DcmDspDataType=UINT8_N, DcmDspDataUsePort=USE_DATA_ASYNCH_CLIENT_SERVER, DcmDspDataConditionCheckReadFncUsed=false:
          Data_22F188_FCA_ESLM_ECU_Software_Number: DcmDspDataSize=88, DcmDspDataInfoRef=DataInfo_DataInfo_22F188_FCA_ESLM_ECU_Software_Number
          Data_22FD07_OC_Result_Read: DcmDspDataSize=64, DcmDspDataInfoRef=DataInfo_DataInfo_22FD07_OC_Result_Read
          Data_22F182_Application_Data_Identification: DcmDspDataSize=320, DcmDspDataInfoRef=DataInfo_DataInfo_22F182_Application_Data_Identification
        DidInfo_DidInfo_22FD2C_USS_Temperature_Read (DcmDspDidInfo)
          DcmDspDidAccess
            DcmDspDidRead: DcmDspDidReadSessionRef=Default_Session, DcmDspDidReadSessionRef=Extended_Diagnostic_Session
        DataInfo_DataInfo_225105_FD_CAN2_Tx_Signals_Read (DcmDspDataInfo): DcmDspDataFixedLength=true
        3 x DcmDspData, all with DcmDspDataType=UINT8_N, DcmDspDataUsePort=USE_DATA_ASYNCH_CLIENT_SERVER, DcmDspDataConditionCheckReadFncUsed=false:
          Data_22FDF0_ECU_shutdown_process_Read: DcmDspDataSize=8, DcmDspDataInfoRef=DataInfo_DataInfo_22FDF0_ECU_shutdown_process_Read
          Data_220103_VIN_Lock_Status: DcmDspDataSize=16, DcmDspDataInfoRef=DataInfo_DataInfo_220103_VIN_Lock_Status
          Data_2EF185_Application_Data_Software_Fingerprint_Writing_Information: DcmDspDataSize=112, DcmDspDataInfoRef=DataInfo_DataInfo_2EF185_Application_Data_Software_Fingerprint_Writing_Information
        DataInfo_DataInfo_224424_USS_Sensor_4_Part_Number_Read (DcmDspDataInfo): DcmDspDataFixedLength=true
        3 x DcmDspDidInfo:
          DidInfo_DidInfo_22F18A_FCA_ESLM_ECU_Software_Calibration_Number
            DcmDspDidAccess
              DcmDspDidRead
          DidInfo_DidInfo_22F188_FCA_ESLM_ECU_Software_Number
            DcmDspDidAccess
              DcmDspDidRead
          DidInfo_DidInfo_2EF185_Application_Data_Software_Fingerprint_Writing_Information
            DcmDspDidAccess
              DcmDspDidWrite: DcmDspDidWriteSessionRef=Programming_Session, DcmDspDidWriteSecurityLevelRef=Authenticated_Diagnostic_Access
        DataInfo_DataInfo_22FD20_ECU_PinStates_Read (DcmDspDataInfo): DcmDspDataFixedLength=true
        DataInfo_DataInfo_2EF184_Application_Software_Fingerprint_writing_information (DcmDspDataInfo): DcmDspDataFixedLength=true
        Data_224428_USS_Sensor_8_Part_Number_Read (DcmDspData):
          DcmDspDataSize = 104
          DcmDspDataType = UINT8_N
          DcmDspDataUsePort = USE_DATA_ASYNCH_CLIENT_SERVER
          DcmDspDataConditionCheckReadFncUsed = false
          DcmDspDataInfoRef = DataInfo_DataInfo_224428_USS_Sensor_8_Part_Number_Read
        RoutineInfo_RoutineInfo_3101FF00_FlashErase_Start (DcmDspRoutineInfo)
          DcmDspRoutineAuthorization: DcmDspRoutineSessionRef=Programming_Session, DcmDspRoutineSecurityLevelRef=Authenticated_Diagnostic_Access
          DcmDspStartRoutineOut
            Out_ResData (DcmDspStartRoutineOutSignal): DcmDspRoutineSignalLength=72, DcmDspRoutineSignalType=UINT8_N, DcmDspRoutineSignalEndianness=opaque, DcmDspRoutineSignalPos=0
        DataInfo_DataInfo_22201A_Application_Software_Programming_Attempt_Counter (DcmDspDataInfo): DcmDspDataFixedLength=true
        DidInfo_DidInfo_22FDF2_Reset_Reason_Read (DcmDspDidInfo)
          DcmDspDidAccess
            DcmDspDidRead: DcmDspDidReadSessionRef=Default_Session, DcmDspDidReadSessionRef=Extended_Diagnostic_Session
        Data_22F193_Supplier_ECU_Hardware_Version_Number (DcmDspData):
          DcmDspDataSize = 8
          DcmDspDataType = UINT8_N
          DcmDspDataUsePort = USE_DATA_ASYNCH_CLIENT_SERVER
          DcmDspDataConditionCheckReadFncUsed = false
          DcmDspDataInfoRef = DataInfo_DataInfo_22F193_Supplier_ECU_Hardware_Version_Number
        DID_225300_Rear_Braking_Event_1_Read (DcmDspDid):
          DcmDspDidIdentifier = 21248
          DcmDspDidUsed = true
          DcmDspDidUsePort = USE_DATA_ELEMENT_SPECIFIC_INTERFACES
          DcmDspDidInfoRef = DidInfo_DidInfo_225300_Rear_Braking_Event_1_Read
          DcmDspDidSignal: DcmDspDidDataPos=0, DcmDspDidDataRef=Data_225300_Rear_Braking_Event_1_Read
        4 x DcmDspDidInfo:
          DidInfo_DidInfo_22F1B3_Boot_Software_Fingerprint_Reading_Information
            DcmDspDidAccess
              DcmDspDidRead
          DidInfo_DidInfo_22F195_Supplier_ECU_Software_Version_Number
            DcmDspDidAccess
              DcmDspDidRead
          DidInfo_DidInfo_22201B_Application_Data_Software_Programming_Attempt_Counter
            DcmDspDidAccess
              DcmDspDidRead
          DidInfo_DidInfo_225104_FD_CAN14_Tx_Signals_Read
            DcmDspDidAccess
              DcmDspDidRead: DcmDspDidReadSessionRef=Extended_Diagnostic_Session, DcmDspDidReadSecurityLevelRef=Authenticated_Diagnostic_Access
        DID_22FD2C_USS_Temperature_Read (DcmDspDid):
          DcmDspDidIdentifier = 64812
          DcmDspDidUsed = true
          DcmDspDidUsePort = USE_DATA_ELEMENT_SPECIFIC_INTERFACES
          DcmDspDidInfoRef = DidInfo_DidInfo_22FD2C_USS_Temperature_Read
          DcmDspDidSignal: DcmDspDidDataPos=0, DcmDspDidDataRef=Data_22FD2C_USS_Temperature_Read
        DidInfo_DidInfo_22FD0A_SC_Data_Read (DcmDspDidInfo)
          DcmDspDidAccess
            DcmDspDidWrite: DcmDspDidWriteSessionRef=Extended_Diagnostic_Session
            DcmDspDidRead: DcmDspDidReadSessionRef=Default_Session, DcmDspDidReadSessionRef=Extended_Diagnostic_Session
        Data_22F1B0_VIN_Current (DcmDspData):
          DcmDspDataSize = 136
          DcmDspDataType = UINT8_N
          DcmDspDataUsePort = USE_DATA_ASYNCH_CLIENT_SERVER
          DcmDspDataConditionCheckReadFncUsed = false
          DcmDspDataInfoRef = DataInfo_DataInfo_22F1B0_VIN_Current
        DID_222003_Boot_Software_Programming_Attempt_Counter (DcmDspDid):
          DcmDspDidIdentifier = 8195
          DcmDspDidUsed = true
          DcmDspDidUsePort = USE_DATA_ELEMENT_SPECIFIC_INTERFACES
          DcmDspDidInfoRef = DidInfo_DidInfo_222003_Boot_Software_Programming_Attempt_Counter
          DcmDspDidSignal: DcmDspDidDataPos=0, DcmDspDidDataRef=Data_222003_Boot_Software_Programming_Attempt_Counter
        Data_22201A_Application_Software_Programming_Attempt_Counter (DcmDspData):
          DcmDspDataSize = 160
          DcmDspDataType = UINT8_N
          DcmDspDataUsePort = USE_DATA_ASYNCH_CLIENT_SERVER
          DcmDspDataConditionCheckReadFncUsed = false
          DcmDspDataInfoRef = DataInfo_DataInfo_22201A_Application_Software_Programming_Attempt_Counter
        Data_22F112_PTESLM_Hardware_Number (DcmDspData):
          DcmDspDataSize = 80
          DcmDspDataType = UINT8_N
          DcmDspDataUsePort = USE_DATA_ASYNCH_CLIENT_SERVER
          DcmDspDataConditionCheckReadFncUsed = false
          DcmDspDataInfoRef = DataInfo_DataInfo_22F112_PTESLM_Hardware_Number
        DID_225501_Trailer_coupler_sense_detection_Function_Data_Read (DcmDspDid):
          DcmDspDidIdentifier = 21761
          DcmDspDidUsed = true
          DcmDspDidUsePort = USE_DATA_ELEMENT_SPECIFIC_INTERFACES
          DcmDspDidInfoRef = DidInfo_DidInfo_225501_Trailer_coupler_sense_detection_Function_Data_Read
          DcmDspDidSignal: DcmDspDidDataPos=0, DcmDspDidDataRef=Data_225501_Trailer_coupler_sense_detection_Function_Data_Read
        DidInfo_DidInfo_2E2023_PROXI_Data (DcmDspDidInfo)
          DcmDspDidAccess
            DcmDspDidWrite: DcmDspDidWriteSessionRef=Default_Session, DcmDspDidWriteSessionRef=Extended_Diagnostic_Session
        DID_22F132_EBOM_ECU_Part_Number (DcmDspDid):
          DcmDspDidIdentifier = 61746
          DcmDspDidUsed = true
          DcmDspDidUsePort = USE_DATA_ELEMENT_SPECIFIC_INTERFACES
          DcmDspDidInfoRef = DidInfo_DidInfo_22F132_EBOM_ECU_Part_Number
          DcmDspDidSignal: DcmDspDidDataPos=0, DcmDspDidDataRef=Data_22F132_EBOM_ECU_Part_Number
        DataInfo_DataInfo_22FD07_OC_Result_Read (DcmDspDataInfo): DcmDspDataFixedLength=true
        DID_22F1B3_Boot_Software_Fingerprint_Reading_Information (DcmDspDid):
          DcmDspDidIdentifier = 61875
          DcmDspDidUsed = true
          DcmDspDidUsePort = USE_DATA_ELEMENT_SPECIFIC_INTERFACES
          DcmDspDidInfoRef = DidInfo_DidInfo_22F1B3_Boot_Software_Fingerprint_Reading_Information
          DcmDspDidSignal: DcmDspDidDataPos=0, DcmDspDidDataRef=Data_22F1B3_Boot_Software_Fingerprint_Reading_Information
        Routine_3101F000_Check_Program_Start (DcmDspRoutine):
          DcmDspRequestResultsRoutineSupported = false
          DcmDspStopRoutineSupported = false
          DcmDspRoutineIdentifier = 61440
          DcmDspRoutineFixedLength = false
          DcmDspRoutineUsePort = true
          DcmDspRoutineUsed = true
          DcmDspRoutineInfoRef = RoutineInfo_RoutineInfo_3101F000_Check_Program_Start
        DID_2F5001_Gear_Position_Read (DcmDspDid):
          DcmDspDidIdentifier = 20481
          DcmDspDidUsed = true
          DcmDspDidUsePort = USE_DATA_ELEMENT_SPECIFIC_INTERFACES
          DcmDspDidInfoRef = DidInfo_DidInfo_2F5001_Gear_Position_Read
          DcmDspDidSignal: DcmDspDidDataPos=0, DcmDspDidDataRef=Data_2F5001_Gear_Position_Read
        DataInfo_DataInfo_22200B_Time_First_DTC_Detection (DcmDspDataInfo): DcmDspDataFixedLength=true
        DidInfo_DidInfo_22FD0F_Right_Camera_Data_EEPROM_Read (DcmDspDidInfo)
          DcmDspDidAccess
            DcmDspDidRead: DcmDspDidReadSessionRef=Default_Session, DcmDspDidReadSessionRef=Extended_Diagnostic_Session
        DID_22F1B4_Application_Software_Fingerprint_Reading_Information (DcmDspDid):
          DcmDspDidIdentifier = 61876
          DcmDspDidUsed = true
          DcmDspDidUsePort = USE_DATA_ELEMENT_SPECIFIC_INTERFACES
          DcmDspDidInfoRef = DidInfo_DidInfo_22F1B4_Application_Software_Fingerprint_Reading_Information
          DcmDspDidSignal: DcmDspDidDataPos=0, DcmDspDidDataRef=Data_22F1B4_Application_Software_Fingerprint_Reading_Information
        Data_224423_USS_Sensor_3_Part_Number_Read (DcmDspData):
          DcmDspDataSize = 104
          DcmDspDataType = UINT8_N
          DcmDspDataUsePort = USE_DATA_ASYNCH_CLIENT_SERVER
          DcmDspDataConditionCheckReadFncUsed = false
          DcmDspDataInfoRef = DataInfo_DataInfo_224423_USS_Sensor_3_Part_Number_Read
        DID_22FD28_USS_Ringing_Frequency_Read (DcmDspDid):
          DcmDspDidIdentifier = 64808
          DcmDspDidUsed = true
          DcmDspDidUsePort = USE_DATA_ELEMENT_SPECIFIC_INTERFACES
          DcmDspDidInfoRef = DidInfo_DidInfo_22FD28_USS_Ringing_Frequency_Read
          DcmDspDidSignal: DcmDspDidDataPos=0, DcmDspDidDataRef=Data_22FD28_USS_Ringing_Frequency_Read
        DataInfo_DataInfo_22F190_VIN_Original (DcmDspDataInfo): DcmDspDataFixedLength=true
        Data_22F190_VIN_Original (DcmDspData):
          DcmDspDataSize = 136
          DcmDspDataType = UINT8_N
          DcmDspDataUsePort = USE_DATA_ASYNCH_CLIENT_SERVER
          DcmDspDataConditionCheckReadFncUsed = false
          DcmDspDataInfoRef = DataInfo_DataInfo_22F190_VIN_Original
        Routine_3101D003_Application_Logical_Block_Hash (DcmDspRoutine):
          DcmDspRequestResultsRoutineSupported = false
          DcmDspStopRoutineSupported = false
          DcmDspRoutineIdentifier = 53251
          DcmDspRoutineFixedLength = false
          DcmDspRoutineUsePort = true
          DcmDspRoutineUsed = true
          DcmDspRoutineInfoRef = RoutineInfo_RoutineInfo_3101D003_Application_Logical_Block_Hash
        DidInfo_DidInfo_224425_USS_Sensor_5_Part_Number_Read (DcmDspDidInfo)
          DcmDspDidAccess
            DcmDspDidRead: DcmDspDidReadSessionRef=Default_Session, DcmDspDidReadSessionRef=Extended_Diagnostic_Session
        Data_222010_Programming_Status (DcmDspData):
          DcmDspDataSize = 16
          DcmDspDataType = UINT8_N
          DcmDspDataUsePort = USE_DATA_ASYNCH_CLIENT_SERVER
          DcmDspDataConditionCheckReadFncUsed = false
          DcmDspDataInfoRef = DataInfo_DataInfo_222010_Programming_Status
        DidInfo_DidInfo_22FD46_Camera_Power_Supply_Read (DcmDspDidInfo)
          DcmDspDidAccess
            DcmDspDidRead: DcmDspDidReadSessionRef=Default_Session, DcmDspDidReadSessionRef=Extended_Diagnostic_Session
        DidInfo_DidInfo_22F186_Active_Diagnostic_Session (DcmDspDidInfo)
          DcmDspDidAccess
            DcmDspDidRead
        DID_22200D_Odometer_Last_Clear_Data_Trouble_Code_DTC (DcmDspDid):
          DcmDspDidIdentifier = 8205
          DcmDspDidUsed = true
          DcmDspDidUsePort = USE_DATA_ELEMENT_SPECIFIC_INTERFACES
          DcmDspDidInfoRef = DidInfo_DidInfo_22200D_Odometer_Last_Clear_Data_Trouble_Code_DTC
          DcmDspDidSignal: DcmDspDidDataPos=0, DcmDspDidDataRef=Data_22200D_Odometer_Last_Clear_Data_Trouble_Code_DTC
        Data_22FD2E_USS_Sensor_ID_Murata_SN_Read (DcmDspData):
          DcmDspDataSize = 384
          DcmDspDataType = UINT8_N
          DcmDspDataUsePort = USE_DATA_ASYNCH_CLIENT_SERVER
          DcmDspDataConditionCheckReadFncUsed = false
          DcmDspDataInfoRef = DataInfo_DataInfo_22FD2E_USS_Sensor_ID_Murata_SN_Read
        DataInfo_DataInfo_22F195_Supplier_ECU_Software_Version_Number (DcmDspDataInfo): DcmDspDataFixedLength=true
        Routine_31012001_Original_VIN_Unlock (DcmDspRoutine):
          DcmDspRequestResultsRoutineSupported = false
          DcmDspStopRoutineSupported = false
          DcmDspRoutineIdentifier = 8193
          DcmDspRoutineFixedLength = false
          DcmDspRoutineUsePort = true
          DcmDspRoutineUsed = true
          DcmDspRoutineInfoRef = RoutineInfo_RoutineInfo_31012001_Original_VIN_Unlock
        DataInfo_DataInfo_22F155_Software_Supplier_Identification (DcmDspDataInfo): DcmDspDataFixedLength=true
        DidInfo_DidInfo_22F181_Application_Software_Identification (DcmDspDidInfo)
          DcmDspDidAccess
            DcmDspDidRead: DcmDspDidReadSessionRef=Default_Session, DcmDspDidReadSessionRef=Extended_Diagnostic_Session
        DID_22FD2D_USS_Sensor_ID_IME_SN_Read (DcmDspDid):
          DcmDspDidIdentifier = 64813
          DcmDspDidUsed = true
          DcmDspDidUsePort = USE_DATA_ELEMENT_SPECIFIC_INTERFACES
          DcmDspDidInfoRef = DidInfo_DidInfo_22FD2D_USS_Sensor_ID_IME_SN_Read
          DcmDspDidSignal: DcmDspDidDataPos=0, DcmDspDidDataRef=Data_22FD2D_USS_Sensor_ID_IME_SN_Read
        Data_22FD31_Magna_EOL_Coding_State_Read (DcmDspData):
          DcmDspDataSize = 32
          DcmDspDataType = UINT8_N
          DcmDspDataUsePort = USE_DATA_ASYNCH_CLIENT_SERVER
          DcmDspDataConditionCheckReadFncUsed = false
          DcmDspDataInfoRef = DataInfo_DataInfo_22FD31_Magna_EOL_Coding_State_Read
        Data_22F122_Software_EBOM_Part_Number (DcmDspData):
          DcmDspDataSize = 720
          DcmDspDataType = UINT8_N
          DcmDspDataUsePort = USE_DATA_ASYNCH_CLIENT_SERVER
          DcmDspDataConditionCheckReadFncUsed = false
          DcmDspDataInfoRef = DataInfo_DataInfo_22F122_Software_EBOM_Part_Number
        DidInfo_DidInfo_221002_Vehicle_Speed (DcmDspDidInfo)
          DcmDspDidAccess
            DcmDspDidRead: DcmDspDidReadSessionRef=Default_Session, DcmDspDidReadSessionRef=Extended_Diagnostic_Session
        DataInfo_DataInfo_224451_EOL_Calibration_State_Read (DcmDspDataInfo): DcmDspDataFixedLength=true
        Data_22200C_Time_Since_Ignition_ON_of_first_DTC_Detection (DcmDspData):
          DcmDspDataSize = 16
          DcmDspDataType = UINT8_N
          DcmDspDataUsePort = USE_DATA_ASYNCH_CLIENT_SERVER
          DcmDspDataConditionCheckReadFncUsed = false
          DcmDspDataInfoRef = DataInfo_DataInfo_22200C_Time_Since_Ignition_ON_of_first_DTC_Detection
        DID_22F134_CODEP_assembly_part_number (DcmDspDid):
          DcmDspDidIdentifier = 61748
          DcmDspDidUsed = true
          DcmDspDidUsePort = USE_DATA_ELEMENT_SPECIFIC_INTERFACES
          DcmDspDidInfoRef = DidInfo_DidInfo_22F134_CODEP_assembly_part_number
          DcmDspDidSignal: DcmDspDidDataPos=0, DcmDspDidDataRef=Data_22F134_CODEP_assembly_part_number
        3 x DcmDspDataInfo, all with DcmDspDataFixedLength=true:
          DataInfo_DataInfo_225201_Plant_Mode_Status_Read
          DataInfo_DataInfo_22F182_Application_Data_Identification
          DataInfo_DataInfo_22FD16_Magna_Production_ICT_Data_Read
        DidInfo_DidInfo_22442A_USS_Sensor_10_Part_Number_Read (DcmDspDidInfo)
          DcmDspDidAccess
            DcmDspDidRead: DcmDspDidReadSessionRef=Default_Session, DcmDspDidReadSessionRef=Extended_Diagnostic_Session
        Data_22F192_Supplier_ECU_Hardware_Part_Number (DcmDspData):
          DcmDspDataSize = 88
          DcmDspDataType = UINT8_N
          DcmDspDataUsePort = USE_DATA_ASYNCH_CLIENT_SERVER
          DcmDspDataConditionCheckReadFncUsed = false
          DcmDspDataInfoRef = DataInfo_DataInfo_22F192_Supplier_ECU_Hardware_Part_Number
        DataInfo_DataInfo_224427_USS_Sensor_7_Part_Number_Read (DcmDspDataInfo): DcmDspDataFixedLength=true
        DID_225301_Rear_Braking_Event_2_Read (DcmDspDid):
          DcmDspDidIdentifier = 21249
          DcmDspDidUsed = true
          DcmDspDidUsePort = USE_DATA_ELEMENT_SPECIFIC_INTERFACES
          DcmDspDidInfoRef = DidInfo_DidInfo_225301_Rear_Braking_Event_2_Read
          DcmDspDidSignal: DcmDspDidDataPos=0, DcmDspDidDataRef=Data_225301_Rear_Braking_Event_2_Read
        DID_22201A_Application_Software_Programming_Attempt_Counter (DcmDspDid):
          DcmDspDidIdentifier = 8218
          DcmDspDidUsed = true
          DcmDspDidUsePort = USE_DATA_ELEMENT_SPECIFIC_INTERFACES
          DcmDspDidInfoRef = DidInfo_DidInfo_22201A_Application_Software_Programming_Attempt_Counter
          DcmDspDidSignal: DcmDspDidDataPos=0, DcmDspDidDataRef=Data_22201A_Application_Software_Programming_Attempt_Counter
        DidInfo_DidInfo_224427_USS_Sensor_7_Part_Number_Read (DcmDspDidInfo)
          DcmDspDidAccess
            DcmDspDidRead: DcmDspDidReadSessionRef=Default_Session, DcmDspDidReadSessionRef=Extended_Diagnostic_Session
        DID_225102_FD_CAN14_Rx_Signals_Read (DcmDspDid):
          DcmDspDidIdentifier = 20738
          DcmDspDidUsed = true
          DcmDspDidUsePort = USE_DATA_ELEMENT_SPECIFIC_INTERFACES
          DcmDspDidInfoRef = DidInfo_DidInfo_225102_FD_CAN14_Rx_Signals_Read
          DcmDspDidSignal: DcmDspDidDataPos=0, DcmDspDidDataRef=Data_225102_FD_CAN14_Rx_Signals_Read
        Data_224425_USS_Sensor_5_Part_Number_Read (DcmDspData):
          DcmDspDataSize = 104
          DcmDspDataType = UINT8_N
          DcmDspDataUsePort = USE_DATA_ASYNCH_CLIENT_SERVER
          DcmDspDataConditionCheckReadFncUsed = false
          DcmDspDataInfoRef = DataInfo_DataInfo_224425_USS_Sensor_5_Part_Number_Read
        DataInfo_DataInfo_221008_ECU_Life_Time (DcmDspDataInfo): DcmDspDataFixedLength=true
        RoutineInfo_RoutineInfo_3101F000_Check_Program_Start (DcmDspRoutineInfo)
          DcmDspRoutineAuthorization: DcmDspRoutineSessionRef=Programming_Session, DcmDspRoutineSecurityLevelRef=Authenticated_Diagnostic_Access
          DcmDspStartRoutineOut
            Out_ResData (DcmDspStartRoutineOutSignal): DcmDspRoutineSignalLength=8, DcmDspRoutineSignalType=UINT8_N, DcmDspRoutineSignalEndianness=opaque, DcmDspRoutineSignalPos=0
        3 x DcmDspDidInfo:
          DidInfo_DidInfo_22F1A1_Configuration_Code
            DcmDspDidAccess
              DcmDspDidRead: DcmDspDidReadSessionRef=Default_Session, DcmDspDidReadSessionRef=Extended_Diagnostic_Session
          DidInfo_DidInfo_222010_Programming_Status
            DcmDspDidAccess
              DcmDspDidRead
          DidInfo_DidInfo_22FD42_Failsafe_Behaviour_Read
            DcmDspDidAccess
              DcmDspDidWrite: DcmDspDidWriteSessionRef=Extended_Diagnostic_Session
              DcmDspDidRead: DcmDspDidReadSessionRef=Default_Session, DcmDspDidReadSessionRef=Extended_Diagnostic_Session
        RoutineInfo_RoutineInfo_31015000_Park_Assist_ON_OFF_State_Start (DcmDspRoutineInfo)
          DcmDspStartRoutineIn
            In_ReqData (DcmDspStartRoutineInSignal): DcmDspRoutineSignalLength=8, DcmDspRoutineSignalType=UINT8_N, DcmDspRoutineSignalEndianness=opaque, DcmDspRoutineSignalPos=0
          DcmDspRoutineAuthorization:
            DcmDspRoutineSessionRef = Extended_Diagnostic_Session
            DcmDspRoutineSecurityLevelRef = Authenticated_Diagnostic_Access
            DcmDspRoutineModeRuleRef = VehicleSpeedCheckRule
        Data_22FD2B_USS_Direct_Distance_0xFD2B_Read (DcmDspData):
          DcmDspDataSize = 192
          DcmDspDataType = UINT8_N
          DcmDspDataUsePort = USE_DATA_ASYNCH_CLIENT_SERVER
          DcmDspDataConditionCheckReadFncUsed = false
          DcmDspDataInfoRef = DataInfo_DataInfo_22FD2B_USS_Direct_Distance_0xFD2B_Read
        DID_22F1B0_VIN_Current (DcmDspDid):
          DcmDspDidIdentifier = 61872
          DcmDspDidUsed = true
          DcmDspDidUsePort = USE_DATA_ELEMENT_SPECIFIC_INTERFACES
          DcmDspDidInfoRef = DidInfo_DidInfo_22F1B0_VIN_Current
          DcmDspDidSignal: DcmDspDidDataPos=0, DcmDspDidDataRef=Data_22F1B0_VIN_Current
        DID_22FD15_Magna_Production_HW_Number_Read (DcmDspDid):
          DcmDspDidIdentifier = 64789
          DcmDspDidUsed = true
          DcmDspDidUsePort = USE_DATA_ELEMENT_SPECIFIC_INTERFACES
          DcmDspDidInfoRef = DidInfo_DidInfo_22FD15_Magna_Production_HW_Number_Read
          DcmDspDidSignal: DcmDspDidDataPos=0, DcmDspDidDataRef=Data_22FD15_Magna_Production_HW_Number_Read
        DataInfo_DataInfo_22F1B0_VIN_Current (DcmDspDataInfo): DcmDspDataFixedLength=true
        DID_22201B_Application_Data_Software_Programming_Attempt_Counter (DcmDspDid):
          DcmDspDidIdentifier = 8219
          DcmDspDidUsed = true
          DcmDspDidUsePort = USE_DATA_ELEMENT_SPECIFIC_INTERFACES
          DcmDspDidInfoRef = DidInfo_DidInfo_22201B_Application_Data_Software_Programming_Attempt_Counter
          DcmDspDidSignal: DcmDspDidDataPos=0, DcmDspDidDataRef=Data_22201B_Application_Data_Software_Programming_Attempt_Counter
        DID_22200C_Time_Since_Ignition_ON_of_first_DTC_Detection (DcmDspDid):
          DcmDspDidIdentifier = 8204
          DcmDspDidUsed = true
          DcmDspDidUsePort = USE_DATA_ELEMENT_SPECIFIC_INTERFACES
          DcmDspDidInfoRef = DidInfo_DidInfo_22200C_Time_Since_Ignition_ON_of_first_DTC_Detection
          DcmDspDidSignal: DcmDspDidDataPos=0, DcmDspDidDataRef=Data_22200C_Time_Since_Ignition_ON_of_first_DTC_Detection
        DidInfo_DidInfo_224421_USS_Sensor_1_Part_Number_Read (DcmDspDidInfo)
          DcmDspDidAccess
            DcmDspDidRead: DcmDspDidReadSessionRef=Default_Session, DcmDspDidReadSessionRef=Extended_Diagnostic_Session
        DataInfo_DataInfo_22FD28_USS_Ringing_Frequency_Read (DcmDspDataInfo): DcmDspDataFixedLength=true
        DID_22FD31_Magna_EOL_Coding_State_Read (DcmDspDid):
          DcmDspDidIdentifier = 64817
          DcmDspDidUsed = true
          DcmDspDidUsePort = USE_DATA_ELEMENT_SPECIFIC_INTERFACES
          DcmDspDidInfoRef = DidInfo_DidInfo_22FD31_Magna_EOL_Coding_State_Read
          DcmDspDidSignal: DcmDspDidDataPos=0, DcmDspDidDataRef=Data_22FD31_Magna_EOL_Coding_State_Read
        3 x DcmDspDataInfo, all with DcmDspDataFixedLength=true:
          DataInfo_DataInfo_22FD1C_Current_Camera_Calibration_Data_Read
          DataInfo_DataInfo_224428_USS_Sensor_8_Part_Number_Read
          DataInfo_DataInfo_225103_FD_CAN2_Rx_Signals_Read
        RoutineInfo_RoutineInfo_31012000_Original_VIN_Lock (DcmDspRoutineInfo)
          DcmDspRoutineAuthorization: DcmDspRoutineSessionRef=Extended_Diagnostic_Session, DcmDspRoutineSecurityLevelRef=Authenticated_Diagnostic_Access
        Data_22F155_Software_Supplier_Identification (DcmDspData):
          DcmDspDataSize = 16
          DcmDspDataType = UINT8_N
          DcmDspDataUsePort = USE_DATA_ASYNCH_CLIENT_SERVER
          DcmDspDataConditionCheckReadFncUsed = false
          DcmDspDataInfoRef = DataInfo_DataInfo_22F155_Software_Supplier_Identification
        DataInfo_DataInfo_22F188_FCA_ESLM_ECU_Software_Number (DcmDspDataInfo): DcmDspDataFixedLength=true
        3 x DcmDspData, all with DcmDspDataType=UINT8_N, DcmDspDataUsePort=USE_DATA_ASYNCH_CLIENT_SERVER, DcmDspDataConditionCheckReadFncUsed=false:
          Data_22F154_Hardware_Supplier_Identification: DcmDspDataSize=16, DcmDspDataInfoRef=DataInfo_DataInfo_22F154_Hardware_Supplier_Identification
          Data_225100_SPM_status_Read: DcmDspDataSize=32, DcmDspDataInfoRef=DataInfo_DataInfo_225100_SPM_status_Read
          Data_22442B_USS_Sensor_11_Part_Number_Read: DcmDspDataSize=104, DcmDspDataInfoRef=DataInfo_DataInfo_22442B_USS_Sensor_11_Part_Number_Read
        DidInfo_DidInfo_222001_Odometer (DcmDspDidInfo)
          DcmDspDidAccess
            DcmDspDidRead: DcmDspDidReadSessionRef=Default_Session, DcmDspDidReadSessionRef=Extended_Diagnostic_Session
        DID_224451_EOL_Calibration_State_Read (DcmDspDid):
          DcmDspDidIdentifier = 17489
          DcmDspDidUsed = true
          DcmDspDidUsePort = USE_DATA_ELEMENT_SPECIFIC_INTERFACES
          DcmDspDidInfoRef = DidInfo_DidInfo_224451_EOL_Calibration_State_Read
          DcmDspDidSignal: DcmDspDidDataPos=0, DcmDspDidDataRef=Data_224451_EOL_Calibration_State_Read
        DataInfo_DataInfo_22F186_Active_Diagnostic_Session (DcmDspDataInfo): DcmDspDataFixedLength=true
        DidInfo_DidInfo_221008_ECU_Life_Time (DcmDspDidInfo)
          DcmDspDidAccess
            DcmDspDidRead: DcmDspDidReadSessionRef=Default_Session, DcmDspDidReadSessionRef=Extended_Diagnostic_Session
        Data_221008_ECU_Life_Time (DcmDspData):
          DcmDspDataSize = 24
          DcmDspDataType = UINT8_N
          DcmDspDataUsePort = USE_DATA_ASYNCH_CLIENT_SERVER
          DcmDspDataConditionCheckReadFncUsed = false
          DcmDspDataInfoRef = DataInfo_DataInfo_221008_ECU_Life_Time
        DataInfo_DataInfo_222026_CAN_Overrun_Counters (DcmDspDataInfo): DcmDspDataFixedLength=true
        Data_225102_FD_CAN14_Rx_Signals_Read (DcmDspData):
          DcmDspDataSize = 272
          DcmDspDataType = UINT8_N
          DcmDspDataUsePort = USE_DATA_ASYNCH_CLIENT_SERVER
          DcmDspDataConditionCheckReadFncUsed = false
          DcmDspDataInfoRef = DataInfo_DataInfo_225102_FD_CAN14_Rx_Signals_Read
        DataInfo_DataInfo_22F134_CODEP_assembly_part_number (DcmDspDataInfo): DcmDspDataFixedLength=true
        Data_22191D_Time_of_Power_Latch (DcmDspData):
          DcmDspDataSize = 8
          DcmDspDataType = UINT8_N
          DcmDspDataUsePort = USE_DATA_ASYNCH_CLIENT_SERVER
          DcmDspDataConditionCheckReadFncUsed = false
          DcmDspDataInfoRef = DataInfo_DataInfo_22191D_Time_of_Power_Latch
        DID_22F155_Software_Supplier_Identification (DcmDspDid):
          DcmDspDidIdentifier = 61781
          DcmDspDidUsed = true
          DcmDspDidUsePort = USE_DATA_ELEMENT_SPECIFIC_INTERFACES
          DcmDspDidInfoRef = DidInfo_DidInfo_22F155_Software_Supplier_Identification
          DcmDspDidSignal: DcmDspDidDataPos=0, DcmDspDidDataRef=Data_22F155_Software_Supplier_Identification
        Data_22200D_Odometer_Last_Clear_Data_Trouble_Code_DTC (DcmDspData):
          DcmDspDataSize = 16
          DcmDspDataType = UINT8_N
          DcmDspDataUsePort = USE_DATA_ASYNCH_CLIENT_SERVER
          DcmDspDataConditionCheckReadFncUsed = false
          DcmDspDataInfoRef = DataInfo_DataInfo_22200D_Odometer_Last_Clear_Data_Trouble_Code_DTC
        DidInfo_DidInfo_22200D_Odometer_Last_Clear_Data_Trouble_Code_DTC (DcmDspDidInfo)
          DcmDspDidAccess
            DcmDspDidRead: DcmDspDidReadSessionRef=Default_Session, DcmDspDidReadSessionRef=Extended_Diagnostic_Session
        DID_22F110_ECU_Diagnostic_Identification (DcmDspDid):
          DcmDspDidIdentifier = 61712
          DcmDspDidUsed = true
          DcmDspDidUsePort = USE_DATA_ELEMENT_SPECIFIC_INTERFACES
          DcmDspDidInfoRef = DidInfo_DidInfo_22F110_ECU_Diagnostic_Identification
          DcmDspDidSignal: DcmDspDidDataPos=0, DcmDspDidDataRef=Data_22F110_ECU_Diagnostic_Identification
        DataInfo_DataInfo_224429_USS_Sensor_9_Part_Number_Read (DcmDspDataInfo): DcmDspDataFixedLength=true
        DID_222024_Read_ECU_PROXI_Data (DcmDspDid):
          DcmDspDidIdentifier = 8228
          DcmDspDidUsed = true
          DcmDspDidUsePort = USE_DATA_ELEMENT_SPECIFIC_INTERFACES
          DcmDspDidInfoRef = DidInfo_DidInfo_222024_Read_ECU_PROXI_Data
          DcmDspDidSignal: DcmDspDidDataPos=0, DcmDspDidDataRef=Data_222024_Read_ECU_PROXI_Data
        3 x DcmDspData, all with DcmDspDataType=UINT8_N, DcmDspDataUsePort=USE_DATA_ASYNCH_CLIENT_SERVER, DcmDspDataConditionCheckReadFncUsed=false:
          Data_22F1A1_Configuration_Code: DcmDspDataSize=88, DcmDspDataInfoRef=DataInfo_DataInfo_22F1A1_Configuration_Code
          Data_22F1B4_Application_Software_Fingerprint_Reading_Information: DcmDspDataSize=568, DcmDspDataInfoRef=DataInfo_DataInfo_22F1B4_Application_Software_Fingerprint_Reading_Information
          Data_224422_USS_Sensor2_Part_Number_Read: DcmDspDataSize=104, DcmDspDataInfoRef=DataInfo_DataInfo_224422_USS_Sensor2_Part_Number_Read
        3 x DcmDspDidInfo:
          DidInfo_DidInfo_22FD2B_USS_Direct_Distance_0xFD2B_Read
            DcmDspDidAccess
              DcmDspDidRead: DcmDspDidReadSessionRef=Default_Session, DcmDspDidReadSessionRef=Extended_Diagnostic_Session
          DidInfo_DidInfo_22FD1E_Calibration_Status_Read
            DcmDspDidAccess
              DcmDspDidRead: DcmDspDidReadSessionRef=Default_Session, DcmDspDidReadSessionRef=Extended_Diagnostic_Session
          DidInfo_DidInfo_22F155_Software_Supplier_Identification
            DcmDspDidAccess
              DcmDspDidRead
        DataInfo_DataInfo_22FD2A_USS_Ringing_Time_Read (DcmDspDataInfo): DcmDspDataFixedLength=true
        Data_222002_Odometer_at_last_Flash_programming (DcmDspData):
          DcmDspDataSize = 16
          DcmDspDataType = UINT8_N
          DcmDspDataUsePort = USE_DATA_ASYNCH_CLIENT_SERVER
          DcmDspDataConditionCheckReadFncUsed = false
          DcmDspDataInfoRef = DataInfo_DataInfo_222002_Odometer_at_last_Flash_programming
        RoutineInfo_RoutineInfo_31012001_Original_VIN_Unlock (DcmDspRoutineInfo)
          DcmDspRoutineAuthorization: DcmDspRoutineSessionRef=Extended_Diagnostic_Session, DcmDspRoutineSecurityLevelRef=Authenticated_Diagnostic_Access
        DidInfo_DidInfo_225304_SPM_Event_Abort_2_Read (DcmDspDidInfo)
          DcmDspDidAccess
            DcmDspDidRead: DcmDspDidReadSessionRef=Default_Session, DcmDspDidReadSessionRef=Extended_Diagnostic_Session
        Data_22FD0F_Right_Camera_Data_EEPROM_Read (DcmDspData):
          DcmDspDataSize = 2048
          DcmDspDataType = UINT8_N
          DcmDspDataUsePort = USE_DATA_ASYNCH_CLIENT_SERVER
          DcmDspDataConditionCheckReadFncUsed = false
          DcmDspDataInfoRef = DataInfo_DataInfo_22FD0F_Right_Camera_Data_EEPROM_Read
        Routine_3101FE02_Test_Write_PMIC_Register_Start (DcmDspRoutine):
          DcmDspRequestResultsRoutineSupported = false
          DcmDspStopRoutineSupported = false
          DcmDspRoutineIdentifier = 65026
          DcmDspRoutineFixedLength = false
          DcmDspRoutineUsePort = true
          DcmDspRoutineUsed = true
          DcmDspRoutineInfoRef = RoutineInfo_RoutineInfo_3101FE02_Test_Write_PMIC_Register_Start
        Data_22100B_Diagnostic_Tool_and_Session_Status (DcmDspData):
          DcmDspDataSize = 8
          DcmDspDataType = UINT8_N
          DcmDspDataUsePort = USE_DATA_ASYNCH_CLIENT_SERVER
          DcmDspDataConditionCheckReadFncUsed = false
          DcmDspDataInfoRef = DataInfo_DataInfo_22100B_Diagnostic_Tool_and_Session_Status
        DID_22FD47_SoC_Temperature_0xFD47_Read (DcmDspDid):
          DcmDspDidIdentifier = 64839
          DcmDspDidUsed = true
          DcmDspDidUsePort = USE_DATA_ELEMENT_SPECIFIC_INTERFACES
          DcmDspDidInfoRef = DidInfo_DidInfo_22FD47_SoC_Temperature_0xFD47_Read
          DcmDspDidSignal: DcmDspDidDataPos=0, DcmDspDidDataRef=Data_22FD47_SoC_Temperature_0xFD47_Read
        DataInfo_DataInfo_22F191_FCA_ESLM_ECU_Hardware_Number (DcmDspDataInfo): DcmDspDataFixedLength=true
        RoutineInfo_RoutineInfo_31015200_Plant_Mode_Routine_Start (DcmDspRoutineInfo)
          DcmDspRoutineRequestResOut
            Out_ResData (DcmDspRoutineRequestResOutSignal): DcmDspRoutineSignalLength=8, DcmDspRoutineSignalType=UINT8_N, DcmDspRoutineSignalEndianness=opaque, DcmDspRoutineSignalPos=0
          DcmDspStartRoutineIn
            In_ReqData (DcmDspStartRoutineInSignal): DcmDspRoutineSignalLength=8, DcmDspRoutineSignalType=UINT8_N, DcmDspRoutineSignalEndianness=opaque, DcmDspRoutineSignalPos=0
          DcmDspRoutineAuthorization: DcmDspRoutineSessionRef=Extended_Diagnostic_Session, DcmDspRoutineModeRuleRef=VehicleSpeedCheckRule
        DataInfo_DataInfo_22FD0C_Front_Camera_Data_EEPROM_Read (DcmDspDataInfo): DcmDspDataFixedLength=true
        DidInfo_DidInfo_224424_USS_Sensor_4_Part_Number_Read (DcmDspDidInfo)
          DcmDspDidAccess
            DcmDspDidRead: DcmDspDidReadSessionRef=Default_Session, DcmDspDidReadSessionRef=Extended_Diagnostic_Session
        Data_22102A_Check_EOL_Configuration_Data (DcmDspData):
          DcmDspDataSize = 72
          DcmDspDataType = UINT8_N
          DcmDspDataUsePort = USE_DATA_ASYNCH_CLIENT_SERVER
          DcmDspDataConditionCheckReadFncUsed = false
          DcmDspDataInfoRef = DataInfo_DataInfo_22102A_Check_EOL_Configuration_Data
        DID_222013_VIN_Lock_State_Read (DcmDspDid):
          DcmDspDidIdentifier = 8211
          DcmDspDidUsed = true
          DcmDspDidUsePort = USE_DATA_ELEMENT_SPECIFIC_INTERFACES
          DcmDspDidInfoRef = DidInfo_DidInfo_222013_VIN_Lock_State_Read
          DcmDspDidSignal: DcmDspDidDataPos=0, DcmDspDidDataRef=Data_222013_VIN_Lock_State_Read
        DidInfo_DidInfo_22FD1C_Current_Camera_Calibration_Data_Read (DcmDspDidInfo)
          DcmDspDidAccess
            DcmDspDidRead: DcmDspDidReadSessionRef=Default_Session, DcmDspDidReadSessionRef=Extended_Diagnostic_Session
        DidInfo_DidInfo_22F112_PTESLM_Hardware_Number (DcmDspDidInfo)
          DcmDspDidAccess
            DcmDspDidRead
        Data_2E2023_PROXI_Data (DcmDspData):
          DcmDspDataSize = 2040
          DcmDspDataType = UINT8_N
          DcmDspDataUsePort = USE_DATA_ASYNCH_CLIENT_SERVER
          DcmDspDataConditionCheckReadFncUsed = false
          DcmDspDataInfoRef = DataInfo_DataInfo_2E2023_PROXI_Data
        RoutineInfo_RoutineInfo_3101D002_Check_Programming_Preconditions_Start (DcmDspRoutineInfo)
          DcmDspRoutineAuthorization
          DcmDspStartRoutineOut
            Out_ResData (DcmDspStartRoutineOutSignal): DcmDspRoutineSignalLength=2048, DcmDspRoutineSignalType=VARIABLE_LENGTH, DcmDspRoutineSignalEndianness=opaque, DcmDspRoutineSignalPos=0
        Data_22F18C_ECU_Serial_Number (DcmDspData):
          DcmDspDataSize = 120
          DcmDspDataType = UINT8_N
          DcmDspDataUsePort = USE_DATA_ASYNCH_CLIENT_SERVER
          DcmDspDataConditionCheckReadFncUsed = false
          DcmDspDataInfoRef = DataInfo_DataInfo_22F18C_ECU_Serial_Number
        DID_22F154_Hardware_Supplier_Identification (DcmDspDid):
          DcmDspDidIdentifier = 61780
          DcmDspDidUsed = true
          DcmDspDidUsePort = USE_DATA_ELEMENT_SPECIFIC_INTERFACES
          DcmDspDidInfoRef = DidInfo_DidInfo_22F154_Hardware_Supplier_Identification
          DcmDspDidSignal: DcmDspDidDataPos=0, DcmDspDidDataRef=Data_22F154_Hardware_Supplier_Identification
        DataInfo_DataInfo_22F18C_ECU_Serial_Number (DcmDspDataInfo): DcmDspDataFixedLength=true
        Data_22FD0E_Rear_Camera_Data_EEPROM_Read (DcmDspData):
          DcmDspDataSize = 2048
          DcmDspDataType = UINT8_N
          DcmDspDataUsePort = USE_DATA_ASYNCH_CLIENT_SERVER
          DcmDspDataConditionCheckReadFncUsed = false
          DcmDspDataInfoRef = DataInfo_DataInfo_22FD0E_Rear_Camera_Data_EEPROM_Read
        DataInfo_DataInfo_22201B_Application_Data_Software_Programming_Attempt_Counter (DcmDspDataInfo): DcmDspDataFixedLength=true
        3 x DcmDspDidInfo:
          DidInfo_DidInfo_22FD0D_Left_Camera_Data_EEPROM_Read
            DcmDspDidAccess
              DcmDspDidRead: DcmDspDidReadSessionRef=Default_Session, DcmDspDidReadSessionRef=Extended_Diagnostic_Session
          DidInfo_DidInfo_224423_USS_Sensor_3_Part_Number_Read
            DcmDspDidAccess
              DcmDspDidRead: DcmDspDidReadSessionRef=Default_Session, DcmDspDidReadSessionRef=Extended_Diagnostic_Session
          DidInfo_DidInfo_22200C_Time_Since_Ignition_ON_of_first_DTC_Detection
            DcmDspDidAccess
              DcmDspDidRead: DcmDspDidReadSessionRef=Default_Session, DcmDspDidReadSessionRef=Extended_Diagnostic_Session
        DataInfo_DataInfo_22442C_USS_Sensor_12_Part_Number_Read (DcmDspDataInfo): DcmDspDataFixedLength=true
        DID_22442A_USS_Sensor_10_Part_Number_Read (DcmDspDid):
          DcmDspDidIdentifier = 17450
          DcmDspDidUsed = true
          DcmDspDidUsePort = USE_DATA_ELEMENT_SPECIFIC_INTERFACES
          DcmDspDidInfoRef = DidInfo_DidInfo_22442A_USS_Sensor_10_Part_Number_Read
          DcmDspDidSignal: DcmDspDidDataPos=0, DcmDspDidDataRef=Data_22442A_USS_Sensor_10_Part_Number_Read
        Data_22F10D_Diagnostic_Specification_Information (DcmDspData):
          DcmDspDataSize = 32
          DcmDspDataType = UINT8_N
          DcmDspDataUsePort = USE_DATA_ASYNCH_CLIENT_SERVER
          DcmDspDataConditionCheckReadFncUsed = false
          DcmDspDataInfoRef = DataInfo_DataInfo_22F10D_Diagnostic_Specification_Information
        DataInfo_DataInfo_22201F_Boot_Failure_Reason_Read (DcmDspDataInfo): DcmDspDataFixedLength=true
        DataInfo_DataInfo_222002_Odometer_at_last_Flash_programming (DcmDspDataInfo): DcmDspDataFixedLength=true
        Data_224421_USS_Sensor_1_Part_Number_Read (DcmDspData):
          DcmDspDataSize = 104
          DcmDspDataType = UINT8_N
          DcmDspDataUsePort = USE_DATA_ASYNCH_CLIENT_SERVER
          DcmDspDataConditionCheckReadFncUsed = false
          DcmDspDataInfoRef = DataInfo_DataInfo_224421_USS_Sensor_1_Part_Number_Read
        DID_22FD17_Magna_Production_HW_Version_information_Read (DcmDspDid):
          DcmDspDidIdentifier = 64791
          DcmDspDidUsed = true
          DcmDspDidUsePort = USE_DATA_ELEMENT_SPECIFIC_INTERFACES
          DcmDspDidInfoRef = DidInfo_DidInfo_22FD17_Magna_Production_HW_Version_information_Read
          DcmDspDidSignal: DcmDspDidDataPos=0, DcmDspDidDataRef=Data_22FD17_Magna_Production_HW_Version_information_Read
        DidInfo_DidInfo_222024_Read_ECU_PROXI_Data (DcmDspDidInfo)
          DcmDspDidAccess
            DcmDspDidRead: DcmDspDidReadSessionRef=Default_Session, DcmDspDidReadSessionRef=Extended_Diagnostic_Session
        DID_225104_FD_CAN14_Tx_Signals_Read (DcmDspDid):
          DcmDspDidIdentifier = 20740
          DcmDspDidUsed = true
          DcmDspDidUsePort = USE_DATA_ELEMENT_SPECIFIC_INTERFACES
          DcmDspDidInfoRef = DidInfo_DidInfo_225104_FD_CAN14_Tx_Signals_Read
          DcmDspDidSignal: DcmDspDidDataPos=0, DcmDspDidDataRef=Data_225104_FD_CAN14_Tx_Signals_Read
        DID_22FD07_OC_Result_Read (DcmDspDid):
          DcmDspDidIdentifier = 64775
          DcmDspDidUsed = true
          DcmDspDidUsePort = USE_DATA_ELEMENT_SPECIFIC_INTERFACES
          DcmDspDidInfoRef = DidInfo_DidInfo_22FD07_OC_Result_Read
          DcmDspDidSignal: DcmDspDidDataPos=0, DcmDspDidDataRef=Data_22FD07_OC_Result_Read
        DataInfo_DataInfo_22F1A1_Configuration_Code (DcmDspDataInfo): DcmDspDataFixedLength=true
        DataInfo_DataInfo_22200A_Ignition_ON_Counter (DcmDspDataInfo): DcmDspDataFixedLength=true
        DidInfo_DidInfo_22F1B0_VIN_Current (DcmDspDidInfo)
          DcmDspDidAccess
            DcmDspDidRead: DcmDspDidReadSessionRef=Default_Session, DcmDspDidReadSessionRef=Extended_Diagnostic_Session
        DataInfo_DataInfo_222939_FDCAN2_BUS_Network_WakeUp_Reason (DcmDspDataInfo): DcmDspDataFixedLength=true
        DID_22F18C_ECU_Serial_Number (DcmDspDid):
          DcmDspDidIdentifier = 61836
          DcmDspDidUsed = true
          DcmDspDidUsePort = USE_DATA_ELEMENT_SPECIFIC_INTERFACES
          DcmDspDidInfoRef = DidInfo_DidInfo_22F18C_ECU_Serial_Number
          DcmDspDidSignal: DcmDspDidDataPos=0, DcmDspDidDataRef=Data_22F18C_ECU_Serial_Number
        Data_22FD2A_USS_Ringing_Time_Read (DcmDspData):
          DcmDspDataSize = 192
          DcmDspDataType = UINT8_N
          DcmDspDataUsePort = USE_DATA_ASYNCH_CLIENT_SERVER
          DcmDspDataConditionCheckReadFncUsed = false
          DcmDspDataInfoRef = DataInfo_DataInfo_22FD2A_USS_Ringing_Time_Read
        DID_224421_USS_Sensor_1_Part_Number_Read (DcmDspDid):
          DcmDspDidIdentifier = 17441
          DcmDspDidUsed = true
          DcmDspDidUsePort = USE_DATA_ELEMENT_SPECIFIC_INTERFACES
          DcmDspDidInfoRef = DidInfo_DidInfo_224421_USS_Sensor_1_Part_Number_Read
          DcmDspDidSignal: DcmDspDidDataPos=0, DcmDspDidDataRef=Data_224421_USS_Sensor_1_Part_Number_Read
        DataInfo_DataInfo_22100B_Diagnostic_Tool_and_Session_Status (DcmDspDataInfo): DcmDspDataFixedLength=true
        DataInfo_DataInfo_22FDF1_CPU_Load_Read (DcmDspDataInfo): DcmDspDataFixedLength=true
        DidInfo_DidInfo_224451_EOL_Calibration_State_Read (DcmDspDidInfo)
          DcmDspDidAccess
            DcmDspDidRead: DcmDspDidReadSessionRef=Default_Session, DcmDspDidReadSessionRef=Extended_Diagnostic_Session
        DID_22FD46_Camera_Power_Supply_Read (DcmDspDid):
          DcmDspDidIdentifier = 64838
          DcmDspDidUsed = true
          DcmDspDidUsePort = USE_DATA_ELEMENT_SPECIFIC_INTERFACES
          DcmDspDidInfoRef = DidInfo_DidInfo_22FD46_Camera_Power_Supply_Read
          DcmDspDidSignal: DcmDspDidDataPos=0, DcmDspDidDataRef=Data_22FD46_Camera_Power_Supply_Read
        DataInfo_DataInfo_22F10B_ECU_Qualification (DcmDspDataInfo): DcmDspDataFixedLength=true
        DID_22201F_Boot_Failure_Reason_Read (DcmDspDid):
          DcmDspDidIdentifier = 8223
          DcmDspDidUsed = true
          DcmDspDidUsePort = USE_DATA_ELEMENT_SPECIFIC_INTERFACES
          DcmDspDidInfoRef = DidInfo_DidInfo_22201F_Boot_Failure_Reason_Read
          DcmDspDidSignal: DcmDspDidDataPos=0, DcmDspDidDataRef=Data_22201F_Boot_Failure_Reason_Read
        DidInfo_DidInfo_221921_Operational_Mode_Status (DcmDspDidInfo)
          DcmDspDidAccess
            DcmDspDidRead: DcmDspDidReadSessionRef=Default_Session, DcmDspDidReadSessionRef=Extended_Diagnostic_Session
        DidInfo_DidInfo_221009_ECU_Time_Since_Ignition_ON (DcmDspDidInfo)
          DcmDspDidAccess
            DcmDspDidRead: DcmDspDidReadSessionRef=Default_Session, DcmDspDidReadSessionRef=Extended_Diagnostic_Session
        Data_22FD08_OC_Data_Read (DcmDspData):
          DcmDspDataSize = 224
          DcmDspDataType = UINT8_N
          DcmDspDataUsePort = USE_DATA_ASYNCH_CLIENT_SERVER
          DcmDspDataConditionCheckReadFncUsed = false
          DcmDspDataInfoRef = DataInfo_DataInfo_22FD08_OC_Data_Read
        DataInfo_DataInfo_2F5001_Gear_Position_Read (DcmDspDataInfo): DcmDspDataFixedLength=true
        DidInfo_DidInfo_22F1A0_System_Identification_Data (DcmDspDidInfo)
          DcmDspDidAccess
            DcmDspDidRead
        DID_22F18B_FCA_ESLM_ECU_Software_Application_Number (DcmDspDid):
          DcmDspDidIdentifier = 61835
          DcmDspDidUsed = true
          DcmDspDidUsePort = USE_DATA_ELEMENT_SPECIFIC_INTERFACES
          DcmDspDidInfoRef = DidInfo_DidInfo_22F18B_FCA_ESLM_ECU_Software_Application_Number
          DcmDspDidSignal: DcmDspDidDataPos=0, DcmDspDidDataRef=Data_22F18B_FCA_ESLM_ECU_Software_Application_Number
        DidInfo_DidInfo_22F110_ECU_Diagnostic_Identification (DcmDspDidInfo)
          DcmDspDidAccess
            DcmDspDidRead
        DataInfo_DataInfo_22442B_USS_Sensor_11_Part_Number_Read (DcmDspDataInfo): DcmDspDataFixedLength=true
        DID_22200A_Ignition_ON_Counter (DcmDspDid):
          DcmDspDidIdentifier = 8202
          DcmDspDidUsed = true
          DcmDspDidUsePort = USE_DATA_ELEMENT_SPECIFIC_INTERFACES
          DcmDspDidInfoRef = DidInfo_DidInfo_22200A_Ignition_ON_Counter
          DcmDspDidSignal: DcmDspDidDataPos=0, DcmDspDidDataRef=Data_22200A_Ignition_ON_Counter
        Data_22F181_Application_Software_Identification (DcmDspData):
          DcmDspDataSize = 528
          DcmDspDataType = UINT8_N
          DcmDspDataUsePort = USE_DATA_ASYNCH_CLIENT_SERVER
          DcmDspDataConditionCheckReadFncUsed = false
          DcmDspDataInfoRef = DataInfo_DataInfo_22F181_Application_Software_Identification
        DataInfo_DataInfo_22F1B4_Application_Software_Fingerprint_Reading_Information (DcmDspDataInfo): DcmDspDataFixedLength=true
        DidInfo_DidInfo_22200A_Ignition_ON_Counter (DcmDspDidInfo)
          DcmDspDidAccess
            DcmDspDidRead: DcmDspDidReadSessionRef=Default_Session, DcmDspDidReadSessionRef=Extended_Diagnostic_Session
        DID_22F10D_Diagnostic_Specification_Information (DcmDspDid):
          DcmDspDidIdentifier = 61709
          DcmDspDidUsed = true
          DcmDspDidUsePort = USE_DATA_ELEMENT_SPECIFIC_INTERFACES
          DcmDspDidInfoRef = DidInfo_DidInfo_22F10D_Diagnostic_Specification_Information
          DcmDspDidSignal: DcmDspDidDataPos=0, DcmDspDidDataRef=Data_22F10D_Diagnostic_Specification_Information
        DataInfo_DataInfo_224426_USS_Sensor_6_Part_Number_Read (DcmDspDataInfo): DcmDspDataFixedLength=true
        DataInfo_DataInfo_222003_Boot_Software_Programming_Attempt_Counter (DcmDspDataInfo): DcmDspDataFixedLength=true
        DidInfo_DidInfo_224428_USS_Sensor_8_Part_Number_Read (DcmDspDidInfo)
          DcmDspDidAccess
            DcmDspDidRead: DcmDspDidReadSessionRef=Default_Session, DcmDspDidReadSessionRef=Extended_Diagnostic_Session
        DidInfo_DidInfo_222026_CAN_Overrun_Counters (DcmDspDidInfo)
          DcmDspDidAccess
            DcmDspDidRead: DcmDspDidReadSessionRef=Default_Session, DcmDspDidReadSessionRef=Extended_Diagnostic_Session
        DID_22F192_Supplier_ECU_Hardware_Part_Number (DcmDspDid):
          DcmDspDidIdentifier = 61842
          DcmDspDidUsed = true
          DcmDspDidUsePort = USE_DATA_ELEMENT_SPECIFIC_INTERFACES
          DcmDspDidInfoRef = DidInfo_DidInfo_22F192_Supplier_ECU_Hardware_Part_Number
          DcmDspDidSignal: DcmDspDidDataPos=0, DcmDspDidDataRef=Data_22F192_Supplier_ECU_Hardware_Part_Number
        RoutineInfo_RoutineInfo_3101FF01_checkProgrammingDependencies_FlashChecksum_Start (DcmDspRoutineInfo)
          DcmDspRoutineAuthorization: DcmDspRoutineSessionRef=Programming_Session, DcmDspRoutineSecurityLevelRef=Authenticated_Diagnostic_Access
          DcmDspStartRoutineOut
            Out_ResData (DcmDspStartRoutineOutSignal): DcmDspRoutineSignalLength=8, DcmDspRoutineSignalType=UINT8_N, DcmDspRoutineSignalEndianness=opaque, DcmDspRoutineSignalPos=0
        DataInfo_DataInfo_225100_SPM_status_Read (DcmDspDataInfo): DcmDspDataFixedLength=true
        DidInfo_DidInfo_225100_SPM_status_Read (DcmDspDidInfo)
          DcmDspDidAccess
            DcmDspDidRead: DcmDspDidReadSessionRef=Default_Session, DcmDspDidReadSessionRef=Extended_Diagnostic_Session
        4 x DcmDspData, all with DcmDspDataType=UINT8_N, DcmDspDataUsePort=USE_DATA_ASYNCH_CLIENT_SERVER, DcmDspDataConditionCheckReadFncUsed=false:
          Data_22F186_Active_Diagnostic_Session: DcmDspDataSize=24, DcmDspDataInfoRef=DataInfo_DataInfo_22F186_Active_Diagnostic_Session
          Data_221002_Vehicle_Speed: DcmDspDataSize=16, DcmDspDataInfoRef=DataInfo_DataInfo_221002_Vehicle_Speed
          Data_22201B_Application_Data_Software_Programming_Attempt_Counter: DcmDspDataSize=96, DcmDspDataInfoRef=DataInfo_DataInfo_22201B_Application_Data_Software_Programming_Attempt_Counter
          Data_224451_EOL_Calibration_State_Read: DcmDspDataSize=352, DcmDspDataInfoRef=DataInfo_DataInfo_224451_EOL_Calibration_State_Read
        DID_222026_CAN_Overrun_Counters (DcmDspDid):
          DcmDspDidIdentifier = 8230
          DcmDspDidUsed = true
          DcmDspDidUsePort = USE_DATA_ELEMENT_SPECIFIC_INTERFACES
          DcmDspDidInfoRef = DidInfo_DidInfo_222026_CAN_Overrun_Counters
          DcmDspDidSignal: DcmDspDidDataPos=0, DcmDspDidDataRef=Data_222026_CAN_Overrun_Counters
        Data_222008_ECU_Life_Time_Not_Volatile_Memory (DcmDspData):
          DcmDspDataSize = 24
          DcmDspDataType = UINT8_N
          DcmDspDataUsePort = USE_DATA_ASYNCH_CLIENT_SERVER
          DcmDspDataConditionCheckReadFncUsed = false
          DcmDspDataInfoRef = DataInfo_DataInfo_222008_ECU_Life_Time_Not_Volatile_Memory
        DID_22F193_Supplier_ECU_Hardware_Version_Number (DcmDspDid):
          DcmDspDidIdentifier = 61843
          DcmDspDidUsed = true
          DcmDspDidUsePort = USE_DATA_ELEMENT_SPECIFIC_INTERFACES
          DcmDspDidInfoRef = DidInfo_DidInfo_22F193_Supplier_ECU_Hardware_Version_Number
          DcmDspDidSignal: DcmDspDidDataPos=0, DcmDspDidDataRef=Data_22F193_Supplier_ECU_Hardware_Version_Number
        DidInfo_DidInfo_225102_FD_CAN14_Rx_Signals_Read (DcmDspDidInfo)
          DcmDspDidAccess
            DcmDspDidRead: DcmDspDidReadSessionRef=Extended_Diagnostic_Session, DcmDspDidReadSecurityLevelRef=Authenticated_Diagnostic_Access
        DidInfo_DidInfo_222002_Odometer_at_last_Flash_programming (DcmDspDidInfo)
          DcmDspDidAccess
            DcmDspDidRead
        3 x DcmDspData, all with DcmDspDataType=UINT8_N, DcmDspDataUsePort=USE_DATA_ASYNCH_CLIENT_SERVER, DcmDspDataConditionCheckReadFncUsed=false:
          Data_22200B_Time_First_DTC_Detection: DcmDspDataSize=24, DcmDspDataInfoRef=DataInfo_DataInfo_22200B_Time_First_DTC_Detection
          Data_222013_VIN_Lock_State_Read: DcmDspDataSize=8, DcmDspDataInfoRef=DataInfo_DataInfo_222013_VIN_Lock_State_Read
          Data_22FD1C_Current_Camera_Calibration_Data_Read: DcmDspDataSize=416, DcmDspDataInfoRef=DataInfo_DataInfo_22FD1C_Current_Camera_Calibration_Data_Read
        DidInfo_DidInfo_22F190_VIN_Original (DcmDspDidInfo)
          DcmDspDidAccess
            DcmDspDidRead: DcmDspDidReadSessionRef=Default_Session, DcmDspDidReadSessionRef=Extended_Diagnostic_Session
        DID_22F1A2_Vector_Delivery_ID (DcmDspDid):
          DcmDspDidIdentifier = 61858
          DcmDspDidUsed = true
          DcmDspDidUsePort = USE_DATA_ELEMENT_SPECIFIC_INTERFACES
          DcmDspDidInfoRef = DidInfo_DidInfo_22F1A2_Vector_Delivery_ID
          DcmDspDidSignal: DcmDspDidDataPos=0, DcmDspDidDataRef=Data_22F1A2_Vector_Delivery_ID
        Data_221009_ECU_Time_Since_Ignition_ON (DcmDspData):
          DcmDspDataSize = 16
          DcmDspDataType = UINT8_N
          DcmDspDataUsePort = USE_DATA_ASYNCH_CLIENT_SERVER
          DcmDspDataConditionCheckReadFncUsed = false
          DcmDspDataInfoRef = DataInfo_DataInfo_221009_ECU_Time_Since_Ignition_ON
        DID_22FD0D_Left_Camera_Data_EEPROM_Read (DcmDspDid):
          DcmDspDidIdentifier = 64781
          DcmDspDidUsed = true
          DcmDspDidUsePort = USE_DATA_ELEMENT_SPECIFIC_INTERFACES
          DcmDspDidInfoRef = DidInfo_DidInfo_22FD0D_Left_Camera_Data_EEPROM_Read
          DcmDspDidSignal: DcmDspDidDataPos=0, DcmDspDidDataRef=Data_22FD0D_Left_Camera_Data_EEPROM_Read
        DID_225100_SPM_status_Read (DcmDspDid):
          DcmDspDidIdentifier = 20736
          DcmDspDidUsed = true
          DcmDspDidUsePort = USE_DATA_ELEMENT_SPECIFIC_INTERFACES
          DcmDspDidInfoRef = DidInfo_DidInfo_225100_SPM_status_Read
          DcmDspDidSignal: DcmDspDidDataPos=0, DcmDspDidDataRef=Data_225100_SPM_status_Read
        DidInfo_DidInfo_222945_Flow_Control_Test (DcmDspDidInfo)
          DcmDspDidAccess
            DcmDspDidWrite: DcmDspDidWriteSessionRef=Default_Session, DcmDspDidWriteSessionRef=Extended_Diagnostic_Session
            DcmDspDidRead: DcmDspDidReadSessionRef=Default_Session, DcmDspDidReadSessionRef=Extended_Diagnostic_Session
        DataInfo_DataInfo_22FD1E_Calibration_Status_Read (DcmDspDataInfo): DcmDspDataFixedLength=true
        DidInfo_DidInfo_225500_Trailer_Sense_and_Drive_Function_Data_Read (DcmDspDidInfo)
          DcmDspDidAccess
            DcmDspDidRead: DcmDspDidReadSessionRef=Extended_Diagnostic_Session, DcmDspDidReadSecurityLevelRef=Authenticated_Diagnostic_Access
        DID_22FD0C_Front_Camera_Data_EEPROM_Read (DcmDspDid):
          DcmDspDidIdentifier = 64780
          DcmDspDidUsed = true
          DcmDspDidUsePort = USE_DATA_ELEMENT_SPECIFIC_INTERFACES
          DcmDspDidInfoRef = DidInfo_DidInfo_22FD0C_Front_Camera_Data_EEPROM_Read
          DcmDspDidSignal: DcmDspDidDataPos=0, DcmDspDidDataRef=Data_22FD0C_Front_Camera_Data_EEPROM_Read
        Data_224426_USS_Sensor_6_Part_Number_Read (DcmDspData):
          DcmDspDataSize = 104
          DcmDspDataType = UINT8_N
          DcmDspDataUsePort = USE_DATA_ASYNCH_CLIENT_SERVER
          DcmDspDataConditionCheckReadFncUsed = false
          DcmDspDataInfoRef = DataInfo_DataInfo_224426_USS_Sensor_6_Part_Number_Read
        Routine_3101D001_Disable_Fail_safe_reaction_Start (DcmDspRoutine):
          DcmDspRequestResultsRoutineSupported = false
          DcmDspStopRoutineSupported = true
          DcmDspRoutineIdentifier = 53249
          DcmDspRoutineFixedLength = false
          DcmDspRoutineUsePort = true
          DcmDspRoutineUsed = true
          DcmDspRoutineInfoRef = RoutineInfo_RoutineInfo_3101D001_Disable_Fail_safe_reaction_Start
        Data_225105_FD_CAN2_Tx_Signals_Read (DcmDspData):
          DcmDspDataSize = 152
          DcmDspDataType = UINT8_N
          DcmDspDataUsePort = USE_DATA_ASYNCH_CLIENT_SERVER
          DcmDspDataConditionCheckReadFncUsed = false
          DcmDspDataInfoRef = DataInfo_DataInfo_225105_FD_CAN2_Tx_Signals_Read
        DidInfo_DidInfo_22F122_Software_EBOM_Part_Number (DcmDspDidInfo)
          DcmDspDidAccess
            DcmDspDidRead
        Data_222945_Flow_Control_Test (DcmDspData):
          DcmDspDataSize = 1600
          DcmDspDataType = UINT8_N
          DcmDspDataUsePort = USE_DATA_ASYNCH_CLIENT_SERVER
          DcmDspDataConditionCheckReadFncUsed = false
          DcmDspDataInfoRef = DataInfo_DataInfo_222945_Flow_Control_Test
        Data_221921_Operational_Mode_Status (DcmDspData):
          DcmDspDataSize = 72
          DcmDspDataType = UINT8_N
          DcmDspDataUsePort = USE_DATA_ASYNCH_CLIENT_SERVER
          DcmDspDataConditionCheckReadFncUsed = false
          DcmDspDataInfoRef = DataInfo_DataInfo_221921_Operational_Mode_Status
        DID_220103_VIN_Lock_Status (DcmDspDid):
          DcmDspDidIdentifier = 259
          DcmDspDidUsed = true
          DcmDspDidUsePort = USE_DATA_ELEMENT_SPECIFIC_INTERFACES
          DcmDspDidInfoRef = DidInfo_DidInfo_220103_VIN_Lock_Status
          DcmDspDidSignal: DcmDspDidDataPos=0, DcmDspDidDataRef=Data_220103_VIN_Lock_Status
        Data_22F1A0_System_Identification_Data (DcmDspData):
          DcmDspDataSize = 720
          DcmDspDataType = UINT8_N
          DcmDspDataUsePort = USE_DATA_ASYNCH_CLIENT_SERVER
          DcmDspDataConditionCheckReadFncUsed = false
          DcmDspDataInfoRef = DataInfo_DataInfo_22F1A0_System_Identification_Data
        Data_22F191_FCA_ESLM_ECU_Hardware_Number (DcmDspData):
          DcmDspDataSize = 88
          DcmDspDataType = UINT8_N
          DcmDspDataUsePort = USE_DATA_ASYNCH_CLIENT_SERVER
          DcmDspDataConditionCheckReadFncUsed = false
          DcmDspDataInfoRef = DataInfo_DataInfo_22F191_FCA_ESLM_ECU_Hardware_Number
        3 x DcmDspDidInfo:
          DidInfo_DidInfo_22F191_FCA_ESLM_ECU_Hardware_Number
            DcmDspDidAccess
              DcmDspDidRead
          DidInfo_DidInfo_2EF184_Application_Software_Fingerprint_writing_information
            DcmDspDidAccess
              DcmDspDidWrite: DcmDspDidWriteSessionRef=Programming_Session, DcmDspDidWriteSecurityLevelRef=Authenticated_Diagnostic_Access
          DidInfo_DidInfo_225501_Trailer_coupler_sense_detection_Function_Data_Read
            DcmDspDidAccess
              DcmDspDidRead: DcmDspDidReadSessionRef=Extended_Diagnostic_Session, DcmDspDidReadSecurityLevelRef=Authenticated_Diagnostic_Access
        Routine_31015200_Plant_Mode_Routine_Start (DcmDspRoutine):
          DcmDspRequestResultsRoutineSupported = true
          DcmDspStopRoutineSupported = false
          DcmDspRoutineIdentifier = 20992
          DcmDspRoutineFixedLength = false
          DcmDspRoutineUsePort = true
          DcmDspRoutineUsed = true
          DcmDspRoutineInfoRef = RoutineInfo_RoutineInfo_31015200_Plant_Mode_Routine_Start
        DidInfo_DidInfo_22F18B_FCA_ESLM_ECU_Software_Application_Number (DcmDspDidInfo)
          DcmDspDidAccess
            DcmDspDidRead
        Data_224427_USS_Sensor_7_Part_Number_Read (DcmDspData):
          DcmDspDataSize = 104
          DcmDspDataType = UINT8_N
          DcmDspDataUsePort = USE_DATA_ASYNCH_CLIENT_SERVER
          DcmDspDataConditionCheckReadFncUsed = false
          DcmDspDataInfoRef = DataInfo_DataInfo_224427_USS_Sensor_7_Part_Number_Read
        DataInfo_DataInfo_22FD0D_Left_Camera_Data_EEPROM_Read (DcmDspDataInfo): DcmDspDataFixedLength=true
        DataInfo_DataInfo_22191D_Time_of_Power_Latch (DcmDspDataInfo): DcmDspDataFixedLength=true
        Data_225303_SPM_Event_Abort_1_Read (DcmDspData):
          DcmDspDataSize = 96
          DcmDspDataType = UINT8_N
          DcmDspDataUsePort = USE_DATA_ASYNCH_CLIENT_SERVER
          DcmDspDataConditionCheckReadFncUsed = false
          DcmDspDataInfoRef = DataInfo_DataInfo_225303_SPM_Event_Abort_1_Read
        Data_22F132_EBOM_ECU_Part_Number (DcmDspData):
          DcmDspDataSize = 80
          DcmDspDataType = UINT8_N
          DcmDspDataUsePort = USE_DATA_ASYNCH_CLIENT_SERVER
          DcmDspDataConditionCheckReadFncUsed = false
          DcmDspDataInfoRef = DataInfo_DataInfo_22F132_EBOM_ECU_Part_Number
        DataInfo_DataInfo_22FD33_Magna_Testing_2_Read (DcmDspDataInfo): DcmDspDataFixedLength=true
        Data_22292E_PROXI_Write_Counter (DcmDspData):
          DcmDspDataSize = 8
          DcmDspDataType = UINT8_N
          DcmDspDataUsePort = USE_DATA_ASYNCH_CLIENT_SERVER
          DcmDspDataConditionCheckReadFncUsed = false
          DcmDspDataInfoRef = DataInfo_DataInfo_22292E_PROXI_Write_Counter
        DID_22FDF0_ECU_shutdown_process_Read (DcmDspDid):
          DcmDspDidIdentifier = 65008
          DcmDspDidUsed = true
          DcmDspDidUsePort = USE_DATA_ELEMENT_SPECIFIC_INTERFACES
          DcmDspDidInfoRef = DidInfo_DidInfo_22FDF0_ECU_shutdown_process_Read
          DcmDspDidSignal: DcmDspDidDataPos=0, DcmDspDidDataRef=Data_22FDF0_ECU_shutdown_process_Read
        Data_22FD0A_SC_Data_Read (DcmDspData):
          DcmDspDataSize = 224
          DcmDspDataType = UINT8_N
          DcmDspDataUsePort = USE_DATA_ASYNCH_CLIENT_SERVER
          DcmDspDataConditionCheckReadFncUsed = false
          DcmDspDataInfoRef = DataInfo_DataInfo_22FD0A_SC_Data_Read
        3 x DcmDspDataInfo, all with DcmDspDataFixedLength=true:
          DataInfo_DataInfo_22FD2E_USS_Sensor_ID_Murata_SN_Read
          DataInfo_DataInfo_22F181_Application_Software_Identification
          DataInfo_DataInfo_22F18B_FCA_ESLM_ECU_Software_Application_Number
        DidInfo_DidInfo_22FD33_Magna_Testing_2_Read (DcmDspDidInfo)
          DcmDspDidAccess
            DcmDspDidWrite: DcmDspDidWriteSessionRef=Extended_Diagnostic_Session
            DcmDspDidRead: DcmDspDidReadSessionRef=Default_Session, DcmDspDidReadSessionRef=Extended_Diagnostic_Session
        DID_22191D_Time_of_Power_Latch (DcmDspDid):
          DcmDspDidIdentifier = 6429
          DcmDspDidUsed = true
          DcmDspDidUsePort = USE_DATA_ELEMENT_SPECIFIC_INTERFACES
          DcmDspDidInfoRef = DidInfo_DidInfo_22191D_Time_of_Power_Latch
          DcmDspDidSignal: DcmDspDidDataPos=0, DcmDspDidDataRef=Data_22191D_Time_of_Power_Latch
        DID_22FDF1_CPU_Load_Read (DcmDspDid):
          DcmDspDidIdentifier = 65009
          DcmDspDidUsed = true
          DcmDspDidUsePort = USE_DATA_ELEMENT_SPECIFIC_INTERFACES
          DcmDspDidInfoRef = DidInfo_DidInfo_22FDF1_CPU_Load_Read
          DcmDspDidSignal: DcmDspDidDataPos=0, DcmDspDidDataRef=Data_22FDF1_CPU_Load_Read
        DataInfo_DataInfo_222024_Read_ECU_PROXI_Data (DcmDspDataInfo): DcmDspDataFixedLength=false
        DID_22F182_Application_Data_Identification (DcmDspDid):
          DcmDspDidIdentifier = 61826
          DcmDspDidUsed = true
          DcmDspDidUsePort = USE_DATA_ELEMENT_SPECIFIC_INTERFACES
          DcmDspDidInfoRef = DidInfo_DidInfo_22F182_Application_Data_Identification
          DcmDspDidSignal: DcmDspDidDataPos=0, DcmDspDidDataRef=Data_22F182_Application_Data_Identification
        DID_22442B_USS_Sensor_11_Part_Number_Read (DcmDspDid):
          DcmDspDidIdentifier = 17451
          DcmDspDidUsed = true
          DcmDspDidUsePort = USE_DATA_ELEMENT_SPECIFIC_INTERFACES
          DcmDspDidInfoRef = DidInfo_DidInfo_22442B_USS_Sensor_11_Part_Number_Read
          DcmDspDidSignal: DcmDspDidDataPos=0, DcmDspDidDataRef=Data_22442B_USS_Sensor_11_Part_Number_Read
        DataInfo_DataInfo_22F1A6_Message_Matrix (DcmDspDataInfo): DcmDspDataFixedLength=true
        DataInfo_DataInfo_22F154_Hardware_Supplier_Identification (DcmDspDataInfo): DcmDspDataFixedLength=true
        DID_2EF184_Application_Software_Fingerprint_writing_information (DcmDspDid):
          DcmDspDidIdentifier = 61828
          DcmDspDidUsed = true
          DcmDspDidUsePort = USE_DATA_ELEMENT_SPECIFIC_INTERFACES
          DcmDspDidInfoRef = DidInfo_DidInfo_2EF184_Application_Software_Fingerprint_writing_information
          DcmDspDidSignal: DcmDspDidDataPos=0, DcmDspDidDataRef=Data_2EF184_Application_Software_Fingerprint_writing_information
        DataInfo_DataInfo_22F112_PTESLM_Hardware_Number (DcmDspDataInfo): DcmDspDataFixedLength=true
        DID_22F180_Boot_Software_Version_Information (DcmDspDid):
          DcmDspDidIdentifier = 61824
          DcmDspDidUsed = true
          DcmDspDidUsePort = USE_DATA_ELEMENT_SPECIFIC_INTERFACES
          DcmDspDidInfoRef = DidInfo_DidInfo_22F180_Boot_Software_Version_Information
          DcmDspDidSignal: DcmDspDidDataPos=0, DcmDspDidDataRef=Data_22F180_Boot_Software_Version_Information
        DidInfo_DidInfo_224429_USS_Sensor_9_Part_Number_Read (DcmDspDidInfo)
          DcmDspDidAccess
            DcmDspDidRead: DcmDspDidReadSessionRef=Default_Session, DcmDspDidReadSessionRef=Extended_Diagnostic_Session
        DID_22FD29_USS_Driving_Frequency_Read (DcmDspDid):
          DcmDspDidIdentifier = 64809
          DcmDspDidUsed = true
          DcmDspDidUsePort = USE_DATA_ELEMENT_SPECIFIC_INTERFACES
          DcmDspDidInfoRef = DidInfo_DidInfo_22FD29_USS_Driving_Frequency_Read
          DcmDspDidSignal: DcmDspDidDataPos=0, DcmDspDidDataRef=Data_22FD29_USS_Driving_Frequency_Read
        DID_22FD2A_USS_Ringing_Time_Read (DcmDspDid):
          DcmDspDidIdentifier = 64810
          DcmDspDidUsed = true
          DcmDspDidUsePort = USE_DATA_ELEMENT_SPECIFIC_INTERFACES
          DcmDspDidInfoRef = DidInfo_DidInfo_22FD2A_USS_Ringing_Time_Read
          DcmDspDidSignal: DcmDspDidDataPos=0, DcmDspDidDataRef=Data_22FD2A_USS_Ringing_Time_Read
        RoutineInfo_RoutineInfo_31015401_Camera_Service_Calibration_Start (DcmDspRoutineInfo)
          DcmDspRoutineRequestResOut
            Out_ResData (DcmDspRoutineRequestResOutSignal): DcmDspRoutineSignalLength=72, DcmDspRoutineSignalType=UINT8_N, DcmDspRoutineSignalEndianness=opaque, DcmDspRoutineSignalPos=0
          DcmDspStartRoutineIn
            In_ReqData (DcmDspStartRoutineInSignal): DcmDspRoutineSignalLength=8, DcmDspRoutineSignalType=UINT8_N, DcmDspRoutineSignalEndianness=opaque, DcmDspRoutineSignalPos=0
          DcmDspRoutineAuthorization: DcmDspRoutineSessionRef=Extended_Diagnostic_Session
          DcmDspStartRoutineOut
            Out_ResData (DcmDspStartRoutineOutSignal): DcmDspRoutineSignalLength=8, DcmDspRoutineSignalType=UINT8_N, DcmDspRoutineSignalEndianness=opaque, DcmDspRoutineSignalPos=0
        DataInfo_DataInfo_22FDF2_Reset_Reason_Read (DcmDspDataInfo): DcmDspDataFixedLength=true
        DidInfo_DidInfo_22FDF1_CPU_Load_Read (DcmDspDidInfo)
          DcmDspDidAccess
            DcmDspDidRead: DcmDspDidReadSessionRef=Default_Session, DcmDspDidReadSessionRef=Extended_Diagnostic_Session
        Data_22F194_Supplier_ECU_Software_Part_Number (DcmDspData):
          DcmDspDataSize = 88
          DcmDspDataType = UINT8_N
          DcmDspDataUsePort = USE_DATA_ASYNCH_CLIENT_SERVER
          DcmDspDataConditionCheckReadFncUsed = false
          DcmDspDataInfoRef = DataInfo_DataInfo_22F194_Supplier_ECU_Software_Part_Number
        Data_22FD2C_USS_Temperature_Read (DcmDspData):
          DcmDspDataSize = 192
          DcmDspDataType = UINT8_N
          DcmDspDataUsePort = USE_DATA_ASYNCH_CLIENT_SERVER
          DcmDspDataConditionCheckReadFncUsed = false
          DcmDspDataInfoRef = DataInfo_DataInfo_22FD2C_USS_Temperature_Read
        DID_221921_Operational_Mode_Status (DcmDspDid):
          DcmDspDidIdentifier = 6433
          DcmDspDidUsed = true
          DcmDspDidUsePort = USE_DATA_ELEMENT_SPECIFIC_INTERFACES
          DcmDspDidInfoRef = DidInfo_DidInfo_221921_Operational_Mode_Status
          DcmDspDidSignal: DcmDspDidDataPos=0, DcmDspDidDataRef=Data_221921_Operational_Mode_Status
        DataInfo_DataInfo_225500_Trailer_Sense_and_Drive_Function_Data_Read (DcmDspDataInfo): DcmDspDataFixedLength=true
        ComControl (DcmDspComControl)
          DspComContolAllChannel (DcmDspComControlAllChannel): DcmDspAllComMChannelRef=CN_FDCAN2_28a8fc44
        Data_2F5001_Gear_Position_Read (DcmDspData):
          DcmDspDataConditionCheckReadFncUsed = false
          DcmDspDataSize = 8
          DcmDspDataType = UINT8_N
          DcmDspDataUsePort = USE_DATA_ASYNCH_CLIENT_SERVER
          DcmDspDataInfoRef = DataInfo_DataInfo_2F5001_Gear_Position_Read
        DID_225304_SPM_Event_Abort_2_Read (DcmDspDid):
          DcmDspDidIdentifier = 21252
          DcmDspDidUsed = true
          DcmDspDidUsePort = USE_DATA_ELEMENT_SPECIFIC_INTERFACES
          DcmDspDidInfoRef = DidInfo_DidInfo_225304_SPM_Event_Abort_2_Read
          DcmDspDidSignal: DcmDspDidDataPos=0, DcmDspDidDataRef=Data_225304_SPM_Event_Abort_2_Read
        DidInfo_DidInfo_22FD2A_USS_Ringing_Time_Read (DcmDspDidInfo)
          DcmDspDidAccess
            DcmDspDidRead: DcmDspDidReadSessionRef=Default_Session, DcmDspDidReadSessionRef=Extended_Diagnostic_Session
        DataInfo_DataInfo_22FD2B_USS_Direct_Distance_0xFD2B_Read (DcmDspDataInfo): DcmDspDataFixedLength=true
        DataInfo_DataInfo_22F133_EBOM_Assembly_Part_Number (DcmDspDataInfo): DcmDspDataFixedLength=true
        DidInfo_DidInfo_22FD20_ECU_PinStates_Read (DcmDspDidInfo)
          DcmDspDidAccess
            DcmDspDidRead: DcmDspDidReadSessionRef=Default_Session, DcmDspDidReadSessionRef=Extended_Diagnostic_Session
        Data_22F1A6_Message_Matrix (DcmDspData):
          DcmDspDataSize = 24
          DcmDspDataType = UINT8_N
          DcmDspDataUsePort = USE_DATA_ASYNCH_CLIENT_SERVER
          DcmDspDataConditionCheckReadFncUsed = false
          DcmDspDataInfoRef = DataInfo_DataInfo_22F1A6_Message_Matrix
        DidInfo_DidInfo_22FD0C_Front_Camera_Data_EEPROM_Read (DcmDspDidInfo)
          DcmDspDidAccess
            DcmDspDidRead: DcmDspDidReadSessionRef=Default_Session, DcmDspDidReadSessionRef=Extended_Diagnostic_Session
        DataInfo_DataInfo_220103_VIN_Lock_Status (DcmDspDataInfo): DcmDspDataFixedLength=true
        Data_222001_Odometer (DcmDspData):
          DcmDspDataSize = 16
          DcmDspDataType = UINT8_N
          DcmDspDataUsePort = USE_DATA_ASYNCH_CLIENT_SERVER
          DcmDspDataConditionCheckReadFncUsed = false
          DcmDspDataInfoRef = DataInfo_DataInfo_222001_Odometer
        DidInfo_DidInfo_220103_VIN_Lock_Status (DcmDspDidInfo)
          DcmDspDidAccess
            DcmDspDidRead: DcmDspDidReadSessionRef=Default_Session, DcmDspDidReadSessionRef=Extended_Diagnostic_Session
        DidInfo_DidInfo_222939_FDCAN2_BUS_Network_WakeUp_Reason (DcmDspDidInfo)
          DcmDspDidAccess
            DcmDspDidRead: DcmDspDidReadSessionRef=Default_Session, DcmDspDidReadSessionRef=Extended_Diagnostic_Session
        DataInfo_DataInfo_2EF185_Application_Data_Software_Fingerprint_Writing_Information (DcmDspDataInfo): DcmDspDataFixedLength=true
        DataInfo_DataInfo_2E2023_PROXI_Data (DcmDspDataInfo): DcmDspDataFixedLength=false
        DID_22F1A1_Configuration_Code (DcmDspDid):
          DcmDspDidIdentifier = 61857
          DcmDspDidUsed = true
          DcmDspDidUsePort = USE_DATA_ELEMENT_SPECIFIC_INTERFACES
          DcmDspDidInfoRef = DidInfo_DidInfo_22F1A1_Configuration_Code
          DcmDspDidSignal: DcmDspDidDataPos=0, DcmDspDidDataRef=Data_22F1A1_Configuration_Code
        DidInfo_DidInfo_22FD2D_USS_Sensor_ID_IME_SN_Read (DcmDspDidInfo)
          DcmDspDidAccess
            DcmDspDidRead: DcmDspDidReadSessionRef=Default_Session, DcmDspDidReadSessionRef=Extended_Diagnostic_Session
        DataInfo_DataInfo_22F18A_FCA_ESLM_ECU_Software_Calibration_Number (DcmDspDataInfo): DcmDspDataFixedLength=true
        DataInfo_DataInfo_224423_USS_Sensor_3_Part_Number_Read (DcmDspDataInfo): DcmDspDataFixedLength=true
        5 x DcmDspDidInfo:
          DidInfo_DidInfo_22F18C_ECU_Serial_Number
            DcmDspDidAccess
              DcmDspDidRead
          DidInfo_DidInfo_22F180_Boot_Software_Version_Information
            DcmDspDidAccess
              DcmDspDidRead
          DidInfo_DidInfo_22FD0E_Rear_Camera_Data_EEPROM_Read
            DcmDspDidAccess
              DcmDspDidRead: DcmDspDidReadSessionRef=Default_Session, DcmDspDidReadSessionRef=Extended_Diagnostic_Session
          DidInfo_DidInfo_22191D_Time_of_Power_Latch
            DcmDspDidAccess
              DcmDspDidRead: DcmDspDidReadSessionRef=Default_Session, DcmDspDidReadSessionRef=Extended_Diagnostic_Session
          DidInfo_DidInfo_22FD31_Magna_EOL_Coding_State_Read
            DcmDspDidAccess
              DcmDspDidWrite: DcmDspDidWriteSessionRef=Extended_Diagnostic_Session
              DcmDspDidRead: DcmDspDidReadSessionRef=Default_Session, DcmDspDidReadSessionRef=Extended_Diagnostic_Session
        DID_22F195_Supplier_ECU_Software_Version_Number (DcmDspDid):
          DcmDspDidIdentifier = 61845
          DcmDspDidUsed = true
          DcmDspDidUsePort = USE_DATA_ELEMENT_SPECIFIC_INTERFACES
          DcmDspDidInfoRef = DidInfo_DidInfo_22F195_Supplier_ECU_Software_Version_Number
          DcmDspDidSignal: DcmDspDidDataPos=0, DcmDspDidDataRef=Data_22F195_Supplier_ECU_Software_Version_Number
        DID_22FD16_Magna_Production_ICT_Data_Read (DcmDspDid):
          DcmDspDidIdentifier = 64790
          DcmDspDidUsed = true
          DcmDspDidUsePort = USE_DATA_ELEMENT_SPECIFIC_INTERFACES
          DcmDspDidInfoRef = DidInfo_DidInfo_22FD16_Magna_Production_ICT_Data_Read
          DcmDspDidSignal: DcmDspDidDataPos=0, DcmDspDidDataRef=Data_22FD16_Magna_Production_ICT_Data_Read
        DidInfo_DidInfo_22201F_Boot_Failure_Reason_Read (DcmDspDidInfo)
          DcmDspDidAccess
            DcmDspDidRead
        DID_224429_USS_Sensor_9_Part_Number_Read (DcmDspDid):
          DcmDspDidIdentifier = 17449
          DcmDspDidUsed = true
          DcmDspDidUsePort = USE_DATA_ELEMENT_SPECIFIC_INTERFACES
          DcmDspDidInfoRef = DidInfo_DidInfo_224429_USS_Sensor_9_Part_Number_Read
          DcmDspDidSignal: DcmDspDidDataPos=0, DcmDspDidDataRef=Data_224429_USS_Sensor_9_Part_Number_Read
        DataInfo_DataInfo_22FD0F_Right_Camera_Data_EEPROM_Read (DcmDspDataInfo): DcmDspDataFixedLength=true
        DidInfo_DidInfo_225303_SPM_Event_Abort_1_Read (DcmDspDidInfo)
          DcmDspDidAccess
            DcmDspDidRead: DcmDspDidReadSessionRef=Default_Session, DcmDspDidReadSessionRef=Extended_Diagnostic_Session
        DidInfo_DidInfo_225300_Rear_Braking_Event_1_Read (DcmDspDidInfo)
          DcmDspDidAccess
            DcmDspDidRead: DcmDspDidReadSessionRef=Default_Session, DcmDspDidReadSessionRef=Extended_Diagnostic_Session
        Data_225501_Trailer_coupler_sense_detection_Function_Data_Read (DcmDspData):
          DcmDspDataSize = 384
          DcmDspDataType = UINT8_N
          DcmDspDataUsePort = USE_DATA_ASYNCH_CLIENT_SERVER
          DcmDspDataConditionCheckReadFncUsed = false
          DcmDspDataInfoRef = DataInfo_DataInfo_225501_Trailer_coupler_sense_detection_Function_Data_Read
        DidInfo_DidInfo_2F5001_Gear_Position_Read (DcmDspDidInfo)
          DcmDspDidAccess
            DcmDspDidControl:
              DcmDspDidFreezeCurrentState = false
              DcmDspDidResetToDefault = false
              DcmDspDidReturnControlToEcu = true
              DcmDspDidShortTermAdjustment = true
              DcmDspDidControlMask = DCM_CONTROLMASK_INTERNAL
              DcmDspDidControlSessionRef = Extended_Diagnostic_Session
              DcmDspDidControlSecurityLevelRef = Authenticated_Diagnostic_Access
            DcmDspDidRead: DcmDspDidReadSessionRef=Extended_Diagnostic_Session
        DataInfo_DataInfo_224421_USS_Sensor_1_Part_Number_Read (DcmDspDataInfo): DcmDspDataFixedLength=true
        DidInfo_DidInfo_22FD17_Magna_Production_HW_Version_information_Read (DcmDspDidInfo)
          DcmDspDidAccess
            DcmDspDidRead: DcmDspDidReadSessionRef=Default_Session, DcmDspDidReadSessionRef=Extended_Diagnostic_Session
        5 x DcmDspDid, all with DcmDspDidUsed=true, DcmDspDidUsePort=USE_DATA_ELEMENT_SPECIFIC_INTERFACES:
          DID_222010_Programming_Status: DcmDspDidIdentifier=8208, DcmDspDidInfoRef=DidInfo_DidInfo_222010_Programming_Status
            DcmDspDidSignal: DcmDspDidDataPos=0, DcmDspDidDataRef=Data_222010_Programming_Status
          DID_22F187_CODEP_ECU_Part_Number: DcmDspDidIdentifier=61831, DcmDspDidInfoRef=DidInfo_DidInfo_22F187_CODEP_ECU_Part_Number
            DcmDspDidSignal: DcmDspDidDataPos=0, DcmDspDidDataRef=Data_22F187_CODEP_ECU_Part_Number
          DID_2E2023_PROXI_Data: DcmDspDidIdentifier=8227, DcmDspDidInfoRef=DidInfo_DidInfo_2E2023_PROXI_Data
            DcmDspDidSignal: DcmDspDidDataPos=0, DcmDspDidDataRef=Data_2E2023_PROXI_Data
          DID_22FD49_SoC_Die_Temperature_ID_0xFD49_Read: DcmDspDidIdentifier=64841, DcmDspDidInfoRef=DidInfo_DidInfo_22FD49_SoC_Die_Temperature_ID_0xFD49_Read
            DcmDspDidSignal: DcmDspDidDataPos=0, DcmDspDidDataRef=Data_22FD49_SoC_Die_Temperature_ID_0xFD49_Read
          DID_22FD08_OC_Data_Read: DcmDspDidIdentifier=64776, DcmDspDidInfoRef=DidInfo_DidInfo_22FD08_OC_Data_Read
            DcmDspDidSignal: DcmDspDidDataPos=0, DcmDspDidDataRef=Data_22FD08_OC_Data_Read
        Data_22442A_USS_Sensor_10_Part_Number_Read (DcmDspData):
          DcmDspDataSize = 104
          DcmDspDataType = UINT8_N
          DcmDspDataUsePort = USE_DATA_ASYNCH_CLIENT_SERVER
          DcmDspDataConditionCheckReadFncUsed = false
          DcmDspDataInfoRef = DataInfo_DataInfo_22442A_USS_Sensor_10_Part_Number_Read
        DataInfo_DataInfo_220107_RoE_Activation_State (DcmDspDataInfo): DcmDspDataFixedLength=true
        DataInfo_DataInfo_225300_Rear_Braking_Event_1_Read (DcmDspDataInfo): DcmDspDataFixedLength=true
        DidInfo_DidInfo_22FD29_USS_Driving_Frequency_Read (DcmDspDidInfo)
          DcmDspDidAccess
            DcmDspDidRead: DcmDspDidReadSessionRef=Default_Session, DcmDspDidReadSessionRef=Extended_Diagnostic_Session
        DataInfo_DataInfo_225104_FD_CAN14_Tx_Signals_Read (DcmDspDataInfo): DcmDspDataFixedLength=true
        DidInfo_DidInfo_22200B_Time_First_DTC_Detection (DcmDspDidInfo)
          DcmDspDidAccess
            DcmDspDidRead: DcmDspDidReadSessionRef=Default_Session, DcmDspDidReadSessionRef=Extended_Diagnostic_Session
        Data_22FD20_ECU_PinStates_Read (DcmDspData):
          DcmDspDataSize = 16
          DcmDspDataType = UINT8_N
          DcmDspDataUsePort = USE_DATA_ASYNCH_CLIENT_SERVER
          DcmDspDataConditionCheckReadFncUsed = false
          DcmDspDataInfoRef = DataInfo_DataInfo_22FD20_ECU_PinStates_Read
        DataInfo_DataInfo_22F1A0_System_Identification_Data (DcmDspDataInfo): DcmDspDataFixedLength=true
        DataInfo_DataInfo_221009_ECU_Time_Since_Ignition_ON (DcmDspDataInfo): DcmDspDataFixedLength=true
        Data_22F187_CODEP_ECU_Part_Number (DcmDspData):
          DcmDspDataSize = 88
          DcmDspDataType = UINT8_N
          DcmDspDataUsePort = USE_DATA_ASYNCH_CLIENT_SERVER
          DcmDspDataConditionCheckReadFncUsed = false
          DcmDspDataInfoRef = DataInfo_DataInfo_22F187_CODEP_ECU_Part_Number
        DidInfo_DidInfo_22FDF0_ECU_shutdown_process_Read (DcmDspDidInfo)
          DcmDspDidAccess
            DcmDspDidWrite: DcmDspDidWriteSessionRef=Default_Session, DcmDspDidWriteSessionRef=Extended_Diagnostic_Session
            DcmDspDidRead: DcmDspDidReadSessionRef=Default_Session, DcmDspDidReadSessionRef=Extended_Diagnostic_Session
        DidInfo_DidInfo_22FD48_PCBA_Temperature_Read (DcmDspDidInfo)
          DcmDspDidAccess
            DcmDspDidRead: DcmDspDidReadSessionRef=Default_Session, DcmDspDidReadSessionRef=Extended_Diagnostic_Session
        Data_221004_Battery_Voltage (DcmDspData):
          DcmDspDataSize = 8
          DcmDspDataType = UINT8_N
          DcmDspDataUsePort = USE_DATA_ASYNCH_CLIENT_SERVER
          DcmDspDataConditionCheckReadFncUsed = false
          DcmDspDataInfoRef = DataInfo_DataInfo_221004_Battery_Voltage
        DataInfo_DataInfo_22FD48_PCBA_Temperature_Read (DcmDspDataInfo): DcmDspDataFixedLength=true
        DidInfo_DidInfo_22FD16_Magna_Production_ICT_Data_Read (DcmDspDidInfo)
          DcmDspDidAccess
            DcmDspDidRead: DcmDspDidReadSessionRef=Default_Session, DcmDspDidReadSessionRef=Extended_Diagnostic_Session
        DID_22FD61_Vehicle_Variant_Coding_Data_Read (DcmDspDid):
          DcmDspDidIdentifier = 64865
          DcmDspDidUsed = true
          DcmDspDidUsePort = USE_DATA_ELEMENT_SPECIFIC_INTERFACES
          DcmDspDidInfoRef = DidInfo_DidInfo_22FD61_Vehicle_Variant_Coding_Data_Read
          DcmDspDidSignal: DcmDspDidDataPos=0, DcmDspDidDataRef=Data_22FD61_Vehicle_Variant_Coding_Data_Read
        RoutineInfo_RoutineInfo_31015101_Sensor_Functional_Test_Start (DcmDspRoutineInfo)
          DcmDspRoutineAuthorization: DcmDspRoutineSessionRef=Extended_Diagnostic_Session, DcmDspRoutineModeRuleRef=VehicleSpeedCheckRule
        DID_22FD33_Magna_Testing_2_Read (DcmDspDid):
          DcmDspDidIdentifier = 64819
          DcmDspDidUsed = true
          DcmDspDidUsePort = USE_DATA_ELEMENT_SPECIFIC_INTERFACES
          DcmDspDidInfoRef = DidInfo_DidInfo_22FD33_Magna_Testing_2_Read
          DcmDspDidSignal: DcmDspDidDataPos=0, DcmDspDidDataRef=Data_22FD33_Magna_Testing_2_Read
        DidInfo_DidInfo_22FD2E_USS_Sensor_ID_Murata_SN_Read (DcmDspDidInfo)
          DcmDspDidAccess
            DcmDspDidRead: DcmDspDidReadSessionRef=Default_Session, DcmDspDidReadSessionRef=Extended_Diagnostic_Session
        DidInfo_DidInfo_225105_FD_CAN2_Tx_Signals_Read (DcmDspDidInfo)
          DcmDspDidAccess
            DcmDspDidRead: DcmDspDidReadSessionRef=Extended_Diagnostic_Session, DcmDspDidReadSecurityLevelRef=Authenticated_Diagnostic_Access
        DID_22F181_Application_Software_Identification (DcmDspDid):
          DcmDspDidIdentifier = 61825
          DcmDspDidUsed = true
          DcmDspDidUsePort = USE_DATA_ELEMENT_SPECIFIC_INTERFACES
          DcmDspDidInfoRef = DidInfo_DidInfo_22F181_Application_Software_Identification
          DcmDspDidSignal: DcmDspDidDataPos=0, DcmDspDidDataRef=Data_22F181_Application_Software_Identification
        DataInfo_DataInfo_22FD46_Camera_Power_Supply_Read (DcmDspDataInfo): DcmDspDataFixedLength=true
        Data_22FD28_USS_Ringing_Frequency_Read (DcmDspData):
          DcmDspDataSize = 192
          DcmDspDataType = UINT8_N
          DcmDspDataUsePort = USE_DATA_ASYNCH_CLIENT_SERVER
          DcmDspDataConditionCheckReadFncUsed = false
          DcmDspDataInfoRef = DataInfo_DataInfo_22FD28_USS_Ringing_Frequency_Read
        DataInfo_DataInfo_22442A_USS_Sensor_10_Part_Number_Read (DcmDspDataInfo): DcmDspDataFixedLength=true
        Data_225302_Rear_Braking_Event_3_Read (DcmDspData):
          DcmDspDataSize = 112
          DcmDspDataType = UINT8_N
          DcmDspDataUsePort = USE_DATA_ASYNCH_CLIENT_SERVER
          DcmDspDataConditionCheckReadFncUsed = false
          DcmDspDataInfoRef = DataInfo_DataInfo_225302_Rear_Braking_Event_3_Read
        Routine_31012000_Original_VIN_Lock (DcmDspRoutine):
          DcmDspRequestResultsRoutineSupported = false
          DcmDspStopRoutineSupported = false
          DcmDspRoutineIdentifier = 8192
          DcmDspRoutineFixedLength = false
          DcmDspRoutineUsePort = true
          DcmDspRoutineUsed = true
          DcmDspRoutineInfoRef = RoutineInfo_RoutineInfo_31012000_Original_VIN_Lock
        DataInfo_DataInfo_22F1A2_Vector_Delivery_ID (DcmDspDataInfo): DcmDspDataFixedLength=true
        DID_224427_USS_Sensor_7_Part_Number_Read (DcmDspDid):
          DcmDspDidIdentifier = 17447
          DcmDspDidUsed = true
          DcmDspDidUsePort = USE_DATA_ELEMENT_SPECIFIC_INTERFACES
          DcmDspDidInfoRef = DidInfo_DidInfo_224427_USS_Sensor_7_Part_Number_Read
          DcmDspDidSignal: DcmDspDidDataPos=0, DcmDspDidDataRef=Data_224427_USS_Sensor_7_Part_Number_Read
        DID_22F188_FCA_ESLM_ECU_Software_Number (DcmDspDid):
          DcmDspDidIdentifier = 61832
          DcmDspDidUsed = true
          DcmDspDidUsePort = USE_DATA_ELEMENT_SPECIFIC_INTERFACES
          DcmDspDidInfoRef = DidInfo_DidInfo_22F188_FCA_ESLM_ECU_Software_Number
          DcmDspDidSignal: DcmDspDidDataPos=0, DcmDspDidDataRef=Data_22F188_FCA_ESLM_ECU_Software_Number
        3 x DcmDspDataInfo, all with DcmDspDataFixedLength=true:
          DataInfo_DataInfo_224422_USS_Sensor2_Part_Number_Read
          DataInfo_DataInfo_225501_Trailer_coupler_sense_detection_Function_Data_Read
          DataInfo_DataInfo_222008_ECU_Life_Time_Not_Volatile_Memory
        DID_22442C_USS_Sensor_12_Part_Number_Read (DcmDspDid):
          DcmDspDidIdentifier = 17452
          DcmDspDidUsed = true
          DcmDspDidUsePort = USE_DATA_ELEMENT_SPECIFIC_INTERFACES
          DcmDspDidInfoRef = DidInfo_DidInfo_22442C_USS_Sensor_12_Part_Number_Read
          DcmDspDidSignal: DcmDspDidDataPos=0, DcmDspDidDataRef=Data_22442C_USS_Sensor_12_Part_Number_Read
        DidInfo_DidInfo_222003_Boot_Software_Programming_Attempt_Counter (DcmDspDidInfo)
          DcmDspDidAccess
            DcmDspDidRead
        DID_224426_USS_Sensor_6_Part_Number_Read (DcmDspDid):
          DcmDspDidIdentifier = 17446
          DcmDspDidUsed = true
          DcmDspDidUsePort = USE_DATA_ELEMENT_SPECIFIC_INTERFACES
          DcmDspDidInfoRef = DidInfo_DidInfo_224426_USS_Sensor_6_Part_Number_Read
          DcmDspDidSignal: DcmDspDidDataPos=0, DcmDspDidDataRef=Data_224426_USS_Sensor_6_Part_Number_Read
        DataInfo_DataInfo_22FD61_Vehicle_Variant_Coding_Data_Read (DcmDspDataInfo): DcmDspDataFixedLength=true
        3 x DcmDspDidInfo:
          DidInfo_DidInfo_22F1B4_Application_Software_Fingerprint_Reading_Information
            DcmDspDidAccess
              DcmDspDidRead
          DidInfo_DidInfo_22100B_Diagnostic_Tool_and_Session_Status
            DcmDspDidAccess
              DcmDspDidRead
          DidInfo_DidInfo_222013_VIN_Lock_State_Read
            DcmDspDidAccess
              DcmDspDidRead: DcmDspDidReadSessionRef=Default_Session, DcmDspDidReadSessionRef=Extended_Diagnostic_Session
        DID_22F10B_ECU_Qualification (DcmDspDid):
          DcmDspDidIdentifier = 61707
          DcmDspDidUsed = true
          DcmDspDidUsePort = USE_DATA_ELEMENT_SPECIFIC_INTERFACES
          DcmDspDidInfoRef = DidInfo_DidInfo_22F10B_ECU_Qualification
          DcmDspDidSignal: DcmDspDidDataPos=0, DcmDspDidDataRef=Data_22F10B_ECU_Qualification
        Data_22FD0D_Left_Camera_Data_EEPROM_Read (DcmDspData):
          DcmDspDataSize = 2048
          DcmDspDataType = UINT8_N
          DcmDspDataUsePort = USE_DATA_ASYNCH_CLIENT_SERVER
          DcmDspDataConditionCheckReadFncUsed = false
          DcmDspDataInfoRef = DataInfo_DataInfo_22FD0D_Left_Camera_Data_EEPROM_Read
        Data_22F110_ECU_Diagnostic_Identification (DcmDspData):
          DcmDspDataSize = 80
          DcmDspDataType = UINT8_N
          DcmDspDataUsePort = USE_DATA_ASYNCH_CLIENT_SERVER
          DcmDspDataConditionCheckReadFncUsed = false
          DcmDspDataInfoRef = DataInfo_DataInfo_22F110_ECU_Diagnostic_Identification
        DidInfo_DidInfo_225301_Rear_Braking_Event_2_Read (DcmDspDidInfo)
          DcmDspDidAccess
            DcmDspDidRead: DcmDspDidReadSessionRef=Default_Session, DcmDspDidReadSessionRef=Extended_Diagnostic_Session
        DID_225201_Plant_Mode_Status_Read (DcmDspDid):
          DcmDspDidIdentifier = 20993
          DcmDspDidUsed = true
          DcmDspDidUsePort = USE_DATA_ELEMENT_SPECIFIC_INTERFACES
          DcmDspDidInfoRef = DidInfo_DidInfo_225201_Plant_Mode_Status_Read
          DcmDspDidSignal: DcmDspDidDataPos=0, DcmDspDidDataRef=Data_225201_Plant_Mode_Status_Read
        DidInfo_DidInfo_22FD61_Vehicle_Variant_Coding_Data_Read (DcmDspDidInfo)
          DcmDspDidAccess
            DcmDspDidRead: DcmDspDidReadSessionRef=Default_Session, DcmDspDidReadSessionRef=Extended_Diagnostic_Session
        Data_22F195_Supplier_ECU_Software_Version_Number (DcmDspData):
          DcmDspDataSize = 16
          DcmDspDataType = UINT8_N
          DcmDspDataUsePort = USE_DATA_ASYNCH_CLIENT_SERVER
          DcmDspDataConditionCheckReadFncUsed = false
          DcmDspDataInfoRef = DataInfo_DataInfo_22F195_Supplier_ECU_Software_Version_Number
        DataInfo_DataInfo_225302_Rear_Braking_Event_3_Read (DcmDspDataInfo): DcmDspDataFixedLength=true
        DataInfo_DataInfo_22292E_PROXI_Write_Counter (DcmDspDataInfo): DcmDspDataFixedLength=true
        Data_22F134_CODEP_assembly_part_number (DcmDspData):
          DcmDspDataSize = 88
          DcmDspDataType = UINT8_N
          DcmDspDataUsePort = USE_DATA_ASYNCH_CLIENT_SERVER
          DcmDspDataConditionCheckReadFncUsed = false
          DcmDspDataInfoRef = DataInfo_DataInfo_22F134_CODEP_assembly_part_number
        DataInfo_DataInfo_221004_Battery_Voltage (DcmDspDataInfo): DcmDspDataFixedLength=true
        DID_222008_ECU_Life_Time_Not_Volatile_Memory (DcmDspDid):
          DcmDspDidIdentifier = 8200
          DcmDspDidUsed = true
          DcmDspDidUsePort = USE_DATA_ELEMENT_SPECIFIC_INTERFACES
          DcmDspDidInfoRef = DidInfo_DidInfo_222008_ECU_Life_Time_Not_Volatile_Memory
          DcmDspDidSignal: DcmDspDidDataPos=0, DcmDspDidDataRef=Data_222008_ECU_Life_Time_Not_Volatile_Memory
        DataInfo_DataInfo_22200D_Odometer_Last_Clear_Data_Trouble_Code_DTC (DcmDspDataInfo): DcmDspDataFixedLength=true
        Data_22F180_Boot_Software_Version_Information (DcmDspData):
          DcmDspDataSize = 112
          DcmDspDataType = UINT8_N
          DcmDspDataUsePort = USE_DATA_ASYNCH_CLIENT_SERVER
          DcmDspDataConditionCheckReadFncUsed = false
          DcmDspDataInfoRef = DataInfo_DataInfo_22F180_Boot_Software_Version_Information
        DID_22F18A_FCA_ESLM_ECU_Software_Calibration_Number (DcmDspDid):
          DcmDspDidIdentifier = 61834
          DcmDspDidUsed = true
          DcmDspDidUsePort = USE_DATA_ELEMENT_SPECIFIC_INTERFACES
          DcmDspDidInfoRef = DidInfo_DidInfo_22F18A_FCA_ESLM_ECU_Software_Calibration_Number
          DcmDspDidSignal: DcmDspDidDataPos=0, DcmDspDidDataRef=Data_22F18A_FCA_ESLM_ECU_Software_Calibration_Number
        Data_222003_Boot_Software_Programming_Attempt_Counter (DcmDspData):
          DcmDspDataSize = 32
          DcmDspDataType = UINT8_N
          DcmDspDataUsePort = USE_DATA_ASYNCH_CLIENT_SERVER
          DcmDspDataConditionCheckReadFncUsed = false
          DcmDspDataInfoRef = DataInfo_DataInfo_222003_Boot_Software_Programming_Attempt_Counter
        Routine_31015401_Camera_Service_Calibration_Start (DcmDspRoutine):
          DcmDspRequestResultsRoutineSupported = true
          DcmDspStopRoutineSupported = false
          DcmDspRoutineIdentifier = 21505
          DcmDspRoutineFixedLength = false
          DcmDspRoutineUsePort = true
          DcmDspRoutineUsed = true
          DcmDspRoutineInfoRef = RoutineInfo_RoutineInfo_31015401_Camera_Service_Calibration_Start
        RoutineInfo_RoutineInfo_31015400_Camera_EOL_Calibration_Start (DcmDspRoutineInfo)
          DcmDspRoutineRequestResOut
            Out_ResData (DcmDspRoutineRequestResOutSignal): DcmDspRoutineSignalLength=64, DcmDspRoutineSignalType=UINT8_N, DcmDspRoutineSignalEndianness=opaque, DcmDspRoutineSignalPos=0
          DcmDspStartRoutineIn
            In_ReqData (DcmDspStartRoutineInSignal): DcmDspRoutineSignalLength=8, DcmDspRoutineSignalType=UINT8_N, DcmDspRoutineSignalEndianness=opaque, DcmDspRoutineSignalPos=0
          DcmDspRoutineAuthorization: DcmDspRoutineSessionRef=Extended_Diagnostic_Session
          DcmDspStartRoutineOut
            Out_ResData (DcmDspStartRoutineOutSignal): DcmDspRoutineSignalLength=8, DcmDspRoutineSignalType=UINT8_N, DcmDspRoutineSignalEndianness=opaque, DcmDspRoutineSignalPos=0
        3 x DcmDspDidInfo:
          DidInfo_DidInfo_222008_ECU_Life_Time_Not_Volatile_Memory
            DcmDspDidAccess
              DcmDspDidRead: DcmDspDidReadSessionRef=Default_Session, DcmDspDidReadSessionRef=Extended_Diagnostic_Session
          DidInfo_DidInfo_220107_RoE_Activation_State
            DcmDspDidAccess
              DcmDspDidWrite: DcmDspDidWriteSessionRef=Extended_Diagnostic_Session, DcmDspDidWriteSecurityLevelRef=Authenticated_Diagnostic_Access
              DcmDspDidRead: DcmDspDidReadSessionRef=Default_Session, DcmDspDidReadSessionRef=Extended_Diagnostic_Session
          DidInfo_DidInfo_22F1A6_Message_Matrix
            DcmDspDidAccess
              DcmDspDidRead: DcmDspDidReadSessionRef=Default_Session, DcmDspDidReadSessionRef=Extended_Diagnostic_Session
        DID_224425_USS_Sensor_5_Part_Number_Read (DcmDspDid):
          DcmDspDidIdentifier = 17445
          DcmDspDidUsed = true
          DcmDspDidUsePort = USE_DATA_ELEMENT_SPECIFIC_INTERFACES
          DcmDspDidInfoRef = DidInfo_DidInfo_224425_USS_Sensor_5_Part_Number_Read
          DcmDspDidSignal: DcmDspDidDataPos=0, DcmDspDidDataRef=Data_224425_USS_Sensor_5_Part_Number_Read
        DataInfo_DataInfo_222001_Odometer (DcmDspDataInfo): DcmDspDataFixedLength=true
        DataInfo_DataInfo_22FD2D_USS_Sensor_ID_IME_SN_Read (DcmDspDataInfo): DcmDspDataFixedLength=true
        DID_22F122_Software_EBOM_Part_Number (DcmDspDid):
          DcmDspDidIdentifier = 61730
          DcmDspDidUsed = true
          DcmDspDidUsePort = USE_DATA_ELEMENT_SPECIFIC_INTERFACES
          DcmDspDidInfoRef = DidInfo_DidInfo_22F122_Software_EBOM_Part_Number
          DcmDspDidSignal: DcmDspDidDataPos=0, DcmDspDidDataRef=Data_22F122_Software_EBOM_Part_Number
        DID_225105_FD_CAN2_Tx_Signals_Read (DcmDspDid):
          DcmDspDidIdentifier = 20741
          DcmDspDidUsed = true
          DcmDspDidUsePort = USE_DATA_ELEMENT_SPECIFIC_INTERFACES
          DcmDspDidInfoRef = DidInfo_DidInfo_225105_FD_CAN2_Tx_Signals_Read
          DcmDspDidSignal: DcmDspDidDataPos=0, DcmDspDidDataRef=Data_225105_FD_CAN2_Tx_Signals_Read
        Data_22FD2D_USS_Sensor_ID_IME_SN_Read (DcmDspData):
          DcmDspDataSize = 384
          DcmDspDataType = UINT8_N
          DcmDspDataUsePort = USE_DATA_ASYNCH_CLIENT_SERVER
          DcmDspDataConditionCheckReadFncUsed = false
          DcmDspDataInfoRef = DataInfo_DataInfo_22FD2D_USS_Sensor_ID_IME_SN_Read
        DID_22F1A0_System_Identification_Data (DcmDspDid):
          DcmDspDidIdentifier = 61856
          DcmDspDidUsed = true
          DcmDspDidUsePort = USE_DATA_ELEMENT_SPECIFIC_INTERFACES
          DcmDspDidInfoRef = DidInfo_DidInfo_22F1A0_System_Identification_Data
          DcmDspDidSignal: DcmDspDidDataPos=0, DcmDspDidDataRef=Data_22F1A0_System_Identification_Data
        DID_22FD0F_Right_Camera_Data_EEPROM_Read (DcmDspDid):
          DcmDspDidIdentifier = 64783
          DcmDspDidUsed = true
          DcmDspDidUsePort = USE_DATA_ELEMENT_SPECIFIC_INTERFACES
          DcmDspDidInfoRef = DidInfo_DidInfo_22FD0F_Right_Camera_Data_EEPROM_Read
          DcmDspDidSignal: DcmDspDidDataPos=0, DcmDspDidDataRef=Data_22FD0F_Right_Camera_Data_EEPROM_Read
        DidInfo_DidInfo_22102A_Check_EOL_Configuration_Data (DcmDspDidInfo)
          DcmDspDidAccess
            DcmDspDidRead: DcmDspDidReadSessionRef=Default_Session, DcmDspDidReadSessionRef=Extended_Diagnostic_Session
        Data_220107_RoE_Activation_State (DcmDspData):
          DcmDspDataSize = 8
          DcmDspDataType = UINT8_N
          DcmDspDataUsePort = USE_DATA_ASYNCH_CLIENT_SERVER
          DcmDspDataConditionCheckReadFncUsed = false
          DcmDspDataInfoRef = DataInfo_DataInfo_220107_RoE_Activation_State
        DID_224424_USS_Sensor_4_Part_Number_Read (DcmDspDid):
          DcmDspDidIdentifier = 17444
          DcmDspDidUsed = true
          DcmDspDidUsePort = USE_DATA_ELEMENT_SPECIFIC_INTERFACES
          DcmDspDidInfoRef = DidInfo_DidInfo_224424_USS_Sensor_4_Part_Number_Read
          DcmDspDidSignal: DcmDspDidDataPos=0, DcmDspDidDataRef=Data_224424_USS_Sensor_4_Part_Number_Read
        DID_221008_ECU_Life_Time (DcmDspDid):
          DcmDspDidIdentifier = 4104
          DcmDspDidUsed = true
          DcmDspDidUsePort = USE_DATA_ELEMENT_SPECIFIC_INTERFACES
          DcmDspDidInfoRef = DidInfo_DidInfo_221008_ECU_Life_Time
          DcmDspDidSignal: DcmDspDidDataPos=0, DcmDspDidDataRef=Data_221008_ECU_Life_Time
        Data_2EF184_Application_Software_Fingerprint_writing_information (DcmDspData):
          DcmDspDataSize = 112
          DcmDspDataType = UINT8_N
          DcmDspDataUsePort = USE_DATA_ASYNCH_CLIENT_SERVER
          DcmDspDataConditionCheckReadFncUsed = false
          DcmDspDataInfoRef = DataInfo_DataInfo_2EF184_Application_Software_Fingerprint_writing_information
        DID_22F194_Supplier_ECU_Software_Part_Number (DcmDspDid):
          DcmDspDidIdentifier = 61844
          DcmDspDidUsed = true
          DcmDspDidUsePort = USE_DATA_ELEMENT_SPECIFIC_INTERFACES
          DcmDspDidInfoRef = DidInfo_DidInfo_22F194_Supplier_ECU_Software_Part_Number
          DcmDspDidSignal: DcmDspDidDataPos=0, DcmDspDidDataRef=Data_22F194_Supplier_ECU_Software_Part_Number
        DidInfo_DidInfo_224422_USS_Sensor2_Part_Number_Read (DcmDspDidInfo)
          DcmDspDidAccess
            DcmDspDidRead: DcmDspDidReadSessionRef=Default_Session, DcmDspDidReadSessionRef=Extended_Diagnostic_Session
        DidInfo_DidInfo_22FD07_OC_Result_Read (DcmDspDidInfo)
          DcmDspDidAccess
            DcmDspDidRead: DcmDspDidReadSessionRef=Default_Session, DcmDspDidReadSessionRef=Extended_Diagnostic_Session
        DID_224423_USS_Sensor_3_Part_Number_Read (DcmDspDid):
          DcmDspDidIdentifier = 17443
          DcmDspDidUsed = true
          DcmDspDidUsePort = USE_DATA_ELEMENT_SPECIFIC_INTERFACES
          DcmDspDidInfoRef = DidInfo_DidInfo_224423_USS_Sensor_3_Part_Number_Read
          DcmDspDidSignal: DcmDspDidDataPos=0, DcmDspDidDataRef=Data_224423_USS_Sensor_3_Part_Number_Read
        DataInfo_DataInfo_22FD42_Failsafe_Behaviour_Read (DcmDspDataInfo): DcmDspDataFixedLength=true
        Data_22F18B_FCA_ESLM_ECU_Software_Application_Number (DcmDspData):
          DcmDspDataSize = 80
          DcmDspDataType = UINT8_N
          DcmDspDataUsePort = USE_DATA_ASYNCH_CLIENT_SERVER
          DcmDspDataConditionCheckReadFncUsed = false
          DcmDspDataInfoRef = DataInfo_DataInfo_22F18B_FCA_ESLM_ECU_Software_Application_Number
        DidInfo_DidInfo_22442C_USS_Sensor_12_Part_Number_Read (DcmDspDidInfo)
          DcmDspDidAccess
            DcmDspDidRead: DcmDspDidReadSessionRef=Default_Session, DcmDspDidReadSessionRef=Extended_Diagnostic_Session
        DID_22FD2E_USS_Sensor_ID_Murata_SN_Read (DcmDspDid):
          DcmDspDidIdentifier = 64814
          DcmDspDidUsed = true
          DcmDspDidUsePort = USE_DATA_ELEMENT_SPECIFIC_INTERFACES
          DcmDspDidInfoRef = DidInfo_DidInfo_22FD2E_USS_Sensor_ID_Murata_SN_Read
          DcmDspDidSignal: DcmDspDidDataPos=0, DcmDspDidDataRef=Data_22FD2E_USS_Sensor_ID_Murata_SN_Read
        Routine_3101FF01_checkProgrammingDependencies_FlashChecksum_Start (DcmDspRoutine):
          DcmDspRequestResultsRoutineSupported = false
          DcmDspStopRoutineSupported = false
          DcmDspRoutineIdentifier = 65281
          DcmDspRoutineFixedLength = false
          DcmDspRoutineUsePort = true
          DcmDspRoutineUsed = true
          DcmDspRoutineInfoRef = RoutineInfo_RoutineInfo_3101FF01_checkProgrammingDependencies_FlashChecksum_Start
        DidInfo_DidInfo_22FD47_SoC_Temperature_0xFD47_Read (DcmDspDidInfo)
          DcmDspDidAccess
            DcmDspDidRead: DcmDspDidReadSessionRef=Default_Session, DcmDspDidReadSessionRef=Extended_Diagnostic_Session
        DataInfo_DataInfo_22200C_Time_Since_Ignition_ON_of_first_DTC_Detection (DcmDspDataInfo): DcmDspDataFixedLength=true
        Data_22FD48_PCBA_Temperature_Read (DcmDspData):
          DcmDspDataSize = 32
          DcmDspDataType = UINT8_N
          DcmDspDataUsePort = USE_DATA_ASYNCH_CLIENT_SERVER
          DcmDspDataConditionCheckReadFncUsed = false
          DcmDspDataInfoRef = DataInfo_DataInfo_22FD48_PCBA_Temperature_Read
        DataInfo_DataInfo_22F180_Boot_Software_Version_Information (DcmDspDataInfo): DcmDspDataFixedLength=true
        Data_225301_Rear_Braking_Event_2_Read (DcmDspData):
          DcmDspDataSize = 112
          DcmDspDataType = UINT8_N
          DcmDspDataUsePort = USE_DATA_ASYNCH_CLIENT_SERVER
          DcmDspDataConditionCheckReadFncUsed = false
          DcmDspDataInfoRef = DataInfo_DataInfo_225301_Rear_Braking_Event_2_Read
        DidInfo_DidInfo_225302_Rear_Braking_Event_3_Read (DcmDspDidInfo)
          DcmDspDidAccess
            DcmDspDidRead: DcmDspDidReadSessionRef=Default_Session, DcmDspDidReadSessionRef=Extended_Diagnostic_Session
        DID_22F1A6_Message_Matrix (DcmDspDid):
          DcmDspDidIdentifier = 61862
          DcmDspDidUsed = true
          DcmDspDidUsePort = USE_DATA_ELEMENT_SPECIFIC_INTERFACES
          DcmDspDidInfoRef = DidInfo_DidInfo_22F1A6_Message_Matrix
          DcmDspDidSignal: DcmDspDidDataPos=0, DcmDspDidDataRef=Data_22F1A6_Message_Matrix
        DidInfo_DidInfo_22F1B5_Application_Data_Software_Fingerprint_Reading_Information (DcmDspDidInfo)
          DcmDspDidAccess
            DcmDspDidRead
        Routine_3101FF00_FlashErase_Start (DcmDspRoutine):
          DcmDspRequestResultsRoutineSupported = false
          DcmDspStopRoutineSupported = false
          DcmDspRoutineIdentifier = 65280
          DcmDspRoutineFixedLength = false
          DcmDspRoutineUsePort = true
          DcmDspRoutineUsed = true
          DcmDspRoutineInfoRef = RoutineInfo_RoutineInfo_3101FF00_FlashErase_Start
        DID_222945_Flow_Control_Test (DcmDspDid):
          DcmDspDidIdentifier = 10565
          DcmDspDidUsed = true
          DcmDspDidUsePort = USE_DATA_ELEMENT_SPECIFIC_INTERFACES
          DcmDspDidInfoRef = DidInfo_DidInfo_222945_Flow_Control_Test
          DcmDspDidSignal: DcmDspDidDataPos=0, DcmDspDidDataRef=Data_222945_Flow_Control_Test
        Data_22F1B5_Application_Data_Software_Fingerprint_Reading_Information (DcmDspData):
          DcmDspDataSize = 344
          DcmDspDataType = UINT8_N
          DcmDspDataUsePort = USE_DATA_ASYNCH_CLIENT_SERVER
          DcmDspDataConditionCheckReadFncUsed = false
          DcmDspDataInfoRef = DataInfo_DataInfo_22F1B5_Application_Data_Software_Fingerprint_Reading_Information
        DataInfo_DataInfo_22F187_CODEP_ECU_Part_Number (DcmDspDataInfo): DcmDspDataFixedLength=true
        DidInfo_DidInfo_22FD15_Magna_Production_HW_Number_Read (DcmDspDidInfo)
          DcmDspDidAccess
            DcmDspDidRead: DcmDspDidReadSessionRef=Default_Session, DcmDspDidReadSessionRef=Extended_Diagnostic_Session
        DID_22F186_Active_Diagnostic_Session (DcmDspDid):
          DcmDspDidIdentifier = 61830
          DcmDspDidUsed = true
          DcmDspDidUsePort = USE_DATA_ELEMENT_SPECIFIC_INTERFACES
          DcmDspDidInfoRef = DidInfo_DidInfo_22F186_Active_Diagnostic_Session
          DcmDspDidSignal: DcmDspDidDataPos=0, DcmDspDidDataRef=Data_22F186_Active_Diagnostic_Session
        DataInfo_DataInfo_225303_SPM_Event_Abort_1_Read (DcmDspDataInfo): DcmDspDataFixedLength=true
        DataInfo_DataInfo_22F1B5_Application_Data_Software_Fingerprint_Reading_Information (DcmDspDataInfo): DcmDspDataFixedLength=true
        RoutineInfo_RoutineInfo_3101D003_Application_Logical_Block_Hash (DcmDspRoutineInfo)
          DcmDspStartRoutineIn
            In_ReqData (DcmDspStartRoutineInSignal): DcmDspRoutineSignalLength=8, DcmDspRoutineSignalType=UINT8_N, DcmDspRoutineSignalEndianness=opaque, DcmDspRoutineSignalPos=0
          DcmDspRoutineAuthorization: DcmDspRoutineSessionRef=Programming_Session, DcmDspRoutineSecurityLevelRef=Authenticated_Diagnostic_Access
          DcmDspStartRoutineOut
            Out_ResData (DcmDspStartRoutineOutSignal): DcmDspRoutineSignalLength=256, DcmDspRoutineSignalType=UINT8_N, DcmDspRoutineSignalEndianness=opaque, DcmDspRoutineSignalPos=0
        RoutineInfo_RoutineInfo_3101D001_Disable_Fail_safe_reaction_Start (DcmDspRoutineInfo)
          DcmDspRoutineAuthorization:
            DcmDspRoutineSessionRef = Extended_Diagnostic_Session
            DcmDspRoutineSecurityLevelRef = Authenticated_Diagnostic_Access
            DcmDspRoutineModeRuleRef = VehicleSpeedCheckRule
        DataInfo_DataInfo_225301_Rear_Braking_Event_2_Read (DcmDspDataInfo): DcmDspDataFixedLength=true
        DataInfo_DataInfo_22FD60_ECU_Software_Status_Read (DcmDspDataInfo): DcmDspDataFixedLength=true
        Routine_3101FE01_Calibration_Data_Reset_Start (DcmDspRoutine):
          DcmDspRequestResultsRoutineSupported = false
          DcmDspStopRoutineSupported = false
          DcmDspRoutineIdentifier = 65025
          DcmDspRoutineFixedLength = false
          DcmDspRoutineUsePort = true
          DcmDspRoutineUsed = true
          DcmDspRoutineInfoRef = RoutineInfo_RoutineInfo_3101FE01_Calibration_Data_Reset_Start
        DidInfo_DidInfo_22FD01_Previous_Camera_Calibration_Data (DcmDspDidInfo)
          DcmDspDidAccess
            DcmDspDidRead: DcmDspDidReadSessionRef=Default_Session, DcmDspDidReadSessionRef=Extended_Diagnostic_Session
        DidInfo_DidInfo_22FD1D_PCB_Serial_Number (DcmDspDidInfo)
          DcmDspDidAccess
            DcmDspDidRead: DcmDspDidReadSessionRef=Default_Session, DcmDspDidReadSessionRef=Extended_Diagnostic_Session
        Routine_3101FF03_Test_Read_PMIC_Register_Start (DcmDspRoutine):
          DcmDspRequestResultsRoutineSupported = false
          DcmDspStopRoutineSupported = false
          DcmDspRoutineIdentifier = 65283
          DcmDspRoutineFixedLength = false
          DcmDspRoutineUsePort = true
          DcmDspRoutineUsed = true
          DcmDspRoutineInfoRef = RoutineInfo_RoutineInfo_3101FF03_Test_Read_PMIC_Register_Start
        DidInfo_DidInfo_22FD00_Plant_Camera_Calibration_Data (DcmDspDidInfo)
          DcmDspDidAccess
            DcmDspDidWrite: DcmDspDidWriteSessionRef=Extended_Diagnostic_Session
            DcmDspDidRead: DcmDspDidReadSessionRef=Default_Session, DcmDspDidReadSessionRef=Extended_Diagnostic_Session
        DID_22FD01_Previous_Camera_Calibration_Data (DcmDspDid):
          DcmDspDidIdentifier = 64769
          DcmDspDidUsed = true
          DcmDspDidUsePort = USE_DATA_ELEMENT_SPECIFIC_INTERFACES
          DcmDspDidInfoRef = DidInfo_DidInfo_22FD01_Previous_Camera_Calibration_Data
          DcmDspDidSignal: DcmDspDidDataPos=0, DcmDspDidDataRef=Data_22FD01_Previous_Camera_Calibration_Data
        DID_22FD60_ECU_Software_Status_Read (DcmDspDid):
          DcmDspDidIdentifier = 64864
          DcmDspDidUsed = true
          DcmDspDidUsePort = USE_DATA_ELEMENT_SPECIFIC_INTERFACES
          DcmDspDidInfoRef = DidInfo_DidInfo_22FD60_ECU_Software_Status_Read
          DcmDspDidSignal: DcmDspDidDataPos=0, DcmDspDidDataRef=Data_22FD60_ECU_Software_Status_Read
        Data_22FD38_Programmed_Assembly (DcmDspData):
          DcmDspDataSize = 128
          DcmDspDataType = UINT8_N
          DcmDspDataUsePort = USE_DATA_ASYNCH_CLIENT_SERVER
          DcmDspDataConditionCheckReadFncUsed = false
          DcmDspDataInfoRef = DataInfo_DataInfo_22FD38_Programmed_Assembly
        RoutineInfo_RoutineInfo_3101FF03_Test_Read_PMIC_Register_Start (DcmDspRoutineInfo)
          DcmDspStartRoutineIn
            In_ReqData (DcmDspStartRoutineInSignal): DcmDspRoutineSignalLength=24, DcmDspRoutineSignalType=UINT8_N, DcmDspRoutineSignalEndianness=opaque, DcmDspRoutineSignalPos=0
          DcmDspRoutineAuthorization: DcmDspRoutineSessionRef=Extended_Diagnostic_Session
          DcmDspStartRoutineOut
            Out_ResData (DcmDspStartRoutineOutSignal): DcmDspRoutineSignalLength=16, DcmDspRoutineSignalType=UINT8_N, DcmDspRoutineSignalEndianness=opaque, DcmDspRoutineSignalPos=0
        DataInfo_DataInfo_225305_SPM_Event_Abort_3_Read (DcmDspDataInfo): DcmDspDataFixedLength=true
        Data_22FD1D_PCB_Serial_Number (DcmDspData):
          DcmDspDataSize = 112
          DcmDspDataType = UINT8_N
          DcmDspDataUsePort = USE_DATA_ASYNCH_CLIENT_SERVER
          DcmDspDataConditionCheckReadFncUsed = false
          DcmDspDataInfoRef = DataInfo_DataInfo_22FD1D_PCB_Serial_Number
        3 x DcmDspDataInfo, all with DcmDspDataFixedLength=true:
          DataInfo_DataInfo_22FD38_Programmed_Assembly
          DataInfo_DataInfo_22FD01_Previous_Camera_Calibration_Data
          DataInfo_DataInfo_22FD13_Magna_Software_Version
        DID_22FD14_FD14_Magna_Production_Date_Read (DcmDspDid):
          DcmDspDidIdentifier = 64788
          DcmDspDidUsed = true
          DcmDspDidUsePort = USE_DATA_ELEMENT_SPECIFIC_INTERFACES
          DcmDspDidInfoRef = DidInfo_DidInfo_22FD14_FD14_Magna_Production_Date_Read
          DcmDspDidSignal: DcmDspDidDataPos=0, DcmDspDidDataRef=Data_22FD14_FD14_Magna_Production_Date_Read
        Data_22FD00_Plant_Camera_Calibration_Data (DcmDspData):
          DcmDspDataSize = 432
          DcmDspDataType = UINT8_N
          DcmDspDataUsePort = USE_DATA_ASYNCH_CLIENT_SERVER
          DcmDspDataConditionCheckReadFncUsed = false
          DcmDspDataInfoRef = DataInfo_DataInfo_22FD00_Plant_Camera_Calibration_Data
        DataInfo_DataInfo_22FD1D_PCB_Serial_Number (DcmDspDataInfo): DcmDspDataFixedLength=true
        Data_225305_SPM_Event_Abort_3_Read (DcmDspData):
          DcmDspDataSize = 96
          DcmDspDataType = UINT8_N
          DcmDspDataUsePort = USE_DATA_ASYNCH_CLIENT_SERVER
          DcmDspDataConditionCheckReadFncUsed = false
          DcmDspDataInfoRef = DataInfo_DataInfo_225305_SPM_Event_Abort_3_Read
        DataInfo_DataInfo_22FD14_FD14_Magna_Production_Date_Read (DcmDspDataInfo): DcmDspDataFixedLength=true
        DidInfo_DidInfo_22FD14_FD14_Magna_Production_Date_Read (DcmDspDidInfo)
          DcmDspDidAccess
            DcmDspDidRead: DcmDspDidReadSessionRef=Default_Session, DcmDspDidReadSessionRef=Extended_Diagnostic_Session
        DidInfo_DidInfo_22FD13_Magna_Software_Version (DcmDspDidInfo)
          DcmDspDidAccess
            DcmDspDidRead: DcmDspDidReadSessionRef=Default_Session, DcmDspDidReadSessionRef=Extended_Diagnostic_Session
        DataInfo_DataInfo_22FD00_Plant_Camera_Calibration_Data (DcmDspDataInfo): DcmDspDataFixedLength=true
        DID_22FD38_Programmed_Assembly (DcmDspDid):
          DcmDspDidIdentifier = 64824
          DcmDspDidUsed = true
          DcmDspDidUsePort = USE_DATA_ELEMENT_SPECIFIC_INTERFACES
          DcmDspDidInfoRef = DidInfo_DidInfo_22FD38_Programmed_Assembly
          DcmDspDidSignal: DcmDspDidDataPos=0, DcmDspDidDataRef=Data_22FD38_Programmed_Assembly
        DidInfo_DidInfo_225305_SPM_Event_Abort_3_Read (DcmDspDidInfo)
          DcmDspDidAccess
            DcmDspDidRead: DcmDspDidReadSessionRef=Default_Session, DcmDspDidReadSessionRef=Extended_Diagnostic_Session
        Data_22FD01_Previous_Camera_Calibration_Data (DcmDspData):
          DcmDspDataSize = 400
          DcmDspDataType = UINT8_N
          DcmDspDataUsePort = USE_DATA_ASYNCH_CLIENT_SERVER
          DcmDspDataConditionCheckReadFncUsed = false
          DcmDspDataInfoRef = DataInfo_DataInfo_22FD01_Previous_Camera_Calibration_Data
        DidInfo_DidInfo_22FD60_ECU_Software_Status_Read (DcmDspDidInfo)
          DcmDspDidAccess
            DcmDspDidRead: DcmDspDidReadSessionRef=Default_Session, DcmDspDidReadSessionRef=Extended_Diagnostic_Session
        Data_22FD13_Magna_Software_Version (DcmDspData):
          DcmDspDataSize = 256
          DcmDspDataType = UINT8_N
          DcmDspDataUsePort = USE_DATA_ASYNCH_CLIENT_SERVER
          DcmDspDataConditionCheckReadFncUsed = false
          DcmDspDataInfoRef = DataInfo_DataInfo_22FD13_Magna_Software_Version
        Routine_3101FE0E_Test_Pattern_Control_Start (DcmDspRoutine):
          DcmDspRequestResultsRoutineSupported = false
          DcmDspStopRoutineSupported = true
          DcmDspRoutineIdentifier = 65038
          DcmDspRoutineFixedLength = false
          DcmDspRoutineUsePort = true
          DcmDspRoutineUsed = true
          DcmDspRoutineInfoRef = RoutineInfo_RoutineInfo_3101FE0E_Test_Pattern_Control_Start
        DID_22FD00_Plant_Camera_Calibration_Data (DcmDspDid):
          DcmDspDidIdentifier = 64768
          DcmDspDidUsed = true
          DcmDspDidUsePort = USE_DATA_ELEMENT_SPECIFIC_INTERFACES
          DcmDspDidInfoRef = DidInfo_DidInfo_22FD00_Plant_Camera_Calibration_Data
          DcmDspDidSignal: DcmDspDidDataPos=0, DcmDspDidDataRef=Data_22FD00_Plant_Camera_Calibration_Data
        Data_22FD14_FD14_Magna_Production_Date_Read (DcmDspData):
          DcmDspDataSize = 40
          DcmDspDataType = UINT8_N
          DcmDspDataUsePort = USE_DATA_ASYNCH_CLIENT_SERVER
          DcmDspDataConditionCheckReadFncUsed = false
          DcmDspDataInfoRef = DataInfo_DataInfo_22FD14_FD14_Magna_Production_Date_Read
        RoutineInfo_RoutineInfo_3101FE0E_Test_Pattern_Control_Start (DcmDspRoutineInfo)
          DcmDspStartRoutineIn
            In_ReqData (DcmDspStartRoutineInSignal): DcmDspRoutineSignalLength=16, DcmDspRoutineSignalType=UINT8_N, DcmDspRoutineSignalEndianness=opaque, DcmDspRoutineSignalPos=0
          DcmDspRoutineAuthorization:
            DcmDspRoutineSessionRef = Extended_Diagnostic_Session
            DcmDspRoutineSecurityLevelRef = Authenticated_Diagnostic_Access
            DcmDspRoutineModeRuleRef = VehicleSpeedCheckRule
          DcmDspStartRoutineOut
            Out_ResData (DcmDspStartRoutineOutSignal): DcmDspRoutineSignalLength=16, DcmDspRoutineSignalType=UINT8_N, DcmDspRoutineSignalEndianness=opaque, DcmDspRoutineSignalPos=0
        DidInfo_DidInfo_22FD38_Programmed_Assembly (DcmDspDidInfo)
          DcmDspDidAccess
            DcmDspDidRead
        RoutineInfo_RoutineInfo_3101FE01_Calibration_Data_Reset_Start (DcmDspRoutineInfo)
          DcmDspStartRoutineIn
            In_ReqData (DcmDspStartRoutineInSignal): DcmDspRoutineSignalLength=16, DcmDspRoutineSignalType=UINT8_N, DcmDspRoutineSignalEndianness=opaque, DcmDspRoutineSignalPos=0
          DcmDspRoutineAuthorization:
            DcmDspRoutineSessionRef = Extended_Diagnostic_Session
            DcmDspRoutineSecurityLevelRef = Authenticated_Diagnostic_Access
            DcmDspRoutineModeRuleRef = VehicleSpeedCheckRule
          DcmDspStartRoutineOut
            Out_ResData (DcmDspStartRoutineOutSignal): DcmDspRoutineSignalLength=16, DcmDspRoutineSignalType=UINT8_N, DcmDspRoutineSignalEndianness=opaque, DcmDspRoutineSignalPos=0
        3 x DcmDspDid, all with DcmDspDidUsed=true, DcmDspDidUsePort=USE_DATA_ELEMENT_SPECIFIC_INTERFACES:
          DID_225305_SPM_Event_Abort_3_Read: DcmDspDidIdentifier=21253, DcmDspDidInfoRef=DidInfo_DidInfo_225305_SPM_Event_Abort_3_Read
            DcmDspDidSignal: DcmDspDidDataPos=0, DcmDspDidDataRef=Data_225305_SPM_Event_Abort_3_Read
          DID_22FD1D_PCB_Serial_Number: DcmDspDidIdentifier=64797, DcmDspDidInfoRef=DidInfo_DidInfo_22FD1D_PCB_Serial_Number
            DcmDspDidSignal: DcmDspDidDataPos=0, DcmDspDidDataRef=Data_22FD1D_PCB_Serial_Number
          DID_22FD13_Magna_Software_Version: DcmDspDidIdentifier=64787, DcmDspDidInfoRef=DidInfo_DidInfo_22FD13_Magna_Software_Version
            DcmDspDidSignal: DcmDspDidDataPos=0, DcmDspDidDataRef=Data_22FD13_Magna_Software_Version
        Data_22FD60_ECU_Software_Status_Read (DcmDspData):
          DcmDspDataSize = 112
          DcmDspDataType = UINT8_N
          DcmDspDataUsePort = USE_DATA_ASYNCH_CLIENT_SERVER
          DcmDspDataConditionCheckReadFncUsed = false
          DcmDspDataInfoRef = DataInfo_DataInfo_22FD60_ECU_Software_Status_Read
        Routine_31013000_XCP_Enable_Disable_Start (DcmDspRoutine):
          DcmDspRequestResultsRoutineSupported = false
          DcmDspStopRoutineSupported = false
          DcmDspRoutineIdentifier = 12288
          DcmDspRoutineFixedLength = false
          DcmDspRoutineUsePort = true
          DcmDspRoutineUsed = true
          DcmDspRoutineInfoRef = RoutineInfo_RoutineInfo_31013000_XCP_Enable_Disable_Start
        RoutineInfo_RoutineInfo_31013000_XCP_Enable_Disable_Start (DcmDspRoutineInfo)
          DcmDspStartRoutineIn
            In_ReqData (DcmDspStartRoutineInSignal): DcmDspRoutineSignalLength=8, DcmDspRoutineSignalType=UINT8_N, DcmDspRoutineSignalEndianness=opaque, DcmDspRoutineSignalPos=0
          DcmDspRoutineAuthorization: DcmDspRoutineSessionRef=Extended_Diagnostic_Session, DcmDspRoutineModeRuleRef=VehicleSpeedCheckRule
          DcmDspStartRoutineOut
            Out_ResData (DcmDspStartRoutineOutSignal): DcmDspRoutineSignalLength=8, DcmDspRoutineSignalType=UINT8_N, DcmDspRoutineSignalEndianness=opaque, DcmDspRoutineSignalPos=0
        RoutineInfo_RoutineInfo_31011000_USS_Debug_Signals_Enable_Disable_Start (DcmDspRoutineInfo)
          DcmDspStartRoutineIn
            In_ReqData (DcmDspStartRoutineInSignal): DcmDspRoutineSignalLength=8, DcmDspRoutineSignalType=UINT8_N, DcmDspRoutineSignalEndianness=opaque, DcmDspRoutineSignalPos=0
          DcmDspRoutineAuthorization: DcmDspRoutineSessionRef=Extended_Diagnostic_Session, DcmDspRoutineModeRuleRef=VehicleSpeedCheckRule
          DcmDspStartRoutineOut
            Out_ResData (DcmDspStartRoutineOutSignal): DcmDspRoutineSignalLength=8, DcmDspRoutineSignalType=UINT8_N, DcmDspRoutineSignalEndianness=opaque, DcmDspRoutineSignalPos=0
        Routine_31011000_USS_Debug_Signals_Enable_Disable_Start (DcmDspRoutine):
          DcmDspRequestResultsRoutineSupported = false
          DcmDspStopRoutineSupported = false
          DcmDspRoutineIdentifier = 4096
          DcmDspRoutineFixedLength = false
          DcmDspRoutineUsePort = true
          DcmDspRoutineUsed = true
          DcmDspRoutineInfoRef = RoutineInfo_RoutineInfo_31011000_USS_Debug_Signals_Enable_Disable_Start
        DID_22F111_Public_Certificates_Regional_Support_Read (DcmDspDid):
          DcmDspDidIdentifier = 61713
          DcmDspDidUsed = true
          DcmDspDidUsePort = USE_DATA_ELEMENT_SPECIFIC_INTERFACES
          DcmDspDidInfoRef = DidInfo_DidInfo_22F111_Public_Certificates_Regional_Support_Read
          DcmDspDidSignal: DcmDspDidDataPos=0, DcmDspDidDataRef=Data_22F111_Public_Certificates_Regional_Support_Read
        DataInfo_DataInfo_22295F_DCL_and_Cerstore_Header_Info_Read (DcmDspDataInfo): DcmDspDataFixedLength=true
        DID_222032_Secure_Log_Read (DcmDspDid):
          DcmDspDidIdentifier = 8242
          DcmDspDidUsed = true
          DcmDspDidUsePort = USE_DATA_ELEMENT_SPECIFIC_INTERFACES
          DcmDspDidInfoRef = DidInfo_DidInfo_222032_Secure_Log_Read
          DcmDspDidSignal: DcmDspDidDataPos=0, DcmDspDidDataRef=Data_222032_Secure_Log_Read
        DataInfo_DataInfo_22FD62_ASIL_QM_Fault_Status_Read (DcmDspDataInfo): DcmDspDataFixedLength=true
        DidInfo_DidInfo_22295F_DCL_and_Cerstore_Header_Info_Read (DcmDspDidInfo)
          DcmDspDidAccess
            DcmDspDidRead:
              DcmDspDidReadSessionRef = Programming_Session
              DcmDspDidReadSessionRef = Extended_Diagnostic_Session
              DcmDspDidReadSecurityLevelRef = Authenticated_Diagnostic_Access
        DataInfo_DataInfo_222957_Hosted_App_Firmware_Header_Info_Read (DcmDspDataInfo): DcmDspDataFixedLength=true
        Data_22FD64_ASIL_B_Fault_Status_Read (DcmDspData):
          DcmDspDataSize = 1104
          DcmDspDataType = UINT8_N
          DcmDspDataUsePort = USE_DATA_ASYNCH_CLIENT_SERVER
          DcmDspDataConditionCheckReadFncUsed = false
          DcmDspDataInfoRef = DataInfo_DataInfo_22FD64_ASIL_B_Fault_Status_Read
        3 x DcmDspDidInfo:
          DidInfo_DidInfo_22F111_Public_Certificates_Regional_Support_Read
            DcmDspDidAccess
              DcmDspDidRead:
                DcmDspDidReadSessionRef = Programming_Session
                DcmDspDidReadSessionRef = Extended_Diagnostic_Session
                DcmDspDidReadSecurityLevelRef = Authenticated_Diagnostic_Access
          DidInfo_DidInfo_22295A_Hosted_App_Firmware_Cal_Config_Data_Header_UUID_Read
            DcmDspDidAccess
              DcmDspDidRead:
                DcmDspDidReadSessionRef = Programming_Session
                DcmDspDidReadSessionRef = Extended_Diagnostic_Session
                DcmDspDidReadSecurityLevelRef = Authenticated_Diagnostic_Access
          DidInfo_DidInfo_222957_Hosted_App_Firmware_Header_Info_Read
            DcmDspDidAccess
              DcmDspDidRead:
                DcmDspDidReadSessionRef = Programming_Session
                DcmDspDidReadSessionRef = Extended_Diagnostic_Session
                DcmDspDidReadSecurityLevelRef = Authenticated_Diagnostic_Access
        DID_222959_Hosted_App_Firmware_Cal_Config_Data_Header_Info_Read (DcmDspDid):
          DcmDspDidIdentifier = 10585
          DcmDspDidUsed = true
          DcmDspDidUsePort = USE_DATA_ELEMENT_SPECIFIC_INTERFACES
          DcmDspDidInfoRef = DidInfo_DidInfo_222959_Hosted_App_Firmware_Cal_Config_Data_Header_Info_Read
          DcmDspDidSignal: DcmDspDidDataPos=0, DcmDspDidDataRef=Data_222959_Hosted_App_Firmware_Cal_Config_Data_Header_Info_Read
        DataInfo_DataInfo_22295A_Hosted_App_Firmware_Cal_Config_Data_Header_UUID_Read (DcmDspDataInfo): DcmDspDataFixedLength=true
        DID_22100C_Security_Status_Read (DcmDspDid):
          DcmDspDidIdentifier = 4108
          DcmDspDidUsed = true
          DcmDspDidUsePort = USE_DATA_ELEMENT_SPECIFIC_INTERFACES
          DcmDspDidInfoRef = DidInfo_DidInfo_22100C_Security_Status_Read
          DcmDspDidSignal: DcmDspDidDataPos=0, DcmDspDidDataRef=Data_22100C_Security_Status_Read
        DataInfo_DataInfo_222031_Disallowed_Certificate_List_Read (DcmDspDataInfo): DcmDspDataFixedLength=true
        DataInfo_DataInfo_222032_Secure_Log_Read (DcmDspDataInfo): DcmDspDataFixedLength=true
        DidInfo_DidInfo_222032_Secure_Log_Read (DcmDspDidInfo)
          DcmDspDidAccess
            DcmDspDidRead:
              DcmDspDidReadSessionRef = Programming_Session
              DcmDspDidReadSessionRef = Extended_Diagnostic_Session
              DcmDspDidReadSecurityLevelRef = Authenticated_Diagnostic_Access
        Data_222954_Policy_Type_Read (DcmDspData):
          DcmDspDataSize = 8
          DcmDspDataType = UINT8_N
          DcmDspDataUsePort = USE_DATA_ASYNCH_CLIENT_SERVER
          DcmDspDataConditionCheckReadFncUsed = false
          DcmDspDataInfoRef = DataInfo_DataInfo_222954_Policy_Type_Read
        DID_222954_Policy_Type_Read (DcmDspDid):
          DcmDspDidIdentifier = 10580
          DcmDspDidUsed = true
          DcmDspDidUsePort = USE_DATA_ELEMENT_SPECIFIC_INTERFACES
          DcmDspDidInfoRef = DidInfo_DidInfo_222954_Policy_Type_Read
          DcmDspDidSignal: DcmDspDidDataPos=0, DcmDspDidDataRef=Data_222954_Policy_Type_Read
        DidInfo_DidInfo_222030_Authenticated_Diagnostic_Previous_Access_Read (DcmDspDidInfo)
          DcmDspDidAccess
            DcmDspDidRead:
              DcmDspDidReadSessionRef = Programming_Session
              DcmDspDidReadSessionRef = Extended_Diagnostic_Session
              DcmDspDidReadSecurityLevelRef = Authenticated_Diagnostic_Access
        Data_22100C_Security_Status_Read (DcmDspData):
          DcmDspDataSize = 40
          DcmDspDataType = UINT8_N
          DcmDspDataUsePort = USE_DATA_ASYNCH_CLIENT_SERVER
          DcmDspDataConditionCheckReadFncUsed = false
          DcmDspDataInfoRef = DataInfo_DataInfo_22100C_Security_Status_Read
        3 x DcmDspDidInfo:
          DidInfo_DidInfo_22FD62_ASIL_QM_Fault_Status_Read
            DcmDspDidAccess
              DcmDspDidRead: DcmDspDidReadSessionRef=Default_Session, DcmDspDidReadSessionRef=Extended_Diagnostic_Session
          DidInfo_DidInfo_222958_Hosted_App_firmware_Header_UUID_Read
            DcmDspDidAccess
              DcmDspDidRead:
                DcmDspDidReadSessionRef = Programming_Session
                DcmDspDidReadSessionRef = Extended_Diagnostic_Session
                DcmDspDidReadSecurityLevelRef = Authenticated_Diagnostic_Access
          DidInfo_DidInfo_222959_Hosted_App_Firmware_Cal_Config_Data_Header_Info_Read
            DcmDspDidAccess
              DcmDspDidRead:
                DcmDspDidReadSessionRef = Programming_Session
                DcmDspDidReadSessionRef = Extended_Diagnostic_Session
                DcmDspDidReadSecurityLevelRef = Authenticated_Diagnostic_Access
        DID_222030_Authenticated_Diagnostic_Previous_Access_Read (DcmDspDid):
          DcmDspDidIdentifier = 8240
          DcmDspDidUsed = true
          DcmDspDidUsePort = USE_DATA_ELEMENT_SPECIFIC_INTERFACES
          DcmDspDidInfoRef = DidInfo_DidInfo_222030_Authenticated_Diagnostic_Previous_Access_Read
          DcmDspDidSignal: DcmDspDidDataPos=0, DcmDspDidDataRef=Data_222030_Authenticated_Diagnostic_Previous_Access_Read
        DataInfo_DataInfo_222958_Hosted_App_firmware_Header_UUID_Read (DcmDspDataInfo): DcmDspDataFixedLength=true
        DidInfo_DidInfo_22100C_Security_Status_Read (DcmDspDidInfo)
          DcmDspDidAccess
            DcmDspDidRead
        DataInfo_DataInfo_22100C_Security_Status_Read (DcmDspDataInfo): DcmDspDataFixedLength=true
        DID_2EFD4E_Reset_NVM_Write (DcmDspDid):
          DcmDspDidIdentifier = 64846
          DcmDspDidUsed = true
          DcmDspDidUsePort = USE_DATA_ELEMENT_SPECIFIC_INTERFACES
          DcmDspDidInfoRef = DidInfo_DidInfo_2EFD4E_Reset_NVM_Write
          DcmDspDidSignal: DcmDspDidDataPos=0, DcmDspDidDataRef=Data_2EFD4E_Reset_NVM_Write
        DID_22FD64_ASIL_B_Fault_Status_Read (DcmDspDid):
          DcmDspDidIdentifier = 64868
          DcmDspDidUsed = true
          DcmDspDidUsePort = USE_DATA_ELEMENT_SPECIFIC_INTERFACES
          DcmDspDidInfoRef = DidInfo_DidInfo_22FD64_ASIL_B_Fault_Status_Read
          DcmDspDidSignal: DcmDspDidDataPos=0, DcmDspDidDataRef=Data_22FD64_ASIL_B_Fault_Status_Read
        DataInfo_DataInfo_220108_Authenticated_Diagnostics_Active_Role_Read (DcmDspDataInfo): DcmDspDataFixedLength=true
        Data_22FD62_ASIL_QM_Fault_Status_Read (DcmDspData):
          DcmDspDataSize = 16
          DcmDspDataType = UINT8_N
          DcmDspDataUsePort = USE_DATA_ASYNCH_CLIENT_SERVER
          DcmDspDataConditionCheckReadFncUsed = false
          DcmDspDataInfoRef = DataInfo_DataInfo_22FD62_ASIL_QM_Fault_Status_Read
        DataInfo_DataInfo_22FD64_ASIL_B_Fault_Status_Read (DcmDspDataInfo): DcmDspDataFixedLength=true
        Data_22295A_Hosted_App_Firmware_Cal_Config_Data_Header_UUID_Read (DcmDspData):
          DcmDspDataSize = 256
          DcmDspDataType = UINT8_N
          DcmDspDataUsePort = USE_DATA_ASYNCH_CLIENT_SERVER
          DcmDspDataConditionCheckReadFncUsed = false
          DcmDspDataInfoRef = DataInfo_DataInfo_22295A_Hosted_App_Firmware_Cal_Config_Data_Header_UUID_Read
        DID_220108_Authenticated_Diagnostics_Active_Role_Read (DcmDspDid):
          DcmDspDidIdentifier = 264
          DcmDspDidUsed = true
          DcmDspDidUsePort = USE_DATA_ELEMENT_SPECIFIC_INTERFACES
          DcmDspDidInfoRef = DidInfo_DidInfo_220108_Authenticated_Diagnostics_Active_Role_Read
          DcmDspDidSignal: DcmDspDidDataPos=0, DcmDspDidDataRef=Data_220108_Authenticated_Diagnostics_Active_Role_Read
        Data_220108_Authenticated_Diagnostics_Active_Role_Read (DcmDspData):
          DcmDspDataSize = 32
          DcmDspDataType = UINT8_N
          DcmDspDataUsePort = USE_DATA_ASYNCH_CLIENT_SERVER
          DcmDspDataConditionCheckReadFncUsed = false
          DcmDspDataInfoRef = DataInfo_DataInfo_220108_Authenticated_Diagnostics_Active_Role_Read
        DidInfo_DidInfo_2EFD4E_Reset_NVM_Write (DcmDspDidInfo)
          DcmDspDidAccess
            DcmDspDidWrite: DcmDspDidWriteSessionRef=Extended_Diagnostic_Session
        DID_22295F_DCL_and_Cerstore_Header_Info_Read (DcmDspDid):
          DcmDspDidIdentifier = 10591
          DcmDspDidUsed = true
          DcmDspDidUsePort = USE_DATA_ELEMENT_SPECIFIC_INTERFACES
          DcmDspDidInfoRef = DidInfo_DidInfo_22295F_DCL_and_Cerstore_Header_Info_Read
          DcmDspDidSignal: DcmDspDidDataPos=0, DcmDspDidDataRef=Data_22295F_DCL_and_Cerstore_Header_Info_Read
        DID_222031_Disallowed_Certificate_List_Read (DcmDspDid):
          DcmDspDidIdentifier = 8241
          DcmDspDidUsed = true
          DcmDspDidUsePort = USE_DATA_ELEMENT_SPECIFIC_INTERFACES
          DcmDspDidInfoRef = DidInfo_DidInfo_222031_Disallowed_Certificate_List_Read
          DcmDspDidSignal: DcmDspDidDataPos=0, DcmDspDidDataRef=Data_222031_Disallowed_Certificate_List_Read
        Data_222030_Authenticated_Diagnostic_Previous_Access_Read (DcmDspData):
          DcmDspDataSize = 7680
          DcmDspDataType = UINT8_N
          DcmDspDataUsePort = USE_DATA_ASYNCH_CLIENT_SERVER
          DcmDspDataConditionCheckReadFncUsed = false
          DcmDspDataInfoRef = DataInfo_DataInfo_222030_Authenticated_Diagnostic_Previous_Access_Read
        DataInfo_DataInfo_222030_Authenticated_Diagnostic_Previous_Access_Read (DcmDspDataInfo): DcmDspDataFixedLength=true
        DataInfo_DataInfo_222954_Policy_Type_Read (DcmDspDataInfo): DcmDspDataFixedLength=true
        DidInfo_DidInfo_222954_Policy_Type_Read (DcmDspDidInfo)
          DcmDspDidAccess
            DcmDspDidRead
        Data_22F111_Public_Certificates_Regional_Support_Read (DcmDspData):
          DcmDspDataSize = 8
          DcmDspDataType = UINT8_N
          DcmDspDataUsePort = USE_DATA_ASYNCH_CLIENT_SERVER
          DcmDspDataConditionCheckReadFncUsed = false
          DcmDspDataInfoRef = DataInfo_DataInfo_22F111_Public_Certificates_Regional_Support_Read
        Data_222032_Secure_Log_Read (DcmDspData):
          DcmDspDataSize = 10368
          DcmDspDataType = UINT8_N
          DcmDspDataUsePort = USE_DATA_ASYNCH_CLIENT_SERVER
          DcmDspDataConditionCheckReadFncUsed = false
          DcmDspDataInfoRef = DataInfo_DataInfo_222032_Secure_Log_Read
        DataInfo_DataInfo_222959_Hosted_App_Firmware_Cal_Config_Data_Header_Info_Read (DcmDspDataInfo): DcmDspDataFixedLength=true
        DidInfo_DidInfo_222031_Disallowed_Certificate_List_Read (DcmDspDidInfo)
          DcmDspDidAccess
            DcmDspDidRead:
              DcmDspDidReadSessionRef = Programming_Session
              DcmDspDidReadSessionRef = Extended_Diagnostic_Session
              DcmDspDidReadSecurityLevelRef = Authenticated_Diagnostic_Access
        DID_22295A_Hosted_App_Firmware_Cal_Config_Data_Header_UUID_Read (DcmDspDid):
          DcmDspDidIdentifier = 10586
          DcmDspDidUsed = true
          DcmDspDidUsePort = USE_DATA_ELEMENT_SPECIFIC_INTERFACES
          DcmDspDidInfoRef = DidInfo_DidInfo_22295A_Hosted_App_Firmware_Cal_Config_Data_Header_UUID_Read
          DcmDspDidSignal: DcmDspDidDataPos=0, DcmDspDidDataRef=Data_22295A_Hosted_App_Firmware_Cal_Config_Data_Header_UUID_Read
        3 x DcmDspData, all with DcmDspDataType=UINT8_N, DcmDspDataUsePort=USE_DATA_ASYNCH_CLIENT_SERVER, DcmDspDataConditionCheckReadFncUsed=false:
          Data_22295F_DCL_and_Cerstore_Header_Info_Read: DcmDspDataSize=1408, DcmDspDataInfoRef=DataInfo_DataInfo_22295F_DCL_and_Cerstore_Header_Info_Read
          Data_222031_Disallowed_Certificate_List_Read: DcmDspDataSize=24576, DcmDspDataInfoRef=DataInfo_DataInfo_222031_Disallowed_Certificate_List_Read
          Data_222957_Hosted_App_Firmware_Header_Info_Read: DcmDspDataSize=8448, DcmDspDataInfoRef=DataInfo_DataInfo_222957_Hosted_App_Firmware_Header_Info_Read
        DID_222958_Hosted_App_firmware_Header_UUID_Read (DcmDspDid):
          DcmDspDidIdentifier = 10584
          DcmDspDidUsed = true
          DcmDspDidUsePort = USE_DATA_ELEMENT_SPECIFIC_INTERFACES
          DcmDspDidInfoRef = DidInfo_DidInfo_222958_Hosted_App_firmware_Header_UUID_Read
          DcmDspDidSignal: DcmDspDidDataPos=0, DcmDspDidDataRef=Data_222958_Hosted_App_firmware_Header_UUID_Read
        Data_2EFD4E_Reset_NVM_Write (DcmDspData):
          DcmDspDataSize = 8
          DcmDspDataType = UINT8_N
          DcmDspDataUsePort = USE_DATA_ASYNCH_CLIENT_SERVER
          DcmDspDataConditionCheckReadFncUsed = false
          DcmDspDataInfoRef = DataInfo_DataInfo_2EFD4E_Reset_NVM_Write
        DataInfo_DataInfo_22F111_Public_Certificates_Regional_Support_Read (DcmDspDataInfo): DcmDspDataFixedLength=true
        DidInfo_DidInfo_220108_Authenticated_Diagnostics_Active_Role_Read (DcmDspDidInfo)
          DcmDspDidAccess
            DcmDspDidRead
        DidInfo_DidInfo_22FD64_ASIL_B_Fault_Status_Read (DcmDspDidInfo)
          DcmDspDidAccess
            DcmDspDidRead: DcmDspDidReadSessionRef=Default_Session, DcmDspDidReadSessionRef=Extended_Diagnostic_Session
        DataInfo_DataInfo_2EFD4E_Reset_NVM_Write (DcmDspDataInfo): DcmDspDataFixedLength=true
        DID_222957_Hosted_App_Firmware_Header_Info_Read (DcmDspDid):
          DcmDspDidIdentifier = 10583
          DcmDspDidUsed = true
          DcmDspDidUsePort = USE_DATA_ELEMENT_SPECIFIC_INTERFACES
          DcmDspDidInfoRef = DidInfo_DidInfo_222957_Hosted_App_Firmware_Header_Info_Read
          DcmDspDidSignal: DcmDspDidDataPos=0, DcmDspDidDataRef=Data_222957_Hosted_App_Firmware_Header_Info_Read
        Data_222958_Hosted_App_firmware_Header_UUID_Read (DcmDspData):
          DcmDspDataSize = 768
          DcmDspDataType = UINT8_N
          DcmDspDataUsePort = USE_DATA_ASYNCH_CLIENT_SERVER
          DcmDspDataConditionCheckReadFncUsed = false
          DcmDspDataInfoRef = DataInfo_DataInfo_222958_Hosted_App_firmware_Header_UUID_Read
        Data_222959_Hosted_App_Firmware_Cal_Config_Data_Header_Info_Read (DcmDspData):
          DcmDspDataSize = 2816
          DcmDspDataType = UINT8_N
          DcmDspDataUsePort = USE_DATA_ASYNCH_CLIENT_SERVER
          DcmDspDataConditionCheckReadFncUsed = false
          DcmDspDataInfoRef = DataInfo_DataInfo_222959_Hosted_App_Firmware_Cal_Config_Data_Header_Info_Read
        DID_22FD62_ASIL_QM_Fault_Status_Read (DcmDspDid):
          DcmDspDidIdentifier = 64866
          DcmDspDidUsed = true
          DcmDspDidUsePort = USE_DATA_ELEMENT_SPECIFIC_INTERFACES
          DcmDspDidInfoRef = DidInfo_DidInfo_22FD62_ASIL_QM_Fault_Status_Read
          DcmDspDidSignal: DcmDspDidDataPos=0, DcmDspDidDataRef=Data_22FD62_ASIL_QM_Fault_Status_Read
        DID_22FD86_Functional_Settings_Read (DcmDspDid):
          DcmDspDidIdentifier = 64902
          DcmDspDidUsed = true
          DcmDspDidUsePort = USE_DATA_ELEMENT_SPECIFIC_INTERFACES
          DcmDspDidInfoRef = DidInfo_DidInfo_22FD86_Functional_Settings_Read
          DcmDspDidSignal: DcmDspDidDataPos=0, DcmDspDidDataRef=Data_22FD86_Functional_Settings_Read
        DataInfo_DataInfo_22FD86_Functional_Settings_Read (DcmDspDataInfo): DcmDspDataFixedLength=true
        Data_22FD86_Functional_Settings_Read (DcmDspData):
          DcmDspDataSize = 48
          DcmDspDataType = UINT8_N
          DcmDspDataUsePort = USE_DATA_ASYNCH_CLIENT_SERVER
          DcmDspDataConditionCheckReadFncUsed = false
          DcmDspDataInfoRef = DataInfo_DataInfo_22FD86_Functional_Settings_Read
        DidInfo_DidInfo_22FD86_Functional_Settings_Read (DcmDspDidInfo)
          DcmDspDidAccess
            DcmDspDidWrite: DcmDspDidWriteSessionRef=Extended_Diagnostic_Session
            DcmDspDidRead: DcmDspDidReadSessionRef=Default_Session, DcmDspDidReadSessionRef=Extended_Diagnostic_Session
        DID_225109_Rear_Sensor_HealthBlockage_LiveDetection_Check_Read (DcmDspDid):
          DcmDspDidIdentifier = 20745
          DcmDspDidUsed = true
          DcmDspDidUsePort = USE_DATA_ELEMENT_SPECIFIC_INTERFACES
          DcmDspDidInfoRef = DidInfo_DidInfo_225109_Rear_Sensor_HealthBlockage_LiveDetection_Check_Read
          DcmDspDidSignal: DcmDspDidDataPos=0, DcmDspDidDataRef=Data_225109_Rear_Sensor_HealthBlockage_LiveDetection_Check_Read
        DataInfo_DataInfo_225107_Front_Sensor_HealthBlockage_LiveDetection_Check_Read (DcmDspDataInfo): DcmDspDataFixedLength=true
        Data_225109_Rear_Sensor_HealthBlockage_LiveDetection_Check_Read (DcmDspData):
          DcmDspDataSize = 120
          DcmDspDataType = UINT8_N
          DcmDspDataUsePort = USE_DATA_ASYNCH_CLIENT_SERVER
          DcmDspDataConditionCheckReadFncUsed = false
          DcmDspDataInfoRef = DataInfo_DataInfo_225109_Rear_Sensor_HealthBlockage_LiveDetection_Check_Read
        DataInfo_DataInfo_225109_Rear_Sensor_HealthBlockage_LiveDetection_Check_Read (DcmDspDataInfo): DcmDspDataFixedLength=true
        DID_225107_Front_Sensor_HealthBlockage_LiveDetection_Check_Read (DcmDspDid):
          DcmDspDidIdentifier = 20743
          DcmDspDidUsed = true
          DcmDspDidUsePort = USE_DATA_ELEMENT_SPECIFIC_INTERFACES
          DcmDspDidInfoRef = DidInfo_DidInfo_225107_Front_Sensor_HealthBlockage_LiveDetection_Check_Read
          DcmDspDidSignal: DcmDspDidDataPos=0, DcmDspDidDataRef=Data_225107_Front_Sensor_HealthBlockage_LiveDetection_Check_Read
        Data_225107_Front_Sensor_HealthBlockage_LiveDetection_Check_Read (DcmDspData):
          DcmDspDataSize = 120
          DcmDspDataType = UINT8_N
          DcmDspDataUsePort = USE_DATA_ASYNCH_CLIENT_SERVER
          DcmDspDataConditionCheckReadFncUsed = false
          DcmDspDataInfoRef = DataInfo_DataInfo_225107_Front_Sensor_HealthBlockage_LiveDetection_Check_Read
        DidInfo_DidInfo_225107_Front_Sensor_HealthBlockage_LiveDetection_Check_Read (DcmDspDidInfo)
          DcmDspDidAccess
            DcmDspDidRead: DcmDspDidReadSessionRef=Extended_Diagnostic_Session, DcmDspDidReadSecurityLevelRef=Authenticated_Diagnostic_Access
        DidInfo_DidInfo_225109_Rear_Sensor_HealthBlockage_LiveDetection_Check_Read (DcmDspDidInfo)
          DcmDspDidAccess
            DcmDspDidRead: DcmDspDidReadSessionRef=Extended_Diagnostic_Session, DcmDspDidReadSecurityLevelRef=Authenticated_Diagnostic_Access
        Data_22FD4A_Ultrasonic_Sensors_Power_supply_and_Current_Level_Read (DcmDspData):
          DcmDspDataSize = 72
          DcmDspDataType = UINT8_N
          DcmDspDataUsePort = USE_DATA_ASYNCH_CLIENT_SERVER
          DcmDspDataConditionCheckReadFncUsed = false
          DcmDspDataInfoRef = DataInfo_DataInfo_22FD4A_Ultrasonic_Sensors_Power_supply_and_Current_Level_Read
        DID_22FD4A_Ultrasonic_Sensors_Power_supply_and_Current_Level_Read (DcmDspDid):
          DcmDspDidIdentifier = 64842
          DcmDspDidUsed = true
          DcmDspDidUsePort = USE_DATA_ELEMENT_SPECIFIC_INTERFACES
          DcmDspDidInfoRef = DidInfo_DidInfo_22FD4A_Ultrasonic_Sensors_Power_supply_and_Current_Level_Read
          DcmDspDidSignal: DcmDspDidDataPos=0, DcmDspDidDataRef=Data_22FD4A_Ultrasonic_Sensors_Power_supply_and_Current_Level_Read
        DataInfo_DataInfo_22FD4A_Ultrasonic_Sensors_Power_supply_and_Current_Level_Read (DcmDspDataInfo): DcmDspDataFixedLength=true
        DidInfo_DidInfo_22FD4A_Ultrasonic_Sensors_Power_supply_and_Current_Level_Read (DcmDspDidInfo)
          DcmDspDidAccess
            DcmDspDidRead: DcmDspDidReadSessionRef=Default_Session, DcmDspDidReadSessionRef=Extended_Diagnostic_Session
        DidInfo_DidInfo_22FD65_FuSa_Module_Status_Read (DcmDspDidInfo)
          DcmDspDidAccess
            DcmDspDidRead: DcmDspDidReadSessionRef=Default_Session, DcmDspDidReadSessionRef=Extended_Diagnostic_Session
        Data_22FD65_FuSa_Module_Status_Read (DcmDspData):
          DcmDspDataSize = 224
          DcmDspDataType = UINT8_N
          DcmDspDataUsePort = USE_DATA_ASYNCH_CLIENT_SERVER
          DcmDspDataConditionCheckReadFncUsed = false
          DcmDspDataInfoRef = DataInfo_DataInfo_22FD65_FuSa_Module_Status_Read
        DID_22FD65_FuSa_Module_Status_Read (DcmDspDid):
          DcmDspDidIdentifier = 64869
          DcmDspDidUsed = true
          DcmDspDidUsePort = USE_DATA_ELEMENT_SPECIFIC_INTERFACES
          DcmDspDidInfoRef = DidInfo_DidInfo_22FD65_FuSa_Module_Status_Read
          DcmDspDidSignal: DcmDspDidDataPos=0, DcmDspDidDataRef=Data_22FD65_FuSa_Module_Status_Read
        DataInfo_DataInfo_22FD65_FuSa_Module_Status_Read (DcmDspDataInfo): DcmDspDataFixedLength=true
        DataInfo_DataInfo_222951_Certificate_Store_UUID_Read (DcmDspDataInfo): DcmDspDataFixedLength=true
        DidInfo_DidInfo_222951_Certificate_Store_UUID_Read (DcmDspDidInfo)
          DcmDspDidAccess
            DcmDspDidRead
        DID_222951_Certificate_Store_UUID_Read (DcmDspDid):
          DcmDspDidIdentifier = 10577
          DcmDspDidUsed = true
          DcmDspDidUsePort = USE_DATA_ELEMENT_SPECIFIC_INTERFACES
          DcmDspDidInfoRef = DidInfo_DidInfo_222951_Certificate_Store_UUID_Read
          DcmDspDidSignal: DcmDspDidDataPos=0, DcmDspDidDataRef=Data_222951_Certificate_Store_UUID_Read
        Data_222951_Certificate_Store_UUID_Read (DcmDspData):
          DcmDspDataSize = 128
          DcmDspDataType = UINT8_N
          DcmDspDataUsePort = USE_DATA_ASYNCH_CLIENT_SERVER
          DcmDspDataConditionCheckReadFncUsed = false
          DcmDspDataInfoRef = DataInfo_DataInfo_222951_Certificate_Store_UUID_Read
        DID_22FD66_Camera_occlusion_and_low_light_status_Read (DcmDspDid):
          DcmDspDidIdentifier = 64870
          DcmDspDidUsed = true
          DcmDspDidUsePort = USE_DATA_ELEMENT_SPECIFIC_INTERFACES
          DcmDspDidInfoRef = DidInfo_DidInfo_22FD66_Camera_occlusion_and_low_light_status_Read
          DcmDspDidSignal: DcmDspDidDataPos=0, DcmDspDidDataRef=Data_22FD66_Camera_occlusion_and_low_light_status_Read
        Data_22FD66_Camera_occlusion_and_low_light_status_Read (DcmDspData):
          DcmDspDataSize = 72
          DcmDspDataType = UINT8_N
          DcmDspDataUsePort = USE_DATA_ASYNCH_CLIENT_SERVER
          DcmDspDataConditionCheckReadFncUsed = false
          DcmDspDataInfoRef = DataInfo_DataInfo_22FD66_Camera_occlusion_and_low_light_status_Read
        DID_22FD67_Camera_DLD_Status_Read (DcmDspDid):
          DcmDspDidIdentifier = 64871
          DcmDspDidUsed = true
          DcmDspDidUsePort = USE_DATA_ELEMENT_SPECIFIC_INTERFACES
          DcmDspDidInfoRef = DidInfo_DidInfo_22FD67_Camera_DLD_Status_Read
          DcmDspDidSignal: DcmDspDidDataPos=0, DcmDspDidDataRef=Data_22FD67_Camera_DLD_Status_Read
        DataInfo_DataInfo_22FD44_Error_Flags_Read (DcmDspDataInfo): DcmDspDataFixedLength=true
        DidInfo_DidInfo_22295B_HTA_Header_Info_Read (DcmDspDidInfo)
          DcmDspDidAccess
            DcmDspDidRead:
              DcmDspDidReadSessionRef = Programming_Session
              DcmDspDidReadSessionRef = Extended_Diagnostic_Session
              DcmDspDidReadSecurityLevelRef = Authenticated_Diagnostic_Access
        DataInfo_DataInfo_22295B_HTA_Header_Info_Read (DcmDspDataInfo): DcmDspDataFixedLength=true
        DID_22295B_HTA_Header_Info_Read (DcmDspDid):
          DcmDspDidIdentifier = 10587
          DcmDspDidUsed = true
          DcmDspDidUsePort = USE_DATA_ELEMENT_SPECIFIC_INTERFACES
          DcmDspDidInfoRef = DidInfo_DidInfo_22295B_HTA_Header_Info_Read
          DcmDspDidSignal: DcmDspDidDataPos=0, DcmDspDidDataRef=Data_22295B_HTA_Header_Info_Read
        Data_22FD43_Active_Safe_State_Read (DcmDspData):
          DcmDspDataSize = 112
          DcmDspDataType = UINT8_N
          DcmDspDataUsePort = USE_DATA_ASYNCH_CLIENT_SERVER
          DcmDspDataConditionCheckReadFncUsed = false
          DcmDspDataInfoRef = DataInfo_DataInfo_22FD43_Active_Safe_State_Read
        DidInfo_DidInfo_22FD66_Camera_occlusion_and_low_light_status_Read (DcmDspDidInfo)
          DcmDspDidAccess
            DcmDspDidRead: DcmDspDidReadSessionRef=Default_Session, DcmDspDidReadSessionRef=Extended_Diagnostic_Session
        Data_22295C_HTA_Header_UUID_Read (DcmDspData):
          DcmDspDataSize = 128
          DcmDspDataType = UINT8_N
          DcmDspDataUsePort = USE_DATA_ASYNCH_CLIENT_SERVER
          DcmDspDataConditionCheckReadFncUsed = false
          DcmDspDataInfoRef = DataInfo_DataInfo_22295C_HTA_Header_UUID_Read
        DataInfo_DataInfo_22295C_HTA_Header_UUID_Read (DcmDspDataInfo): DcmDspDataFixedLength=true
        DidInfo_DidInfo_22295C_HTA_Header_UUID_Read (DcmDspDidInfo)
          DcmDspDidAccess
            DcmDspDidRead:
              DcmDspDidReadSessionRef = Programming_Session
              DcmDspDidReadSessionRef = Extended_Diagnostic_Session
              DcmDspDidReadSecurityLevelRef = Authenticated_Diagnostic_Access
        DID_22FD43_Active_Safe_State_Read (DcmDspDid):
          DcmDspDidIdentifier = 64835
          DcmDspDidUsed = true
          DcmDspDidUsePort = USE_DATA_ELEMENT_SPECIFIC_INTERFACES
          DcmDspDidInfoRef = DidInfo_DidInfo_22FD43_Active_Safe_State_Read
          DcmDspDidSignal: DcmDspDidDataPos=0, DcmDspDidDataRef=Data_22FD43_Active_Safe_State_Read
        DataInfo_DataInfo_22FD67_Camera_DLD_Status_Read (DcmDspDataInfo): DcmDspDataFixedLength=true
        Data_22295B_HTA_Header_Info_Read (DcmDspData):
          DcmDspDataSize = 1408
          DcmDspDataType = UINT8_N
          DcmDspDataUsePort = USE_DATA_ASYNCH_CLIENT_SERVER
          DcmDspDataConditionCheckReadFncUsed = false
          DcmDspDataInfoRef = DataInfo_DataInfo_22295B_HTA_Header_Info_Read
        DID_22FD44_Error_Flags_Read (DcmDspDid):
          DcmDspDidIdentifier = 64836
          DcmDspDidUsed = true
          DcmDspDidUsePort = USE_DATA_ELEMENT_SPECIFIC_INTERFACES
          DcmDspDidInfoRef = DidInfo_DidInfo_22FD44_Error_Flags_Read
          DcmDspDidSignal: DcmDspDidDataPos=0, DcmDspDidDataRef=Data_22FD44_Error_Flags_Read
        DID_22295E_DCL_Header_UUID_Read (DcmDspDid):
          DcmDspDidIdentifier = 10590
          DcmDspDidUsed = true
          DcmDspDidUsePort = USE_DATA_ELEMENT_SPECIFIC_INTERFACES
          DcmDspDidInfoRef = DidInfo_DidInfo_22295E_DCL_Header_UUID_Read
          DcmDspDidSignal: DcmDspDidDataPos=0, DcmDspDidDataRef=Data_22295E_DCL_Header_UUID_Read
        DidInfo_DidInfo_22FD43_Active_Safe_State_Read (DcmDspDidInfo)
          DcmDspDidAccess
            DcmDspDidRead: DcmDspDidReadSessionRef=Default_Session, DcmDspDidReadSessionRef=Extended_Diagnostic_Session
        Data_22FD44_Error_Flags_Read (DcmDspData):
          DcmDspDataSize = 32
          DcmDspDataType = UINT8_N
          DcmDspDataUsePort = USE_DATA_ASYNCH_CLIENT_SERVER
          DcmDspDataConditionCheckReadFncUsed = false
          DcmDspDataInfoRef = DataInfo_DataInfo_22FD44_Error_Flags_Read
        DataInfo_DataInfo_22295E_DCL_Header_UUID_Read (DcmDspDataInfo): DcmDspDataFixedLength=true
        DidInfo_DidInfo_22FD67_Camera_DLD_Status_Read (DcmDspDidInfo)
          DcmDspDidAccess
            DcmDspDidRead: DcmDspDidReadSessionRef=Default_Session, DcmDspDidReadSessionRef=Extended_Diagnostic_Session
        DataInfo_DataInfo_22FD66_Camera_occlusion_and_low_light_status_Read (DcmDspDataInfo): DcmDspDataFixedLength=true
        DidInfo_DidInfo_22FD44_Error_Flags_Read (DcmDspDidInfo)
          DcmDspDidAccess
            DcmDspDidRead: DcmDspDidReadSessionRef=Default_Session, DcmDspDidReadSessionRef=Extended_Diagnostic_Session
        DID_22295C_HTA_Header_UUID_Read (DcmDspDid):
          DcmDspDidIdentifier = 10588
          DcmDspDidUsed = true
          DcmDspDidUsePort = USE_DATA_ELEMENT_SPECIFIC_INTERFACES
          DcmDspDidInfoRef = DidInfo_DidInfo_22295C_HTA_Header_UUID_Read
          DcmDspDidSignal: DcmDspDidDataPos=0, DcmDspDidDataRef=Data_22295C_HTA_Header_UUID_Read
        DataInfo_DataInfo_22FD43_Active_Safe_State_Read (DcmDspDataInfo): DcmDspDataFixedLength=true
        DidInfo_DidInfo_22295E_DCL_Header_UUID_Read (DcmDspDidInfo)
          DcmDspDidAccess
            DcmDspDidRead:
              DcmDspDidReadSessionRef = Programming_Session
              DcmDspDidReadSessionRef = Extended_Diagnostic_Session
              DcmDspDidReadSecurityLevelRef = Authenticated_Diagnostic_Access
        Data_22295E_DCL_Header_UUID_Read (DcmDspData):
          DcmDspDataSize = 128
          DcmDspDataType = UINT8_N
          DcmDspDataUsePort = USE_DATA_ASYNCH_CLIENT_SERVER
          DcmDspDataConditionCheckReadFncUsed = false
          DcmDspDataInfoRef = DataInfo_DataInfo_22295E_DCL_Header_UUID_Read
        Data_22FD67_Camera_DLD_Status_Read (DcmDspData):
          DcmDspDataSize = 32
          DcmDspDataType = UINT8_N
          DcmDspDataUsePort = USE_DATA_ASYNCH_CLIENT_SERVER
          DcmDspDataConditionCheckReadFncUsed = false
          DcmDspDataInfoRef = DataInfo_DataInfo_22FD67_Camera_DLD_Status_Read
        DataInfo_DataInfo_22FD74_PHY_Tunning_Error_And_Buffer_Mark_Error_Read (DcmDspDataInfo): DcmDspDataFixedLength=true
        Data_22FD74_PHY_Tunning_Error_And_Buffer_Mark_Error_Read (DcmDspData):
          DcmDspDataSize = 32
          DcmDspDataType = UINT8_N
          DcmDspDataUsePort = USE_DATA_ASYNCH_CLIENT_SERVER
          DcmDspDataConditionCheckReadFncUsed = false
          DcmDspDataInfoRef = DataInfo_DataInfo_22FD74_PHY_Tunning_Error_And_Buffer_Mark_Error_Read
        DID_22FD74_PHY_Tunning_Error_And_Buffer_Mark_Error_Read (DcmDspDid):
          DcmDspDidIdentifier = 64884
          DcmDspDidUsed = true
          DcmDspDidUsePort = USE_DATA_ELEMENT_SPECIFIC_INTERFACES
          DcmDspDidInfoRef = DidInfo_DidInfo_22FD74_PHY_Tunning_Error_And_Buffer_Mark_Error_Read
          DcmDspDidSignal: DcmDspDidDataPos=0, DcmDspDidDataRef=Data_22FD74_PHY_Tunning_Error_And_Buffer_Mark_Error_Read
        DidInfo_DidInfo_22FD74_PHY_Tunning_Error_And_Buffer_Mark_Error_Read (DcmDspDidInfo)
          DcmDspDidAccess
            DcmDspDidRead: DcmDspDidReadSessionRef=Default_Session, DcmDspDidReadSessionRef=Extended_Diagnostic_Session
        Routine_31015502_TRSC_Trailer_Calibration_Memory_Clear_Start (DcmDspRoutine):
          DcmDspRequestResultsRoutineSupported = true
          DcmDspStopRoutineSupported = false
          DcmDspRoutineIdentifier = 21762
          DcmDspRoutineFixedLength = false
          DcmDspRoutineUsePort = true
          DcmDspRoutineUsed = true
          DcmDspRoutineInfoRef = RoutineInfo_RoutineInfo_31015502_TRSC_Trailer_Calibration_Memory_Clear_Start
        RoutineInfo_RoutineInfo_31015502_TRSC_Trailer_Calibration_Memory_Clear_Start (DcmDspRoutineInfo)
          DcmDspRoutineRequestResOut
            Out_ResData (DcmDspRoutineRequestResOutSignal): DcmDspRoutineSignalLength=16, DcmDspRoutineSignalType=UINT8_N, DcmDspRoutineSignalEndianness=opaque, DcmDspRoutineSignalPos=0
          DcmDspRoutineAuthorization: DcmDspRoutineSessionRef=Extended_Diagnostic_Session
          DcmDspStartRoutineOut
            Out_ResData (DcmDspStartRoutineOutSignal): DcmDspRoutineSignalLength=8, DcmDspRoutineSignalType=UINT8_N, DcmDspRoutineSignalEndianness=opaque, DcmDspRoutineSignalPos=0
        DataInfo_DataInfo_22FDF7_Intrinsic_Camera_NvM_Data_Read (DcmDspDataInfo): DcmDspDataFixedLength=true
        Data_22FDF7_Intrinsic_Camera_NvM_Data_Read (DcmDspData):
          DcmDspDataSize = 352
          DcmDspDataType = UINT8_N
          DcmDspDataUsePort = USE_DATA_ASYNCH_CLIENT_SERVER
          DcmDspDataConditionCheckReadFncUsed = false
          DcmDspDataInfoRef = DataInfo_DataInfo_22FDF7_Intrinsic_Camera_NvM_Data_Read
        DidInfo_DidInfo_22FDF6_RunTimeStatsData_Read (DcmDspDidInfo)
          DcmDspDidAccess
            DcmDspDidRead: DcmDspDidReadSessionRef=Default_Session, DcmDspDidReadSessionRef=Extended_Diagnostic_Session
        DataInfo_DataInfo_22FDF6_RunTimeStatsData_Read (DcmDspDataInfo): DcmDspDataFixedLength=true
        DidInfo_DidInfo_22FDF7_Intrinsic_Camera_NvM_Data_Read (DcmDspDidInfo)
          DcmDspDidAccess
            DcmDspDidRead: DcmDspDidReadSessionRef=Default_Session, DcmDspDidReadSessionRef=Extended_Diagnostic_Session
        Data_22FDF6_RunTimeStatsData_Read (DcmDspData):
          DcmDspDataSize = 2448
          DcmDspDataType = UINT8_N
          DcmDspDataUsePort = USE_DATA_ASYNCH_CLIENT_SERVER
          DcmDspDataConditionCheckReadFncUsed = false
          DcmDspDataInfoRef = DataInfo_DataInfo_22FDF6_RunTimeStatsData_Read
        DID_22FDF7_Intrinsic_Camera_NvM_Data_Read (DcmDspDid):
          DcmDspDidIdentifier = 65015
          DcmDspDidUsed = true
          DcmDspDidUsePort = USE_DATA_ELEMENT_SPECIFIC_INTERFACES
          DcmDspDidInfoRef = DidInfo_DidInfo_22FDF7_Intrinsic_Camera_NvM_Data_Read
          DcmDspDidSignal: DcmDspDidDataPos=0, DcmDspDidDataRef=Data_22FDF7_Intrinsic_Camera_NvM_Data_Read
        DID_22FDF6_RunTimeStatsData_Read (DcmDspDid):
          DcmDspDidIdentifier = 65014
          DcmDspDidUsed = true
          DcmDspDidUsePort = USE_DATA_ELEMENT_SPECIFIC_INTERFACES
          DcmDspDidInfoRef = DidInfo_DidInfo_22FDF6_RunTimeStatsData_Read
          DcmDspDidSignal: DcmDspDidDataPos=0, DcmDspDidDataRef=Data_22FDF6_RunTimeStatsData_Read
        DataInfo_DataInfo_22FD04_USS_Sensor_tuning_values_Read (DcmDspDataInfo): DcmDspDataFixedLength=false
        DID_22FD04_USS_Sensor_tuning_values_Read (DcmDspDid):
          DcmDspDidIdentifier = 64772
          DcmDspDidUsed = true
          DcmDspDidUsePort = USE_DATA_ELEMENT_SPECIFIC_INTERFACES
          DcmDspDidInfoRef = DidInfo_DidInfo_22FD04_USS_Sensor_tuning_values_Read
          DcmDspDidSignal: DcmDspDidDataPos=0, DcmDspDidDataRef=Data_22FD04_USS_Sensor_tuning_values_Read
        DidInfo_DidInfo_22FD04_USS_Sensor_tuning_values_Read (DcmDspDidInfo)
          DcmDspDidAccess
            DcmDspDidWrite: DcmDspDidWriteSessionRef=Extended_Diagnostic_Session, DcmDspDidWriteSecurityLevelRef=Authenticated_Diagnostic_Access
            DcmDspDidRead: DcmDspDidReadSessionRef=Extended_Diagnostic_Session, DcmDspDidReadSecurityLevelRef=Authenticated_Diagnostic_Access
        Data_22FD04_USS_Sensor_tuning_values_Read (DcmDspData):
          DcmDspDataSize = 24576
          DcmDspDataType = UINT8_N
          DcmDspDataUsePort = USE_DATA_ASYNCH_CLIENT_SERVER
          DcmDspDataConditionCheckReadFncUsed = false
          DcmDspDataInfoRef = DataInfo_DataInfo_22FD04_USS_Sensor_tuning_values_Read
        DID_22FDF8_StackUsage_Read (DcmDspDid):
          DcmDspDidIdentifier = 65016
          DcmDspDidUsed = true
          DcmDspDidUsePort = USE_DATA_ELEMENT_SPECIFIC_INTERFACES
          DcmDspDidInfoRef = DidInfo_DidInfo_22FDF8_StackUsage_Read
          DcmDspDidSignal: DcmDspDidDataPos=0, DcmDspDidDataRef=Data_22FDF8_StackUsage_Read
        DataInfo_DataInfo_22FDF8_StackUsage_Read (DcmDspDataInfo): DcmDspDataFixedLength=true
        Data_22FDF8_StackUsage_Read (DcmDspData):
          DcmDspDataSize = 296
          DcmDspDataType = UINT8_N
          DcmDspDataUsePort = USE_DATA_ASYNCH_CLIENT_SERVER
          DcmDspDataConditionCheckReadFncUsed = false
          DcmDspDataInfoRef = DataInfo_DataInfo_22FDF8_StackUsage_Read
        DidInfo_DidInfo_22FDF8_StackUsage_Read (DcmDspDidInfo)
          DcmDspDidAccess
            DcmDspDidRead: DcmDspDidReadSessionRef=Default_Session, DcmDspDidReadSessionRef=Extended_Diagnostic_Session
        Data_22FDF5_PerformanceStatEnable_Read (DcmDspData):
          DcmDspDataSize = 16
          DcmDspDataType = UINT8_N
          DcmDspDataUsePort = USE_DATA_ASYNCH_CLIENT_SERVER
          DcmDspDataConditionCheckReadFncUsed = false
          DcmDspDataInfoRef = DataInfo_DataInfo_22FDF5_PerformanceStatEnable_Read
        DidInfo_DidInfo_22FDF5_PerformanceStatEnable_Read (DcmDspDidInfo)
          DcmDspDidAccess
            DcmDspDidWrite: DcmDspDidWriteSessionRef=Default_Session, DcmDspDidWriteSessionRef=Extended_Diagnostic_Session
            DcmDspDidRead: DcmDspDidReadSessionRef=Default_Session, DcmDspDidReadSessionRef=Extended_Diagnostic_Session
        DID_22FDF5_PerformanceStatEnable_Read (DcmDspDid):
          DcmDspDidIdentifier = 65013
          DcmDspDidUsed = true
          DcmDspDidUsePort = USE_DATA_ELEMENT_SPECIFIC_INTERFACES
          DcmDspDidInfoRef = DidInfo_DidInfo_22FDF5_PerformanceStatEnable_Read
          DcmDspDidSignal: DcmDspDidDataPos=0, DcmDspDidDataRef=Data_22FDF5_PerformanceStatEnable_Read
        DataInfo_DataInfo_22FDF5_PerformanceStatEnable_Read (DcmDspDataInfo): DcmDspDataFixedLength=true
      DcmPageBufferCfg: DcmPagedBufferEnabled=true
      DcmProcessingConditions
        VehicleSpeedCheck (DcmModeCondition): DcmConditionType=DCM_EQUALS, DcmSwcModeRef=EcuSwComposition.SWC_SafeVCANRx.PpMode_VehicleSpeedCheck.Mode.VehicleSpeedZero
        VehicleSpeedCheckRule (DcmModeRule): DcmModeRuleNrcValue=34, DcmLogicalOperator=DCM_OR, DcmArgumentRef=VehicleSpeedCheck
        ProgrammingPreconditionCheck (DcmModeCondition): DcmConditionType=DCM_EQUALS, DcmSwcModeRef=EcuSwComposition.SWC_RIDMgr.PpModeProgPreconditionCheck.ModeProgPreconditionCheck.StateOK
        ProgrammingPreconditionCheckRule (DcmModeRule): DcmModeRuleNrcValue=34, DcmLogicalOperator=DCM_OR, DcmArgumentRef=ProgrammingPreconditionCheck
