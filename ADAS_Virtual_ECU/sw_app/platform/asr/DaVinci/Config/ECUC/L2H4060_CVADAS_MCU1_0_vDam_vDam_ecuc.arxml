AUTOSAR XML (schema 00048)
package /ActiveEcuC
  module config vDam: implementation-config-variant=VARIANT-PRE-COMPILE, module-description=vDam_Impl
    vDamGeneral:
      vDamVersionInfoApi = false
      vDamDevErrorDetect = true
      vDamServiceConfigurationStrategy = ALLOW_NOT_CONFIGURED
      vDamSafeBswChecks = true
      vDamCustomRemapNrcCalloutFunc = Os_Call_Appl_vDamRemapNrcCalloutFunc
      vDamUserRoleSource
        vDamUserRoleCallout: vDamUserRoleCalloutFunc=Appl_vDamUserRoleCalloutFunc
    10 x vDamUserRole:
      Engineer: vDamUserRoleIdentifier=1
      WorkshopOperatorOnline: vDamUserRoleIdentifier=2
      Manufacturing: vDamUserRoleIdentifier=4
      Supplier: vDamUserRoleIdentifier=8
      AfterMarket: vDamUserRoleIdentifier=16
      OnBoardTool: vDamUserRoleIdentifier=32
      WorkshopOperatorOffline: vDamUserRoleIdentifier=64
      IndependentWorkshopOperatorOnline: vDamUserRoleIdentifier=128
      IndependentWorkshopOperatorPassThroughOnline: vDamUserRoleIdentifier=256
      FOTA: vDamUserRoleIdentifier=512
    vDamService_220103 (vDamService):
      vDamUserRoleRef = Engineer
      vDamServiceRef = ReadDataById
      vDamUserRoleRef = AfterMarket
      vDamUserRoleRef = FOTA
      vDamUserRoleRef = IndependentWorkshopOperatorOnline
      vDamUserRoleRef = IndependentWorkshopOperatorPassThroughOnline
      vDamUserRoleRef = Manufacturing
      vDamUserRoleRef = OnBoardTool
      vDamUserRoleRef = Supplier
      vDamUserRoleRef = WorkshopOperatorOffline
      vDamUserRoleRef = WorkshopOperatorOnline
      vDamIdentifierRef = DID_220103_VIN_Lock_Status
      vDamUserRoleRef = Anonymous
    vDamCustomSubService_IOControl_0 (vDamCustomSubService): vDamCustomSubServiceId=0
    53 x vDamService, all with vDamUserRoleRef=Supplier, vDamUserRoleRef=Manufacturing, vDamUserRoleRef=Engineer:
      vDamService_220107: vDamServiceRef=ReadDataById, vDamIdentifierRef=DID_220107_RoE_Activation_State, vDamUserRoleRef=WorkshopOperatorOnline, vDamUserRoleRef=OnBoardTool, vDamUserRoleRef=IndependentWorkshopOperatorPassThroughOnline, vDamUserRoleRef=IndependentWorkshopOperatorOnline, vDamUserRoleRef=FOTA, vDamUserRoleRef=AfterMarket, vDamUserRoleRef=WorkshopOperatorOffline, vDamUserRoleRef=Anonymous
      vDamService_22102A: vDamServiceRef=ReadDataById, vDamIdentifierRef=DID_22102A_Check_EOL_Configuration_Data, vDamUserRoleRef=AfterMarket, vDamUserRoleRef=FOTA, vDamUserRoleRef=IndependentWorkshopOperatorOnline, vDamUserRoleRef=IndependentWorkshopOperatorPassThroughOnline, vDamUserRoleRef=OnBoardTool, vDamUserRoleRef=WorkshopOperatorOffline, vDamUserRoleRef=WorkshopOperatorOnline, vDamUserRoleRef=Anonymous
      vDamService_222010: vDamServiceRef=ReadDataById, vDamIdentifierRef=DID_222010_Programming_Status, vDamUserRoleRef=WorkshopOperatorOnline, vDamUserRoleRef=OnBoardTool, vDamUserRoleRef=IndependentWorkshopOperatorPassThroughOnline, vDamUserRoleRef=IndependentWorkshopOperatorOnline, vDamUserRoleRef=FOTA, vDamUserRoleRef=AfterMarket, vDamUserRoleRef=WorkshopOperatorOffline, vDamUserRoleRef=Anonymous
      vDamService_222013: vDamServiceRef=ReadDataById, vDamIdentifierRef=DID_222013_VIN_Lock_State_Read, vDamUserRoleRef=AfterMarket, vDamUserRoleRef=FOTA, vDamUserRoleRef=IndependentWorkshopOperatorOnline, vDamUserRoleRef=IndependentWorkshopOperatorPassThroughOnline, vDamUserRoleRef=OnBoardTool, vDamUserRoleRef=WorkshopOperatorOffline, vDamUserRoleRef=WorkshopOperatorOnline, vDamUserRoleRef=Anonymous
      vDamService_22201A: vDamServiceRef=ReadDataById, vDamIdentifierRef=DID_22201A_Application_Software_Programming_Attempt_Counter, vDamUserRoleRef=AfterMarket, vDamUserRoleRef=FOTA, vDamUserRoleRef=IndependentWorkshopOperatorOnline, vDamUserRoleRef=IndependentWorkshopOperatorPassThroughOnline, vDamUserRoleRef=OnBoardTool, vDamUserRoleRef=WorkshopOperatorOffline, vDamUserRoleRef=WorkshopOperatorOnline, vDamUserRoleRef=Anonymous
      vDamService_22201B: vDamServiceRef=ReadDataById, vDamIdentifierRef=DID_22201B_Application_Data_Software_Programming_Attempt_Counter, vDamUserRoleRef=AfterMarket, vDamUserRoleRef=FOTA, vDamUserRoleRef=IndependentWorkshopOperatorOnline, vDamUserRoleRef=IndependentWorkshopOperatorPassThroughOnline, vDamUserRoleRef=OnBoardTool, vDamUserRoleRef=WorkshopOperatorOffline, vDamUserRoleRef=WorkshopOperatorOnline, vDamUserRoleRef=Anonymous
      vDamService_22201F: vDamServiceRef=ReadDataById, vDamIdentifierRef=DID_22201F_Boot_Failure_Reason_Read, vDamUserRoleRef=AfterMarket, vDamUserRoleRef=FOTA, vDamUserRoleRef=IndependentWorkshopOperatorOnline, vDamUserRoleRef=IndependentWorkshopOperatorPassThroughOnline, vDamUserRoleRef=OnBoardTool, vDamUserRoleRef=WorkshopOperatorOffline, vDamUserRoleRef=WorkshopOperatorOnline, vDamUserRoleRef=Anonymous
      vDamService_222032: vDamServiceRef=ReadDataById, vDamIdentifierRef=DID_222032_Secure_Log_Read
      vDamService_22292E: vDamServiceRef=ReadDataById, vDamUserRoleRef=AfterMarket, vDamUserRoleRef=FOTA, vDamUserRoleRef=IndependentWorkshopOperatorOnline, vDamUserRoleRef=IndependentWorkshopOperatorPassThroughOnline, vDamUserRoleRef=OnBoardTool, vDamUserRoleRef=WorkshopOperatorOffline, vDamUserRoleRef=WorkshopOperatorOnline, vDamIdentifierRef=DID_22292E_PROXI_Write_Counter, vDamUserRoleRef=Anonymous
      vDamService_222939: vDamServiceRef=ReadDataById, vDamUserRoleRef=WorkshopOperatorOnline, vDamUserRoleRef=OnBoardTool, vDamUserRoleRef=IndependentWorkshopOperatorPassThroughOnline, vDamUserRoleRef=IndependentWorkshopOperatorOnline, vDamUserRoleRef=FOTA, vDamUserRoleRef=AfterMarket, vDamIdentifierRef=DID_222939_FDCAN2_BUS_Network_WakeUp_Reason, vDamUserRoleRef=WorkshopOperatorOffline, vDamUserRoleRef=Anonymous
      vDamService_222945: vDamServiceRef=ReadDataById, vDamIdentifierRef=DID_222945_Flow_Control_Test, vDamUserRoleRef=AfterMarket, vDamUserRoleRef=FOTA, vDamUserRoleRef=IndependentWorkshopOperatorOnline, vDamUserRoleRef=IndependentWorkshopOperatorPassThroughOnline, vDamUserRoleRef=OnBoardTool, vDamUserRoleRef=WorkshopOperatorOffline, vDamUserRoleRef=WorkshopOperatorOnline, vDamUserRoleRef=Anonymous
      vDamService_222954: vDamServiceRef=ReadDataById, vDamIdentifierRef=DID_222954_Policy_Type_Read, vDamUserRoleRef=AfterMarket, vDamUserRoleRef=FOTA, vDamUserRoleRef=IndependentWorkshopOperatorOnline, vDamUserRoleRef=IndependentWorkshopOperatorPassThroughOnline, vDamUserRoleRef=OnBoardTool, vDamUserRoleRef=WorkshopOperatorOffline, vDamUserRoleRef=WorkshopOperatorOnline, vDamUserRoleRef=Anonymous
      vDamService_225100: vDamServiceRef=ReadDataById, vDamUserRoleRef=OnBoardTool, vDamUserRoleRef=IndependentWorkshopOperatorPassThroughOnline, vDamUserRoleRef=IndependentWorkshopOperatorOnline, vDamUserRoleRef=FOTA, vDamUserRoleRef=AfterMarket, vDamIdentifierRef=DID_225100_SPM_status_Read, vDamUserRoleRef=WorkshopOperatorOffline, vDamUserRoleRef=Anonymous, vDamUserRoleRef=WorkshopOperatorOnline
      vDamService_225102: vDamServiceRef=ReadDataById, vDamIdentifierRef=DID_225102_FD_CAN14_Rx_Signals_Read
      vDamService_225103: vDamServiceRef=ReadDataById, vDamIdentifierRef=DID_225103_FD_CAN2_Rx_Signals_Read
      vDamService_225104: vDamServiceRef=ReadDataById, vDamIdentifierRef=DID_225104_FD_CAN14_Tx_Signals_Read
      vDamService_225105: vDamServiceRef=ReadDataById, vDamIdentifierRef=DID_225105_FD_CAN2_Tx_Signals_Read
      vDamService_225107: vDamServiceRef=ReadDataById, vDamIdentifierRef=DID_225107_Front_Sensor_HealthBlockage_LiveDetection_Check_Read
      vDamService_225109: vDamServiceRef=ReadDataById, vDamIdentifierRef=DID_225109_Rear_Sensor_HealthBlockage_LiveDetection_Check_Read
      vDamService_225201: vDamServiceRef=ReadDataById, vDamIdentifierRef=DID_225201_Plant_Mode_Status_Read, vDamUserRoleRef=AfterMarket, vDamUserRoleRef=FOTA, vDamUserRoleRef=IndependentWorkshopOperatorOnline, vDamUserRoleRef=IndependentWorkshopOperatorPassThroughOnline, vDamUserRoleRef=OnBoardTool, vDamUserRoleRef=WorkshopOperatorOffline, vDamUserRoleRef=WorkshopOperatorOnline, vDamUserRoleRef=Anonymous
      vDamService_225303: vDamServiceRef=ReadDataById, vDamIdentifierRef=DID_225303_SPM_Event_Abort_1_Read, vDamUserRoleRef=WorkshopOperatorOnline, vDamUserRoleRef=OnBoardTool, vDamUserRoleRef=IndependentWorkshopOperatorOnline, vDamUserRoleRef=FOTA, vDamUserRoleRef=AfterMarket, vDamUserRoleRef=WorkshopOperatorOffline, vDamUserRoleRef=Anonymous, vDamUserRoleRef=IndependentWorkshopOperatorPassThroughOnline
      vDamService_225304: vDamServiceRef=ReadDataById, vDamUserRoleRef=WorkshopOperatorOnline, vDamUserRoleRef=OnBoardTool, vDamUserRoleRef=IndependentWorkshopOperatorOnline, vDamUserRoleRef=FOTA, vDamUserRoleRef=AfterMarket, vDamIdentifierRef=DID_225304_SPM_Event_Abort_2_Read, vDamUserRoleRef=WorkshopOperatorOffline, vDamUserRoleRef=Anonymous, vDamUserRoleRef=IndependentWorkshopOperatorPassThroughOnline
      vDamService_225305: vDamServiceRef=ReadDataById, vDamUserRoleRef=WorkshopOperatorOnline, vDamUserRoleRef=OnBoardTool, vDamUserRoleRef=IndependentWorkshopOperatorOnline, vDamUserRoleRef=FOTA, vDamUserRoleRef=AfterMarket, vDamIdentifierRef=DID_225305_SPM_Event_Abort_3_Read, vDamUserRoleRef=WorkshopOperatorOffline, vDamUserRoleRef=Anonymous, vDamUserRoleRef=IndependentWorkshopOperatorPassThroughOnline
      vDamService_22F10B: vDamServiceRef=ReadDataById, vDamIdentifierRef=DID_22F10B_ECU_Qualification, vDamUserRoleRef=AfterMarket, vDamUserRoleRef=FOTA, vDamUserRoleRef=IndependentWorkshopOperatorOnline, vDamUserRoleRef=IndependentWorkshopOperatorPassThroughOnline, vDamUserRoleRef=OnBoardTool, vDamUserRoleRef=WorkshopOperatorOffline, vDamUserRoleRef=WorkshopOperatorOnline, vDamUserRoleRef=Anonymous
      vDamService_22F10D: vDamServiceRef=ReadDataById, vDamIdentifierRef=DID_22F10D_Diagnostic_Specification_Information, vDamUserRoleRef=AfterMarket, vDamUserRoleRef=FOTA, vDamUserRoleRef=IndependentWorkshopOperatorOnline, vDamUserRoleRef=IndependentWorkshopOperatorPassThroughOnline, vDamUserRoleRef=OnBoardTool, vDamUserRoleRef=WorkshopOperatorOffline, vDamUserRoleRef=WorkshopOperatorOnline, vDamUserRoleRef=Anonymous
      vDamService_22F111: vDamServiceRef=ReadDataById, vDamIdentifierRef=DID_22F111_Public_Certificates_Regional_Support_Read
      vDamService_22F112: vDamServiceRef=ReadDataById, vDamIdentifierRef=DID_22F112_PTESLM_Hardware_Number, vDamUserRoleRef=AfterMarket, vDamUserRoleRef=FOTA, vDamUserRoleRef=IndependentWorkshopOperatorOnline, vDamUserRoleRef=IndependentWorkshopOperatorPassThroughOnline, vDamUserRoleRef=OnBoardTool, vDamUserRoleRef=WorkshopOperatorOffline, vDamUserRoleRef=WorkshopOperatorOnline, vDamUserRoleRef=Anonymous
      vDamService_22F122: vDamServiceRef=ReadDataById, vDamUserRoleRef=WorkshopOperatorOnline, vDamUserRoleRef=OnBoardTool, vDamUserRoleRef=IndependentWorkshopOperatorPassThroughOnline, vDamUserRoleRef=IndependentWorkshopOperatorOnline, vDamUserRoleRef=AfterMarket, vDamIdentifierRef=DID_22F122_Software_EBOM_Part_Number, vDamUserRoleRef=WorkshopOperatorOffline, vDamUserRoleRef=FOTA, vDamUserRoleRef=Anonymous
      vDamService_22F132: vDamServiceRef=ReadDataById, vDamUserRoleRef=WorkshopOperatorOnline, vDamUserRoleRef=OnBoardTool, vDamUserRoleRef=IndependentWorkshopOperatorPassThroughOnline, vDamUserRoleRef=IndependentWorkshopOperatorOnline, vDamUserRoleRef=FOTA, vDamUserRoleRef=AfterMarket, vDamIdentifierRef=DID_22F132_EBOM_ECU_Part_Number, vDamUserRoleRef=Anonymous, vDamUserRoleRef=WorkshopOperatorOffline
      vDamService_22F133: vDamServiceRef=ReadDataById, vDamUserRoleRef=WorkshopOperatorOnline, vDamUserRoleRef=OnBoardTool, vDamUserRoleRef=IndependentWorkshopOperatorPassThroughOnline, vDamUserRoleRef=IndependentWorkshopOperatorOnline, vDamUserRoleRef=FOTA, vDamUserRoleRef=AfterMarket, vDamIdentifierRef=DID_22F133_EBOM_Assembly_Part_Number, vDamUserRoleRef=Anonymous, vDamUserRoleRef=WorkshopOperatorOffline
      vDamService_22F134: vDamServiceRef=ReadDataById, vDamIdentifierRef=DID_22F134_CODEP_assembly_part_number, vDamUserRoleRef=AfterMarket, vDamUserRoleRef=FOTA, vDamUserRoleRef=IndependentWorkshopOperatorOnline, vDamUserRoleRef=IndependentWorkshopOperatorPassThroughOnline, vDamUserRoleRef=OnBoardTool, vDamUserRoleRef=WorkshopOperatorOffline, vDamUserRoleRef=WorkshopOperatorOnline, vDamUserRoleRef=Anonymous
      vDamService_22F154: vDamServiceRef=ReadDataById, vDamUserRoleRef=WorkshopOperatorOnline, vDamUserRoleRef=OnBoardTool, vDamUserRoleRef=IndependentWorkshopOperatorPassThroughOnline, vDamUserRoleRef=IndependentWorkshopOperatorOnline, vDamUserRoleRef=FOTA, vDamUserRoleRef=AfterMarket, vDamIdentifierRef=DID_22F154_Hardware_Supplier_Identification, vDamUserRoleRef=Anonymous, vDamUserRoleRef=WorkshopOperatorOffline
      vDamService_22F155: vDamServiceRef=ReadDataById, vDamUserRoleRef=WorkshopOperatorOnline, vDamUserRoleRef=OnBoardTool, vDamUserRoleRef=IndependentWorkshopOperatorPassThroughOnline, vDamUserRoleRef=IndependentWorkshopOperatorOnline, vDamUserRoleRef=FOTA, vDamUserRoleRef=AfterMarket, vDamIdentifierRef=DID_22F155_Software_Supplier_Identification, vDamUserRoleRef=Anonymous, vDamUserRoleRef=WorkshopOperatorOffline
      vDamService_22F180: vDamServiceRef=ReadDataById, vDamUserRoleRef=WorkshopOperatorOnline, vDamUserRoleRef=OnBoardTool, vDamUserRoleRef=IndependentWorkshopOperatorPassThroughOnline, vDamUserRoleRef=IndependentWorkshopOperatorOnline, vDamUserRoleRef=FOTA, vDamUserRoleRef=AfterMarket, vDamIdentifierRef=DID_22F180_Boot_Software_Version_Information, vDamUserRoleRef=Anonymous, vDamUserRoleRef=WorkshopOperatorOffline
      vDamService_22F182: vDamServiceRef=ReadDataById, vDamIdentifierRef=DID_22F182_Application_Data_Identification, vDamUserRoleRef=AfterMarket, vDamUserRoleRef=FOTA, vDamUserRoleRef=IndependentWorkshopOperatorOnline, vDamUserRoleRef=IndependentWorkshopOperatorPassThroughOnline, vDamUserRoleRef=OnBoardTool, vDamUserRoleRef=WorkshopOperatorOffline, vDamUserRoleRef=WorkshopOperatorOnline, vDamUserRoleRef=Anonymous
      vDamService_22F181: vDamServiceRef=ReadDataById, vDamUserRoleRef=WorkshopOperatorOnline, vDamUserRoleRef=OnBoardTool, vDamUserRoleRef=IndependentWorkshopOperatorPassThroughOnline, vDamUserRoleRef=IndependentWorkshopOperatorOnline, vDamUserRoleRef=FOTA, vDamUserRoleRef=AfterMarket, vDamIdentifierRef=DID_22F181_Application_Software_Identification, vDamUserRoleRef=Anonymous, vDamUserRoleRef=WorkshopOperatorOffline
      vDamService_22F187: vDamServiceRef=ReadDataById, vDamIdentifierRef=DID_22F187_CODEP_ECU_Part_Number, vDamUserRoleRef=AfterMarket, vDamUserRoleRef=FOTA, vDamUserRoleRef=IndependentWorkshopOperatorOnline, vDamUserRoleRef=IndependentWorkshopOperatorPassThroughOnline, vDamUserRoleRef=OnBoardTool, vDamUserRoleRef=WorkshopOperatorOffline, vDamUserRoleRef=WorkshopOperatorOnline, vDamUserRoleRef=Anonymous
      vDamService_22F188: vDamServiceRef=ReadDataById, vDamIdentifierRef=DID_22F188_FCA_ESLM_ECU_Software_Number, vDamUserRoleRef=AfterMarket, vDamUserRoleRef=FOTA, vDamUserRoleRef=IndependentWorkshopOperatorOnline, vDamUserRoleRef=IndependentWorkshopOperatorPassThroughOnline, vDamUserRoleRef=OnBoardTool, vDamUserRoleRef=WorkshopOperatorOffline, vDamUserRoleRef=WorkshopOperatorOnline, vDamUserRoleRef=Anonymous
      vDamService_22F18A: vDamServiceRef=ReadDataById, vDamIdentifierRef=DID_22F18A_FCA_ESLM_ECU_Software_Calibration_Number, vDamUserRoleRef=AfterMarket, vDamUserRoleRef=FOTA, vDamUserRoleRef=IndependentWorkshopOperatorOnline, vDamUserRoleRef=IndependentWorkshopOperatorPassThroughOnline, vDamUserRoleRef=OnBoardTool, vDamUserRoleRef=WorkshopOperatorOffline, vDamUserRoleRef=WorkshopOperatorOnline, vDamUserRoleRef=Anonymous
      vDamService_22F18B: vDamServiceRef=ReadDataById, vDamIdentifierRef=DID_22F18B_FCA_ESLM_ECU_Software_Application_Number, vDamUserRoleRef=AfterMarket, vDamUserRoleRef=FOTA, vDamUserRoleRef=IndependentWorkshopOperatorOnline, vDamUserRoleRef=IndependentWorkshopOperatorPassThroughOnline, vDamUserRoleRef=OnBoardTool, vDamUserRoleRef=WorkshopOperatorOffline, vDamUserRoleRef=WorkshopOperatorOnline, vDamUserRoleRef=Anonymous
      vDamService_22F191: vDamServiceRef=ReadDataById, vDamIdentifierRef=DID_22F191_FCA_ESLM_ECU_Hardware_Number, vDamUserRoleRef=AfterMarket, vDamUserRoleRef=FOTA, vDamUserRoleRef=IndependentWorkshopOperatorOnline, vDamUserRoleRef=IndependentWorkshopOperatorPassThroughOnline, vDamUserRoleRef=OnBoardTool, vDamUserRoleRef=WorkshopOperatorOffline, vDamUserRoleRef=WorkshopOperatorOnline, vDamUserRoleRef=Anonymous
      vDamService_22F192: vDamServiceRef=ReadDataById, vDamUserRoleRef=WorkshopOperatorOnline, vDamUserRoleRef=IndependentWorkshopOperatorPassThroughOnline, vDamUserRoleRef=IndependentWorkshopOperatorOnline, vDamUserRoleRef=FOTA, vDamUserRoleRef=OnBoardTool, vDamUserRoleRef=AfterMarket, vDamIdentifierRef=DID_22F192_Supplier_ECU_Hardware_Part_Number, vDamUserRoleRef=Anonymous, vDamUserRoleRef=WorkshopOperatorOffline
      vDamService_22F193: vDamServiceRef=ReadDataById, vDamUserRoleRef=WorkshopOperatorOnline, vDamUserRoleRef=IndependentWorkshopOperatorPassThroughOnline, vDamUserRoleRef=IndependentWorkshopOperatorOnline, vDamUserRoleRef=FOTA, vDamUserRoleRef=OnBoardTool, vDamUserRoleRef=AfterMarket, vDamIdentifierRef=DID_22F193_Supplier_ECU_Hardware_Version_Number, vDamUserRoleRef=Anonymous, vDamUserRoleRef=WorkshopOperatorOffline
      vDamService_22F194: vDamServiceRef=ReadDataById, vDamUserRoleRef=WorkshopOperatorOnline, vDamUserRoleRef=IndependentWorkshopOperatorPassThroughOnline, vDamUserRoleRef=IndependentWorkshopOperatorOnline, vDamUserRoleRef=FOTA, vDamUserRoleRef=OnBoardTool, vDamUserRoleRef=AfterMarket, vDamIdentifierRef=DID_22F194_Supplier_ECU_Software_Part_Number, vDamUserRoleRef=Anonymous, vDamUserRoleRef=WorkshopOperatorOffline
      vDamService_22F195: vDamServiceRef=ReadDataById, vDamUserRoleRef=WorkshopOperatorOnline, vDamUserRoleRef=IndependentWorkshopOperatorPassThroughOnline, vDamUserRoleRef=IndependentWorkshopOperatorOnline, vDamUserRoleRef=FOTA, vDamUserRoleRef=OnBoardTool, vDamUserRoleRef=AfterMarket, vDamIdentifierRef=DID_22F195_Supplier_ECU_Software_Version_Number, vDamUserRoleRef=Anonymous, vDamUserRoleRef=WorkshopOperatorOffline
      vDamService_22F1A0: vDamServiceRef=ReadDataById, vDamIdentifierRef=DID_22F1A0_System_Identification_Data, vDamUserRoleRef=AfterMarket, vDamUserRoleRef=FOTA, vDamUserRoleRef=IndependentWorkshopOperatorOnline, vDamUserRoleRef=IndependentWorkshopOperatorPassThroughOnline, vDamUserRoleRef=OnBoardTool, vDamUserRoleRef=WorkshopOperatorOffline, vDamUserRoleRef=WorkshopOperatorOnline, vDamUserRoleRef=Anonymous
      vDamService_22F1A1: vDamServiceRef=ReadDataById, vDamIdentifierRef=DID_22F1A1_Configuration_Code, vDamUserRoleRef=AfterMarket, vDamUserRoleRef=FOTA, vDamUserRoleRef=IndependentWorkshopOperatorOnline, vDamUserRoleRef=IndependentWorkshopOperatorPassThroughOnline, vDamUserRoleRef=OnBoardTool, vDamUserRoleRef=WorkshopOperatorOffline, vDamUserRoleRef=WorkshopOperatorOnline, vDamUserRoleRef=Anonymous
      vDamService_22F1A2: vDamServiceRef=ReadDataById, vDamIdentifierRef=DID_22F1A2_Vector_Delivery_ID, vDamUserRoleRef=AfterMarket, vDamUserRoleRef=FOTA, vDamUserRoleRef=IndependentWorkshopOperatorOnline, vDamUserRoleRef=IndependentWorkshopOperatorPassThroughOnline, vDamUserRoleRef=OnBoardTool, vDamUserRoleRef=WorkshopOperatorOffline, vDamUserRoleRef=WorkshopOperatorOnline, vDamUserRoleRef=Anonymous
      vDamService_22F1B3: vDamServiceRef=ReadDataById, vDamIdentifierRef=DID_22F1B3_Boot_Software_Fingerprint_Reading_Information, vDamUserRoleRef=AfterMarket, vDamUserRoleRef=FOTA, vDamUserRoleRef=IndependentWorkshopOperatorOnline, vDamUserRoleRef=IndependentWorkshopOperatorPassThroughOnline, vDamUserRoleRef=OnBoardTool, vDamUserRoleRef=WorkshopOperatorOffline, vDamUserRoleRef=WorkshopOperatorOnline, vDamUserRoleRef=Anonymous
      vDamService_22F1B4: vDamServiceRef=ReadDataById, vDamIdentifierRef=DID_22F1B4_Application_Software_Fingerprint_Reading_Information, vDamUserRoleRef=AfterMarket, vDamUserRoleRef=FOTA, vDamUserRoleRef=IndependentWorkshopOperatorOnline, vDamUserRoleRef=IndependentWorkshopOperatorPassThroughOnline, vDamUserRoleRef=OnBoardTool, vDamUserRoleRef=WorkshopOperatorOffline, vDamUserRoleRef=WorkshopOperatorOnline, vDamUserRoleRef=Anonymous
      vDamService_22F1B5: vDamServiceRef=ReadDataById, vDamIdentifierRef=DID_22F1B5_Application_Data_Software_Fingerprint_Reading_Information, vDamUserRoleRef=AfterMarket, vDamUserRoleRef=FOTA, vDamUserRoleRef=IndependentWorkshopOperatorOnline, vDamUserRoleRef=IndependentWorkshopOperatorPassThroughOnline, vDamUserRoleRef=OnBoardTool, vDamUserRoleRef=WorkshopOperatorOffline, vDamUserRoleRef=WorkshopOperatorOnline, vDamUserRoleRef=Anonymous
      vDamService_22FD33: vDamServiceRef=ReadDataById, vDamIdentifierRef=DID_22FD33_Magna_Testing_2_Read, vDamUserRoleRef=WorkshopOperatorOnline, vDamUserRoleRef=WorkshopOperatorOffline, vDamUserRoleRef=OnBoardTool, vDamUserRoleRef=IndependentWorkshopOperatorPassThroughOnline, vDamUserRoleRef=IndependentWorkshopOperatorOnline, vDamUserRoleRef=FOTA, vDamUserRoleRef=Anonymous, vDamUserRoleRef=AfterMarket
      vDamService_2F5001: vDamServiceRef=IoControlById, vDamIdentifierRef=DID_2F5001_Gear_Position_Read, vDamSubServiceRef=vDamCustomSubService_IOControl_3, vDamSubServiceRef=vDamCustomSubService_IOControl_0
    vDamCustomSubService_IOControl_3 (vDamCustomSubService): vDamCustomSubServiceId=3
    14 x vDamService, all with vDamServiceRef=RoutineControl, vDamUserRoleRef=Engineer, vDamUserRoleRef=Manufacturing:
      vDamService_31012000: vDamIdentifierRef=Routine_31012000_Original_VIN_Lock, vDamUserRoleRef=FOTA, vDamUserRoleRef=IndependentWorkshopOperatorOnline, vDamUserRoleRef=IndependentWorkshopOperatorPassThroughOnline, vDamUserRoleRef=Supplier, vDamUserRoleRef=WorkshopOperatorOnline
      vDamService_31012001: vDamIdentifierRef=Routine_31012001_Original_VIN_Unlock
      vDamService_31015000: vDamIdentifierRef=Routine_31015000_Park_Assist_ON_OFF_State_Start, vDamUserRoleRef=Supplier
      vDamService_31015101: vDamUserRoleRef=WorkshopOperatorOnline, vDamUserRoleRef=Supplier, vDamUserRoleRef=IndependentWorkshopOperatorPassThroughOnline, vDamUserRoleRef=IndependentWorkshopOperatorOnline, vDamUserRoleRef=FOTA, vDamUserRoleRef=AfterMarket, vDamIdentifierRef=Routine_31015101_Sensor_Functional_Test_Start, vDamUserRoleRef=WorkshopOperatorOffline, vDamUserRoleRef=Anonymous, vDamUserRoleRef=OnBoardTool
      vDamService_31015200: vDamIdentifierRef=Routine_31015200_Plant_Mode_Routine_Start, vDamUserRoleRef=FOTA, vDamUserRoleRef=AfterMarket, vDamUserRoleRef=Anonymous, vDamUserRoleRef=IndependentWorkshopOperatorOnline, vDamUserRoleRef=IndependentWorkshopOperatorPassThroughOnline, vDamUserRoleRef=OnBoardTool, vDamUserRoleRef=Supplier, vDamUserRoleRef=WorkshopOperatorOffline, vDamUserRoleRef=WorkshopOperatorOnline
      vDamService_31015400: vDamIdentifierRef=Routine_31015400_Camera_EOL_Calibration_Start, vDamUserRoleRef=AfterMarket, vDamUserRoleRef=FOTA, vDamUserRoleRef=IndependentWorkshopOperatorOnline, vDamUserRoleRef=IndependentWorkshopOperatorPassThroughOnline, vDamUserRoleRef=OnBoardTool, vDamUserRoleRef=Supplier, vDamUserRoleRef=WorkshopOperatorOffline, vDamUserRoleRef=WorkshopOperatorOnline, vDamUserRoleRef=Anonymous
      vDamService_31015401: vDamIdentifierRef=Routine_31015401_Camera_Service_Calibration_Start, vDamUserRoleRef=AfterMarket, vDamUserRoleRef=FOTA, vDamUserRoleRef=IndependentWorkshopOperatorOnline, vDamUserRoleRef=IndependentWorkshopOperatorPassThroughOnline, vDamUserRoleRef=OnBoardTool, vDamUserRoleRef=Supplier, vDamUserRoleRef=WorkshopOperatorOffline, vDamUserRoleRef=WorkshopOperatorOnline, vDamUserRoleRef=Anonymous
      vDamService_3101D001: vDamIdentifierRef=Routine_3101D001_Disable_Fail_safe_reaction_Start, vDamUserRoleRef=FOTA, vDamUserRoleRef=IndependentWorkshopOperatorOnline, vDamUserRoleRef=IndependentWorkshopOperatorPassThroughOnline, vDamUserRoleRef=Supplier, vDamUserRoleRef=WorkshopOperatorOnline
      vDamService_3101D002: vDamIdentifierRef=Routine_3101D002_Check_Programming_Preconditions_Start, vDamUserRoleRef=FOTA, vDamUserRoleRef=IndependentWorkshopOperatorOnline, vDamUserRoleRef=IndependentWorkshopOperatorPassThroughOnline, vDamUserRoleRef=Supplier, vDamUserRoleRef=WorkshopOperatorOnline, vDamUserRoleRef=Anonymous, vDamUserRoleRef=AfterMarket, vDamUserRoleRef=OnBoardTool, vDamUserRoleRef=WorkshopOperatorOffline
      vDamService_3101D003: vDamIdentifierRef=Routine_3101D003_Application_Logical_Block_Hash, vDamUserRoleRef=FOTA, vDamUserRoleRef=IndependentWorkshopOperatorOnline, vDamUserRoleRef=IndependentWorkshopOperatorPassThroughOnline, vDamUserRoleRef=Supplier, vDamUserRoleRef=WorkshopOperatorOnline
      vDamService_3101F000: vDamIdentifierRef=Routine_3101F000_Check_Program_Start, vDamUserRoleRef=FOTA, vDamUserRoleRef=IndependentWorkshopOperatorOnline, vDamUserRoleRef=IndependentWorkshopOperatorPassThroughOnline, vDamUserRoleRef=Supplier, vDamUserRoleRef=WorkshopOperatorOnline
      vDamService_3101FF00: vDamIdentifierRef=Routine_3101FF00_FlashErase_Start, vDamUserRoleRef=FOTA, vDamUserRoleRef=IndependentWorkshopOperatorOnline, vDamUserRoleRef=IndependentWorkshopOperatorPassThroughOnline, vDamUserRoleRef=Supplier, vDamUserRoleRef=WorkshopOperatorOnline
      vDamService_3101FF01: vDamIdentifierRef=Routine_3101FF01_checkProgrammingDependencies_FlashChecksum_Start, vDamUserRoleRef=FOTA, vDamUserRoleRef=IndependentWorkshopOperatorOnline, vDamUserRoleRef=IndependentWorkshopOperatorPassThroughOnline, vDamUserRoleRef=Supplier, vDamUserRoleRef=WorkshopOperatorOnline
      vDamService_3101FE0E: vDamUserRoleRef=Supplier, vDamIdentifierRef=Routine_3101FE0E_Test_Pattern_Control_Start, vDamUserRoleRef=AfterMarket, vDamUserRoleRef=Anonymous, vDamUserRoleRef=FOTA, vDamUserRoleRef=IndependentWorkshopOperatorOnline, vDamUserRoleRef=IndependentWorkshopOperatorPassThroughOnline, vDamUserRoleRef=OnBoardTool, vDamUserRoleRef=WorkshopOperatorOffline, vDamUserRoleRef=WorkshopOperatorOnline
    EngineerLevel2 (vDamUserRole): vDamUserRoleIdentifier=1024
    96 x vDamService, all with vDamUserRoleRef=Engineer, vDamUserRoleRef=Manufacturing, vDamUserRoleRef=Supplier:
      vDamService_31011000: vDamServiceRef=RoutineControl, vDamUserRoleRef=AfterMarket, vDamIdentifierRef=Routine_31011000_USS_Debug_Signals_Enable_Disable_Start, vDamUserRoleRef=FOTA, vDamUserRoleRef=IndependentWorkshopOperatorOnline, vDamUserRoleRef=IndependentWorkshopOperatorPassThroughOnline, vDamUserRoleRef=OnBoardTool, vDamUserRoleRef=WorkshopOperatorOffline, vDamUserRoleRef=WorkshopOperatorOnline, vDamUserRoleRef=Anonymous
      vDamService_31013000: vDamServiceRef=RoutineControl, vDamUserRoleRef=AfterMarket, vDamIdentifierRef=Routine_31013000_XCP_Enable_Disable_Start, vDamUserRoleRef=FOTA, vDamUserRoleRef=IndependentWorkshopOperatorOnline, vDamUserRoleRef=IndependentWorkshopOperatorPassThroughOnline, vDamUserRoleRef=OnBoardTool, vDamUserRoleRef=WorkshopOperatorOffline, vDamUserRoleRef=WorkshopOperatorOnline, vDamUserRoleRef=Anonymous
      vDamService_3101FE01: vDamServiceRef=RoutineControl, vDamUserRoleRef=AfterMarket, vDamIdentifierRef=Routine_3101FE01_Calibration_Data_Reset_Start, vDamUserRoleRef=FOTA, vDamUserRoleRef=IndependentWorkshopOperatorOnline, vDamUserRoleRef=IndependentWorkshopOperatorPassThroughOnline, vDamUserRoleRef=OnBoardTool, vDamUserRoleRef=WorkshopOperatorOffline, vDamUserRoleRef=WorkshopOperatorOnline, vDamUserRoleRef=Anonymous
      vDamService_3101FE02: vDamServiceRef=RoutineControl, vDamUserRoleRef=AfterMarket, vDamUserRoleRef=FOTA, vDamUserRoleRef=IndependentWorkshopOperatorOnline, vDamUserRoleRef=IndependentWorkshopOperatorPassThroughOnline, vDamUserRoleRef=OnBoardTool, vDamUserRoleRef=WorkshopOperatorOffline, vDamUserRoleRef=WorkshopOperatorOnline, vDamIdentifierRef=Routine_3101FE02_Test_Write_PMIC_Register_Start, vDamUserRoleRef=Anonymous
      vDamService_3101FE0B: vDamServiceRef=RoutineControl, vDamUserRoleRef=AfterMarket, vDamUserRoleRef=FOTA, vDamUserRoleRef=IndependentWorkshopOperatorOnline, vDamUserRoleRef=IndependentWorkshopOperatorPassThroughOnline, vDamUserRoleRef=OnBoardTool, vDamUserRoleRef=WorkshopOperatorOffline, vDamUserRoleRef=WorkshopOperatorOnline, vDamUserRoleRef=Anonymous
      vDamService_3101FE12: vDamServiceRef=RoutineControl, vDamUserRoleRef=AfterMarket, vDamUserRoleRef=FOTA, vDamUserRoleRef=IndependentWorkshopOperatorOnline, vDamUserRoleRef=IndependentWorkshopOperatorPassThroughOnline, vDamUserRoleRef=OnBoardTool, vDamUserRoleRef=WorkshopOperatorOffline, vDamUserRoleRef=WorkshopOperatorOnline, vDamUserRoleRef=Anonymous
      vDamService_3101FF03: vDamServiceRef=RoutineControl, vDamUserRoleRef=AfterMarket, vDamUserRoleRef=FOTA, vDamUserRoleRef=IndependentWorkshopOperatorOnline, vDamUserRoleRef=IndependentWorkshopOperatorPassThroughOnline, vDamUserRoleRef=OnBoardTool, vDamUserRoleRef=WorkshopOperatorOffline, vDamUserRoleRef=WorkshopOperatorOnline, vDamIdentifierRef=Routine_3101FF03_Test_Read_PMIC_Register_Start, vDamUserRoleRef=Anonymous
      vDamService_220108: vDamServiceRef=ReadDataById, vDamUserRoleRef=AfterMarket, vDamUserRoleRef=FOTA, vDamUserRoleRef=IndependentWorkshopOperatorOnline, vDamUserRoleRef=IndependentWorkshopOperatorPassThroughOnline, vDamUserRoleRef=OnBoardTool, vDamUserRoleRef=WorkshopOperatorOffline, vDamUserRoleRef=WorkshopOperatorOnline, vDamIdentifierRef=DID_220108_Authenticated_Diagnostics_Active_Role_Read, vDamUserRoleRef=Anonymous
      vDamService_221004: vDamServiceRef=ReadDataById, vDamUserRoleRef=AfterMarket, vDamUserRoleRef=FOTA, vDamUserRoleRef=IndependentWorkshopOperatorOnline, vDamUserRoleRef=IndependentWorkshopOperatorPassThroughOnline, vDamUserRoleRef=OnBoardTool, vDamUserRoleRef=WorkshopOperatorOffline, vDamUserRoleRef=WorkshopOperatorOnline, vDamIdentifierRef=DID_221004_Battery_Voltage, vDamUserRoleRef=Anonymous
      vDamService_221008: vDamServiceRef=ReadDataById, vDamUserRoleRef=AfterMarket, vDamUserRoleRef=FOTA, vDamUserRoleRef=IndependentWorkshopOperatorOnline, vDamUserRoleRef=IndependentWorkshopOperatorPassThroughOnline, vDamUserRoleRef=OnBoardTool, vDamUserRoleRef=WorkshopOperatorOffline, vDamUserRoleRef=WorkshopOperatorOnline, vDamIdentifierRef=DID_221008_ECU_Life_Time, vDamUserRoleRef=Anonymous
      vDamService_221009: vDamServiceRef=ReadDataById, vDamUserRoleRef=AfterMarket, vDamUserRoleRef=FOTA, vDamUserRoleRef=IndependentWorkshopOperatorOnline, vDamUserRoleRef=IndependentWorkshopOperatorPassThroughOnline, vDamUserRoleRef=OnBoardTool, vDamUserRoleRef=WorkshopOperatorOffline, vDamUserRoleRef=WorkshopOperatorOnline, vDamIdentifierRef=DID_221009_ECU_Time_Since_Ignition_ON, vDamUserRoleRef=Anonymous
      vDamService_22100B: vDamServiceRef=ReadDataById, vDamUserRoleRef=AfterMarket, vDamUserRoleRef=FOTA, vDamUserRoleRef=IndependentWorkshopOperatorOnline, vDamUserRoleRef=IndependentWorkshopOperatorPassThroughOnline, vDamUserRoleRef=OnBoardTool, vDamUserRoleRef=WorkshopOperatorOffline, vDamUserRoleRef=WorkshopOperatorOnline, vDamIdentifierRef=DID_22100B_Diagnostic_Tool_and_Session_Status, vDamUserRoleRef=Anonymous
      vDamService_22100C: vDamServiceRef=ReadDataById, vDamUserRoleRef=AfterMarket, vDamUserRoleRef=FOTA, vDamUserRoleRef=IndependentWorkshopOperatorOnline, vDamUserRoleRef=IndependentWorkshopOperatorPassThroughOnline, vDamUserRoleRef=OnBoardTool, vDamUserRoleRef=WorkshopOperatorOffline, vDamUserRoleRef=WorkshopOperatorOnline, vDamIdentifierRef=DID_22100C_Security_Status_Read, vDamUserRoleRef=Anonymous
      vDamService_22191D: vDamServiceRef=ReadDataById, vDamUserRoleRef=AfterMarket, vDamUserRoleRef=FOTA, vDamUserRoleRef=IndependentWorkshopOperatorOnline, vDamUserRoleRef=IndependentWorkshopOperatorPassThroughOnline, vDamUserRoleRef=OnBoardTool, vDamUserRoleRef=WorkshopOperatorOffline, vDamUserRoleRef=WorkshopOperatorOnline, vDamIdentifierRef=DID_22191D_Time_of_Power_Latch, vDamUserRoleRef=Anonymous
      vDamService_221921: vDamServiceRef=ReadDataById, vDamUserRoleRef=AfterMarket, vDamUserRoleRef=FOTA, vDamUserRoleRef=IndependentWorkshopOperatorOnline, vDamUserRoleRef=IndependentWorkshopOperatorPassThroughOnline, vDamUserRoleRef=OnBoardTool, vDamUserRoleRef=WorkshopOperatorOffline, vDamUserRoleRef=WorkshopOperatorOnline, vDamIdentifierRef=DID_221921_Operational_Mode_Status, vDamUserRoleRef=Anonymous
      vDamService_222001: vDamServiceRef=ReadDataById, vDamUserRoleRef=AfterMarket, vDamUserRoleRef=FOTA, vDamUserRoleRef=IndependentWorkshopOperatorOnline, vDamUserRoleRef=IndependentWorkshopOperatorPassThroughOnline, vDamUserRoleRef=OnBoardTool, vDamUserRoleRef=WorkshopOperatorOffline, vDamUserRoleRef=WorkshopOperatorOnline, vDamIdentifierRef=DID_222001_Odometer, vDamUserRoleRef=Anonymous
      vDamService_222002: vDamServiceRef=ReadDataById, vDamUserRoleRef=AfterMarket, vDamUserRoleRef=FOTA, vDamUserRoleRef=IndependentWorkshopOperatorOnline, vDamUserRoleRef=IndependentWorkshopOperatorPassThroughOnline, vDamUserRoleRef=OnBoardTool, vDamUserRoleRef=WorkshopOperatorOffline, vDamUserRoleRef=WorkshopOperatorOnline, vDamIdentifierRef=DID_222002_Odometer_at_last_Flash_programming, vDamUserRoleRef=Anonymous
      vDamService_222008: vDamServiceRef=ReadDataById, vDamUserRoleRef=AfterMarket, vDamUserRoleRef=FOTA, vDamUserRoleRef=IndependentWorkshopOperatorOnline, vDamUserRoleRef=IndependentWorkshopOperatorPassThroughOnline, vDamUserRoleRef=OnBoardTool, vDamUserRoleRef=WorkshopOperatorOffline, vDamUserRoleRef=WorkshopOperatorOnline, vDamIdentifierRef=DID_222008_ECU_Life_Time_Not_Volatile_Memory, vDamUserRoleRef=Anonymous
      vDamService_22200A: vDamServiceRef=ReadDataById, vDamUserRoleRef=AfterMarket, vDamUserRoleRef=FOTA, vDamUserRoleRef=IndependentWorkshopOperatorOnline, vDamUserRoleRef=IndependentWorkshopOperatorPassThroughOnline, vDamUserRoleRef=OnBoardTool, vDamUserRoleRef=WorkshopOperatorOffline, vDamUserRoleRef=WorkshopOperatorOnline, vDamIdentifierRef=DID_22200A_Ignition_ON_Counter, vDamUserRoleRef=Anonymous
      vDamService_22200B: vDamServiceRef=ReadDataById, vDamUserRoleRef=AfterMarket, vDamUserRoleRef=FOTA, vDamUserRoleRef=IndependentWorkshopOperatorOnline, vDamUserRoleRef=IndependentWorkshopOperatorPassThroughOnline, vDamUserRoleRef=OnBoardTool, vDamUserRoleRef=WorkshopOperatorOffline, vDamUserRoleRef=WorkshopOperatorOnline, vDamIdentifierRef=DID_22200B_Time_First_DTC_Detection, vDamUserRoleRef=Anonymous
      vDamService_22200C: vDamServiceRef=ReadDataById, vDamUserRoleRef=AfterMarket, vDamUserRoleRef=FOTA, vDamUserRoleRef=IndependentWorkshopOperatorOnline, vDamUserRoleRef=IndependentWorkshopOperatorPassThroughOnline, vDamUserRoleRef=OnBoardTool, vDamUserRoleRef=WorkshopOperatorOffline, vDamUserRoleRef=WorkshopOperatorOnline, vDamIdentifierRef=DID_22200C_Time_Since_Ignition_ON_of_first_DTC_Detection, vDamUserRoleRef=Anonymous
      vDamService_22200D: vDamServiceRef=ReadDataById, vDamUserRoleRef=AfterMarket, vDamUserRoleRef=FOTA, vDamUserRoleRef=IndependentWorkshopOperatorOnline, vDamUserRoleRef=IndependentWorkshopOperatorPassThroughOnline, vDamUserRoleRef=OnBoardTool, vDamUserRoleRef=WorkshopOperatorOffline, vDamUserRoleRef=WorkshopOperatorOnline, vDamIdentifierRef=DID_22200D_Odometer_Last_Clear_Data_Trouble_Code_DTC, vDamUserRoleRef=Anonymous
      vDamService_222026: vDamServiceRef=ReadDataById, vDamUserRoleRef=AfterMarket, vDamUserRoleRef=FOTA, vDamUserRoleRef=IndependentWorkshopOperatorOnline, vDamUserRoleRef=IndependentWorkshopOperatorPassThroughOnline, vDamUserRoleRef=OnBoardTool, vDamUserRoleRef=WorkshopOperatorOffline, vDamUserRoleRef=WorkshopOperatorOnline, vDamIdentifierRef=DID_222026_CAN_Overrun_Counters, vDamUserRoleRef=Anonymous
      vDamService_225300: vDamServiceRef=ReadDataById, vDamUserRoleRef=AfterMarket, vDamUserRoleRef=FOTA, vDamUserRoleRef=IndependentWorkshopOperatorOnline, vDamUserRoleRef=IndependentWorkshopOperatorPassThroughOnline, vDamUserRoleRef=OnBoardTool, vDamUserRoleRef=WorkshopOperatorOffline, vDamUserRoleRef=WorkshopOperatorOnline, vDamIdentifierRef=DID_225300_Rear_Braking_Event_1_Read, vDamUserRoleRef=Anonymous
      vDamService_225301: vDamServiceRef=ReadDataById, vDamUserRoleRef=AfterMarket, vDamUserRoleRef=FOTA, vDamUserRoleRef=IndependentWorkshopOperatorOnline, vDamUserRoleRef=IndependentWorkshopOperatorPassThroughOnline, vDamUserRoleRef=OnBoardTool, vDamUserRoleRef=WorkshopOperatorOffline, vDamUserRoleRef=WorkshopOperatorOnline, vDamIdentifierRef=DID_225301_Rear_Braking_Event_2_Read, vDamUserRoleRef=Anonymous
      vDamService_225302: vDamServiceRef=ReadDataById, vDamUserRoleRef=AfterMarket, vDamUserRoleRef=FOTA, vDamUserRoleRef=IndependentWorkshopOperatorOnline, vDamUserRoleRef=IndependentWorkshopOperatorPassThroughOnline, vDamUserRoleRef=OnBoardTool, vDamUserRoleRef=WorkshopOperatorOffline, vDamUserRoleRef=WorkshopOperatorOnline, vDamIdentifierRef=DID_225302_Rear_Braking_Event_3_Read, vDamUserRoleRef=Anonymous
      vDamService_225500: vDamServiceRef=ReadDataById, vDamIdentifierRef=DID_225500_Trailer_Sense_and_Drive_Function_Data_Read
      vDamService_225501: vDamServiceRef=ReadDataById, vDamIdentifierRef=DID_225501_Trailer_coupler_sense_detection_Function_Data_Read
      vDamService_22F110: vDamServiceRef=ReadDataById, vDamUserRoleRef=AfterMarket, vDamUserRoleRef=FOTA, vDamUserRoleRef=IndependentWorkshopOperatorOnline, vDamUserRoleRef=IndependentWorkshopOperatorPassThroughOnline, vDamUserRoleRef=OnBoardTool, vDamUserRoleRef=WorkshopOperatorOffline, vDamUserRoleRef=WorkshopOperatorOnline, vDamIdentifierRef=DID_22F110_ECU_Diagnostic_Identification, vDamUserRoleRef=Anonymous
      vDamService_22F186: vDamServiceRef=ReadDataById, vDamUserRoleRef=AfterMarket, vDamUserRoleRef=FOTA, vDamUserRoleRef=IndependentWorkshopOperatorOnline, vDamUserRoleRef=IndependentWorkshopOperatorPassThroughOnline, vDamUserRoleRef=OnBoardTool, vDamUserRoleRef=WorkshopOperatorOffline, vDamUserRoleRef=WorkshopOperatorOnline, vDamIdentifierRef=DID_22F186_Active_Diagnostic_Session, vDamUserRoleRef=Anonymous
      vDamService_22F18C: vDamServiceRef=ReadDataById, vDamUserRoleRef=AfterMarket, vDamUserRoleRef=FOTA, vDamUserRoleRef=IndependentWorkshopOperatorOnline, vDamUserRoleRef=IndependentWorkshopOperatorPassThroughOnline, vDamUserRoleRef=OnBoardTool, vDamUserRoleRef=WorkshopOperatorOffline, vDamUserRoleRef=WorkshopOperatorOnline, vDamIdentifierRef=DID_22F18C_ECU_Serial_Number, vDamUserRoleRef=Anonymous
      vDamService_22F190: vDamServiceRef=ReadDataById, vDamUserRoleRef=AfterMarket, vDamUserRoleRef=FOTA, vDamUserRoleRef=IndependentWorkshopOperatorOnline, vDamUserRoleRef=IndependentWorkshopOperatorPassThroughOnline, vDamUserRoleRef=OnBoardTool, vDamUserRoleRef=WorkshopOperatorOffline, vDamUserRoleRef=WorkshopOperatorOnline, vDamIdentifierRef=DID_22F190_VIN_Original, vDamUserRoleRef=Anonymous
      vDamService_22F1A6: vDamServiceRef=ReadDataById, vDamUserRoleRef=AfterMarket, vDamUserRoleRef=FOTA, vDamUserRoleRef=IndependentWorkshopOperatorOnline, vDamUserRoleRef=IndependentWorkshopOperatorPassThroughOnline, vDamUserRoleRef=OnBoardTool, vDamUserRoleRef=WorkshopOperatorOffline, vDamUserRoleRef=WorkshopOperatorOnline, vDamIdentifierRef=DID_22F1A6_Message_Matrix, vDamUserRoleRef=Anonymous
      vDamService_22F1B0: vDamServiceRef=ReadDataById, vDamUserRoleRef=AfterMarket, vDamUserRoleRef=FOTA, vDamUserRoleRef=IndependentWorkshopOperatorOnline, vDamUserRoleRef=IndependentWorkshopOperatorPassThroughOnline, vDamUserRoleRef=OnBoardTool, vDamUserRoleRef=WorkshopOperatorOffline, vDamUserRoleRef=WorkshopOperatorOnline, vDamIdentifierRef=DID_22F1B0_VIN_Current, vDamUserRoleRef=Anonymous
      vDamService_22FD00: vDamServiceRef=ReadDataById, vDamUserRoleRef=AfterMarket, vDamUserRoleRef=FOTA, vDamUserRoleRef=IndependentWorkshopOperatorOnline, vDamUserRoleRef=IndependentWorkshopOperatorPassThroughOnline, vDamUserRoleRef=OnBoardTool, vDamUserRoleRef=WorkshopOperatorOffline, vDamUserRoleRef=WorkshopOperatorOnline, vDamIdentifierRef=DID_22FD00_Plant_Camera_Calibration_Data, vDamUserRoleRef=Anonymous
      vDamService_22FD01: vDamServiceRef=ReadDataById, vDamUserRoleRef=AfterMarket, vDamUserRoleRef=FOTA, vDamUserRoleRef=IndependentWorkshopOperatorOnline, vDamUserRoleRef=IndependentWorkshopOperatorPassThroughOnline, vDamUserRoleRef=OnBoardTool, vDamUserRoleRef=WorkshopOperatorOffline, vDamUserRoleRef=WorkshopOperatorOnline, vDamIdentifierRef=DID_22FD01_Previous_Camera_Calibration_Data, vDamUserRoleRef=Anonymous
      vDamService_22FD46: vDamServiceRef=ReadDataById, vDamUserRoleRef=AfterMarket, vDamUserRoleRef=FOTA, vDamUserRoleRef=IndependentWorkshopOperatorOnline, vDamUserRoleRef=IndependentWorkshopOperatorPassThroughOnline, vDamUserRoleRef=OnBoardTool, vDamUserRoleRef=WorkshopOperatorOffline, vDamUserRoleRef=WorkshopOperatorOnline, vDamIdentifierRef=DID_22FD46_Camera_Power_Supply_Read, vDamUserRoleRef=Anonymous
      vDamService_22FD47: vDamServiceRef=ReadDataById, vDamUserRoleRef=AfterMarket, vDamUserRoleRef=FOTA, vDamUserRoleRef=IndependentWorkshopOperatorOnline, vDamUserRoleRef=IndependentWorkshopOperatorPassThroughOnline, vDamUserRoleRef=OnBoardTool, vDamUserRoleRef=WorkshopOperatorOffline, vDamUserRoleRef=WorkshopOperatorOnline, vDamIdentifierRef=DID_22FD47_SoC_Temperature_0xFD47_Read, vDamUserRoleRef=Anonymous
      vDamService_22FD48: vDamServiceRef=ReadDataById, vDamUserRoleRef=AfterMarket, vDamUserRoleRef=FOTA, vDamUserRoleRef=IndependentWorkshopOperatorOnline, vDamUserRoleRef=IndependentWorkshopOperatorPassThroughOnline, vDamUserRoleRef=OnBoardTool, vDamUserRoleRef=WorkshopOperatorOffline, vDamUserRoleRef=WorkshopOperatorOnline, vDamIdentifierRef=DID_22FD48_PCBA_Temperature_Read, vDamUserRoleRef=Anonymous
      vDamService_22FD49: vDamServiceRef=ReadDataById, vDamUserRoleRef=AfterMarket, vDamUserRoleRef=FOTA, vDamUserRoleRef=IndependentWorkshopOperatorOnline, vDamUserRoleRef=IndependentWorkshopOperatorPassThroughOnline, vDamUserRoleRef=OnBoardTool, vDamUserRoleRef=WorkshopOperatorOffline, vDamUserRoleRef=WorkshopOperatorOnline, vDamIdentifierRef=DID_22FD49_SoC_Die_Temperature_ID_0xFD49_Read, vDamUserRoleRef=Anonymous
      vDamService_22FD4A: vDamServiceRef=ReadDataById, vDamUserRoleRef=AfterMarket, vDamUserRoleRef=FOTA, vDamUserRoleRef=IndependentWorkshopOperatorOnline, vDamUserRoleRef=IndependentWorkshopOperatorPassThroughOnline, vDamUserRoleRef=OnBoardTool, vDamUserRoleRef=WorkshopOperatorOffline, vDamUserRoleRef=WorkshopOperatorOnline, vDamIdentifierRef=DID_22FD4A_Ultrasonic_Sensors_Power_supply_and_Current_Level_Read, vDamUserRoleRef=Anonymous
      vDamService_22FD38: vDamServiceRef=ReadDataById, vDamUserRoleRef=AfterMarket, vDamUserRoleRef=FOTA, vDamUserRoleRef=IndependentWorkshopOperatorOnline, vDamUserRoleRef=IndependentWorkshopOperatorPassThroughOnline, vDamUserRoleRef=OnBoardTool, vDamUserRoleRef=WorkshopOperatorOffline, vDamUserRoleRef=WorkshopOperatorOnline, vDamIdentifierRef=DID_22FD38_Programmed_Assembly, vDamUserRoleRef=Anonymous
      vDamService_22FD17: vDamServiceRef=ReadDataById, vDamUserRoleRef=AfterMarket, vDamUserRoleRef=FOTA, vDamUserRoleRef=IndependentWorkshopOperatorOnline, vDamUserRoleRef=IndependentWorkshopOperatorPassThroughOnline, vDamUserRoleRef=OnBoardTool, vDamUserRoleRef=WorkshopOperatorOffline, vDamUserRoleRef=WorkshopOperatorOnline, vDamIdentifierRef=DID_22FD17_Magna_Production_HW_Version_information_Read, vDamUserRoleRef=Anonymous
      vDamService_22FD13: vDamServiceRef=ReadDataById, vDamUserRoleRef=AfterMarket, vDamUserRoleRef=FOTA, vDamUserRoleRef=IndependentWorkshopOperatorOnline, vDamUserRoleRef=IndependentWorkshopOperatorPassThroughOnline, vDamUserRoleRef=OnBoardTool, vDamUserRoleRef=WorkshopOperatorOffline, vDamUserRoleRef=WorkshopOperatorOnline, vDamIdentifierRef=DID_22FD13_Magna_Software_Version, vDamUserRoleRef=Anonymous
      vDamService_22FD08: vDamServiceRef=ReadDataById, vDamUserRoleRef=AfterMarket, vDamUserRoleRef=FOTA, vDamUserRoleRef=IndependentWorkshopOperatorOnline, vDamUserRoleRef=IndependentWorkshopOperatorPassThroughOnline, vDamUserRoleRef=OnBoardTool, vDamUserRoleRef=WorkshopOperatorOffline, vDamUserRoleRef=WorkshopOperatorOnline, vDamIdentifierRef=DID_22FD08_OC_Data_Read, vDamUserRoleRef=Anonymous
      vDamService_22FD0A: vDamServiceRef=ReadDataById, vDamUserRoleRef=AfterMarket, vDamUserRoleRef=FOTA, vDamUserRoleRef=IndependentWorkshopOperatorOnline, vDamUserRoleRef=IndependentWorkshopOperatorPassThroughOnline, vDamUserRoleRef=OnBoardTool, vDamUserRoleRef=WorkshopOperatorOffline, vDamUserRoleRef=WorkshopOperatorOnline, vDamIdentifierRef=DID_22FD0A_SC_Data_Read, vDamUserRoleRef=Anonymous
      vDamService_22FD0D: vDamServiceRef=ReadDataById, vDamUserRoleRef=AfterMarket, vDamUserRoleRef=FOTA, vDamUserRoleRef=IndependentWorkshopOperatorOnline, vDamUserRoleRef=IndependentWorkshopOperatorPassThroughOnline, vDamUserRoleRef=OnBoardTool, vDamUserRoleRef=WorkshopOperatorOffline, vDamUserRoleRef=WorkshopOperatorOnline, vDamIdentifierRef=DID_22FD0D_Left_Camera_Data_EEPROM_Read, vDamUserRoleRef=Anonymous
      vDamService_22FD0E: vDamServiceRef=ReadDataById, vDamUserRoleRef=AfterMarket, vDamUserRoleRef=FOTA, vDamUserRoleRef=IndependentWorkshopOperatorOnline, vDamUserRoleRef=IndependentWorkshopOperatorPassThroughOnline, vDamUserRoleRef=OnBoardTool, vDamUserRoleRef=WorkshopOperatorOffline, vDamUserRoleRef=WorkshopOperatorOnline, vDamIdentifierRef=DID_22FD0E_Rear_Camera_Data_EEPROM_Read, vDamUserRoleRef=Anonymous
      vDamService_22FD0F: vDamServiceRef=ReadDataById, vDamUserRoleRef=AfterMarket, vDamUserRoleRef=FOTA, vDamUserRoleRef=IndependentWorkshopOperatorOnline, vDamUserRoleRef=IndependentWorkshopOperatorPassThroughOnline, vDamUserRoleRef=OnBoardTool, vDamUserRoleRef=WorkshopOperatorOffline, vDamUserRoleRef=WorkshopOperatorOnline, vDamIdentifierRef=DID_22FD0F_Right_Camera_Data_EEPROM_Read, vDamUserRoleRef=Anonymous
      vDamService_22FD14: vDamServiceRef=ReadDataById, vDamUserRoleRef=AfterMarket, vDamUserRoleRef=FOTA, vDamUserRoleRef=IndependentWorkshopOperatorOnline, vDamUserRoleRef=IndependentWorkshopOperatorPassThroughOnline, vDamUserRoleRef=OnBoardTool, vDamUserRoleRef=WorkshopOperatorOffline, vDamUserRoleRef=WorkshopOperatorOnline, vDamIdentifierRef=DID_22FD14_FD14_Magna_Production_Date_Read, vDamUserRoleRef=Anonymous
      vDamService_22FD15: vDamServiceRef=ReadDataById, vDamUserRoleRef=AfterMarket, vDamUserRoleRef=FOTA, vDamUserRoleRef=IndependentWorkshopOperatorOnline, vDamUserRoleRef=IndependentWorkshopOperatorPassThroughOnline, vDamUserRoleRef=OnBoardTool, vDamUserRoleRef=WorkshopOperatorOffline, vDamUserRoleRef=WorkshopOperatorOnline, vDamIdentifierRef=DID_22FD15_Magna_Production_HW_Number_Read, vDamUserRoleRef=Anonymous
      vDamService_22FD16: vDamServiceRef=ReadDataById, vDamUserRoleRef=AfterMarket, vDamUserRoleRef=FOTA, vDamUserRoleRef=IndependentWorkshopOperatorOnline, vDamUserRoleRef=IndependentWorkshopOperatorPassThroughOnline, vDamUserRoleRef=OnBoardTool, vDamUserRoleRef=WorkshopOperatorOffline, vDamUserRoleRef=WorkshopOperatorOnline, vDamIdentifierRef=DID_22FD16_Magna_Production_ICT_Data_Read, vDamUserRoleRef=Anonymous
      vDamService_22FD1C: vDamServiceRef=ReadDataById, vDamUserRoleRef=AfterMarket, vDamUserRoleRef=FOTA, vDamUserRoleRef=IndependentWorkshopOperatorOnline, vDamUserRoleRef=IndependentWorkshopOperatorPassThroughOnline, vDamUserRoleRef=OnBoardTool, vDamUserRoleRef=WorkshopOperatorOffline, vDamUserRoleRef=WorkshopOperatorOnline, vDamIdentifierRef=DID_22FD1C_Current_Camera_Calibration_Data_Read, vDamUserRoleRef=Anonymous
      vDamService_22FD1E: vDamServiceRef=ReadDataById, vDamUserRoleRef=AfterMarket, vDamUserRoleRef=FOTA, vDamUserRoleRef=IndependentWorkshopOperatorOnline, vDamUserRoleRef=IndependentWorkshopOperatorPassThroughOnline, vDamUserRoleRef=OnBoardTool, vDamUserRoleRef=WorkshopOperatorOffline, vDamUserRoleRef=WorkshopOperatorOnline, vDamIdentifierRef=DID_22FD1E_Calibration_Status_Read, vDamUserRoleRef=Anonymous
      vDamService_22FD20: vDamServiceRef=ReadDataById, vDamUserRoleRef=AfterMarket, vDamUserRoleRef=FOTA, vDamUserRoleRef=IndependentWorkshopOperatorOnline, vDamUserRoleRef=IndependentWorkshopOperatorPassThroughOnline, vDamUserRoleRef=OnBoardTool, vDamUserRoleRef=WorkshopOperatorOffline, vDamUserRoleRef=WorkshopOperatorOnline, vDamIdentifierRef=DID_22FD20_ECU_PinStates_Read, vDamUserRoleRef=Anonymous
      vDamService_22FD28: vDamServiceRef=ReadDataById, vDamUserRoleRef=AfterMarket, vDamUserRoleRef=FOTA, vDamUserRoleRef=IndependentWorkshopOperatorOnline, vDamUserRoleRef=IndependentWorkshopOperatorPassThroughOnline, vDamUserRoleRef=OnBoardTool, vDamUserRoleRef=WorkshopOperatorOffline, vDamUserRoleRef=WorkshopOperatorOnline, vDamIdentifierRef=DID_22FD28_USS_Ringing_Frequency_Read, vDamUserRoleRef=Anonymous
      vDamService_22FD29: vDamServiceRef=ReadDataById, vDamUserRoleRef=AfterMarket, vDamUserRoleRef=FOTA, vDamUserRoleRef=IndependentWorkshopOperatorOnline, vDamUserRoleRef=IndependentWorkshopOperatorPassThroughOnline, vDamUserRoleRef=OnBoardTool, vDamUserRoleRef=WorkshopOperatorOffline, vDamUserRoleRef=WorkshopOperatorOnline, vDamIdentifierRef=DID_22FD29_USS_Driving_Frequency_Read, vDamUserRoleRef=Anonymous
      vDamService_22FD2A: vDamServiceRef=ReadDataById, vDamUserRoleRef=AfterMarket, vDamUserRoleRef=FOTA, vDamUserRoleRef=IndependentWorkshopOperatorOnline, vDamUserRoleRef=IndependentWorkshopOperatorPassThroughOnline, vDamUserRoleRef=OnBoardTool, vDamUserRoleRef=WorkshopOperatorOffline, vDamUserRoleRef=WorkshopOperatorOnline, vDamIdentifierRef=DID_22FD2A_USS_Ringing_Time_Read, vDamUserRoleRef=Anonymous
      vDamService_22FD2B: vDamServiceRef=ReadDataById, vDamUserRoleRef=AfterMarket, vDamUserRoleRef=FOTA, vDamUserRoleRef=IndependentWorkshopOperatorOnline, vDamUserRoleRef=IndependentWorkshopOperatorPassThroughOnline, vDamUserRoleRef=OnBoardTool, vDamUserRoleRef=WorkshopOperatorOffline, vDamUserRoleRef=WorkshopOperatorOnline, vDamIdentifierRef=DID_22FD2B_USS_Direct_Distance_0xFD2B_Read, vDamUserRoleRef=Anonymous
      vDamService_22FD2C: vDamServiceRef=ReadDataById, vDamUserRoleRef=AfterMarket, vDamUserRoleRef=FOTA, vDamUserRoleRef=IndependentWorkshopOperatorOnline, vDamUserRoleRef=IndependentWorkshopOperatorPassThroughOnline, vDamUserRoleRef=OnBoardTool, vDamUserRoleRef=WorkshopOperatorOffline, vDamUserRoleRef=WorkshopOperatorOnline, vDamIdentifierRef=DID_22FD2C_USS_Temperature_Read, vDamUserRoleRef=Anonymous
      vDamService_22FD2D: vDamServiceRef=ReadDataById, vDamUserRoleRef=AfterMarket, vDamUserRoleRef=FOTA, vDamUserRoleRef=IndependentWorkshopOperatorOnline, vDamUserRoleRef=IndependentWorkshopOperatorPassThroughOnline, vDamUserRoleRef=OnBoardTool, vDamUserRoleRef=WorkshopOperatorOffline, vDamUserRoleRef=WorkshopOperatorOnline, vDamIdentifierRef=DID_22FD2D_USS_Sensor_ID_IME_SN_Read, vDamUserRoleRef=Anonymous
      vDamService_22FD2E: vDamServiceRef=ReadDataById, vDamUserRoleRef=AfterMarket, vDamUserRoleRef=FOTA, vDamUserRoleRef=IndependentWorkshopOperatorOnline, vDamUserRoleRef=IndependentWorkshopOperatorPassThroughOnline, vDamUserRoleRef=OnBoardTool, vDamUserRoleRef=WorkshopOperatorOffline, vDamUserRoleRef=WorkshopOperatorOnline, vDamIdentifierRef=DID_22FD2E_USS_Sensor_ID_Murata_SN_Read, vDamUserRoleRef=Anonymous
      vDamService_22FD31: vDamServiceRef=ReadDataById, vDamUserRoleRef=AfterMarket, vDamUserRoleRef=FOTA, vDamUserRoleRef=IndependentWorkshopOperatorOnline, vDamUserRoleRef=IndependentWorkshopOperatorPassThroughOnline, vDamUserRoleRef=OnBoardTool, vDamUserRoleRef=WorkshopOperatorOffline, vDamUserRoleRef=WorkshopOperatorOnline, vDamIdentifierRef=DID_22FD31_Magna_EOL_Coding_State_Read, vDamUserRoleRef=Anonymous
      vDamService_22FD86: vDamServiceRef=ReadDataById, vDamUserRoleRef=AfterMarket, vDamUserRoleRef=FOTA, vDamUserRoleRef=IndependentWorkshopOperatorOnline, vDamUserRoleRef=IndependentWorkshopOperatorPassThroughOnline, vDamUserRoleRef=OnBoardTool, vDamUserRoleRef=WorkshopOperatorOffline, vDamUserRoleRef=WorkshopOperatorOnline, vDamIdentifierRef=DID_22FD86_Functional_Settings_Read, vDamUserRoleRef=Anonymous
      vDamService_22FD42: vDamServiceRef=ReadDataById, vDamUserRoleRef=AfterMarket, vDamUserRoleRef=FOTA, vDamUserRoleRef=IndependentWorkshopOperatorOnline, vDamUserRoleRef=IndependentWorkshopOperatorPassThroughOnline, vDamUserRoleRef=OnBoardTool, vDamUserRoleRef=WorkshopOperatorOffline, vDamUserRoleRef=WorkshopOperatorOnline, vDamIdentifierRef=DID_22FD42_Failsafe_Behaviour_Read, vDamUserRoleRef=Anonymous
      vDamService_224421: vDamServiceRef=ReadDataById, vDamUserRoleRef=AfterMarket, vDamUserRoleRef=FOTA, vDamUserRoleRef=IndependentWorkshopOperatorOnline, vDamUserRoleRef=IndependentWorkshopOperatorPassThroughOnline, vDamUserRoleRef=OnBoardTool, vDamUserRoleRef=WorkshopOperatorOffline, vDamUserRoleRef=WorkshopOperatorOnline, vDamIdentifierRef=DID_224421_USS_Sensor_1_Part_Number_Read, vDamUserRoleRef=Anonymous
      vDamService_224422: vDamServiceRef=ReadDataById, vDamUserRoleRef=AfterMarket, vDamUserRoleRef=FOTA, vDamUserRoleRef=IndependentWorkshopOperatorOnline, vDamUserRoleRef=IndependentWorkshopOperatorPassThroughOnline, vDamUserRoleRef=OnBoardTool, vDamUserRoleRef=WorkshopOperatorOffline, vDamUserRoleRef=WorkshopOperatorOnline, vDamIdentifierRef=DID_224422_USS_Sensor2_Part_Number_Read, vDamUserRoleRef=Anonymous
      vDamService_224423: vDamServiceRef=ReadDataById, vDamUserRoleRef=AfterMarket, vDamUserRoleRef=FOTA, vDamUserRoleRef=IndependentWorkshopOperatorOnline, vDamUserRoleRef=IndependentWorkshopOperatorPassThroughOnline, vDamUserRoleRef=OnBoardTool, vDamUserRoleRef=WorkshopOperatorOffline, vDamUserRoleRef=WorkshopOperatorOnline, vDamIdentifierRef=DID_224423_USS_Sensor_3_Part_Number_Read, vDamUserRoleRef=Anonymous
      vDamService_224424: vDamServiceRef=ReadDataById, vDamUserRoleRef=AfterMarket, vDamUserRoleRef=FOTA, vDamUserRoleRef=IndependentWorkshopOperatorOnline, vDamUserRoleRef=IndependentWorkshopOperatorPassThroughOnline, vDamUserRoleRef=OnBoardTool, vDamUserRoleRef=WorkshopOperatorOffline, vDamUserRoleRef=WorkshopOperatorOnline, vDamIdentifierRef=DID_224424_USS_Sensor_4_Part_Number_Read, vDamUserRoleRef=Anonymous
      vDamService_224425: vDamServiceRef=ReadDataById, vDamUserRoleRef=AfterMarket, vDamUserRoleRef=FOTA, vDamUserRoleRef=IndependentWorkshopOperatorOnline, vDamUserRoleRef=IndependentWorkshopOperatorPassThroughOnline, vDamUserRoleRef=OnBoardTool, vDamUserRoleRef=WorkshopOperatorOffline, vDamUserRoleRef=WorkshopOperatorOnline, vDamIdentifierRef=DID_224425_USS_Sensor_5_Part_Number_Read, vDamUserRoleRef=Anonymous
      vDamService_224426: vDamServiceRef=ReadDataById, vDamUserRoleRef=AfterMarket, vDamUserRoleRef=FOTA, vDamUserRoleRef=IndependentWorkshopOperatorOnline, vDamUserRoleRef=IndependentWorkshopOperatorPassThroughOnline, vDamUserRoleRef=OnBoardTool, vDamUserRoleRef=WorkshopOperatorOffline, vDamUserRoleRef=WorkshopOperatorOnline, vDamIdentifierRef=DID_224426_USS_Sensor_6_Part_Number_Read, vDamUserRoleRef=Anonymous
      vDamService_224427: vDamServiceRef=ReadDataById, vDamUserRoleRef=AfterMarket, vDamUserRoleRef=FOTA, vDamUserRoleRef=IndependentWorkshopOperatorOnline, vDamUserRoleRef=IndependentWorkshopOperatorPassThroughOnline, vDamUserRoleRef=OnBoardTool, vDamUserRoleRef=WorkshopOperatorOffline, vDamUserRoleRef=WorkshopOperatorOnline, vDamIdentifierRef=DID_224427_USS_Sensor_7_Part_Number_Read, vDamUserRoleRef=Anonymous
      vDamService_224428: vDamServiceRef=ReadDataById, vDamUserRoleRef=AfterMarket, vDamUserRoleRef=FOTA, vDamUserRoleRef=IndependentWorkshopOperatorOnline, vDamUserRoleRef=IndependentWorkshopOperatorPassThroughOnline, vDamUserRoleRef=OnBoardTool, vDamUserRoleRef=WorkshopOperatorOffline, vDamUserRoleRef=WorkshopOperatorOnline, vDamIdentifierRef=DID_224428_USS_Sensor_8_Part_Number_Read, vDamUserRoleRef=Anonymous
      vDamService_224429: vDamServiceRef=ReadDataById, vDamUserRoleRef=AfterMarket, vDamUserRoleRef=FOTA, vDamUserRoleRef=IndependentWorkshopOperatorOnline, vDamUserRoleRef=IndependentWorkshopOperatorPassThroughOnline, vDamUserRoleRef=OnBoardTool, vDamUserRoleRef=WorkshopOperatorOffline, vDamUserRoleRef=WorkshopOperatorOnline, vDamIdentifierRef=DID_224429_USS_Sensor_9_Part_Number_Read, vDamUserRoleRef=Anonymous
      vDamService_22442A: vDamServiceRef=ReadDataById, vDamUserRoleRef=AfterMarket, vDamUserRoleRef=FOTA, vDamUserRoleRef=IndependentWorkshopOperatorOnline, vDamUserRoleRef=IndependentWorkshopOperatorPassThroughOnline, vDamUserRoleRef=OnBoardTool, vDamUserRoleRef=WorkshopOperatorOffline, vDamUserRoleRef=WorkshopOperatorOnline, vDamIdentifierRef=DID_22442A_USS_Sensor_10_Part_Number_Read, vDamUserRoleRef=Anonymous
      vDamService_22442B: vDamServiceRef=ReadDataById, vDamUserRoleRef=AfterMarket, vDamUserRoleRef=FOTA, vDamUserRoleRef=IndependentWorkshopOperatorOnline, vDamUserRoleRef=IndependentWorkshopOperatorPassThroughOnline, vDamUserRoleRef=OnBoardTool, vDamUserRoleRef=WorkshopOperatorOffline, vDamUserRoleRef=WorkshopOperatorOnline, vDamIdentifierRef=DID_22442B_USS_Sensor_11_Part_Number_Read, vDamUserRoleRef=Anonymous
      vDamService_22FD62: vDamServiceRef=ReadDataById, vDamUserRoleRef=AfterMarket, vDamUserRoleRef=FOTA, vDamUserRoleRef=IndependentWorkshopOperatorOnline, vDamUserRoleRef=IndependentWorkshopOperatorPassThroughOnline, vDamUserRoleRef=OnBoardTool, vDamUserRoleRef=WorkshopOperatorOffline, vDamUserRoleRef=WorkshopOperatorOnline, vDamIdentifierRef=DID_22FD62_ASIL_QM_Fault_Status_Read, vDamUserRoleRef=Anonymous
      vDamService_22FD64: vDamServiceRef=ReadDataById, vDamUserRoleRef=AfterMarket, vDamUserRoleRef=FOTA, vDamUserRoleRef=IndependentWorkshopOperatorOnline, vDamUserRoleRef=IndependentWorkshopOperatorPassThroughOnline, vDamUserRoleRef=OnBoardTool, vDamUserRoleRef=WorkshopOperatorOffline, vDamUserRoleRef=WorkshopOperatorOnline, vDamIdentifierRef=DID_22FD64_ASIL_B_Fault_Status_Read, vDamUserRoleRef=Anonymous
      vDamService_22FDF0: vDamServiceRef=ReadDataById, vDamUserRoleRef=AfterMarket, vDamUserRoleRef=FOTA, vDamUserRoleRef=IndependentWorkshopOperatorOnline, vDamUserRoleRef=IndependentWorkshopOperatorPassThroughOnline, vDamUserRoleRef=OnBoardTool, vDamUserRoleRef=WorkshopOperatorOffline, vDamUserRoleRef=WorkshopOperatorOnline, vDamIdentifierRef=DID_22FDF0_ECU_shutdown_process_Read, vDamUserRoleRef=Anonymous
      vDamService_22FDF1: vDamServiceRef=ReadDataById, vDamUserRoleRef=AfterMarket, vDamUserRoleRef=FOTA, vDamUserRoleRef=IndependentWorkshopOperatorOnline, vDamUserRoleRef=IndependentWorkshopOperatorPassThroughOnline, vDamUserRoleRef=OnBoardTool, vDamUserRoleRef=WorkshopOperatorOffline, vDamUserRoleRef=WorkshopOperatorOnline, vDamIdentifierRef=DID_22FDF1_CPU_Load_Read, vDamUserRoleRef=Anonymous
      vDamService_22FDF2: vDamServiceRef=ReadDataById, vDamUserRoleRef=AfterMarket, vDamUserRoleRef=FOTA, vDamUserRoleRef=IndependentWorkshopOperatorOnline, vDamUserRoleRef=IndependentWorkshopOperatorPassThroughOnline, vDamUserRoleRef=OnBoardTool, vDamUserRoleRef=WorkshopOperatorOffline, vDamUserRoleRef=WorkshopOperatorOnline, vDamIdentifierRef=DID_22FDF2_Reset_Reason_Read, vDamUserRoleRef=Anonymous
      vDamService_22442C: vDamServiceRef=ReadDataById, vDamUserRoleRef=AfterMarket, vDamUserRoleRef=FOTA, vDamUserRoleRef=IndependentWorkshopOperatorOnline, vDamUserRoleRef=IndependentWorkshopOperatorPassThroughOnline, vDamUserRoleRef=OnBoardTool, vDamUserRoleRef=WorkshopOperatorOffline, vDamUserRoleRef=WorkshopOperatorOnline, vDamIdentifierRef=DID_22442C_USS_Sensor_12_Part_Number_Read, vDamUserRoleRef=Anonymous
      vDamService_224451: vDamServiceRef=ReadDataById, vDamUserRoleRef=AfterMarket, vDamUserRoleRef=FOTA, vDamUserRoleRef=IndependentWorkshopOperatorOnline, vDamUserRoleRef=IndependentWorkshopOperatorPassThroughOnline, vDamUserRoleRef=OnBoardTool, vDamUserRoleRef=WorkshopOperatorOffline, vDamUserRoleRef=WorkshopOperatorOnline, vDamIdentifierRef=DID_224451_EOL_Calibration_State_Read, vDamUserRoleRef=Anonymous
      vDamService_22FD61: vDamServiceRef=ReadDataById, vDamUserRoleRef=AfterMarket, vDamUserRoleRef=FOTA, vDamUserRoleRef=IndependentWorkshopOperatorOnline, vDamUserRoleRef=IndependentWorkshopOperatorPassThroughOnline, vDamUserRoleRef=OnBoardTool, vDamUserRoleRef=WorkshopOperatorOffline, vDamUserRoleRef=WorkshopOperatorOnline, vDamIdentifierRef=DID_22FD61_Vehicle_Variant_Coding_Data_Read, vDamUserRoleRef=Anonymous
      vDamService_22FD1D: vDamServiceRef=ReadDataById, vDamUserRoleRef=AfterMarket, vDamUserRoleRef=FOTA, vDamUserRoleRef=IndependentWorkshopOperatorOnline, vDamUserRoleRef=IndependentWorkshopOperatorPassThroughOnline, vDamUserRoleRef=OnBoardTool, vDamUserRoleRef=WorkshopOperatorOffline, vDamUserRoleRef=WorkshopOperatorOnline, vDamIdentifierRef=DID_22FD1D_PCB_Serial_Number, vDamUserRoleRef=Anonymous
      vDamService_221002: vDamServiceRef=ReadDataById, vDamUserRoleRef=AfterMarket, vDamUserRoleRef=FOTA, vDamUserRoleRef=IndependentWorkshopOperatorOnline, vDamUserRoleRef=IndependentWorkshopOperatorPassThroughOnline, vDamUserRoleRef=OnBoardTool, vDamUserRoleRef=WorkshopOperatorOffline, vDamUserRoleRef=WorkshopOperatorOnline, vDamIdentifierRef=DID_221002_Vehicle_Speed, vDamUserRoleRef=Anonymous
      vDamService_222003: vDamServiceRef=ReadDataById, vDamUserRoleRef=IndependentWorkshopOperatorOnline, vDamUserRoleRef=IndependentWorkshopOperatorPassThroughOnline, vDamUserRoleRef=WorkshopOperatorOnline, vDamIdentifierRef=DID_222003_Boot_Software_Programming_Attempt_Counter
      vDamService_222030: vDamServiceRef=ReadDataById, vDamIdentifierRef=DID_222030_Authenticated_Diagnostic_Previous_Access_Read
      vDamService_222031: vDamServiceRef=ReadDataById, vDamIdentifierRef=DID_222031_Disallowed_Certificate_List_Read
      vDamService_222957: vDamServiceRef=ReadDataById, vDamIdentifierRef=DID_222957_Hosted_App_Firmware_Header_Info_Read
      vDamService_222958: vDamServiceRef=ReadDataById, vDamIdentifierRef=DID_222958_Hosted_App_firmware_Header_UUID_Read
      vDamService_222959: vDamServiceRef=ReadDataById, vDamIdentifierRef=DID_222959_Hosted_App_Firmware_Cal_Config_Data_Header_Info_Read
      vDamService_22295A: vDamServiceRef=ReadDataById, vDamIdentifierRef=DID_22295A_Hosted_App_Firmware_Cal_Config_Data_Header_UUID_Read
      vDamService_22295E: vDamServiceRef=ReadDataById, vDamIdentifierRef=DID_22295E_DCL_Header_UUID_Read
      vDamService_22295F: vDamServiceRef=ReadDataById, vDamIdentifierRef=DID_22295F_DCL_and_Cerstore_Header_Info_Read
      vDamService_22FD60: vDamServiceRef=ReadDataById, vDamUserRoleRef=AfterMarket, vDamUserRoleRef=FOTA, vDamUserRoleRef=IndependentWorkshopOperatorOnline, vDamUserRoleRef=IndependentWorkshopOperatorPassThroughOnline, vDamUserRoleRef=OnBoardTool, vDamUserRoleRef=WorkshopOperatorOffline, vDamUserRoleRef=WorkshopOperatorOnline, vDamIdentifierRef=DID_22FD60_ECU_Software_Status_Read, vDamUserRoleRef=Anonymous
    Anonymous (vDamUserRole): vDamUserRoleIdentifier=2048
    18 x vDamService, all with vDamUserRoleRef=Engineer, vDamUserRoleRef=Manufacturing, vDamUserRoleRef=Supplier:
      vDamService_22FD07: vDamServiceRef=ReadDataById, vDamUserRoleRef=AfterMarket, vDamUserRoleRef=FOTA, vDamUserRoleRef=IndependentWorkshopOperatorOnline, vDamUserRoleRef=IndependentWorkshopOperatorPassThroughOnline, vDamUserRoleRef=OnBoardTool, vDamUserRoleRef=WorkshopOperatorOffline, vDamUserRoleRef=WorkshopOperatorOnline, vDamUserRoleRef=Anonymous, vDamIdentifierRef=DID_22FD07_OC_Result_Read
      vDamService_22FD0C: vDamServiceRef=ReadDataById, vDamUserRoleRef=AfterMarket, vDamUserRoleRef=FOTA, vDamUserRoleRef=IndependentWorkshopOperatorOnline, vDamUserRoleRef=IndependentWorkshopOperatorPassThroughOnline, vDamUserRoleRef=OnBoardTool, vDamUserRoleRef=WorkshopOperatorOffline, vDamUserRoleRef=WorkshopOperatorOnline, vDamUserRoleRef=Anonymous, vDamIdentifierRef=DID_22FD0C_Front_Camera_Data_EEPROM_Read
      vDamService_222024: vDamServiceRef=ReadDataById, vDamUserRoleRef=AfterMarket, vDamUserRoleRef=FOTA, vDamUserRoleRef=IndependentWorkshopOperatorOnline, vDamUserRoleRef=IndependentWorkshopOperatorPassThroughOnline, vDamUserRoleRef=OnBoardTool, vDamUserRoleRef=WorkshopOperatorOffline, vDamUserRoleRef=WorkshopOperatorOnline, vDamUserRoleRef=Anonymous, vDamIdentifierRef=DID_222024_Read_ECU_PROXI_Data
      vDamService_222951: vDamUserRoleRef=WorkshopOperatorOnline, vDamUserRoleRef=IndependentWorkshopOperatorPassThroughOnline, vDamUserRoleRef=IndependentWorkshopOperatorOnline, vDamUserRoleRef=FOTA, vDamUserRoleRef=AfterMarket, vDamUserRoleRef=WorkshopOperatorOffline, vDamUserRoleRef=OnBoardTool, vDamUserRoleRef=Anonymous, vDamIdentifierRef=DID_222951_Certificate_Store_UUID_Read, vDamServiceRef=ReadDataById
      vDamService_2E2023: vDamServiceRef=WriteDataById, vDamUserRoleRef=AfterMarket, vDamUserRoleRef=FOTA, vDamUserRoleRef=IndependentWorkshopOperatorOnline, vDamUserRoleRef=IndependentWorkshopOperatorPassThroughOnline, vDamUserRoleRef=OnBoardTool, vDamUserRoleRef=WorkshopOperatorOffline, vDamUserRoleRef=WorkshopOperatorOnline, vDamUserRoleRef=Anonymous, vDamIdentifierRef=DID_2E2023_PROXI_Data
      vDamService_2EF184: vDamServiceRef=WriteDataById, vDamUserRoleRef=FOTA, vDamUserRoleRef=IndependentWorkshopOperatorOnline, vDamUserRoleRef=IndependentWorkshopOperatorPassThroughOnline, vDamUserRoleRef=WorkshopOperatorOnline, vDamIdentifierRef=DID_2EF184_Application_Software_Fingerprint_writing_information
      vDamService_2EF185: vDamServiceRef=WriteDataById, vDamUserRoleRef=FOTA, vDamUserRoleRef=IndependentWorkshopOperatorOnline, vDamUserRoleRef=IndependentWorkshopOperatorPassThroughOnline, vDamUserRoleRef=WorkshopOperatorOnline, vDamIdentifierRef=DID_2EF185_Application_Data_Software_Fingerprint_Writing_Information
      vDamService_1002: vDamServiceRef=DiagSessionControl, vDamSubServiceRef=Programming, vDamUserRoleRef=EngineerLevel2, vDamUserRoleRef=FOTA, vDamUserRoleRef=IndependentWorkshopOperatorOnline, vDamUserRoleRef=IndependentWorkshopOperatorPassThroughOnline, vDamUserRoleRef=WorkshopOperatorOnline
      vDamService_34: vDamServiceRef=RequestDownload, vDamUserRoleRef=EngineerLevel2, vDamUserRoleRef=FOTA, vDamUserRoleRef=IndependentWorkshopOperatorOnline, vDamUserRoleRef=IndependentWorkshopOperatorPassThroughOnline, vDamUserRoleRef=WorkshopOperatorOnline
      vDamService_36: vDamServiceRef=TransferData, vDamUserRoleRef=EngineerLevel2, vDamUserRoleRef=FOTA, vDamUserRoleRef=IndependentWorkshopOperatorOnline, vDamUserRoleRef=IndependentWorkshopOperatorPassThroughOnline, vDamUserRoleRef=WorkshopOperatorOnline
      vDamService_37: vDamServiceRef=RequestTransferExit, vDamUserRoleRef=EngineerLevel2, vDamUserRoleRef=FOTA, vDamUserRoleRef=IndependentWorkshopOperatorOnline, vDamUserRoleRef=IndependentWorkshopOperatorPassThroughOnline, vDamUserRoleRef=WorkshopOperatorOnline
      vDamService_2E0107: vDamServiceRef=WriteDataById, vDamUserRoleRef=WorkshopOperatorOnline, vDamUserRoleRef=IndependentWorkshopOperatorPassThroughOnline, vDamUserRoleRef=IndependentWorkshopOperatorOnline, vDamUserRoleRef=FOTA, vDamIdentifierRef=DID_220107_RoE_Activation_State
      vDamService_2E2945: vDamServiceRef=WriteDataById, vDamIdentifierRef=DID_222945_Flow_Control_Test, vDamUserRoleRef=FOTA, vDamUserRoleRef=IndependentWorkshopOperatorOnline, vDamUserRoleRef=IndependentWorkshopOperatorPassThroughOnline, vDamUserRoleRef=WorkshopOperatorOnline
      vDamService_22FD43: vDamServiceRef=ReadDataById, vDamUserRoleRef=AfterMarket, vDamUserRoleRef=FOTA, vDamUserRoleRef=IndependentWorkshopOperatorOnline, vDamUserRoleRef=IndependentWorkshopOperatorPassThroughOnline, vDamUserRoleRef=OnBoardTool, vDamUserRoleRef=WorkshopOperatorOffline, vDamUserRoleRef=WorkshopOperatorOnline, vDamUserRoleRef=Anonymous, vDamIdentifierRef=DID_22FD43_Active_Safe_State_Read
      vDamService_22FD44: vDamServiceRef=ReadDataById, vDamUserRoleRef=AfterMarket, vDamUserRoleRef=FOTA, vDamUserRoleRef=IndependentWorkshopOperatorOnline, vDamUserRoleRef=IndependentWorkshopOperatorPassThroughOnline, vDamUserRoleRef=OnBoardTool, vDamUserRoleRef=WorkshopOperatorOffline, vDamUserRoleRef=WorkshopOperatorOnline, vDamUserRoleRef=Anonymous, vDamIdentifierRef=DID_22FD44_Error_Flags_Read
      vDamService_22FD74: vDamServiceRef=ReadDataById, vDamUserRoleRef=AfterMarket, vDamUserRoleRef=FOTA, vDamUserRoleRef=IndependentWorkshopOperatorOnline, vDamUserRoleRef=IndependentWorkshopOperatorPassThroughOnline, vDamUserRoleRef=OnBoardTool, vDamUserRoleRef=WorkshopOperatorOffline, vDamUserRoleRef=WorkshopOperatorOnline, vDamUserRoleRef=Anonymous, vDamIdentifierRef=DID_22FD74_PHY_Tunning_Error_And_Buffer_Mark_Error_Read
      vDamService_22295B: vDamServiceRef=ReadDataById, vDamIdentifierRef=DID_22295B_HTA_Header_Info_Read
      vDamService_22295C: vDamServiceRef=ReadDataById, vDamIdentifierRef=DID_22295C_HTA_Header_UUID_Read
