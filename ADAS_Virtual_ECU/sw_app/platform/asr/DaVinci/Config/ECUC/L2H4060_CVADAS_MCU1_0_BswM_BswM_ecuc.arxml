AUTOSAR XML (schema 00048)
package /ActiveEcuC
  module config BswM: implementation-config-variant=VARIANT-PRE-COMPILE, module-description=BswM_Impl
    BswMGeneral:
      BswMCanSMEnabled = true
      BswMComMEnabled = true
      BswMDcmEnabled = true
      BswMDevErrorDetect = true
      BswMEcuMEnabled = true
      BswMEthIfEnabled = false
      BswMEthSMEnabled = false
      BswMFrSMEnabled = false
      BswMGenericRequestEnabled = true
      BswMJ1939DcmEnabled = false
      BswMJ1939NmEnabled = false
      BswMLinSMEnabled = false
      BswMLinTPEnabled = false
      BswMNmEnabled = true
      BswMNvMEnabled = true
      BswMPduREnabled = true
      BswMRuleControlEnabled = false
      BswMSdEnabled = false
      BswMVersionInfoApi = false
      BswMWdgMEnabled = true
      BswMModeCheck = true
      BswMActionListQueueSearchAlgorithm = LINEAR_SEARCH
      BswMSafeBswChecks = false
      BswMMainFunctionPeriod = 0.01
      BswMCommonData
      BswMGeneration:
        BswMOutOfBoundsWriteSanitizer = false
        BswMOutOfBoundsReadSanitizer = false
        BswMReduceConstantData2Define = true
        BswMBoolDataInArrayOfStructStrategy = BITMASKING
        BswMInterfacesForDeactivatedData = false
    BswMConfig
      BswMArbitration
        ESH_RunToPostRun (BswMRule):
          BswMNestedExecutionOnly = false
          BswMRuleId = 31
          BswMRuleInitState = BSWM_FALSE
          BswMRuleExpressionRef = ESH_LE_RunToPostRunTransition
          BswMRuleTrueActionList = ESH_AL_ExitRun
        ESH_LE_RunToPostRunTransition (BswMLogicalExpression): BswMLogicalOperator=BSWM_AND, BswMArgumentRef=ESH_LE_RunReached, BswMArgumentRef=ESH_LE_NoRunAndNoKillAllRequest
        ESH_LE_RunReached (BswMLogicalExpression): BswMLogicalOperator=BSWM_AND, BswMArgumentRef=ESH_Cond_StateIsRun, BswMArgumentRef=ESH_Cond_ModeIsRun
        ESH_Cond_StateIsRun (BswMModeCondition): BswMConditionType=BSWM_EQUALS, BswMConditionMode=ESH_State
          BswMConditionValue
            BswMBswMode: BswMBswRequestedMode=ESH_RUN
        ESH_State (BswMModeRequestPort): BswMArbitrateOnInit=true, BswMRequestProcessing=BSWM_IMMEDIATE
          BswMModeRequestSource
            BswMGenericRequest: BswMModeRequesterId=230, BswMRequestedModeMax=7
              7 x BswMGenericRequestMode:
                ESH_INIT: BswMGenericRequestModeValue=0
                ESH_RUN: BswMGenericRequestModeValue=1
                ESH_POST_RUN: BswMGenericRequestModeValue=2
                ESH_PREP_SHUTDOWN: BswMGenericRequestModeValue=3
                ESH_WAIT_FOR_NVM: BswMGenericRequestModeValue=4
                ESH_SHUTDOWN: BswMGenericRequestModeValue=5
                ESH_WAKEUP: BswMGenericRequestModeValue=6
          BswMModeInitValue
            BswMBswModeInitValue: BswMBswModeInitValueMode=ESH_INIT
        ESH_Cond_ModeIsRun (BswMModeCondition): BswMConditionType=BSWM_EQUALS, BswMConditionMode=ESH_ModeNotification
          BswMConditionValue
            BswMModeDeclaration: BswMModeValueRef=RUN
        ESH_ModeNotification (BswMModeRequestPort): BswMArbitrateOnInit=false, BswMRequestProcessing=BSWM_DEFERRED
          BswMModeRequestSource
            BswMSwcModeNotification: BswMSwcModeNotificationModeDeclarationGroupPrototypeRef=BswM_MDGP_ESH_Mode
          BswMModeInitValue
            BswMSwcModeInitValue: BswMSwcModeInitValueRef=STARTUP
        3 x BswMLogicalExpression:
          ESH_LE_NoRunAndNoKillAllRequest: BswMLogicalOperator=BSWM_OR, BswMArgumentRef=ESH_LE_NoRunReasons
          ESH_LE_NoRunReasons: BswMLogicalOperator=BSWM_AND, BswMArgumentRef=ESH_LE_AllChannelsNoCom, BswMArgumentRef=ESH_LE_RunReleased, BswMArgumentRef=ESH_Cond_SelfRunReqTimerExpired
          ESH_LE_AllChannelsNoCom: BswMLogicalOperator=BSWM_OR, BswMArgumentRef=ESH_Cond_NoComOn_CN_FDCAN2_28a8fc44, BswMArgumentRef=ESH_Cond_NoComOn_CN_FDCAN14_a902658e
        ESH_Cond_NoComOn_CN_FDCAN2_28a8fc44 (BswMModeCondition): BswMConditionType=BSWM_EQUALS, BswMConditionMode=ESH_ComMIndication_CN_FDCAN2_28a8fc44
          BswMConditionValue
            BswMBswMode: BswMBswRequestedMode=COMM_NO_COMMUNICATION
        ESH_ComMIndication_CN_FDCAN2_28a8fc44 (BswMModeRequestPort): BswMArbitrateOnInit=false, BswMRequestProcessing=BSWM_DEFERRED
          BswMModeRequestSource
            BswMComMIndication: BswMComMChannelRef=CN_FDCAN2_28a8fc44
          BswMModeInitValue
            BswMBswModeInitValue: BswMBswModeInitValueMode=COMM_NO_COMMUNICATION
        ESH_Cond_NoComOn_CN_FDCAN14_a902658e (BswMModeCondition): BswMConditionType=BSWM_EQUALS, BswMConditionMode=ESH_ComMIndication_CN_FDCAN14_a902658e
          BswMConditionValue
            BswMBswMode: BswMBswRequestedMode=COMM_NO_COMMUNICATION
        ESH_ComMIndication_CN_FDCAN14_a902658e (BswMModeRequestPort): BswMArbitrateOnInit=false, BswMRequestProcessing=BSWM_DEFERRED
          BswMModeRequestSource
            BswMComMIndication: BswMComMChannelRef=CN_FDCAN14_a902658e
          BswMModeInitValue
            BswMBswModeInitValue: BswMBswModeInitValueMode=COMM_NO_COMMUNICATION
        ESH_LE_RunReleased (BswMLogicalExpression): BswMLogicalOperator=BSWM_AND, BswMArgumentRef=ESH_Cond_RunRequest0IsReleased, BswMArgumentRef=ESH_Cond_RunRequest1IsReleased
        ESH_Cond_RunRequest0IsReleased (BswMModeCondition): BswMConditionType=BSWM_EQUALS, BswMConditionMode=ESH_RunRequest_0
          BswMConditionValue
            BswMModeDeclaration: BswMModeValueRef=RELEASED
        ESH_RunRequest_0 (BswMModeRequestPort): BswMArbitrateOnInit=false, BswMRequestProcessing=BSWM_DEFERRED
          BswMModeRequestSource
            BswMSwcModeRequest: BswMModeRequestDataElementPrototypeName=requestedMode, BswMSwcModeRequestModeDeclarationGroupPrototypeRef=BswM_MDGP_ESH_RunRequest
          BswMModeInitValue
            BswMSwcModeInitValue: BswMSwcModeInitValueRef=RELEASED
        ESH_Cond_RunRequest1IsReleased (BswMModeCondition): BswMConditionType=BSWM_EQUALS, BswMConditionMode=ESH_RunRequest_1
          BswMConditionValue
            BswMModeDeclaration: BswMModeValueRef=RELEASED
        ESH_RunRequest_1 (BswMModeRequestPort): BswMArbitrateOnInit=false, BswMRequestProcessing=BSWM_DEFERRED
          BswMModeRequestSource
            BswMSwcModeRequest: BswMModeRequestDataElementPrototypeName=requestedMode, BswMSwcModeRequestModeDeclarationGroupPrototypeRef=BswM_MDGP_ESH_RunRequest
          BswMModeInitValue
            BswMSwcModeInitValue: BswMSwcModeInitValueRef=RELEASED
        ESH_Cond_SelfRunReqTimerExpired (BswMModeCondition): BswMConditionType=BSWM_EQUALS, BswMConditionMode=ESH_SelfRunRequestTimer
          BswMConditionValue
            BswMBswMode: BswMBswRequestedMode=BSWM_TIMER_EXPIRED
        ESH_SelfRunRequestTimer (BswMModeRequestPort): BswMArbitrateOnInit=false, BswMRequestProcessing=BSWM_DEFERRED
          BswMModeRequestSource
            BswMTimer
          BswMModeInitValue
            BswMBswModeInitValue: BswMBswModeInitValueMode=BSWM_TIMER_STOPPED
        ESH_RunToPostRunNested (BswMRule):
          BswMNestedExecutionOnly = true
          BswMRuleId = 32
          BswMRuleInitState = BSWM_FALSE
          BswMRuleExpressionRef = ESH_LE_ComMNoPendingRequests
          BswMRuleTrueActionList = ESH_AL_RunToPostRun
        ESH_LE_ComMNoPendingRequests (BswMLogicalExpression): BswMArgumentRef=BswMModeCondition_018
        ESH_ComMPendingRequests (BswMModeRequestPort): BswMArbitrateOnInit=false, BswMRequestProcessing=BSWM_DEFERRED
          BswMModeRequestSource
            BswMGenericRequest: BswMModeRequesterId=232, BswMRequestedModeMax=2
              ESH_COMM_NO_REQUEST (BswMGenericRequestMode): BswMGenericRequestModeValue=0
              ESH_COMM_PENDING_REQUEST (BswMGenericRequestMode): BswMGenericRequestModeValue=1
          BswMModeInitValue
            BswMBswModeInitValue: BswMBswModeInitValueMode=ESH_COMM_NO_REQUEST
        ESH_WaitToShutdown (BswMRule):
          BswMNestedExecutionOnly = false
          BswMRuleId = 33
          BswMRuleInitState = BSWM_FALSE
          BswMRuleExpressionRef = ESH_LE_WaitForNvMToShutdown
          BswMRuleTrueActionList = ESH_AL_WaitForNvMToShutdown
        ESH_LE_WaitForNvMToShutdown (BswMLogicalExpression):
          BswMLogicalOperator = BSWM_AND
          BswMArgumentRef = ESH_Cond_StateIsWaitForNvm
          BswMArgumentRef = ESH_LE_WriteNotPending
          BswMArgumentRef = ESH_LE_NoWakeupOrKillAll
        ESH_Cond_StateIsWaitForNvm (BswMModeCondition): BswMConditionType=BSWM_EQUALS, BswMConditionMode=ESH_State
          BswMConditionValue
            BswMBswMode: BswMBswRequestedMode=ESH_WAIT_FOR_NVM
        ESH_LE_WriteNotPending (BswMLogicalExpression): BswMLogicalOperator=BSWM_OR, BswMArgumentRef=ESH_Cond_NvMWAIsNotPending, BswMArgumentRef=ESH_Cond_NvWWriteAllTimerNotRunning
        ESH_Cond_NvMWAIsNotPending (BswMModeCondition): BswMConditionType=BSWM_EQUALS_NOT, BswMConditionMode=ESH_NvMIndication
          BswMConditionValue
            BswMBswMode: BswMBswRequestedMode=NVM_REQ_PENDING
        ESH_NvMIndication (BswMModeRequestPort): BswMArbitrateOnInit=false, BswMRequestProcessing=BSWM_DEFERRED
          BswMModeRequestSource
            BswMNvMJobModeIndication: BswMNvmService=NvmWriteAll
          BswMModeInitValue
            BswMBswModeInitValue: BswMBswModeInitValueMode=NVM_REQ_OK
        ESH_Cond_NvWWriteAllTimerNotRunning (BswMModeCondition): BswMConditionType=BSWM_EQUALS_NOT, BswMConditionMode=ESH_NvM_WriteAllTimer
          BswMConditionValue
            BswMBswMode: BswMBswRequestedMode=BSWM_TIMER_STARTED
        ESH_NvM_WriteAllTimer (BswMModeRequestPort): BswMArbitrateOnInit=false, BswMRequestProcessing=BSWM_DEFERRED
          BswMModeRequestSource
            BswMTimer
          BswMModeInitValue
            BswMBswModeInitValue: BswMBswModeInitValueMode=BSWM_TIMER_STOPPED
        ESH_LE_NoWakeupOrKillAll (BswMLogicalExpression): BswMArgumentRef=ESH_LE_NoWakeup
        ESH_LE_NoWakeup (BswMLogicalExpression): BswMLogicalOperator=BSWM_OR, BswMArgumentRef=BswMModeCondition_013, BswMArgumentRef=BswMModeCondition_012, BswMArgumentRef=BswMModeCondition_011
        ESH_Cond_NoValidatedWakeups (BswMModeCondition): BswMConditionType=BSWM_EQUALS, BswMConditionMode=ESH_EcuM_GetValidatedWakeupEvents
          BswMConditionValue
            BswMBswMode: BswMBswRequestedMode=0
        ESH_EcuM_GetValidatedWakeupEvents (BswMModeRequestPort): BswMArbitrateOnInit=false, BswMRequestProcessing=BSWM_DEFERRED
          BswMModeRequestSource
            BswMUserConditionRequest: BswMUserCondition=EcuM_GetValidatedWakeupEvents()
        ESH_WakeupToPrep (BswMRule):
          BswMNestedExecutionOnly = false
          BswMRuleId = 35
          BswMRuleInitState = BSWM_FALSE
          BswMRuleExpressionRef = ESH_LE_WakeupToPrepShutdown
          BswMRuleTrueActionList = ESH_AL_WakeupToPrep
        ESH_LE_WakeupToPrepShutdown (BswMLogicalExpression):
          BswMLogicalOperator = BSWM_AND
          BswMArgumentRef = ESH_Cond_StateIsWakeup
          BswMArgumentRef = ESH_LE_CancelNotPending
          BswMArgumentRef = ESH_Cond_NoPendingWakeups
          BswMArgumentRef = ESH_LE_NoWakeup
          BswMArgumentRef = ESH_Cond_ModeIsWakeup
          BswMArgumentRef = ESH_LE_ComMNoPendingRequests
        ESH_Cond_StateIsWakeup (BswMModeCondition): BswMConditionType=BSWM_EQUALS, BswMConditionMode=ESH_State
          BswMConditionValue
            BswMBswMode: BswMBswRequestedMode=ESH_WAKEUP
        ESH_LE_CancelNotPending (BswMLogicalExpression): BswMLogicalOperator=BSWM_OR, BswMArgumentRef=ESH_Cond_NvMWAIsNotPending, BswMArgumentRef=ESH_Cond_NvWCancelTimerNotRunning
        ESH_Cond_NvWCancelTimerNotRunning (BswMModeCondition): BswMConditionType=BSWM_EQUALS_NOT, BswMConditionMode=ESH_NvM_CancelWriteAllTimer
          BswMConditionValue
            BswMBswMode: BswMBswRequestedMode=BSWM_TIMER_STARTED
        ESH_NvM_CancelWriteAllTimer (BswMModeRequestPort): BswMArbitrateOnInit=false, BswMRequestProcessing=BSWM_DEFERRED
          BswMModeRequestSource
            BswMTimer
          BswMModeInitValue
            BswMBswModeInitValue: BswMBswModeInitValueMode=BSWM_TIMER_STOPPED
        ESH_Cond_NoPendingWakeups (BswMModeCondition): BswMConditionType=BSWM_EQUALS, BswMConditionMode=ESH_EcuM_GetPendingWakeupEvents
          BswMConditionValue
            BswMBswMode: BswMBswRequestedMode=0
        ESH_EcuM_GetPendingWakeupEvents (BswMModeRequestPort): BswMArbitrateOnInit=false, BswMRequestProcessing=BSWM_DEFERRED
          BswMModeRequestSource
            BswMUserConditionRequest: BswMUserCondition=EcuM_GetPendingWakeupEvents()
        ESH_Cond_ModeIsWakeup (BswMModeCondition): BswMConditionType=BSWM_EQUALS, BswMConditionMode=ESH_ModeNotification
          BswMConditionValue
            BswMModeDeclaration: BswMModeValueRef=WAKEUP
        ESH_WaitToWakeup (BswMRule):
          BswMNestedExecutionOnly = false
          BswMRuleId = 34
          BswMRuleInitState = BSWM_FALSE
          BswMRuleExpressionRef = ESH_LE_WaitForNvMToWakeup
          BswMRuleTrueActionList = ESH_AL_WaitForNvMWakeup
        ESH_LE_WaitForNvMToWakeup (BswMLogicalExpression):
          BswMLogicalOperator = BSWM_AND
          BswMArgumentRef = ESH_Cond_StateIsWaitForNvm
          BswMArgumentRef = ESH_LE_ValidWakeup
          BswMArgumentRef = BswMModeCondition_015
        ESH_LE_ValidWakeup (BswMLogicalExpression):
          BswMLogicalOperator = BSWM_OR
          BswMArgumentRef = ESH_Cond_ValidatedWakeups
          BswMArgumentRef = BswMModeCondition_009
          BswMArgumentRef = BswMModeCondition_008
        ESH_Cond_ValidatedWakeups (BswMModeCondition): BswMConditionType=BSWM_EQUALS_NOT, BswMConditionMode=ESH_EcuM_GetValidatedWakeupEvents
          BswMConditionValue
            BswMBswMode: BswMBswRequestedMode=0
        ESH_WakeupToRun (BswMRule):
          BswMNestedExecutionOnly = false
          BswMRuleId = 36
          BswMRuleInitState = BSWM_FALSE
          BswMRuleExpressionRef = ESH_LE_WakeupToRun
          BswMRuleTrueActionList = ESH_AL_WakeupToRun
        ESH_LE_WakeupToRun (BswMLogicalExpression):
          BswMLogicalOperator = BSWM_AND
          BswMArgumentRef = ESH_Cond_StateIsWakeup
          BswMArgumentRef = ESH_LE_ValidWakeup
          BswMArgumentRef = ESH_LE_CancelNotPending
          BswMArgumentRef = ESH_Cond_ModeIsWakeup
          BswMArgumentRef = BswMModeCondition_014
        ESH_DemInit (BswMRule):
          BswMNestedExecutionOnly = true
          BswMRuleId = 25
          BswMRuleInitState = BSWM_FALSE
          BswMRuleExpressionRef = ESH_LE_DemNotInitialized
          BswMRuleTrueActionList = ESH_AL_DemInit
        ESH_LE_DemNotInitialized (BswMLogicalExpression): BswMLogicalOperator=BSWM_OR, BswMArgumentRef=ESH_Cond_DemNotInitialized
        ESH_Cond_DemNotInitialized (BswMModeCondition): BswMConditionType=BSWM_EQUALS, BswMConditionMode=ESH_DemInitStatus
          BswMConditionValue
            BswMBswMode: BswMBswRequestedMode=DEM_NOT_INITIALIZED
        ESH_DemInitStatus (BswMModeRequestPort): BswMArbitrateOnInit=false, BswMRequestProcessing=BSWM_IMMEDIATE
          BswMModeRequestSource
            BswMGenericRequest: BswMModeRequesterId=231, BswMRequestedModeMax=2
              DEM_INITIALIZED (BswMGenericRequestMode): BswMGenericRequestModeValue=0
              DEM_NOT_INITIALIZED (BswMGenericRequestMode): BswMGenericRequestModeValue=1
          BswMModeInitValue
            BswMBswModeInitValue: BswMBswModeInitValueMode=DEM_INITIALIZED
        ESH_InitToWakeup (BswMRule):
          BswMNestedExecutionOnly = false
          BswMRuleId = 26
          BswMRuleInitState = BSWM_FALSE
          BswMRuleExpressionRef = ESH_LE_InitToWakeup
          BswMRuleTrueActionList = ESH_AL_InitToWakeup
        ESH_LE_InitToWakeup (BswMLogicalExpression): BswMLogicalOperator=BSWM_AND, BswMArgumentRef=ESH_Cond_StateIsInit
        ESH_Cond_StateIsInit (BswMModeCondition): BswMConditionType=BSWM_EQUALS, BswMConditionMode=ESH_State
          BswMConditionValue
            BswMBswMode: BswMBswRequestedMode=ESH_INIT
        ESH_PostRunToPrepNested (BswMRule):
          BswMNestedExecutionOnly = true
          BswMRuleId = 29
          BswMRuleInitState = BSWM_FALSE
          BswMRuleExpressionRef = ESH_LE_Dem_PostRunRequested
          BswMRuleTrueActionList = ESH_AL_PostRunToPrepShutdown
        3 x BswMLogicalExpression:
          ESH_LE_Dem_PostRunRequested: BswMLogicalOperator=BSWM_AND, BswMArgumentRef=ESH_LE_PostRunToPrep, BswMArgumentRef=ESH_Cond_DemPostRunRequested
          ESH_LE_PostRunToPrep: BswMLogicalOperator=BSWM_OR, BswMArgumentRef=ESH_LE_PostRunReleased
          ESH_LE_PostRunReleased: BswMLogicalOperator=BSWM_AND, BswMArgumentRef=ESH_Cond_PostRunRequest0IsReleased, BswMArgumentRef=ESH_Cond_PostRunRequest1IsReleased
        ESH_Cond_PostRunRequest0IsReleased (BswMModeCondition): BswMConditionType=BSWM_EQUALS, BswMConditionMode=ESH_PostRunRequest_0
          BswMConditionValue
            BswMModeDeclaration: BswMModeValueRef=RELEASED
        ESH_PostRunRequest_0 (BswMModeRequestPort): BswMArbitrateOnInit=false, BswMRequestProcessing=BSWM_DEFERRED
          BswMModeRequestSource
            BswMSwcModeRequest: BswMModeRequestDataElementPrototypeName=requestedMode, BswMSwcModeRequestModeDeclarationGroupPrototypeRef=BswM_MDGP_ESH_RunRequest
          BswMModeInitValue
            BswMSwcModeInitValue: BswMSwcModeInitValueRef=RELEASED
        ESH_Cond_PostRunRequest1IsReleased (BswMModeCondition): BswMConditionType=BSWM_EQUALS, BswMConditionMode=ESH_PostRunRequest_1
          BswMConditionValue
            BswMModeDeclaration: BswMModeValueRef=RELEASED
        ESH_PostRunRequest_1 (BswMModeRequestPort): BswMArbitrateOnInit=false, BswMRequestProcessing=BSWM_DEFERRED
          BswMModeRequestSource
            BswMSwcModeRequest: BswMModeRequestDataElementPrototypeName=requestedMode, BswMSwcModeRequestModeDeclarationGroupPrototypeRef=BswM_MDGP_ESH_RunRequest
          BswMModeInitValue
            BswMSwcModeInitValue: BswMSwcModeInitValueRef=RELEASED
        ESH_Cond_DemPostRunRequested (BswMModeCondition): BswMConditionType=BSWM_EQUALS, BswMConditionMode=ESH_DemPostRunRequested
          BswMConditionValue
            BswMBswMode: BswMBswRequestedMode=FALSE
        ESH_DemPostRunRequested (BswMModeRequestPort): BswMArbitrateOnInit=false, BswMRequestProcessing=BSWM_DEFERRED
          BswMModeRequestSource
            BswMGenericRequest: BswMModeRequesterId=233, BswMRequestedModeMax=2
              TRUE (BswMGenericRequestMode): BswMGenericRequestModeValue=0
              FALSE (BswMGenericRequestMode): BswMGenericRequestModeValue=1
          BswMModeInitValue
            BswMBswModeInitValue: BswMBswModeInitValueMode=TRUE
        ESH_PostRunNested (BswMRule):
          BswMNestedExecutionOnly = true
          BswMRuleId = 28
          BswMRuleInitState = BSWM_FALSE
          BswMRuleExpressionRef = ESH_LE_PostRunToRun
          BswMRuleFalseActionList = ESH_AL_ESH_PostRunToPrepCheck
          BswMRuleTrueActionList = ESH_AL_PostRunToRun
        3 x BswMLogicalExpression:
          ESH_LE_PostRunToRun: BswMLogicalOperator=BSWM_AND, BswMArgumentRef=ESH_LE_RunRequestsOrWakeup
          ESH_LE_RunRequestsOrWakeup: BswMLogicalOperator=BSWM_OR, BswMArgumentRef=ESH_LE_RunRequested, BswMArgumentRef=ESH_LE_ValidWakeup
          ESH_LE_RunRequested: BswMLogicalOperator=BSWM_OR, BswMArgumentRef=ESH_Cond_RunRequest0IsRequested, BswMArgumentRef=ESH_Cond_RunRequest1IsRequested
        ESH_Cond_RunRequest0IsRequested (BswMModeCondition): BswMConditionType=BSWM_EQUALS, BswMConditionMode=ESH_RunRequest_0
          BswMConditionValue
            BswMModeDeclaration: BswMModeValueRef=REQUESTED
        ESH_Cond_RunRequest1IsRequested (BswMModeCondition): BswMConditionType=BSWM_EQUALS, BswMConditionMode=ESH_RunRequest_1
          BswMConditionValue
            BswMModeDeclaration: BswMModeValueRef=REQUESTED
        ESH_PostRun (BswMRule):
          BswMNestedExecutionOnly = false
          BswMRuleId = 27
          BswMRuleInitState = BSWM_FALSE
          BswMRuleExpressionRef = ESH_LE_PostRun
          BswMRuleTrueActionList = ESH_AL_ExitPostRun
        ESH_LE_PostRun (BswMLogicalExpression): BswMLogicalOperator=BSWM_AND, BswMArgumentRef=ESH_Cond_StateIsPostRun, BswMArgumentRef=ESH_Cond_ModeIsPostRun
        ESH_Cond_StateIsPostRun (BswMModeCondition): BswMConditionType=BSWM_EQUALS, BswMConditionMode=ESH_State
          BswMConditionValue
            BswMBswMode: BswMBswRequestedMode=ESH_POST_RUN
        ESH_Cond_ModeIsPostRun (BswMModeCondition): BswMConditionType=BSWM_EQUALS, BswMConditionMode=ESH_ModeNotification
          BswMConditionValue
            BswMModeDeclaration: BswMModeValueRef=POSTRUN
        ESH_PrepToWait (BswMRule):
          BswMNestedExecutionOnly = false
          BswMRuleId = 30
          BswMRuleInitState = BSWM_FALSE
          BswMRuleExpressionRef = ESH_LE_PrepShutdownToWaitForNvM
          BswMRuleTrueActionList = ESH_AL_PrepShutdownToWaitForNvM
        ESH_LE_PrepShutdownToWaitForNvM (BswMLogicalExpression): BswMLogicalOperator=BSWM_AND, BswMArgumentRef=ESH_Cond_StateIsPrepShutdown, BswMArgumentRef=ESH_Cond_ModeIsShutdown
        ESH_Cond_StateIsPrepShutdown (BswMModeCondition): BswMConditionType=BSWM_EQUALS, BswMConditionMode=ESH_State
          BswMConditionValue
            BswMBswMode: BswMBswRequestedMode=ESH_PREP_SHUTDOWN
        ESH_Cond_ModeIsShutdown (BswMModeCondition): BswMConditionType=BSWM_EQUALS, BswMConditionMode=ESH_ModeNotification
          BswMConditionValue
            BswMModeDeclaration: BswMModeValueRef=SHUTDOWN
        CC_CN_FDCAN14_a902658e_RX_DM (BswMRule):
          BswMNestedExecutionOnly = false
          BswMRuleId = 23
          BswMRuleInitState = BSWM_FALSE
          BswMRuleExpressionRef = CC_LE_CN_FDCAN14_a902658e_RX_DM
          BswMRuleFalseActionList = CC_AL_CN_FDCAN14_a902658e_Disable_DM
          BswMRuleTrueActionList = CC_AL_CN_FDCAN14_a902658e_Enable_DM
        CC_LE_CN_FDCAN14_a902658e_RX_DM (BswMLogicalExpression): BswMLogicalOperator=BSWM_AND, BswMArgumentRef=CC_Cond_CanSMIndication_CN_FDCAN14_a902658e_EQ_CANSM_BSWM_FULL_COMMUNICATION
        CC_Cond_CanSMIndication_CN_FDCAN14_a902658e_EQ_CANSM_BSWM_FULL_COMMUNICATION (BswMModeCondition): BswMConditionType=BSWM_EQUALS, BswMConditionMode=CC_CanSMIndication_CN_FDCAN14_a902658e
          BswMConditionValue
            BswMBswMode: BswMBswRequestedMode=CANSM_BSWM_FULL_COMMUNICATION
        CC_CanSMIndication_CN_FDCAN14_a902658e (BswMModeRequestPort): BswMArbitrateOnInit=false, BswMRequestProcessing=BSWM_IMMEDIATE
          BswMModeRequestSource
            BswMCanSMIndication: BswMCanSMChannelRef=CN_FDCAN14_a902658e
          BswMModeInitValue
            BswMBswModeInitValue: BswMBswModeInitValueMode=CANSM_BSWM_NO_COMMUNICATION
        CC_CN_FDCAN14_a902658e_TX (BswMRule):
          BswMNestedExecutionOnly = false
          BswMRuleId = 24
          BswMRuleInitState = BSWM_FALSE
          BswMRuleExpressionRef = CC_LE_CN_FDCAN14_a902658e_TX
          BswMRuleFalseActionList = CC_AL_CN_FDCAN14_a902658e_TX_Disable
          BswMRuleTrueActionList = CC_AL_CN_FDCAN14_a902658e_TX_EnableNoinit
        CC_LE_CN_FDCAN14_a902658e_TX (BswMLogicalExpression): BswMLogicalOperator=BSWM_AND, BswMArgumentRef=CC_Cond_CanSMIndication_CN_FDCAN14_a902658e_EQ_CANSM_BSWM_FULL_COMMUNICATION
        CC_CN_FDCAN14_a902658e_RX (BswMRule):
          BswMNestedExecutionOnly = false
          BswMRuleId = 22
          BswMRuleInitState = BSWM_FALSE
          BswMRuleExpressionRef = CC_LE_CN_FDCAN14_a902658e_RX
          BswMRuleFalseActionList = CC_AL_CN_FDCAN14_a902658e_RX_Disable
          BswMRuleTrueActionList = CC_AL_CN_FDCAN14_a902658e_RX_EnableNoinit
        CC_LE_CN_FDCAN14_a902658e_RX (BswMLogicalExpression): BswMLogicalOperator=BSWM_AND, BswMArgumentRef=CC_Cond_CanSMIndication_CN_FDCAN14_a902658e_NEQ_CANSM_BSWM_NO_COMMUNICATION
        CC_Cond_CanSMIndication_CN_FDCAN14_a902658e_NEQ_CANSM_BSWM_NO_COMMUNICATION (BswMModeCondition): BswMConditionType=BSWM_EQUALS_NOT, BswMConditionMode=CC_CanSMIndication_CN_FDCAN14_a902658e
          BswMConditionValue
            BswMBswMode: BswMBswRequestedMode=CANSM_BSWM_NO_COMMUNICATION
        CC_CN_FDCAN2_28a8fc44_RX_DM (BswMRule):
          BswMNestedExecutionOnly = false
          BswMRuleId = 18
          BswMRuleInitState = BSWM_FALSE
          BswMRuleExpressionRef = CC_LE_CN_FDCAN2_28a8fc44_RX_DM
          BswMRuleFalseActionList = CC_AL_CN_FDCAN2_28a8fc44_Disable_DM
          BswMRuleTrueActionList = CC_AL_CN_FDCAN2_28a8fc44_Enable_DM
        CC_LE_CN_FDCAN2_28a8fc44_RX_DM (BswMLogicalExpression):
          BswMLogicalOperator = BSWM_AND
          BswMArgumentRef = CC_Cond_CanSMIndication_CN_FDCAN2_28a8fc44_EQ_CANSM_BSWM_FULL_COMMUNICATION
          BswMArgumentRef = CC_Cond_DcmComIndication_CN_FDCAN2_28a8fc44_NEQ_DCM_DISABLE_RX_ENABLE_TX_NORM
          BswMArgumentRef = CC_Cond_DcmComIndication_CN_FDCAN2_28a8fc44_NEQ_DCM_DISABLE_RX_TX_NORMAL
          BswMArgumentRef = CC_Cond_DcmComIndication_CN_FDCAN2_28a8fc44_NEQ_DCM_DISABLE_RX_ENABLE_TX_NM
          BswMArgumentRef = CC_Cond_DcmComIndication_CN_FDCAN2_28a8fc44_NEQ_DCM_DISABLE_RX_TX_NM
          BswMArgumentRef = CC_Cond_DcmComIndication_CN_FDCAN2_28a8fc44_NEQ_DCM_DISABLE_RX_ENABLE_TX_NORM_NM
          BswMArgumentRef = CC_Cond_DcmComIndication_CN_FDCAN2_28a8fc44_NEQ_DCM_DISABLE_RX_TX_NORM_NM
        CC_Cond_CanSMIndication_CN_FDCAN2_28a8fc44_EQ_CANSM_BSWM_FULL_COMMUNICATION (BswMModeCondition): BswMConditionType=BSWM_EQUALS, BswMConditionMode=CC_CanSMIndication_CN_FDCAN2_28a8fc44
          BswMConditionValue
            BswMBswMode: BswMBswRequestedMode=CANSM_BSWM_FULL_COMMUNICATION
        CC_CanSMIndication_CN_FDCAN2_28a8fc44 (BswMModeRequestPort): BswMArbitrateOnInit=false, BswMRequestProcessing=BSWM_IMMEDIATE
          BswMModeRequestSource
            BswMCanSMIndication: BswMCanSMChannelRef=CN_FDCAN2_28a8fc44
          BswMModeInitValue
            BswMBswModeInitValue: BswMBswModeInitValueMode=CANSM_BSWM_NO_COMMUNICATION
        CC_CN_FDCAN2_28a8fc44_RX (BswMRule):
          BswMNestedExecutionOnly = false
          BswMRuleId = 17
          BswMRuleInitState = BSWM_FALSE
          BswMRuleExpressionRef = CC_LE_CN_FDCAN2_28a8fc44_RX
          BswMRuleFalseActionList = CC_AL_CN_FDCAN2_28a8fc44_RX_Disable
          BswMRuleTrueActionList = CC_AL_CN_FDCAN2_28a8fc44_RX_EnableReinit
        CC_LE_CN_FDCAN2_28a8fc44_RX (BswMLogicalExpression):
          BswMLogicalOperator = BSWM_AND
          BswMArgumentRef = CC_Cond_CanSMIndication_CN_FDCAN2_28a8fc44_NEQ_CANSM_BSWM_NO_COMMUNICATION
          BswMArgumentRef = CC_Cond_DcmComIndication_CN_FDCAN2_28a8fc44_NEQ_DCM_DISABLE_RX_ENABLE_TX_NORM
          BswMArgumentRef = CC_Cond_DcmComIndication_CN_FDCAN2_28a8fc44_NEQ_DCM_DISABLE_RX_TX_NORMAL
          BswMArgumentRef = CC_Cond_DcmComIndication_CN_FDCAN2_28a8fc44_NEQ_DCM_DISABLE_RX_ENABLE_TX_NM
          BswMArgumentRef = CC_Cond_DcmComIndication_CN_FDCAN2_28a8fc44_NEQ_DCM_DISABLE_RX_TX_NM
          BswMArgumentRef = CC_Cond_DcmComIndication_CN_FDCAN2_28a8fc44_NEQ_DCM_DISABLE_RX_ENABLE_TX_NORM_NM
          BswMArgumentRef = CC_Cond_DcmComIndication_CN_FDCAN2_28a8fc44_NEQ_DCM_DISABLE_RX_TX_NORM_NM
        CC_Cond_CanSMIndication_CN_FDCAN2_28a8fc44_NEQ_CANSM_BSWM_NO_COMMUNICATION (BswMModeCondition): BswMConditionType=BSWM_EQUALS_NOT, BswMConditionMode=CC_CanSMIndication_CN_FDCAN2_28a8fc44
          BswMConditionValue
            BswMBswMode: BswMBswRequestedMode=CANSM_BSWM_NO_COMMUNICATION
        CC_CN_FDCAN2_28a8fc44_NM (BswMRule):
          BswMNestedExecutionOnly = false
          BswMRuleId = 15
          BswMRuleInitState = BSWM_FALSE
          BswMRuleExpressionRef = CC_LE_CN_FDCAN2_28a8fc44_NM
          BswMRuleTrueActionList = CC_AL_CN_FDCAN2_28a8fc44_NmDisable
        CC_LE_CN_FDCAN2_28a8fc44_NM (BswMLogicalExpression):
          BswMLogicalOperator = BSWM_OR
          BswMArgumentRef = CC_Cond_DcmComIndication_CN_FDCAN2_28a8fc44_EQ_DCM_ENABLE_RX_DISABLE_TX_NM
          BswMArgumentRef = CC_Cond_DcmComIndication_CN_FDCAN2_28a8fc44_EQ_DCM_DISABLE_RX_TX_NM
          BswMArgumentRef = CC_Cond_DcmComIndication_CN_FDCAN2_28a8fc44_EQ_DCM_ENABLE_RX_DISABLE_TX_NORM_NM
          BswMArgumentRef = CC_Cond_DcmComIndication_CN_FDCAN2_28a8fc44_EQ_DCM_DISABLE_RX_TX_NORM_NM
        CC_Cond_DcmComIndication_CN_FDCAN2_28a8fc44_EQ_DCM_ENABLE_RX_DISABLE_TX_NM (BswMModeCondition): BswMConditionType=BSWM_EQUALS, BswMConditionMode=CC_DcmComIndication_CN_FDCAN2_28a8fc44
          BswMConditionValue
            BswMBswMode: BswMBswRequestedMode=DCM_ENABLE_RX_DISABLE_TX_NM
        CC_DcmComIndication_CN_FDCAN2_28a8fc44 (BswMModeRequestPort): BswMArbitrateOnInit=false, BswMRequestProcessing=BSWM_IMMEDIATE
          BswMModeRequestSource
            BswMDcmComModeRequest: BswMDcmComMChannelRef=CN_FDCAN2_28a8fc44
          BswMModeInitValue
            BswMBswModeInitValue: BswMBswModeInitValueMode=DCM_ENABLE_RX_TX_NORM_NM
        3 x BswMModeCondition, all with BswMConditionType=BSWM_EQUALS, BswMConditionMode=CC_DcmComIndication_CN_FDCAN2_28a8fc44:
          CC_Cond_DcmComIndication_CN_FDCAN2_28a8fc44_EQ_DCM_DISABLE_RX_TX_NM
            BswMConditionValue
              BswMBswMode: BswMBswRequestedMode=DCM_DISABLE_RX_TX_NM
          CC_Cond_DcmComIndication_CN_FDCAN2_28a8fc44_EQ_DCM_ENABLE_RX_DISABLE_TX_NORM_NM
            BswMConditionValue
              BswMBswMode: BswMBswRequestedMode=DCM_ENABLE_RX_DISABLE_TX_NORM_NM
          CC_Cond_DcmComIndication_CN_FDCAN2_28a8fc44_EQ_DCM_DISABLE_RX_TX_NORM_NM
            BswMConditionValue
              BswMBswMode: BswMBswRequestedMode=DCM_DISABLE_RX_TX_NORM_NM
        CC_CN_FDCAN2_28a8fc44_BUSOFF_SILENT (BswMRule):
          BswMNestedExecutionOnly = false
          BswMRuleId = 14
          BswMRuleInitState = BSWM_FALSE
          BswMRuleExpressionRef = CC_LE_CanSMIndication_CN_FDCAN2_28a8fc44_BUSOFF_SILENT
          BswMRuleTrueActionList = CC_AL_CN_FDCAN2_28a8fc44_BUSOFF_SILENT
        CC_LE_CanSMIndication_CN_FDCAN2_28a8fc44_BUSOFF_SILENT (BswMLogicalExpression):
          BswMLogicalOperator = BSWM_OR
          BswMArgumentRef = CC_Cond_CanSMIndication_CN_FDCAN2_28a8fc44_EQ_CANSM_BSWM_BUS_OFF
          BswMArgumentRef = CC_Cond_CanSMIndication_CN_FDCAN2_28a8fc44_EQ_CANSM_BSWM_SILENT_COMMUNICATION
        CC_Cond_CanSMIndication_CN_FDCAN2_28a8fc44_EQ_CANSM_BSWM_BUS_OFF (BswMModeCondition): BswMConditionType=BSWM_EQUALS, BswMConditionMode=CC_CanSMIndication_CN_FDCAN2_28a8fc44
          BswMConditionValue
            BswMBswMode: BswMBswRequestedMode=CANSM_BSWM_BUS_OFF
        CC_Cond_CanSMIndication_CN_FDCAN2_28a8fc44_EQ_CANSM_BSWM_SILENT_COMMUNICATION (BswMModeCondition): BswMConditionType=BSWM_EQUALS, BswMConditionMode=CC_CanSMIndication_CN_FDCAN2_28a8fc44
          BswMConditionValue
            BswMBswMode: BswMBswRequestedMode=CANSM_BSWM_SILENT_COMMUNICATION
        CC_Generic_BusOff_CN_FDCAN2_28a8fc44 (BswMModeRequestPort): BswMArbitrateOnInit=false, BswMRequestProcessing=BSWM_IMMEDIATE
          BswMModeRequestSource
            BswMGenericRequest: BswMModeRequesterId=241, BswMRequestedModeMax=2
              NO_COM (BswMGenericRequestMode): BswMGenericRequestModeValue=0
              BUSOFF_SILENT (BswMGenericRequestMode): BswMGenericRequestModeValue=1
          BswMModeInitValue
            BswMBswModeInitValue: BswMBswModeInitValueMode=NO_COM
        CC_CN_FDCAN2_28a8fc44_TX_DISABLE (BswMRule):
          BswMNestedExecutionOnly = false
          BswMRuleId = 19
          BswMRuleInitState = BSWM_FALSE
          BswMRuleExpressionRef = CC_LE_CN_FDCAN2_28a8fc44_TX_DISABLE
          BswMRuleTrueActionList = CC_AL_CN_FDCAN2_28a8fc44_TX_Disable
        CC_LE_CN_FDCAN2_28a8fc44_TX_DISABLE (BswMLogicalExpression):
          BswMLogicalOperator = BSWM_OR
          BswMArgumentRef = CC_Cond_CanSMIndication_CN_FDCAN2_28a8fc44_NEQ_CANSM_BSWM_FULL_COMMUNICATION
          BswMArgumentRef = CC_Cond_NmIndication_CN_FDCAN2_28a8fc44_EQ_NM_STATE_BUS_SLEEP
          BswMArgumentRef = CC_Cond_NmIndication_CN_FDCAN2_28a8fc44_EQ_NM_STATE_PREPARE_BUS_SLEEP
          BswMArgumentRef = CC_Cond_DcmComIndication_CN_FDCAN2_28a8fc44_EQ_DCM_ENABLE_RX_DISABLE_TX_NORM
          BswMArgumentRef = CC_Cond_DcmComIndication_CN_FDCAN2_28a8fc44_EQ_DCM_DISABLE_RX_TX_NORMAL
          BswMArgumentRef = CC_Cond_DcmComIndication_CN_FDCAN2_28a8fc44_EQ_DCM_DISABLE_RX_TX_NM
          BswMArgumentRef = CC_Cond_DcmComIndication_CN_FDCAN2_28a8fc44_EQ_DCM_ENABLE_RX_DISABLE_TX_NORM_NM
          BswMArgumentRef = CC_Cond_DcmComIndication_CN_FDCAN2_28a8fc44_EQ_DCM_DISABLE_RX_TX_NORM_NM
        CC_Cond_CanSMIndication_CN_FDCAN2_28a8fc44_NEQ_CANSM_BSWM_FULL_COMMUNICATION (BswMModeCondition): BswMConditionType=BSWM_EQUALS_NOT, BswMConditionMode=CC_CanSMIndication_CN_FDCAN2_28a8fc44
          BswMConditionValue
            BswMBswMode: BswMBswRequestedMode=CANSM_BSWM_FULL_COMMUNICATION
        CC_Cond_NmIndication_CN_FDCAN2_28a8fc44_EQ_NM_STATE_BUS_SLEEP (BswMModeCondition): BswMConditionType=BSWM_EQUALS, BswMConditionMode=CC_NmIndication_CN_FDCAN2_28a8fc44
          BswMConditionValue
            BswMBswMode: BswMBswRequestedMode=NM_STATE_BUS_SLEEP
        CC_NmIndication_CN_FDCAN2_28a8fc44 (BswMModeRequestPort): BswMArbitrateOnInit=false, BswMRequestProcessing=BSWM_IMMEDIATE
          BswMModeRequestSource
            BswMNmIndication: BswMNmChannelRef=CN_FDCAN2_28a8fc44
          BswMModeInitValue
            BswMBswModeInitValue: BswMBswModeInitValueMode=NM_STATE_BUS_SLEEP
        9 x BswMModeCondition:
          CC_Cond_NmIndication_CN_FDCAN2_28a8fc44_EQ_NM_STATE_PREPARE_BUS_SLEEP: BswMConditionType=BSWM_EQUALS, BswMConditionMode=CC_NmIndication_CN_FDCAN2_28a8fc44
            BswMConditionValue
              BswMBswMode: BswMBswRequestedMode=NM_STATE_PREPARE_BUS_SLEEP
          CC_Cond_DcmComIndication_CN_FDCAN2_28a8fc44_EQ_DCM_ENABLE_RX_DISABLE_TX_NORM: BswMConditionType=BSWM_EQUALS, BswMConditionMode=CC_DcmComIndication_CN_FDCAN2_28a8fc44
            BswMConditionValue
              BswMBswMode: BswMBswRequestedMode=DCM_ENABLE_RX_DISABLE_TX_NORM
          CC_Cond_DcmComIndication_CN_FDCAN2_28a8fc44_EQ_DCM_DISABLE_RX_TX_NORMAL: BswMConditionType=BSWM_EQUALS, BswMConditionMode=CC_DcmComIndication_CN_FDCAN2_28a8fc44
            BswMConditionValue
              BswMBswMode: BswMBswRequestedMode=DCM_DISABLE_RX_TX_NORMAL
          CC_Cond_DcmComIndication_CN_FDCAN2_28a8fc44_NEQ_DCM_DISABLE_RX_ENABLE_TX_NORM: BswMConditionType=BSWM_EQUALS_NOT, BswMConditionMode=CC_DcmComIndication_CN_FDCAN2_28a8fc44
            BswMConditionValue
              BswMBswMode: BswMBswRequestedMode=DCM_DISABLE_RX_ENABLE_TX_NORM
          CC_Cond_DcmComIndication_CN_FDCAN2_28a8fc44_NEQ_DCM_DISABLE_RX_TX_NORMAL: BswMConditionType=BSWM_EQUALS_NOT, BswMConditionMode=CC_DcmComIndication_CN_FDCAN2_28a8fc44
            BswMConditionValue
              BswMBswMode: BswMBswRequestedMode=DCM_DISABLE_RX_TX_NORMAL
          CC_Cond_DcmComIndication_CN_FDCAN2_28a8fc44_NEQ_DCM_DISABLE_RX_ENABLE_TX_NM: BswMConditionType=BSWM_EQUALS_NOT, BswMConditionMode=CC_DcmComIndication_CN_FDCAN2_28a8fc44
            BswMConditionValue
              BswMBswMode: BswMBswRequestedMode=DCM_DISABLE_RX_ENABLE_TX_NM
          CC_Cond_DcmComIndication_CN_FDCAN2_28a8fc44_NEQ_DCM_DISABLE_RX_TX_NM: BswMConditionType=BSWM_EQUALS_NOT, BswMConditionMode=CC_DcmComIndication_CN_FDCAN2_28a8fc44
            BswMConditionValue
              BswMBswMode: BswMBswRequestedMode=DCM_DISABLE_RX_TX_NM
          CC_Cond_DcmComIndication_CN_FDCAN2_28a8fc44_NEQ_DCM_DISABLE_RX_ENABLE_TX_NORM_NM: BswMConditionType=BSWM_EQUALS_NOT, BswMConditionMode=CC_DcmComIndication_CN_FDCAN2_28a8fc44
            BswMConditionValue
              BswMBswMode: BswMBswRequestedMode=DCM_DISABLE_RX_ENABLE_TX_NORM_NM
          CC_Cond_DcmComIndication_CN_FDCAN2_28a8fc44_NEQ_DCM_DISABLE_RX_TX_NORM_NM: BswMConditionType=BSWM_EQUALS_NOT, BswMConditionMode=CC_DcmComIndication_CN_FDCAN2_28a8fc44
            BswMConditionValue
              BswMBswMode: BswMBswRequestedMode=DCM_DISABLE_RX_TX_NORM_NM
        CC_CN_FDCAN2_28a8fc44_NO_COM (BswMRule):
          BswMNestedExecutionOnly = false
          BswMRuleId = 16
          BswMRuleInitState = BSWM_TRUE
          BswMRuleExpressionRef = CC_LE_CanSMIndication_CN_FDCAN2_28a8fc44_EQ_CANSM_BSWM_NO_COMMUNICATION
          BswMRuleTrueActionList = CC_AL_CN_FDCAN2_28a8fc44_NO_COM
        CC_LE_CanSMIndication_CN_FDCAN2_28a8fc44_EQ_CANSM_BSWM_NO_COMMUNICATION (BswMLogicalExpression): BswMLogicalOperator=BSWM_AND, BswMArgumentRef=CC_Cond_CanSMIndication_CN_FDCAN2_28a8fc44_EQ_CANSM_BSWM_NO_COMMUNICATION
        CC_Cond_CanSMIndication_CN_FDCAN2_28a8fc44_EQ_CANSM_BSWM_NO_COMMUNICATION (BswMModeCondition): BswMConditionType=BSWM_EQUALS, BswMConditionMode=CC_CanSMIndication_CN_FDCAN2_28a8fc44
          BswMConditionValue
            BswMBswMode: BswMBswRequestedMode=CANSM_BSWM_NO_COMMUNICATION
        CC_CN_FDCAN2_28a8fc44_TX_ENABLE_BUSOFF (BswMRule):
          BswMNestedExecutionOnly = false
          BswMRuleId = 21
          BswMRuleInitState = BSWM_FALSE
          BswMRuleExpressionRef = CC_LE_CN_FDCAN2_28a8fc44_TX_ENABLE
          BswMRuleTrueActionList = CC_AL_CN_FDCAN2_28a8fc44_TX_EnableNoinit
        CC_LE_CN_FDCAN2_28a8fc44_TX_ENABLE (BswMLogicalExpression):
          BswMLogicalOperator = BSWM_AND
          BswMArgumentRef = BswMModeCondition_021
          BswMArgumentRef = CC_Cond_CanSMIndication_CN_FDCAN2_28a8fc44_EQ_CANSM_BSWM_FULL_COMMUNICATION
          BswMArgumentRef = CC_Cond_NmIndication_CN_FDCAN2_28a8fc44_NEQ_NM_STATE_BUS_SLEEP
          BswMArgumentRef = CC_Cond_NmIndication_CN_FDCAN2_28a8fc44_NEQ_NM_STATE_PREPARE_BUS_SLEEP
          BswMArgumentRef = CC_Cond_Generic_BusOff_CN_FDCAN2_28a8fc44_EQ_BUSOFF_SILENT
          BswMArgumentRef = CC_Cond_DcmComIndication_CN_FDCAN2_28a8fc44_NEQ_DCM_ENABLE_RX_DISABLE_TX_NORM
          BswMArgumentRef = CC_Cond_DcmComIndication_CN_FDCAN2_28a8fc44_NEQ_DCM_DISABLE_RX_TX_NORMAL
          BswMArgumentRef = CC_Cond_DcmComIndication_CN_FDCAN2_28a8fc44_NEQ_DCM_ENABLE_RX_DISABLE_TX_NM
          BswMArgumentRef = CC_Cond_DcmComIndication_CN_FDCAN2_28a8fc44_NEQ_DCM_DISABLE_RX_TX_NM
          BswMArgumentRef = CC_Cond_DcmComIndication_CN_FDCAN2_28a8fc44_NEQ_DCM_ENABLE_RX_DISABLE_TX_NORM_NM
          BswMArgumentRef = CC_Cond_DcmComIndication_CN_FDCAN2_28a8fc44_NEQ_DCM_DISABLE_RX_TX_NORM_NM
        6 x BswMModeCondition:
          CC_Cond_NmIndication_CN_FDCAN2_28a8fc44_NEQ_NM_STATE_BUS_SLEEP: BswMConditionType=BSWM_EQUALS_NOT, BswMConditionMode=CC_NmIndication_CN_FDCAN2_28a8fc44
            BswMConditionValue
              BswMBswMode: BswMBswRequestedMode=NM_STATE_BUS_SLEEP
          CC_Cond_NmIndication_CN_FDCAN2_28a8fc44_NEQ_NM_STATE_PREPARE_BUS_SLEEP: BswMConditionType=BSWM_EQUALS_NOT, BswMConditionMode=CC_NmIndication_CN_FDCAN2_28a8fc44
            BswMConditionValue
              BswMBswMode: BswMBswRequestedMode=NM_STATE_PREPARE_BUS_SLEEP
          CC_Cond_Generic_BusOff_CN_FDCAN2_28a8fc44_EQ_BUSOFF_SILENT: BswMConditionType=BSWM_EQUALS, BswMConditionMode=CC_Generic_BusOff_CN_FDCAN2_28a8fc44
            BswMConditionValue
              BswMBswMode: BswMBswRequestedMode=BUSOFF_SILENT
          CC_Cond_DcmComIndication_CN_FDCAN2_28a8fc44_NEQ_DCM_ENABLE_RX_DISABLE_TX_NORM: BswMConditionType=BSWM_EQUALS_NOT, BswMConditionMode=CC_DcmComIndication_CN_FDCAN2_28a8fc44
            BswMConditionValue
              BswMBswMode: BswMBswRequestedMode=DCM_ENABLE_RX_DISABLE_TX_NORM
          CC_Cond_DcmComIndication_CN_FDCAN2_28a8fc44_NEQ_DCM_ENABLE_RX_DISABLE_TX_NM: BswMConditionType=BSWM_EQUALS_NOT, BswMConditionMode=CC_DcmComIndication_CN_FDCAN2_28a8fc44
            BswMConditionValue
              BswMBswMode: BswMBswRequestedMode=DCM_ENABLE_RX_DISABLE_TX_NM
          CC_Cond_DcmComIndication_CN_FDCAN2_28a8fc44_NEQ_DCM_ENABLE_RX_DISABLE_TX_NORM_NM: BswMConditionType=BSWM_EQUALS_NOT, BswMConditionMode=CC_DcmComIndication_CN_FDCAN2_28a8fc44
            BswMConditionValue
              BswMBswMode: BswMBswRequestedMode=DCM_ENABLE_RX_DISABLE_TX_NORM_NM
        CC_CN_FDCAN2_28a8fc44_TX_ENABLE (BswMRule):
          BswMNestedExecutionOnly = false
          BswMRuleId = 20
          BswMRuleInitState = BSWM_FALSE
          BswMRuleExpressionRef = CC_LE_CN_FDCAN2_28a8fc44_TX_ENABLE_REINIT
          BswMRuleTrueActionList = CC_AL_CN_FDCAN2_28a8fc44_TX_EnableReinit
        CC_LE_CN_FDCAN2_28a8fc44_TX_ENABLE_REINIT (BswMLogicalExpression):
          BswMLogicalOperator = BSWM_AND
          BswMArgumentRef = BswMModeCondition_023
          BswMArgumentRef = CC_Cond_CanSMIndication_CN_FDCAN2_28a8fc44_EQ_CANSM_BSWM_FULL_COMMUNICATION
          BswMArgumentRef = CC_Cond_NmIndication_CN_FDCAN2_28a8fc44_NEQ_NM_STATE_BUS_SLEEP
          BswMArgumentRef = CC_Cond_NmIndication_CN_FDCAN2_28a8fc44_NEQ_NM_STATE_PREPARE_BUS_SLEEP
          BswMArgumentRef = CC_Cond_Generic_BusOff_CN_FDCAN2_28a8fc44_EQ_NO_COM
          BswMArgumentRef = CC_Cond_DcmComIndication_CN_FDCAN2_28a8fc44_NEQ_DCM_ENABLE_RX_DISABLE_TX_NORM
          BswMArgumentRef = CC_Cond_DcmComIndication_CN_FDCAN2_28a8fc44_NEQ_DCM_DISABLE_RX_TX_NORMAL
          BswMArgumentRef = CC_Cond_DcmComIndication_CN_FDCAN2_28a8fc44_NEQ_DCM_ENABLE_RX_DISABLE_TX_NM
          BswMArgumentRef = CC_Cond_DcmComIndication_CN_FDCAN2_28a8fc44_NEQ_DCM_DISABLE_RX_TX_NM
          BswMArgumentRef = CC_Cond_DcmComIndication_CN_FDCAN2_28a8fc44_NEQ_DCM_ENABLE_RX_DISABLE_TX_NORM_NM
          BswMArgumentRef = CC_Cond_DcmComIndication_CN_FDCAN2_28a8fc44_NEQ_DCM_DISABLE_RX_TX_NORM_NM
        CC_Cond_Generic_BusOff_CN_FDCAN2_28a8fc44_EQ_NO_COM (BswMModeCondition): BswMConditionType=BSWM_EQUALS, BswMConditionMode=CC_Generic_BusOff_CN_FDCAN2_28a8fc44
          BswMConditionValue
            BswMBswMode: BswMBswRequestedMode=NO_COM
        NmIndication_CN_FDCAN2_28a8fc44 (BswMModeRequestPort): BswMArbitrateOnInit=false, BswMRequestProcessing=BSWM_IMMEDIATE
          BswMModeRequestSource
            BswMNmIndication: BswMNmChannelRef=CN_FDCAN2_28a8fc44
          BswMModeInitValue
            BswMBswModeInitValue: BswMBswModeInitValueMode=NM_STATE_BUS_SLEEP
        4 x BswMModeCondition, all with BswMConditionMode=NmIndication_CN_FDCAN2_28a8fc44:
          BswMModeCondition: BswMConditionType=BSWM_EQUALS
            BswMConditionValue
              BswMBswMode: BswMBswRequestedMode=NM_STATE_NORMAL_OPERATION
          BswMModeCondition_001: BswMConditionType=BSWM_EQUALS_NOT
            BswMConditionValue
              BswMBswMode: BswMBswRequestedMode=NM_STATE_REPEAT_MESSAGE
          BswMModeCondition_002: BswMConditionType=BSWM_EQUALS_NOT
            BswMConditionValue
              BswMBswMode: BswMBswRequestedMode=NM_STATE_PREPARE_BUS_SLEEP
          BswMModeCondition_003: BswMConditionType=BSWM_EQUALS_NOT
            BswMConditionValue
              BswMBswMode: BswMBswRequestedMode=NM_STATE_READY_SLEEP
        SwcModeNotification_Current_CmdIgnition (BswMModeRequestPort): BswMArbitrateOnInit=false, BswMRequestProcessing=BSWM_DEFERRED
          BswMModeRequestSource
            BswMSwcModeNotification: BswMSwcModeNotificationModeDeclarationGroupPrototypeRef=Current_CmdIgnition
          BswMModeInitValue
            BswMSwcModeInitValue: BswMSwcModeInitValueRef=CmdIgnitionState_INVALID
        SwcModeNotification_SYSModeRequestType (BswMModeRequestPort): BswMArbitrateOnInit=false, BswMRequestProcessing=BSWM_DEFERRED
          BswMModeRequestSource
            BswMSwcModeNotification: BswMSwcModeNotificationModeDeclarationGroupPrototypeRef=SYSModeRequestType
          BswMModeInitValue
            BswMSwcModeInitValue: BswMSwcModeInitValueRef=SYS_REQ_INIT
        8 x BswMRule, all with BswMNestedExecutionOnly=false, BswMRuleInitState=BSWM_FALSE:
          BSWM_JumpToBoot: BswMRuleId=0, BswMRuleExpressionRef=LE_JumpToBootloader, BswMRuleTrueActionList=AL_Run_JumpToBOOT
          BSWM_NMNormalNtfy: BswMRuleId=1, BswMRuleExpressionRef=LE_NM_INDICATION_NORMAL_NTY, BswMRuleTrueActionList=AL_NMIndicationNormal
          BSWM_NMReadySleepNtfy: BswMRuleId=2, BswMRuleExpressionRef=LE_NM_INDICATION_READY_SLEEP_NTY, BswMRuleTrueActionList=AL_NMIndicationReadySleep
          BSWM_NmOtherNtfy: BswMRuleId=3, BswMRuleExpressionRef=LE_NM_INDICATION_OTHER_NTY, BswMRuleTrueActionList=AL_NMIndicationUninit
          BSWM_NmPrepareSleepNtfy: BswMRuleId=4, BswMRuleExpressionRef=LE_NM_INDICATION_PREPARE_SLEEP_NTY, BswMRuleTrueActionList=AL_NMIndicationPrepareSleep
          BSWM_NmRepeatNtfy: BswMRuleId=5, BswMRuleExpressionRef=LE_NM_INDICATION_REPEAT_NTY, BswMRuleTrueActionList=AL_NMIndicationRepeat
          BSWM_PerfromHardReset: BswMRuleId=6, BswMRuleExpressionRef=LE_HardReset, BswMRuleTrueActionList=AL_Run_HardReset
          BSWN_NmEnable: BswMRuleId=9, BswMRuleExpressionRef=LE_NMEnable, BswMRuleTrueActionList=CC_AL_CN_FDCAN2_28a8fc44_NmEnable
        19 x BswMModeCondition:
          BswMModeCondition_004: BswMConditionType=BSWM_EQUALS_NOT, BswMConditionMode=NmIndication_CN_FDCAN2_28a8fc44
            BswMConditionValue
              BswMBswMode: BswMBswRequestedMode=NM_STATE_NORMAL_OPERATION
          BswMModeCondition_005: BswMConditionType=BSWM_EQUALS, BswMConditionMode=NmIndication_CN_FDCAN2_28a8fc44
            BswMConditionValue
              BswMBswMode: BswMBswRequestedMode=NM_STATE_PREPARE_BUS_SLEEP
          BswMModeCondition_006: BswMConditionType=BSWM_EQUALS, BswMConditionMode=NmIndication_CN_FDCAN2_28a8fc44
            BswMConditionValue
              BswMBswMode: BswMBswRequestedMode=NM_STATE_READY_SLEEP
          BswMModeCondition_007: BswMConditionType=BSWM_EQUALS, BswMConditionMode=NmIndication_CN_FDCAN2_28a8fc44
            BswMConditionValue
              BswMBswMode: BswMBswRequestedMode=NM_STATE_REPEAT_MESSAGE
          BswMModeCondition_008: BswMConditionType=BSWM_EQUALS, BswMConditionMode=ESH_RunRequest_0
            BswMConditionValue
              BswMModeDeclaration: BswMModeValueRef=REQUESTED
          BswMModeCondition_009: BswMConditionType=BSWM_EQUALS, BswMConditionMode=ESH_RunRequest_1
            BswMConditionValue
              BswMModeDeclaration: BswMModeValueRef=REQUESTED
          BswMModeCondition_010: BswMConditionType=BSWM_EQUALS, BswMConditionMode=SwcModeNotification_SYSModeRequestType
            BswMConditionValue
              BswMModeDeclaration: BswMModeValueRef=SYS_REQ_JUMPTOBOOT
          BswMModeCondition_011: BswMConditionType=BSWM_EQUALS, BswMConditionMode=ESH_RunRequest_1
            BswMConditionValue
              BswMModeDeclaration: BswMModeValueRef=RELEASED
          BswMModeCondition_012: BswMConditionType=BSWM_EQUALS, BswMConditionMode=ESH_RunRequest_0
            BswMConditionValue
              BswMModeDeclaration: BswMModeValueRef=RELEASED
          BswMModeCondition_014: BswMConditionType=BSWM_EQUALS, BswMConditionMode=ESH_ComMPendingRequests
            BswMConditionValue
              BswMBswMode: BswMBswRequestedMode=ESH_COMM_PENDING_REQUEST
          BswMModeCondition_015: BswMConditionType=BSWM_EQUALS, BswMConditionMode=ESH_ComMPendingRequests
            BswMConditionValue
              BswMBswMode: BswMBswRequestedMode=ESH_COMM_PENDING_REQUEST
          BswMModeCondition_016: BswMConditionType=BSWM_EQUALS, BswMConditionMode=SwcModeNotification_Current_CmdIgnition
            BswMConditionValue
              BswMModeDeclaration: BswMModeValueRef=CmdIgnitionState_ON
          BswMModeCondition_017: BswMConditionType=BSWM_EQUALS_NOT, BswMConditionMode=NmIndication_CN_FDCAN2_28a8fc44
            BswMConditionValue
              BswMBswMode: BswMBswRequestedMode=NM_STATE_BUS_SLEEP
          BswMModeCondition_018: BswMConditionType=BSWM_EQUALS, BswMConditionMode=ESH_ComMPendingRequests
            BswMConditionValue
              BswMBswMode: BswMBswRequestedMode=ESH_COMM_NO_REQUEST
          BswMModeCondition_019: BswMConditionType=BSWM_EQUALS, BswMConditionMode=CC_DcmComIndication_CN_FDCAN2_28a8fc44
            BswMConditionValue
              BswMBswMode: BswMBswRequestedMode=DCM_ENABLE_RX_TX_NORM_NM
          BswMModeCondition_020: BswMConditionType=BSWM_EQUALS, BswMConditionMode=CC_DcmComIndication_CN_FDCAN2_28a8fc44
            BswMConditionValue
              BswMBswMode: BswMBswRequestedMode=DCM_ENABLE_RX_TX_NM
          BswMModeCondition_021: BswMConditionType=BSWM_EQUALS_NOT, BswMConditionMode=CC_DcmComIndication_CN_FDCAN2_28a8fc44
            BswMConditionValue
              BswMBswMode: BswMBswRequestedMode=DCM_ENABLE_RX_TX_NM
          BswMModeCondition_023: BswMConditionType=BSWM_EQUALS_NOT, BswMConditionMode=CC_DcmComIndication_CN_FDCAN2_28a8fc44
            BswMConditionValue
              BswMBswMode: BswMBswRequestedMode=DCM_ENABLE_RX_TX_NM
          BswMModeCondition_HardReset: BswMConditionType=BSWM_EQUALS, BswMConditionMode=SwcModeNotification_SYSModeRequestType
            BswMConditionValue
              BswMModeDeclaration: BswMModeValueRef=SYS_REQ_HARDRESET
        BswMRule_NMCheckRequest (BswMRule):
          BswMNestedExecutionOnly = false
          BswMRuleId = 8
          BswMRuleInitState = BSWM_FALSE
          BswMRuleExpressionRef = LE_CheckNMRequest
          BswMRuleTrueActionList = AL_CheckNMPendingRequest
          BswMRuleFalseActionList = AL_CheckNMPendingRequest
        9 x BswMLogicalExpression:
          LE_CheckNMRequest: BswMLogicalOperator=BSWM_OR, BswMArgumentRef=BswMModeCondition_017, BswMArgumentRef=BswMModeCondition_016
          LE_HardReset: BswMArgumentRef=BswMModeCondition_HardReset
          LE_JumpToBootloader: BswMArgumentRef=BswMModeCondition_010
          LE_NMEnable: BswMLogicalOperator=BSWM_OR, BswMArgumentRef=BswMModeCondition_020, BswMArgumentRef=BswMModeCondition_019
          LE_NM_INDICATION_NORMAL_NTY: BswMArgumentRef=BswMModeCondition
          LE_NM_INDICATION_OTHER_NTY: BswMLogicalOperator=BSWM_AND, BswMArgumentRef=BswMModeCondition_004, BswMArgumentRef=BswMModeCondition_003, BswMArgumentRef=BswMModeCondition_002, BswMArgumentRef=BswMModeCondition_001
          LE_NM_INDICATION_PREPARE_SLEEP_NTY: BswMArgumentRef=BswMModeCondition_005
          LE_NM_INDICATION_READY_SLEEP_NTY: BswMArgumentRef=BswMModeCondition_006
          LE_NM_INDICATION_REPEAT_NTY: BswMArgumentRef=BswMModeCondition_007
        BswMModeCondition_013 (BswMModeCondition): BswMConditionType=BSWM_EQUALS, BswMConditionMode=ESH_EcuM_GetValidatedWakeupEvents
          BswMConditionValue
            BswMBswMode: BswMBswRequestedMode=0
        BswMModeCondition_022 (BswMModeCondition): BswMConditionType=BSWM_EQUALS, BswMConditionMode=ESH_ComMPendingRequests
          BswMConditionValue
            BswMBswMode: BswMBswRequestedMode=ESH_COMM_PENDING_REQUEST
        BSWM_SSM_Shutdown_Execute (BswMRule):
          BswMNestedExecutionOnly = false
          BswMRuleId = 7
          BswMRuleInitState = BSWM_FALSE
          BswMRuleExpressionRef = LE_BSW_SSM_Systemstate_Expression
          BswMRuleTrueActionList = AL_SSM_BSW_Shutdown_execute
        SwcModeNotification_SSM_ModeNotification_State (BswMModeRequestPort): BswMArbitrateOnInit=false, BswMRequestProcessing=BSWM_DEFERRED
          BswMModeRequestSource
            BswMSwcModeNotification: BswMSwcModeNotificationModeDeclarationGroupPrototypeRef=Mode
          BswMModeInitValue
            BswMSwcModeInitValue: BswMSwcModeInitValueRef=SSM_STATE_BOOTING
        BswMModeCondition_024 (BswMModeCondition): BswMConditionType=BSWM_EQUALS, BswMConditionMode=SwcModeNotification_SSM_ModeNotification_State
          BswMConditionValue
            BswMModeDeclaration: BswMModeValueRef=SSM_STATE_MASTERCORE_SHUTDOWNJOBSEXECUTE
        LE_BSW_SSM_Systemstate_Expression (BswMLogicalExpression): BswMArgumentRef=BswMModeCondition_024
        SwcModeNotification_ADAS_ECU_Reset (BswMModeRequestPort): BswMArbitrateOnInit=false, BswMRequestProcessing=BSWM_DEFERRED
          BswMModeRequestSource
            BswMSwcModeNotification: BswMSwcModeNotificationModeDeclarationGroupPrototypeRef=DcmEcuReset
          BswMModeInitValue
            BswMSwcModeInitValue: BswMSwcModeInitValueRef=NONE
        BswMRule_ADAS_Shutdown_Request_CAN (BswMRule):
          BswMNestedExecutionOnly = false
          BswMRuleId = 11
          BswMRuleInitState = BSWM_FALSE
          BswMRuleExpressionRef = LE_ADAS_Shutdown_Request
          BswMRuleTrueActionList = AL_ADAS_EcuM_stateSwitch
        BswMModeCondition_025 (BswMModeCondition): BswMConditionType=BSWM_EQUALS, BswMConditionMode=CC_NmIndication_CN_FDCAN2_28a8fc44
          BswMConditionValue
            BswMBswMode: BswMBswRequestedMode=NM_STATE_BUS_SLEEP
        LE_ADAS_Shutdown_Request (BswMLogicalExpression): BswMArgumentRef=BswMModeCondition_025
        BswM_ADAS_ECUReset (BswMRule):
          BswMNestedExecutionOnly = false
          BswMRuleId = 13
          BswMRuleInitState = BSWM_FALSE
          BswMRuleExpressionRef = LE_ADAS_ECUResetRequest
          BswMRuleTrueActionList = AL_ADAS_ECUReset
        BswMModeCondition_026 (BswMModeCondition): BswMConditionType=BSWM_EQUALS, BswMConditionMode=SwcModeNotification_ADAS_ECU_Reset
          BswMConditionValue
            BswMModeDeclaration: BswMModeValueRef=EXECUTE
        LE_ADAS_ECUResetRequest (BswMLogicalExpression): BswMArgumentRef=BswMModeCondition_026
        SwcModeNotification_SafetyGuard_SysResetReq (BswMModeRequestPort): BswMArbitrateOnInit=false, BswMRequestProcessing=BSWM_DEFERRED
          BswMModeRequestSource
            BswMSwcModeNotification: BswMSwcModeNotificationModeDeclarationGroupPrototypeRef=Mode
          BswMModeInitValue
            BswMSwcModeInitValue: BswMSwcModeInitValueRef=SAFETTYGUARD_SAFASTATE_NORMAL
        BswMRule_SafetyGuard_SysResetReq (BswMRule):
          BswMNestedExecutionOnly = false
          BswMRuleId = 12
          BswMRuleInitState = BSWM_FALSE
          BswMRuleExpressionRef = LE_BswMRule_SafetyGuard_SysResetReq
          BswMRuleTrueActionList = AL_SafetyGuard_SysResetReq
        BswMModeCondition_027 (BswMModeCondition): BswMConditionType=BSWM_EQUALS, BswMConditionMode=SwcModeNotification_SafetyGuard_SysResetReq
          BswMConditionValue
            BswMModeDeclaration: BswMModeValueRef=SAFETYGUARD_SAFESTATE_2_RESET
        LE_BswMRule_SafetyGuard_SysResetReq (BswMLogicalExpression): BswMArgumentRef=BswMModeCondition_027
        RpPreviousNMState (BswMModeRequestPort): BswMArbitrateOnInit=false, BswMRequestProcessing=BSWM_DEFERRED
          BswMModeRequestSource
            BswMSwcModeRequest: BswMModeRequestDataElementPrototypeName=requestedMode, BswMSwcModeRequestModeDeclarationGroupPrototypeRef=BswM_MDGP_BswM_PreviousNMState
          BswMModeInitValue
            BswMSwcModeInitValue: BswMSwcModeInitValueRef=NM_STATE_BUS_SLEEP
        BswMRule_SCCalStatus (BswMRule):
          BswMNestedExecutionOnly = false
          BswMRuleId = 10
          BswMRuleInitState = BSWM_FALSE
          BswMRuleExpressionRef = LE_SCCalStatus
          BswMRuleTrueActionList = AL_SCCalStatus
        BswM_ScCalStatus (BswMModeRequestPort): BswMArbitrateOnInit=false, BswMRequestProcessing=BSWM_DEFERRED
          BswMModeRequestSource
            BswMSwcModeRequest: BswMModeRequestDataElementPrototypeName=requestedMode, BswMSwcModeRequestModeDeclarationGroupPrototypeRef=BswM_MDGP_CalDataProSCCalStatus
          BswMModeInitValue
            BswMSwcModeInitValue: BswMSwcModeInitValueRef=SC_CAL_NOT_STARTED
        BswMModeCondition_028 (BswMModeCondition): BswMConditionType=BSWM_EQUALS, BswMConditionMode=BswM_ScCalStatus
          BswMConditionValue
            BswMModeDeclaration: BswMModeValueRef=SC_CAL_FINISHED
        LE_SCCalStatus (BswMLogicalExpression): BswMArgumentRef=BswMModeCondition_028
      BswMModeControl: BswMInitActionListRef=INIT_AL_Initialize
        INIT_AL_Initialize (BswMActionList): BswMActionListExecution=BSWM_CONDITION
          44 x BswMActionListItem, all with BswMAbortOnFail=false:
            INIT_Action_Adc_Init: BswMActionListItemIndex=2, BswMActionListItemRef=BswMModeControl/INIT_Action_Adc_Init
            INIT_Action_CanTrcv_30_Tja1043_Init: BswMActionListItemIndex=8, BswMActionListItemRef=BswMModeControl/INIT_Action_CanTrcv_30_Tja1043_Init
            INIT_Action_Can_30_Mcan_Init: BswMActionListItemIndex=9, BswMActionListItemRef=BswMModeControl/INIT_Action_Can_30_Mcan_Init
            INIT_Action_Eep_30_XXi2c01_Init: BswMActionListItemIndex=4, BswMActionListItemRef=BswMModeControl/INIT_Action_Eep_30_XXi2c01_Init
            INIT_Action_CanIf_Init: BswMActionListItemIndex=12, BswMActionListItemRef=BswMModeControl/INIT_Action_CanIf_Init
            INIT_Action_Ea_Init: BswMActionListItemIndex=3, BswMActionListItemRef=BswMModeControl/INIT_Action_Ea_Init
            INIT_Action_Com_Init: BswMActionListItemIndex=15, BswMActionListItemRef=BswMModeControl/INIT_Action_Com_Init
            INIT_Action_PduR_Init: BswMActionListItemIndex=16, BswMActionListItemRef=BswMModeControl/INIT_Action_PduR_Init
            INIT_Action_CanSM_Init: BswMActionListItemIndex=17, BswMActionListItemRef=BswMModeControl/INIT_Action_CanSM_Init
            INIT_Action_CanNm_Init: BswMActionListItemIndex=18, BswMActionListItemRef=BswMModeControl/INIT_Action_CanNm_Init
            INIT_Action_Nm_Init: BswMActionListItemIndex=19, BswMActionListItemRef=BswMModeControl/INIT_Action_Nm_Init
            INIT_Action_CanTp_Init: BswMActionListItemIndex=20, BswMActionListItemRef=BswMModeControl/INIT_Action_CanTp_Init
            INIT_Action_NvM_Init: BswMActionListItemIndex=5, BswMActionListItemRef=BswMModeControl/INIT_Action_NvM_Init
            INIT_Action_NvMReadAll: BswMActionListItemIndex=6, BswMActionListItemRef=BswMModeControl/INIT_Action_NvMReadAll
            INIT_Action_EnableInterrupts: BswMActionListItemIndex=1, BswMActionListItemRef=BswMModeControl/INIT_Action_EnableInterrupts
            INIT_Action_ComM_Init: BswMActionListItemIndex=26, BswMActionListItemRef=BswMModeControl/INIT_Action_ComM_Init
            INIT_Action_Dcm_Init: BswMActionListItemIndex=27, BswMActionListItemRef=BswMModeControl/INIT_Action_Dcm_Init
            INIT_Action_Dem_Init: BswMActionListItemIndex=28, BswMActionListItemRef=BswMModeControl/INIT_Action_Dem_Init
            INIT_Action_IoHwAb_Init: BswMActionListItemIndex=29, BswMActionListItemRef=BswMModeControl/INIT_Action_IoHwAb_Init
            INIT_Action_vRoE_Init: BswMActionListItemIndex=30, BswMActionListItemRef=BswMModeControl/INIT_Action_vRoE_Init
            INIT_Action_ComM_PostInit: BswMActionListItemIndex=31, BswMActionListItemRef=BswMModeControl/INIT_Action_ComM_PostInit
            INIT_Action_Nm_PostInit: BswMActionListItemIndex=32, BswMActionListItemRef=BswMModeControl/INIT_Action_Nm_PostInit
            INIT_Action_Rte_Start: BswMActionListItemIndex=43, BswMActionListItemRef=BswMModeControl/INIT_Action_Rte_Start
            ESH_Action_OnEnterWakeup: BswMActionListItemIndex=0, BswMActionListItemRef=BswMModeControl/ESH_Action_OnEnterWakeup
            ESH_Action_ComMAllow_CN_FDCAN14_a902658e: BswMActionListItemIndex=36, BswMActionListItemRef=BswMModeControl/ESH_Action_ComMAllow_CN_FDCAN14_a902658e
            ESH_Action_ComMAllow_CN_FDCAN2_28a8fc44: BswMActionListItemIndex=35, BswMActionListItemRef=BswMModeControl/ESH_Action_ComMAllow_CN_FDCAN2_28a8fc44
            CC_EnableDM_CVADAS_oFDCAN14_Rx_885c637a: BswMActionListItemIndex=33, BswMActionListItemRef=BswMModeControl/CC_EnableDM_CVADAS_oFDCAN14_Rx_885c637a
            CC_EnableDM_CVADAS_oFDCAN2_Rx_6371d032: BswMActionListItemIndex=37, BswMActionListItemRef=BswMModeControl/CC_EnableDM_CVADAS_oFDCAN2_Rx_6371d032
            CC_EnablePDUGroup_CVADAS_oFDCAN14_Rx_885c637a: BswMActionListItemIndex=38, BswMActionListItemRef=BswMModeControl/CC_EnablePDUGroup_CVADAS_oFDCAN14_Rx_885c637a
            CC_EnablePDUGroup_CVADAS_oFDCAN14_Tx_de06c4fc: BswMActionListItemIndex=39, BswMActionListItemRef=BswMModeControl/CC_EnablePDUGroup_CVADAS_oFDCAN14_Tx_de06c4fc
            CC_EnablePDUGroup_CVADAS_oFDCAN2_Rx_6371d032: BswMActionListItemIndex=40, BswMActionListItemRef=BswMModeControl/CC_EnablePDUGroup_CVADAS_oFDCAN2_Rx_6371d032
            CC_EnablePDUGroup_CVADAS_oFDCAN2_Tx_352b77b4: BswMActionListItemIndex=41, BswMActionListItemRef=BswMModeControl/CC_EnablePDUGroup_CVADAS_oFDCAN2_Tx_352b77b4
            CC_EnablePDUGroup_Noinit_CVADAS_oFDCAN2_Tx_352b77b4: BswMActionListItemIndex=42, BswMActionListItemRef=BswMModeControl/CC_EnablePDUGroup_Noinit_CVADAS_oFDCAN2_Tx_352b77b4
            Action_BSWM_FULL_COM_CN_FDCAN2_3de30c40: BswMActionListItemIndex=34, BswMActionListItemRef=BswMModeControl/Action_BSWM_FULL_COM_CN_FDCAN2_3de30c40
            INIT_Action_CanXcp_Init: BswMActionListItemIndex=21, BswMActionListItemRef=BswMModeControl/INIT_Action_CanXcp_Init
            INIT_Action_Xcp_Init: BswMActionListItemIndex=22, BswMActionListItemRef=BswMModeControl/INIT_Action_Xcp_Init
            INIT_Action_CryIf_Init: BswMActionListItemIndex=13, BswMActionListItemRef=BswMModeControl/INIT_Action_CryIf_Init
            INIT_Action_Csm_Init: BswMActionListItemIndex=23, BswMActionListItemRef=BswMModeControl/INIT_Action_Csm_Init
            INIT_Action_vDiagSecAcc_Init: BswMActionListItemIndex=25, BswMActionListItemRef=BswMModeControl/INIT_Action_vDiagSecAcc_Init
            INIT_Action_Wdg_Init: BswMActionListItemIndex=7, BswMActionListItemRef=BswMModeControl/INIT_Action_Wdg_Init
            INIT_Action_WdgM_Init: BswMActionListItemIndex=14, BswMActionListItemRef=BswMModeControl/INIT_Action_WdgM_Init
            INIT_Action_Crypto_30_vHsm_Init: BswMActionListItemIndex=11, BswMActionListItemRef=BswMModeControl/INIT_Action_Crypto_30_vHsm_Init
            INIT_Action_vDam_Init: BswMActionListItemIndex=24, BswMActionListItemRef=BswMModeControl/INIT_Action_vDam_Init
            INIT_Action_Crypto_30_vHsm_WaitForHsmRam: BswMActionListItemIndex=10, BswMActionListItemRef=BswMModeControl/INIT_Action_Crypto_30_vHsm_WaitForHsmRam
        23 x BswMAction:
          INIT_Action_Adc_Init
            BswMAvailableActions
              BswMUserCallout: BswMUserCalloutFunction=Adc_Init(&ADC_INIT_CONFIG_PC), BswMCreateCallout=false, BswMUserIncludeFile=Adc.h
          INIT_Action_CanTrcv_30_Tja1043_Init
            BswMAvailableActions
              BswMUserCallout:
                BswMUserCalloutFunction = CanTrcv_30_Tja1043_Init(CanTrcv_30_Tja1043_Config_Ptr)
                BswMCreateCallout = false
                BswMUserIncludeFile = CanTrcv_30_Tja1043.h
          INIT_Action_Can_30_Mcan_Init
            BswMAvailableActions
              BswMUserCallout: BswMUserCalloutFunction=Can_30_Mcan_Init(Can_30_Mcan_Config_Ptr), BswMCreateCallout=false, BswMUserIncludeFile=Can_30_Mcan.h
          INIT_Action_Eep_30_XXi2c01_Init
            BswMAvailableActions
              BswMUserCallout: BswMUserCalloutFunction=Eep_30_XXi2c01_Init(&Eep_30_XXi2c01_Runtime), BswMCreateCallout=false, BswMUserIncludeFile=Eep_30_XXi2c01.h
          INIT_Action_CanIf_Init
            BswMAvailableActions
              BswMUserCallout: BswMUserCalloutFunction=CanIf_Init(CanIf_Config_Ptr), BswMCreateCallout=false, BswMUserIncludeFile=CanIf.h
          INIT_Action_Ea_Init
            BswMAvailableActions
              BswMUserCallout: BswMUserCalloutFunction=Ea_Init(), BswMCreateCallout=false, BswMUserIncludeFile=Ea.h
          INIT_Action_Com_Init
            BswMAvailableActions
              BswMUserCallout: BswMUserCalloutFunction=Com_Init(Com_Config_Ptr), BswMCreateCallout=false, BswMUserIncludeFile=Com.h
          INIT_Action_PduR_Init
            BswMAvailableActions
              BswMUserCallout: BswMUserCalloutFunction=PduR_Init(PduR_Config_Ptr), BswMCreateCallout=false, BswMUserIncludeFile=PduR.h
          INIT_Action_CanSM_Init
            BswMAvailableActions
              BswMUserCallout: BswMUserCalloutFunction=CanSM_Init(CanSM_Config_Ptr), BswMCreateCallout=false, BswMUserIncludeFile=CanSM_EcuM.h
          INIT_Action_CanNm_Init
            BswMAvailableActions
              BswMUserCallout: BswMUserCalloutFunction=CanNm_Init(CanNm_Config_Ptr), BswMCreateCallout=false, BswMUserIncludeFile=CanNm.h
          INIT_Action_Nm_Init
            BswMAvailableActions
              BswMUserCallout: BswMUserCalloutFunction=Nm_Init(Nm_Config_Ptr), BswMCreateCallout=false, BswMUserIncludeFile=Nm.h
          INIT_Action_CanTp_Init
            BswMAvailableActions
              BswMUserCallout: BswMUserCalloutFunction=CanTp_Init(CanTp_Config_Ptr), BswMCreateCallout=false, BswMUserIncludeFile=CanTp.h
          INIT_Action_NvM_Init
            BswMAvailableActions
              BswMUserCallout: BswMUserCalloutFunction=NvM_Init(), BswMCreateCallout=false, BswMUserIncludeFile=NvM.h
          INIT_Action_NvMReadAll
            BswMAvailableActions
              BswMUserCallout: BswMUserCalloutFunction=BswM_INIT_NvMReadAll(), BswMCreateCallout=true, BswMUserCode=
          INIT_Action_EnableInterrupts
            BswMAvailableActions
              BswMUserCallout:
                BswMUserCalloutFunction = BswM_AL_SetProgrammableInterrupts()
                BswMCreateCallout = true
                BswMUserCode = Os_EnableInterruptSource(ADC0,TRUE); Os_EnableInterruptSource(ADC1,TRUE); Os_EnableInterruptSource(I2c_IrqUnit0,TRUE); Os_EnableInterruptSource(I2c_IrqUnit0,TRUE); Os_EnableInterruptSource(I2c_IrqUnit0,TRUE); Os_EnableInterruptSource(Can_30_McanIsr_0,TRUE); Os_EnableInterruptSource(Can_30_McanIsr_1,TRUE); Os_EnableInterruptSource(vHsmResponseIsr,TRUE);
          INIT_Action_ComM_Init
            BswMAvailableActions
              BswMUserCallout: BswMUserCalloutFunction=ComM_Init(ComM_Config_Ptr), BswMCreateCallout=false, BswMUserIncludeFile=ComM.h
          INIT_Action_Dcm_Init
            BswMAvailableActions
              BswMUserCallout: BswMUserCalloutFunction=Dcm_Init(NULL_PTR), BswMCreateCallout=false, BswMUserIncludeFile=Dcm.h
          INIT_Action_Dem_Init
            BswMAvailableActions
              BswMUserCallout: BswMUserCalloutFunction=Dem_Init(Dem_Config_Ptr), BswMCreateCallout=false, BswMUserIncludeFile=Dem.h
          INIT_Action_IoHwAb_Init
            BswMAvailableActions
              BswMUserCallout: BswMUserCalloutFunction=IoHwAb_Init(), BswMCreateCallout=false, BswMUserIncludeFile=IoHwAb.h
          INIT_Action_vRoE_Init
            BswMAvailableActions
              BswMUserCallout: BswMUserCalloutFunction=vRoE_Init(), BswMCreateCallout=false, BswMUserIncludeFile=vRoE.h
          INIT_Action_ComM_PostInit
            BswMAvailableActions
              BswMUserCallout: BswMUserCalloutFunction=ComM_PostInit(), BswMCreateCallout=false, BswMUserIncludeFile=ComM.h
          INIT_Action_Nm_PostInit
            BswMAvailableActions
              BswMUserCallout: BswMUserCalloutFunction=Nm_PostInit(), BswMCreateCallout=false, BswMUserIncludeFile=Nm.h
          INIT_Action_Rte_Start
            BswMAvailableActions
              BswMUserCallout: BswMUserCalloutFunction=Rte_Start(), BswMCreateCallout=false, BswMUserIncludeFile=Rte_Main.h
        ESH_AL_ExitRun (BswMActionList): BswMActionListExecution=BSWM_CONDITION
          4 x BswMActionListItem, all with BswMAbortOnFail=false:
            ESH_Action_EnterExclusiveArea: BswMActionListItemIndex=0, BswMActionListItemRef=BswMModeControl/ESH_Action_EnterExclusiveArea
            ESH_Action_ComMCheckPendingRequests: BswMActionListItemIndex=1, BswMActionListItemRef=BswMModeControl/ESH_Action_ComMCheckPendingRequests
            ESH_RunToPostRunNested: BswMActionListItemIndex=2, BswMActionListItemRef=BswMArbitration/ESH_RunToPostRunNested
            ESH_Action_ExitExclusiveArea: BswMActionListItemIndex=3, BswMActionListItemRef=BswMModeControl/ESH_Action_ExitExclusiveArea
        ESH_Action_EnterExclusiveArea (BswMAction)
          BswMAvailableActions
            BswMUserCallout: BswMUserCalloutFunction=SchM_Enter_BswM_BSWM_EXCLUSIVE_AREA_0(), BswMCreateCallout=false, BswMUserIncludeFile=SchM_BswM.h
        ESH_Action_ComMCheckPendingRequests (BswMAction)
          BswMAvailableActions
            BswMUserCallout:
              BswMUserCalloutFunction = ESH_ComM_CheckPendingRequests()
              BswMCreateCallout = true
              BswMUserCode = ComM_StateType CN_FDCAN2_28a8fc44 = COMM_NO_COM_NO_PENDING_REQUEST; ComM_StateType CN_FDCAN14_a902658e = COMM_NO_COM_NO_PENDING_REQUEST; (void)ComM_GetState(ComMConf_ComMChannel_CN_FDCAN2_28a8fc44, &CN_FDCAN2_28a8fc44); /* SBSW_BSWM_FCTCALL_LOCALVAR */ (void)ComM_GetState(ComMConf_ComMChannel_CN_FDCAN14_a902658e, &CN_FDCAN14_a902658e); /* SBSW_BSWM_FCTCALL_LOCALVAR */ if((CN_FDCAN2_28a8fc44 != COMM_NO_COM_NO_PENDING_REQUEST) || (CN_FDCAN14_a902658e != COMM_NO_COM_NO_PENDING_REQUEST)) { BswM_RequestMode(BSWM_GENERIC_ESH_ComMPendingRequests, BSWM_GENERICVALUE_ESH_ComMPendingRequests_ESH_COMM_PENDING_REQUEST); } else { BswM_RequestMode(BSWM_GENERIC_ESH_ComMPendingRequests, BSWM_GENERICVALUE_ESH_ComMPendingRequests_ESH_COMM_NO_REQUEST); }
        ESH_AL_RunToPostRun (BswMActionList): BswMActionListExecution=BSWM_CONDITION
          6 x BswMActionListItem, all with BswMAbortOnFail=false:
            ESH_Action_ComMDisallow_CN_FDCAN2_28a8fc44: BswMActionListItemIndex=0, BswMActionListItemRef=BswMModeControl/ESH_Action_ComMDisallow_CN_FDCAN2_28a8fc44
            ESH_Action_ComMDisallow_CN_FDCAN14_a902658e: BswMActionListItemIndex=1, BswMActionListItemRef=BswMModeControl/ESH_Action_ComMDisallow_CN_FDCAN14_a902658e
            ESH_Action_EcuMClearValidatedWakeupEvents: BswMActionListItemIndex=2, BswMActionListItemRef=BswMModeControl/ESH_Action_EcuMClearValidatedWakeupEvents
            ESH_Action_OnEnterPostRun: BswMActionListItemIndex=3, BswMActionListItemRef=BswMModeControl/ESH_Action_OnEnterPostRun
            ESH_Action_SwitchPostRun: BswMActionListItemIndex=4, BswMActionListItemRef=BswMModeControl/ESH_Action_SwitchPostRun
            ESH_Action_ESH_PostRun: BswMActionListItemIndex=5, BswMActionListItemRef=BswMModeControl/ESH_Action_ESH_PostRun
        5 x BswMAction:
          ESH_Action_ComMDisallow_CN_FDCAN2_28a8fc44
            BswMAvailableActions
              BswMComMAllowCom: BswMComAllowed=false, BswMComMAllowChannelRef=CN_FDCAN2_28a8fc44
          ESH_Action_ComMDisallow_CN_FDCAN14_a902658e
            BswMAvailableActions
              BswMComMAllowCom: BswMComAllowed=false, BswMComMAllowChannelRef=CN_FDCAN14_a902658e
          ESH_Action_EcuMClearValidatedWakeupEvents
            BswMAvailableActions
              BswMUserCallout: BswMUserCalloutFunction=EcuM_ClearValidatedWakeupEvent(ECUM_WKSOURCE_ALL_SOURCES), BswMCreateCallout=false, BswMUserIncludeFile=EcuM.h
          ESH_Action_OnEnterPostRun
            BswMAvailableActions
              BswMUserCallout: BswMUserCalloutFunction=BswM_ESH_OnEnterPostRun(), BswMCreateCallout=true
          ESH_Action_SwitchPostRun
            BswMAvailableActions
              BswMRteSwitch: BswMSwitchedMode=POSTRUN, BswMRteSwitchPortRef=ESH_ModeSwitch
        ESH_ModeSwitch (BswMSwitchPort): BswMModeSwitchInterfaceRef=BswM_MSI_ESH_Mode
        ESH_Action_ESH_PostRun (BswMAction)
          BswMAvailableActions
            BswMGenericModeSwitch: BswMGenericRequestRef=ESH_State, BswMGenericRequestModeRef=ESH_POST_RUN
        ESH_Action_ExitExclusiveArea (BswMAction)
          BswMAvailableActions
            BswMUserCallout: BswMUserCalloutFunction=SchM_Exit_BswM_BSWM_EXCLUSIVE_AREA_0(), BswMCreateCallout=false, BswMUserIncludeFile=SchM_BswM.h
        ESH_AL_WaitForNvMToShutdown (BswMActionList): BswMActionListExecution=BSWM_CONDITION
          4 x BswMActionListItem, all with BswMAbortOnFail=false:
            ESH_Action_WriteAllTimer_Stop: BswMActionListItemIndex=0, BswMActionListItemRef=BswMModeControl/ESH_Action_WriteAllTimer_Stop
            ESH_Action_OnEnterShutdown: BswMActionListItemIndex=1, BswMActionListItemRef=BswMModeControl/ESH_Action_OnEnterShutdown
            ESH_Action_EcuMGoToSelectedShutdownTarget: BswMActionListItemIndex=2, BswMActionListItemRef=BswMModeControl/ESH_Action_EcuMGoToSelectedShutdownTarget
            Action_RTE_SWITCH_ESH_ModeSwitch_SHUTDOWN: BswMActionListItemIndex=3, BswMActionListItemRef=BswMModeControl/Action_RTE_SWITCH_ESH_ModeSwitch_SHUTDOWN
        3 x BswMAction:
          ESH_Action_WriteAllTimer_Stop
            BswMAvailableActions
              BswMTimerControl: BswMTimerAction=BSWM_TIMER_STOP, BswMTimerValue=0, BswMTimerRef=ESH_NvM_WriteAllTimer
          ESH_Action_OnEnterShutdown
            BswMAvailableActions
              BswMUserCallout: BswMUserCalloutFunction=BswM_ESH_OnEnterShutdown(), BswMCreateCallout=true
          ESH_Action_EcuMGoToSelectedShutdownTarget
            BswMAvailableActions
              BswMUserCallout: BswMUserCalloutFunction=(void)EcuM_GoToSelectedShutdownTarget(), BswMCreateCallout=false, BswMUserIncludeFile=EcuM.h
        ESH_AL_WakeupToPrep (BswMActionList): BswMActionListExecution=BSWM_CONDITION
          3 x BswMActionListItem, all with BswMAbortOnFail=false:
            ESH_Action_OnEnterPrepShutdown: BswMActionListItemIndex=0, BswMActionListItemRef=BswMModeControl/ESH_Action_OnEnterPrepShutdown
            ESH_Action_SwitchShutdown: BswMActionListItemIndex=1, BswMActionListItemRef=BswMModeControl/ESH_Action_SwitchShutdown
            ESH_Action_ESH_PrepShutdown: BswMActionListItemIndex=2, BswMActionListItemRef=BswMModeControl/ESH_Action_ESH_PrepShutdown
        3 x BswMAction:
          ESH_Action_OnEnterPrepShutdown
            BswMAvailableActions
              BswMUserCallout: BswMUserCalloutFunction=BswM_ESH_OnEnterPrepShutdown(), BswMCreateCallout=true
          ESH_Action_SwitchShutdown
            BswMAvailableActions
              BswMRteSwitch: BswMSwitchedMode=SHUTDOWN, BswMRteSwitchPortRef=ESH_ModeSwitch
          ESH_Action_ESH_PrepShutdown
            BswMAvailableActions
              BswMGenericModeSwitch: BswMGenericRequestRef=ESH_State, BswMGenericRequestModeRef=ESH_PREP_SHUTDOWN
        ESH_AL_WaitForNvMWakeup (BswMActionList): BswMActionListExecution=BSWM_CONDITION
          6 x BswMActionListItem, all with BswMAbortOnFail=false:
            ESH_Action_WriteAllTimer_Stop: BswMActionListItemIndex=0, BswMActionListItemRef=BswMModeControl/ESH_Action_WriteAllTimer_Stop
            ESH_Action_CancelWriteAllTimer_Start: BswMActionListItemIndex=1, BswMActionListItemRef=BswMModeControl/ESH_Action_CancelWriteAllTimer_Start
            ESH_Action_CancelNvMWriteAll: BswMActionListItemIndex=2, BswMActionListItemRef=BswMModeControl/ESH_Action_CancelNvMWriteAll
            ESH_Action_OnEnterWakeup: BswMActionListItemIndex=3, BswMActionListItemRef=BswMModeControl/ESH_Action_OnEnterWakeup
            ESH_Action_SwitchWakeup: BswMActionListItemIndex=4, BswMActionListItemRef=BswMModeControl/ESH_Action_SwitchWakeup
            ESH_Action_ESH_Wakeup: BswMActionListItemIndex=5, BswMActionListItemRef=BswMModeControl/ESH_Action_ESH_Wakeup
        5 x BswMAction:
          ESH_Action_CancelWriteAllTimer_Start
            BswMAvailableActions
              BswMTimerControl: BswMTimerAction=BSWM_TIMER_START, BswMTimerValue=0.5, BswMTimerRef=ESH_NvM_CancelWriteAllTimer
          ESH_Action_CancelNvMWriteAll
            BswMAvailableActions
              BswMUserCallout: BswMUserCalloutFunction=NvM_CancelWriteAll(), BswMCreateCallout=false, BswMUserIncludeFile=NvM.h
          ESH_Action_OnEnterWakeup
            BswMAvailableActions
              BswMUserCallout:
                BswMUserCalloutFunction = BswM_ESH_OnEnterWakeup()
                BswMCreateCallout = true
                BswMUserCode = EcuM_ClearWakeupEvent(ECUM_WKSOURCE_RESET); EcuM_SetWakeupEvent(ECUM_WKSOURCE_CN_FDCAN2_28a8fc44);
          ESH_Action_SwitchWakeup
            BswMAvailableActions
              BswMRteSwitch: BswMSwitchedMode=WAKEUP, BswMRteSwitchPortRef=ESH_ModeSwitch
          ESH_Action_ESH_Wakeup
            BswMAvailableActions
              BswMGenericModeSwitch: BswMGenericRequestRef=ESH_State, BswMGenericRequestModeRef=ESH_WAKEUP
        ESH_AL_WakeupToRun (BswMActionList): BswMActionListExecution=BSWM_CONDITION
          8 x BswMActionListItem, all with BswMAbortOnFail=false:
            ESH_Action_CancelWriteAllTimer_Stop: BswMActionListItemIndex=0, BswMActionListItemRef=BswMModeControl/ESH_Action_CancelWriteAllTimer_Stop
            ESH_DemInit: BswMActionListItemIndex=1, BswMActionListItemRef=BswMArbitration/ESH_DemInit
            ESH_Action_ComMAllow_CN_FDCAN2_28a8fc44: BswMActionListItemIndex=2, BswMActionListItemRef=BswMModeControl/ESH_Action_ComMAllow_CN_FDCAN2_28a8fc44
            ESH_Action_ComMAllow_CN_FDCAN14_a902658e: BswMActionListItemIndex=3, BswMActionListItemRef=BswMModeControl/ESH_Action_ComMAllow_CN_FDCAN14_a902658e
            ESH_Action_SelfRunRequestTimer_Start: BswMActionListItemIndex=4, BswMActionListItemRef=BswMModeControl/ESH_Action_SelfRunRequestTimer_Start
            ESH_Action_OnEnterRun: BswMActionListItemIndex=5, BswMActionListItemRef=BswMModeControl/ESH_Action_OnEnterRun
            ESH_Action_SwitchRun: BswMActionListItemIndex=6, BswMActionListItemRef=BswMModeControl/ESH_Action_SwitchRun
            ESH_Action_ESH_Run: BswMActionListItemIndex=7, BswMActionListItemRef=BswMModeControl/ESH_Action_ESH_Run
        ESH_Action_CancelWriteAllTimer_Stop (BswMAction)
          BswMAvailableActions
            BswMTimerControl: BswMTimerAction=BSWM_TIMER_STOP, BswMTimerValue=0, BswMTimerRef=ESH_NvM_CancelWriteAllTimer
        ESH_AL_DemInit (BswMActionList): BswMActionListExecution=BSWM_CONDITION
          ESH_Action_DemInit (BswMActionListItem): BswMAbortOnFail=false, BswMActionListItemIndex=0, BswMActionListItemRef=BswMModeControl/ESH_Action_DemInit
          ESH_Action_DemInitialized (BswMActionListItem): BswMAbortOnFail=false, BswMActionListItemIndex=1, BswMActionListItemRef=BswMModeControl/ESH_Action_DemInitialized
        8 x BswMAction:
          ESH_Action_DemInit
            BswMAvailableActions
              BswMUserCallout: BswMUserCalloutFunction=Dem_Init(Dem_Config_Ptr), BswMCreateCallout=false, BswMUserIncludeFile=Dem.h
          ESH_Action_DemInitialized
            BswMAvailableActions
              BswMGenericModeSwitch: BswMGenericRequestRef=ESH_DemInitStatus, BswMGenericRequestModeRef=DEM_INITIALIZED
          ESH_Action_ComMAllow_CN_FDCAN2_28a8fc44
            BswMAvailableActions
              BswMComMAllowCom: BswMComAllowed=true, BswMComMAllowChannelRef=CN_FDCAN2_28a8fc44
          ESH_Action_ComMAllow_CN_FDCAN14_a902658e
            BswMAvailableActions
              BswMComMAllowCom: BswMComAllowed=true, BswMComMAllowChannelRef=CN_FDCAN14_a902658e
          ESH_Action_SelfRunRequestTimer_Start
            BswMAvailableActions
              BswMTimerControl: BswMTimerAction=BSWM_TIMER_START, BswMTimerValue=0.1, BswMTimerRef=ESH_SelfRunRequestTimer
          ESH_Action_OnEnterRun
            BswMAvailableActions
              BswMUserCallout: BswMUserCalloutFunction=BswM_ESH_OnEnterRun(), BswMCreateCallout=true
          ESH_Action_SwitchRun
            BswMAvailableActions
              BswMRteSwitch: BswMSwitchedMode=RUN, BswMRteSwitchPortRef=ESH_ModeSwitch
          ESH_Action_ESH_Run
            BswMAvailableActions
              BswMGenericModeSwitch: BswMGenericRequestRef=ESH_State, BswMGenericRequestModeRef=ESH_RUN
        ESH_AL_InitToWakeup (BswMActionList): BswMActionListExecution=BSWM_CONDITION
          3 x BswMActionListItem, all with BswMAbortOnFail=false:
            ESH_Action_OnEnterWakeup: BswMActionListItemIndex=0, BswMActionListItemRef=BswMModeControl/ESH_Action_OnEnterWakeup
            ESH_Action_SwitchWakeup: BswMActionListItemIndex=1, BswMActionListItemRef=BswMModeControl/ESH_Action_SwitchWakeup
            ESH_Action_ESH_Wakeup: BswMActionListItemIndex=2, BswMActionListItemRef=BswMModeControl/ESH_Action_ESH_Wakeup
        ESH_AL_PostRunToPrepShutdown (BswMActionList): BswMActionListExecution=BSWM_CONDITION
          5 x BswMActionListItem, all with BswMAbortOnFail=false:
            ESH_Action_DemShutdown: BswMActionListItemIndex=0, BswMActionListItemRef=BswMModeControl/ESH_Action_DemShutdown
            ESH_Action_DemNotInitialized: BswMActionListItemIndex=1, BswMActionListItemRef=BswMModeControl/ESH_Action_DemNotInitialized
            ESH_Action_OnEnterPrepShutdown: BswMActionListItemIndex=2, BswMActionListItemRef=BswMModeControl/ESH_Action_OnEnterPrepShutdown
            ESH_Action_SwitchShutdown: BswMActionListItemIndex=3, BswMActionListItemRef=BswMModeControl/ESH_Action_SwitchShutdown
            ESH_Action_ESH_PrepShutdown: BswMActionListItemIndex=4, BswMActionListItemRef=BswMModeControl/ESH_Action_ESH_PrepShutdown
        ESH_Action_DemShutdown (BswMAction)
          BswMAvailableActions
            BswMUserCallout: BswMUserCalloutFunction=Dem_Shutdown(), BswMCreateCallout=false, BswMUserIncludeFile=Dem.h
        ESH_Action_DemNotInitialized (BswMAction)
          BswMAvailableActions
            BswMGenericModeSwitch: BswMGenericRequestRef=ESH_DemInitStatus, BswMGenericRequestModeRef=DEM_NOT_INITIALIZED
        3 x BswMActionList, all with BswMActionListExecution=BSWM_CONDITION:
          ESH_AL_ESH_PostRunToPrepCheck
            ESH_PostRunToPrepNested (BswMActionListItem): BswMAbortOnFail=false, BswMActionListItemIndex=0, BswMActionListItemRef=BswMArbitration/ESH_PostRunToPrepNested
          ESH_AL_PostRunToRun
            6 x BswMActionListItem, all with BswMAbortOnFail=false:
              ESH_Action_ComMAllow_CN_FDCAN2_28a8fc44: BswMActionListItemIndex=0, BswMActionListItemRef=BswMModeControl/ESH_Action_ComMAllow_CN_FDCAN2_28a8fc44
              ESH_Action_ComMAllow_CN_FDCAN14_a902658e: BswMActionListItemIndex=1, BswMActionListItemRef=BswMModeControl/ESH_Action_ComMAllow_CN_FDCAN14_a902658e
              ESH_Action_SelfRunRequestTimer_Start: BswMActionListItemIndex=2, BswMActionListItemRef=BswMModeControl/ESH_Action_SelfRunRequestTimer_Start
              ESH_Action_OnEnterRun: BswMActionListItemIndex=3, BswMActionListItemRef=BswMModeControl/ESH_Action_OnEnterRun
              ESH_Action_SwitchRun: BswMActionListItemIndex=4, BswMActionListItemRef=BswMModeControl/ESH_Action_SwitchRun
              ESH_Action_ESH_Run: BswMActionListItemIndex=5, BswMActionListItemRef=BswMModeControl/ESH_Action_ESH_Run
          ESH_AL_ExitPostRun
            5 x BswMActionListItem, all with BswMAbortOnFail=false:
              ESH_Action_EnterExclusiveArea: BswMActionListItemIndex=0, BswMActionListItemRef=BswMModeControl/ESH_Action_EnterExclusiveArea
              ESH_Action_ComMCheckPendingRequests: BswMActionListItemIndex=1, BswMActionListItemRef=BswMModeControl/ESH_Action_ComMCheckPendingRequests
              ESH_Action_DemPostRunRequested: BswMActionListItemIndex=2, BswMActionListItemRef=BswMModeControl/ESH_Action_DemPostRunRequested
              ESH_PostRunNested: BswMActionListItemIndex=3, BswMActionListItemRef=BswMArbitration/ESH_PostRunNested
              ESH_Action_ExitExclusiveArea: BswMActionListItemIndex=4, BswMActionListItemRef=BswMModeControl/ESH_Action_ExitExclusiveArea
        ESH_Action_DemPostRunRequested (BswMAction)
          BswMAvailableActions
            BswMUserCallout:
              BswMUserCalloutFunction = ESH_Dem_PostRunRequested()
              BswMCreateCallout = true
              BswMUserIncludeFile = Dem.h
              BswMUserCode = boolean isRequested = FALSE; (void)Dem_PostRunRequested(&isRequested); /* SBSW_BSWM_FCTCALL_LOCALVAR */ if (isRequested == TRUE) { BswM_RequestMode(BSWM_GENERIC_ESH_DemPostRunRequested, BSWM_GENERICVALUE_ESH_DemPostRunRequested_TRUE); } else { BswM_RequestMode(BSWM_GENERIC_ESH_DemPostRunRequested, BSWM_GENERICVALUE_ESH_DemPostRunRequested_FALSE); }
        ESH_AL_PrepShutdownToWaitForNvM (BswMActionList): BswMActionListExecution=BSWM_CONDITION
        4 x BswMAction:
          ESH_Action_WriteAllTimer_Start
            BswMAvailableActions
              BswMTimerControl: BswMTimerAction=BSWM_TIMER_START, BswMTimerValue=0.5, BswMTimerRef=ESH_NvM_WriteAllTimer
          ESH_Action_NvMWriteAll
            BswMAvailableActions
              BswMUserCallout: BswMUserCalloutFunction=BswM_NvM_WriteAll(), BswMCreateCallout=true, BswMUserIncludeFile=NvM.h, BswMUserCode=
          ESH_Action_OnEnterWaitForNvm
            BswMAvailableActions
              BswMUserCallout: BswMUserCalloutFunction=BswM_ESH_OnEnterWaitForNvm(), BswMCreateCallout=true
          ESH_Action_ESH_WaitForNvm
            BswMAvailableActions
              BswMGenericModeSwitch: BswMGenericRequestRef=ESH_State, BswMGenericRequestModeRef=ESH_WAIT_FOR_NVM
        CC_AL_CN_FDCAN14_a902658e_Disable_DM (BswMActionList): BswMActionListExecution=BSWM_TRIGGER
          CC_DisableDM_CVADAS_oFDCAN14_Rx_885c637a (BswMActionListItem): BswMAbortOnFail=false, BswMActionListItemIndex=0, BswMActionListItemRef=BswMModeControl/CC_DisableDM_CVADAS_oFDCAN14_Rx_885c637a
        CC_DisableDM_CVADAS_oFDCAN14_Rx_885c637a (BswMAction)
          BswMAvailableActions
            BswMDeadlineMonitoringControl: BswMDisabledDMPduGroupRef=CVADAS_oFDCAN14_Rx_885c637a
        CC_AL_CN_FDCAN14_a902658e_Enable_DM (BswMActionList): BswMActionListExecution=BSWM_TRIGGER
          CC_EnableDM_CVADAS_oFDCAN14_Rx_885c637a (BswMActionListItem): BswMAbortOnFail=false, BswMActionListItemIndex=0, BswMActionListItemRef=BswMModeControl/CC_EnableDM_CVADAS_oFDCAN14_Rx_885c637a
        CC_EnableDM_CVADAS_oFDCAN14_Rx_885c637a (BswMAction)
          BswMAvailableActions
            BswMDeadlineMonitoringControl: BswMEnabledDMPduGroupRef=CVADAS_oFDCAN14_Rx_885c637a
        CC_AL_CN_FDCAN14_a902658e_TX_Disable (BswMActionList): BswMActionListExecution=BSWM_TRIGGER
          CC_DisablePDUGroup_CVADAS_oFDCAN14_Tx_de06c4fc (BswMActionListItem): BswMAbortOnFail=false, BswMActionListItemIndex=0, BswMActionListItemRef=BswMModeControl/CC_DisablePDUGroup_CVADAS_oFDCAN14_Tx_de06c4fc
        CC_DisablePDUGroup_CVADAS_oFDCAN14_Tx_de06c4fc (BswMAction)
          BswMAvailableActions
            BswMPduGroupSwitch: BswMPduGroupSwitchReinit=false, BswMDisabledPduGroupRef=CVADAS_oFDCAN14_Tx_de06c4fc
        CC_AL_CN_FDCAN14_a902658e_TX_EnableNoinit (BswMActionList): BswMActionListExecution=BSWM_TRIGGER
          CC_EnablePDUGroup_CVADAS_oFDCAN14_Tx_de06c4fc (BswMActionListItem): BswMAbortOnFail=false, BswMActionListItemIndex=0, BswMActionListItemRef=BswMModeControl/CC_EnablePDUGroup_CVADAS_oFDCAN14_Tx_de06c4fc
        CC_EnablePDUGroup_CVADAS_oFDCAN14_Tx_de06c4fc (BswMAction)
          BswMAvailableActions
            BswMPduGroupSwitch: BswMPduGroupSwitchReinit=false, BswMEnabledPduGroupRef=CVADAS_oFDCAN14_Tx_de06c4fc
        CC_AL_CN_FDCAN14_a902658e_RX_Disable (BswMActionList): BswMActionListExecution=BSWM_TRIGGER
          CC_DisablePDUGroup_CVADAS_oFDCAN14_Rx_885c637a (BswMActionListItem): BswMAbortOnFail=false, BswMActionListItemIndex=0, BswMActionListItemRef=BswMModeControl/CC_DisablePDUGroup_CVADAS_oFDCAN14_Rx_885c637a
        CC_DisablePDUGroup_CVADAS_oFDCAN14_Rx_885c637a (BswMAction)
          BswMAvailableActions
            BswMPduGroupSwitch: BswMPduGroupSwitchReinit=false, BswMDisabledPduGroupRef=CVADAS_oFDCAN14_Rx_885c637a
        CC_AL_CN_FDCAN14_a902658e_RX_EnableNoinit (BswMActionList): BswMActionListExecution=BSWM_TRIGGER
          CC_EnablePDUGroup_CVADAS_oFDCAN14_Rx_885c637a (BswMActionListItem): BswMAbortOnFail=false, BswMActionListItemIndex=0, BswMActionListItemRef=BswMModeControl/CC_EnablePDUGroup_CVADAS_oFDCAN14_Rx_885c637a
        CC_EnablePDUGroup_CVADAS_oFDCAN14_Rx_885c637a (BswMAction)
          BswMAvailableActions
            BswMPduGroupSwitch: BswMPduGroupSwitchReinit=false, BswMEnabledPduGroupRef=CVADAS_oFDCAN14_Rx_885c637a
        CC_AL_CN_FDCAN2_28a8fc44_Disable_DM (BswMActionList): BswMActionListExecution=BSWM_TRIGGER
          CC_DisableDM_CVADAS_oFDCAN2_Rx_6371d032 (BswMActionListItem): BswMAbortOnFail=false, BswMActionListItemIndex=0, BswMActionListItemRef=BswMModeControl/CC_DisableDM_CVADAS_oFDCAN2_Rx_6371d032
        CC_DisableDM_CVADAS_oFDCAN2_Rx_6371d032 (BswMAction)
          BswMAvailableActions
            BswMDeadlineMonitoringControl: BswMDisabledDMPduGroupRef=CVADAS_oFDCAN2_Rx_6371d032
        CC_AL_CN_FDCAN2_28a8fc44_Enable_DM (BswMActionList): BswMActionListExecution=BSWM_TRIGGER
          CC_EnableDM_CVADAS_oFDCAN2_Rx_6371d032 (BswMActionListItem): BswMAbortOnFail=false, BswMActionListItemIndex=0, BswMActionListItemRef=BswMModeControl/CC_EnableDM_CVADAS_oFDCAN2_Rx_6371d032
        CC_EnableDM_CVADAS_oFDCAN2_Rx_6371d032 (BswMAction)
          BswMAvailableActions
            BswMDeadlineMonitoringControl: BswMEnabledDMPduGroupRef=CVADAS_oFDCAN2_Rx_6371d032
        CC_AL_CN_FDCAN2_28a8fc44_RX_Disable (BswMActionList): BswMActionListExecution=BSWM_TRIGGER
          CC_DisablePDUGroup_CVADAS_oFDCAN2_Rx_6371d032 (BswMActionListItem): BswMAbortOnFail=false, BswMActionListItemIndex=0, BswMActionListItemRef=BswMModeControl/CC_DisablePDUGroup_CVADAS_oFDCAN2_Rx_6371d032
        CC_DisablePDUGroup_CVADAS_oFDCAN2_Rx_6371d032 (BswMAction)
          BswMAvailableActions
            BswMPduGroupSwitch: BswMPduGroupSwitchReinit=false, BswMDisabledPduGroupRef=CVADAS_oFDCAN2_Rx_6371d032
        CC_EnablePDUGroup_CVADAS_oFDCAN2_Rx_6371d032 (BswMAction)
          BswMAvailableActions
            BswMPduGroupSwitch: BswMPduGroupSwitchReinit=true, BswMEnabledPduGroupRef=CVADAS_oFDCAN2_Rx_6371d032
        CC_AL_CN_FDCAN2_28a8fc44_TX_Disable (BswMActionList): BswMActionListExecution=BSWM_TRIGGER
          CC_DisablePDUGroup_CVADAS_oFDCAN2_Tx_352b77b4 (BswMActionListItem): BswMAbortOnFail=false, BswMActionListItemIndex=0, BswMActionListItemRef=BswMModeControl/CC_DisablePDUGroup_CVADAS_oFDCAN2_Tx_352b77b4
        CC_DisablePDUGroup_CVADAS_oFDCAN2_Tx_352b77b4 (BswMAction)
          BswMAvailableActions
            BswMPduGroupSwitch: BswMPduGroupSwitchReinit=false, BswMDisabledPduGroupRef=CVADAS_oFDCAN2_Tx_352b77b4
        CC_AL_CN_FDCAN2_28a8fc44_TX_EnableNoinit (BswMActionList): BswMActionListExecution=BSWM_TRIGGER
          CC_EnablePDUGroup_Noinit_CVADAS_oFDCAN2_Tx_352b77b4 (BswMActionListItem): BswMAbortOnFail=false, BswMActionListItemIndex=0, BswMActionListItemRef=BswMModeControl/CC_EnablePDUGroup_Noinit_CVADAS_oFDCAN2_Tx_352b77b4
        CC_EnablePDUGroup_CVADAS_oFDCAN2_Tx_352b77b4 (BswMAction)
          BswMAvailableActions
            BswMPduGroupSwitch: BswMPduGroupSwitchReinit=true, BswMEnabledPduGroupRef=CVADAS_oFDCAN2_Tx_352b77b4
        CC_AL_CN_FDCAN2_28a8fc44_NmEnable (BswMActionList): BswMActionListExecution=BSWM_TRIGGER
          CC_NmComControl_CN_FDCAN2_28a8fc44_BSWM_NM_ENABLE (BswMActionListItem): BswMAbortOnFail=false, BswMActionListItemIndex=0, BswMActionListItemRef=BswMModeControl/CC_NmComControl_CN_FDCAN2_28a8fc44_BSWM_NM_ENABLE
        CC_NmComControl_CN_FDCAN2_28a8fc44_BSWM_NM_ENABLE (BswMAction)
          BswMAvailableActions
            BswMNMControl: BswMNMAction=BSWM_NM_ENABLE, BswMComMNetworkHandleRef=CN_FDCAN2_28a8fc44
        CC_AL_CN_FDCAN2_28a8fc44_NmDisable (BswMActionList): BswMActionListExecution=BSWM_TRIGGER
          CC_NmComControl_CN_FDCAN2_28a8fc44_BSWM_NM_DISABLE (BswMActionListItem): BswMAbortOnFail=false, BswMActionListItemIndex=0, BswMActionListItemRef=BswMModeControl/CC_NmComControl_CN_FDCAN2_28a8fc44_BSWM_NM_DISABLE
        CC_NmComControl_CN_FDCAN2_28a8fc44_BSWM_NM_DISABLE (BswMAction)
          BswMAvailableActions
            BswMNMControl: BswMNMAction=BSWM_NM_DISABLE, BswMComMNetworkHandleRef=CN_FDCAN2_28a8fc44
        CC_AL_CN_FDCAN2_28a8fc44_BUSOFF_SILENT (BswMActionList): BswMActionListExecution=BSWM_TRIGGER
          CC_GenericSwitch_Generic_BusOff_CN_FDCAN2_28a8fc44_BUSOFF_SILENT (BswMActionListItem):
            BswMAbortOnFail = false
            BswMActionListItemIndex = 0
            BswMActionListItemRef = BswMModeControl/CC_GenericSwitch_Generic_BusOff_CN_FDCAN2_28a8fc44_BUSOFF_SILENT
          CC_NmComControl_CN_FDCAN2_28a8fc44_BSWM_NM_DISABLE (BswMActionListItem): BswMAbortOnFail=false, BswMActionListItemIndex=1, BswMActionListItemRef=BswMModeControl/CC_NmComControl_CN_FDCAN2_28a8fc44_BSWM_NM_DISABLE
        CC_GenericSwitch_Generic_BusOff_CN_FDCAN2_28a8fc44_BUSOFF_SILENT (BswMAction)
          BswMAvailableActions
            BswMGenericModeSwitch: BswMGenericRequestRef=CC_Generic_BusOff_CN_FDCAN2_28a8fc44, BswMGenericRequestModeRef=BUSOFF_SILENT
        CC_AL_CN_FDCAN2_28a8fc44_NO_COM (BswMActionList): BswMActionListExecution=BSWM_TRIGGER
          CC_GenericSwitch_Generic_BusOff_CN_FDCAN2_28a8fc44_NO_COM (BswMActionListItem):
            BswMAbortOnFail = false
            BswMActionListItemIndex = 0
            BswMActionListItemRef = BswMModeControl/CC_GenericSwitch_Generic_BusOff_CN_FDCAN2_28a8fc44_NO_COM
        CC_GenericSwitch_Generic_BusOff_CN_FDCAN2_28a8fc44_NO_COM (BswMAction)
          BswMAvailableActions
            BswMGenericModeSwitch: BswMGenericRequestRef=CC_Generic_BusOff_CN_FDCAN2_28a8fc44, BswMGenericRequestModeRef=NO_COM
        CC_EnablePDUGroup_Noinit_CVADAS_oFDCAN2_Tx_352b77b4 (BswMAction)
          BswMAvailableActions
            BswMPduGroupSwitch: BswMPduGroupSwitchReinit=false, BswMEnabledPduGroupRef=CVADAS_oFDCAN2_Tx_352b77b4
        CC_AL_CN_FDCAN2_28a8fc44_RX_EnableReinit (BswMActionList): BswMActionListExecution=BSWM_TRIGGER
          CC_EnablePDUGroup_CVADAS_oFDCAN2_Rx_6371d032 (BswMActionListItem): BswMAbortOnFail=false, BswMActionListItemIndex=0, BswMActionListItemRef=BswMModeControl/CC_EnablePDUGroup_CVADAS_oFDCAN2_Rx_6371d032
        CC_AL_CN_FDCAN2_28a8fc44_TX_EnableReinit (BswMActionList): BswMActionListExecution=BSWM_TRIGGER
          CC_EnablePDUGroup_CVADAS_oFDCAN2_Tx_352b77b4 (BswMActionListItem): BswMAbortOnFail=false, BswMActionListItemIndex=0, BswMActionListItemRef=BswMModeControl/CC_EnablePDUGroup_CVADAS_oFDCAN2_Tx_352b77b4
        Action_RTE_SWITCH_ESH_ModeSwitch_SHUTDOWN (BswMAction)
          BswMAvailableActions
            BswMRteSwitch: BswMSwitchedMode=SHUTDOWN, BswMRteSwitchPortRef=ESH_ModeSwitch
        BswMSwitchPort_BswmToSysNmIndication (BswMSwitchPort): BswMModeSwitchInterfaceRef=IF_NM_State
        8 x BswMActionList, all with BswMActionListExecution=BSWM_TRIGGER:
          AL_CheckNMPendingRequest
            ESH_Action_ComMCheckPendingRequests_NM (BswMActionListItem): BswMAbortOnFail=false, BswMActionListItemIndex=0, BswMActionListItemRef=BswMModeControl/ESH_Action_ComMCheckPendingRequests_NM
          AL_NMIndicationNormal
            Action_RTE_SWITCH_BswMSwitchPort_BswmToSysNmIndication_NM_STATE_NORMAL (BswMActionListItem):
              BswMAbortOnFail = false
              BswMActionListItemIndex = 0
              BswMActionListItemRef = BswMModeControl/Action_RTE_SWITCH_BswMSwitchPort_BswmToSysNmIndication_NM_STATE_NORMAL
            Bsw_SetNewDemOperationCycleState (BswMActionListItem): BswMAbortOnFail=false, BswMActionListItemIndex=1, BswMActionListItemRef=BswMModeControl/Bsw_SetNewDemOperationCycleState
          AL_NMIndicationPrepareSleep
            Action_RTE_SWITCH_BswMSwitchPort_BswmToSysNmIndication_NM_STATE_PREPARE_SLEEP (BswMActionListItem):
              BswMAbortOnFail = false
              BswMActionListItemIndex = 0
              BswMActionListItemRef = BswMModeControl/Action_RTE_SWITCH_BswMSwitchPort_BswmToSysNmIndication_NM_STATE_PREPARE_SLEEP
          AL_NMIndicationReadySleep
            Action_RTE_SWITCH_BswMSwitchPort_BswmToSysNmIndication_NM_STATE_READY_SLEEP (BswMActionListItem):
              BswMAbortOnFail = false
              BswMActionListItemIndex = 0
              BswMActionListItemRef = BswMModeControl/Action_RTE_SWITCH_BswMSwitchPort_BswmToSysNmIndication_NM_STATE_READY_SLEEP
          AL_NMIndicationRepeat
            Action_RTE_SWITCH_BswMSwitchPort_BswmToSysNmIndication_NM_STATE_REPEAT (BswMActionListItem):
              BswMAbortOnFail = false
              BswMActionListItemIndex = 0
              BswMActionListItemRef = BswMModeControl/Action_RTE_SWITCH_BswMSwitchPort_BswmToSysNmIndication_NM_STATE_REPEAT
          AL_NMIndicationUninit
            Action_RTE_SWITCH_BswMSwitchPort_BswmToSysNmIndication_NM_UINIT (BswMActionListItem):
              BswMAbortOnFail = false
              BswMActionListItemIndex = 0
              BswMActionListItemRef = BswMModeControl/Action_RTE_SWITCH_BswMSwitchPort_BswmToSysNmIndication_NM_UINIT
          AL_Run_HardReset
            3 x BswMActionListItem, all with BswMAbortOnFail=false:
              ESH_Action_EcuMGoToSelectedShutdownTarget: BswMActionListItemIndex=2, BswMActionListItemRef=BswMModeControl/ESH_Action_EcuMGoToSelectedShutdownTarget
              EcuMSelectShutdownCauseCallout: BswMActionListItemIndex=1, BswMActionListItemRef=BswMModeControl/EcuMSelectShutdownCauseCallout
              Action_SELECT_RESET_MODE_ECUM_RESET_MCU: BswMActionListItemIndex=0, BswMActionListItemRef=BswMModeControl/Action_SELECT_RESET_MODE_ECUM_RESET_MCU
          AL_Run_JumpToBOOT
            4 x BswMActionListItem, all with BswMAbortOnFail=false:
              ESH_Action_EcuMGoToSelectedShutdownTarget: BswMActionListItemIndex=3, BswMActionListItemRef=BswMModeControl/ESH_Action_EcuMGoToSelectedShutdownTarget
              EcuMSelectShutdownCauseCallout: BswMActionListItemIndex=2, BswMActionListItemRef=BswMModeControl/EcuMSelectShutdownCauseCallout
              Action_SELECT_RESET_MODE_ECUM_RESET_BOOT: BswMActionListItemIndex=1, BswMActionListItemRef=BswMModeControl/Action_SELECT_RESET_MODE_ECUM_RESET_BOOT
              Action_DisableInterrupts: BswMActionListItemIndex=0, BswMActionListItemRef=BswMModeControl/Action_DisableInterrupts
        20 x BswMAction:
          Action_DisableInterrupts
            BswMAvailableActions
              BswMUserCallout:
                BswMUserCalloutFunction = BswM_AL_ResetProgrammableInterrupts()
                BswMCreateCallout = true
                BswMUserCode = Os_DisableInterruptSource(ADC0); Os_DisableInterruptSource(ADC1); Os_DisableInterruptSource(Can_30_McanIsr_0); Os_DisableInterruptSource(Can_30_McanIsr_1);
          Action_RTE_SWITCH_BswMSwitchPort_BswmToSysNmIndication_NM_STATE_NORMAL
            BswMAvailableActions
              BswMRteSwitch: BswMSwitchedMode=NM_STATE_NORMAL, BswMRteSwitchPortRef=BswMSwitchPort_BswmToSysNmIndication
          Action_RTE_SWITCH_BswMSwitchPort_BswmToSysNmIndication_NM_STATE_PREPARE_SLEEP
            BswMAvailableActions
              BswMRteSwitch: BswMSwitchedMode=NM_STATE_PREPARE_SLEEP, BswMRteSwitchPortRef=BswMSwitchPort_BswmToSysNmIndication
          Action_RTE_SWITCH_BswMSwitchPort_BswmToSysNmIndication_NM_STATE_READY_SLEEP
            BswMAvailableActions
              BswMRteSwitch: BswMSwitchedMode=NM_STATE_READY_SLEEP, BswMRteSwitchPortRef=BswMSwitchPort_BswmToSysNmIndication
          Action_RTE_SWITCH_BswMSwitchPort_BswmToSysNmIndication_NM_STATE_REPEAT
            BswMAvailableActions
              BswMRteSwitch: BswMSwitchedMode=NM_STATE_REPEAT, BswMRteSwitchPortRef=BswMSwitchPort_BswmToSysNmIndication
          Action_RTE_SWITCH_BswMSwitchPort_BswmToSysNmIndication_NM_UINIT
            BswMAvailableActions
              BswMRteSwitch: BswMSwitchedMode=NM_UINIT, BswMRteSwitchPortRef=BswMSwitchPort_BswmToSysNmIndication
          Action_SELECT_RESET_MODE_ECUM_RESET_BOOT
            BswMAvailableActions
              BswMEcuMSelectShutdownTarget: BswMEcuMShutdownTarget=RESET, BswMEcuMResetModeRef=ECUM_RESET_BOOT
          Action_SELECT_RESET_MODE_ECUM_RESET_MCU
            BswMAvailableActions
              BswMEcuMSelectShutdownTarget: BswMEcuMShutdownTarget=RESET, BswMEcuMResetModeRef=ECUM_RESET_MCU
          ESH_Action_ComMCheckPendingRequests_NM
            BswMAvailableActions
              BswMUserCallout:
                BswMUserCalloutFunction = ESH_ComM_CheckPendingRequests()
                BswMCreateCallout = true
                BswMUserCode = ComM_StateType CN_FDCAN2_28a8fc44 = COMM_NO_COM_NO_PENDING_REQUEST; (void)ComM_GetState(ComMConf_ComMChannel_CN_FDCAN2_28a8fc44, &CN_FDCAN2_28a8fc44); /* SBSW_BSWM_FCTCALL_LOCALVAR */ if(CN_FDCAN2_28a8fc44 != COMM_NO_COM_NO_PENDING_REQUEST) { BswM_RequestMode(BSWM_GENERIC_ESH_ComMPendingRequests, BSWM_GENERICVALUE_ESH_ComMPendingRequests_ESH_COMM_PENDING_REQUEST); } else { BswM_RequestMode(BSWM_GENERIC_ESH_ComMPendingRequests, BSWM_GENERICVALUE_ESH_ComMPendingRequests_ESH_COMM_NO_REQUEST); }
          EcuMSelectShutdownCauseCallout
            BswMAvailableActions
              BswMUserCallout: BswMUserCalloutFunction=EcuM_SelectShutdownCause(EcuMConf_EcuMShutdownCause_ECUM_CAUSE_DCM), BswMCreateCallout=false, BswMUserIncludeFile=EcuM.h
          Action_BSWM_FULL_COM_CN_FDCAN2_3de30c40
            BswMAvailableActions
              BswMComMModeSwitch: BswMComMRequestedMode=BSWM_FULL_COM, BswMComMUserRef=CN_FDCAN2_3de30c40
          INIT_Action_CanXcp_Init
            BswMAvailableActions
              BswMUserCallout: BswMUserCalloutFunction=CanXcp_Init(NULL_PTR), BswMCreateCallout=false, BswMUserIncludeFile=CanXcp.h
          INIT_Action_Xcp_Init
            BswMAvailableActions
              BswMUserCallout: BswMUserCalloutFunction=Xcp_Init(), BswMCreateCallout=false, BswMUserIncludeFile=Xcp.h
          INIT_Action_CryIf_Init
            BswMAvailableActions
              BswMUserCallout: BswMUserCalloutFunction=CryIf_Init(), BswMCreateCallout=false, BswMUserIncludeFile=CryIf.h
          INIT_Action_Csm_Init
            BswMAvailableActions
              BswMUserCallout: BswMUserCalloutFunction=Csm_Init(), BswMCreateCallout=false, BswMUserIncludeFile=Csm.h
          INIT_Action_vDiagSecAcc_Init
            BswMAvailableActions
              BswMUserCallout: BswMUserCalloutFunction=vDiagSecAcc_Init(), BswMCreateCallout=false, BswMUserIncludeFile=vDiagSecAcc.h
          INIT_Action_Wdg_Init
            BswMAvailableActions
              BswMUserCallout: BswMUserCalloutFunction=Wdg_Init(), BswMCreateCallout=false, BswMUserIncludeFile=Wdg.h
          INIT_Action_WdgM_Init
            BswMAvailableActions
              BswMUserCallout: BswMUserCalloutFunction=WdgM_Init(&WdgMConfig_Mode0_core0), BswMCreateCallout=false, BswMUserIncludeFile=WdgM.h
          INIT_Action_Crypto_30_vHsm_Init
            BswMAvailableActions
              BswMUserCallout: BswMUserCalloutFunction=Crypto_30_vHsm_Init(), BswMCreateCallout=false, BswMUserIncludeFile=Crypto_30_vHsm.h
          INIT_Action_vDam_Init
            BswMAvailableActions
              BswMUserCallout: BswMUserCalloutFunction=vDam_Init(vDam_Config_Ptr), BswMCreateCallout=false, BswMUserIncludeFile=vDam.h
        SSM_BSW_SystemState (BswMSwitchPort): BswMModeSwitchInterfaceRef=IF_SSM_SystemState
        BSW_Shutdown (BswMAction)
          BswMAvailableActions
            BswMUserCallout:
              BswMUserCalloutFunction = BSW_Shutdown()
              BswMCreateCallout = true
              BswMUserCode = /* Disable Ext Watchdog */ //disable_pmicExtWdg(); /*Stop Dem operation cycle */ Dem_SetOperationCycleState(DemConf_DemOperationCycle_IgnitionCycle, DEM_CYCLE_STATE_END); /* Shutdown DEM */ Dem_Shutdown(); /* Clear Wakeup Events */ EcuM_ClearValidatedWakeupEvent(ECUM_WKSOURCE_ALL_SOURCES); /* Stop RTE & Scheduler*/ Rte_Stop(); SchM_Deinit(); /*shutdown other cores */ /* Set NVM Write */ /* Write NVM */ /* Shutdown Target will be performed when NVM write all is completed or when timeout happened*/ /* Switch OFF the ECU */ (void)ActivateTask(ShutdownTask); TerminateTask();
              BswMUserIncludeFile = Rte_Type.h
        ADAS_EcuM_SetTargetToOff (BswMAction)
          BswMAvailableActions
            BswMEcuMSelectShutdownTarget: BswMEcuMShutdownTarget=OFF
        AL_SSM_BSW_Shutdown_execute (BswMActionList): BswMActionListExecution=BSWM_TRIGGER
          ADAS_EcuM_SetTargetToOff (BswMActionListItem): BswMAbortOnFail=false, BswMActionListItemIndex=0, BswMActionListItemRef=BswMModeControl/ADAS_EcuM_SetTargetToOff
          BSW_Shutdown (BswMActionListItem): BswMAbortOnFail=false, BswMActionListItemIndex=1, BswMActionListItemRef=BswMModeControl/BSW_Shutdown
        BSW_SSM_Master_SetRestartRequest (BswMAction)
          BswMAvailableActions
            BswMUserCallout:
              BswMUserCalloutFunction = BSW_SSM_Master_SetRestartRequest()
              BswMCreateCallout = true
              BswMUserCode = SSM_Master_SetRestartRequest();
              BswMUserIncludeFile = SSM_BSW_Interface.h
        BSW_SSM_Master_SetShutDownRequest (BswMAction)
          BswMAvailableActions
            BswMUserCallout:
              BswMUserCalloutFunction = BSW_SSM_Master_SetShutDownRequest()
              BswMCreateCallout = true
              BswMUserCode = SSM_Master_SetShutDownRequest();
              BswMUserIncludeFile = SSM_BSW_Interface.h
        AL_ADAS_EcuM_stateSwitch (BswMActionList): BswMActionListExecution=BSWM_TRIGGER
          BSW_SSM_Master_SetShutDownRequest (BswMActionListItem): BswMAbortOnFail=false, BswMActionListItemIndex=0, BswMActionListItemRef=BswMModeControl/BSW_SSM_Master_SetShutDownRequest
        AL_ADAS_ECUReset (BswMActionList): BswMActionListExecution=BSWM_TRIGGER
          ADAS_EcuM_SetTargetToReset (BswMActionListItem): BswMAbortOnFail=false, BswMActionListItemIndex=0, BswMActionListItemRef=BswMModeControl/ADAS_EcuM_SetTargetToReset
        3 x BswMAction:
          ADAS_EcuM_SetTargetToReset
            BswMAvailableActions
              BswMEcuMSelectShutdownTarget: BswMEcuMShutdownTarget=RESET, BswMEcuMResetModeRef=ECUM_RESET_MCU
          INIT_Action_Crypto_30_vHsm_WaitForHsmRam
            BswMAvailableActions
              BswMUserCallout: BswMUserCalloutFunction=Crypto_30_vHsm_WaitForHsmRam(), BswMCreateCallout=false, BswMUserIncludeFile=Crypto_30_vHsm.h
          BSW_ApplDiag_SetRestartReq
            BswMAvailableActions
              BswMUserCallout:
                BswMUserCalloutFunction = BSW_AppDiag_InternalError_SysResetReq()
                BswMCreateCallout = true
                BswMUserCode = AppDiag_InternalError_SysResetReq();
                BswMUserIncludeFile = AppDiag_Services.h
        AL_SafetyGuard_SysResetReq (BswMActionList): BswMActionListExecution=BSWM_TRIGGER
          BSW_ApplDiag_SetRestartReq (BswMActionListItem): BswMAbortOnFail=false, BswMActionListItemIndex=0, BswMActionListItemRef=BswMModeControl/BSW_ApplDiag_SetRestartReq
        Bsw_SetNewDemOperationCycleState (BswMAction)
          BswMAvailableActions
            BswMUserCallout: BswMUserCalloutFunction=BswM_SetNewDemOperationCycleState(), BswMCreateCallout=true
        BswM_DTCSettingClearFlag (BswMRteModeRequestPort): BswMRteModeRequestPortInterfaceRef=SWC_DTCMgr.PRpDtcSettingClearFlagModeGrp.requestedMode
        AL_SCCalStatus (BswMActionList): BswMActionListExecution=BSWM_TRIGGER
          BSW_SSM_Master_SetShutDownRequest (BswMActionListItem): BswMAbortOnFail=false, BswMActionListItemIndex=1, BswMActionListItemRef=BswMModeControl/BSW_SSM_Master_SetShutDownRequest
          BSW_Set_SC_CAL_ResetType (BswMActionListItem): BswMAbortOnFail=false, BswMActionListItemIndex=0, BswMActionListItemRef=BswMModeControl/BSW_Set_SC_CAL_ResetType
        BSW_Set_SC_CAL_ResetType (BswMAction)
          BswMAvailableActions
            BswMUserCallout: BswMUserCalloutFunction=BSW_Set_SC_CAL_ResetType(), BswMCreateCallout=false, BswMUserIncludeFile=AppDiag_Services.h
      ESH_Mode (BswMRteModeDclGroup): BswMInitMode=STARTUP
        5 x BswMRteMode:
          STARTUP: BswMModePhysicalValue=0
          RUN: BswMModePhysicalValue=1
          POSTRUN: BswMModePhysicalValue=2
          WAKEUP: BswMModePhysicalValue=3
          SHUTDOWN: BswMModePhysicalValue=4
      ESH_RunRequest (BswMRteModeDclGroup): BswMInitMode=RELEASED
        RELEASED (BswMRteMode): BswMModePhysicalValue=0
        REQUESTED (BswMRteMode): BswMModePhysicalValue=1
      BswMDataTypeMappingSets: BswMDataTypeMappingSetRef=BswMMappingSet
      3 x BswMRteModeDclGroup:
        DtcSettingClearFlagModeGrp: BswMInitMode=DtcSettingClearFlagModeGrp/FALSE
          TRUE (BswMRteMode): BswMModePhysicalValue=1
          FALSE (BswMRteMode): BswMModePhysicalValue=0
        BswM_PreviousNMState: BswMInitMode=NM_STATE_BUS_SLEEP
          6 x BswMRteMode:
            NM_STATE_BUS_SLEEP: BswMModePhysicalValue=1
            NM_STATE_NORMAL: BswMModePhysicalValue=4
            NM_STATE_PREPARE_SLEEP: BswMModePhysicalValue=2
            NM_STATE_READY_SLEEP: BswMModePhysicalValue=3
            NM_STATE_REPEAT: BswMModePhysicalValue=5
            NM_UINIT: BswMModePhysicalValue=0
        CalDataProSCCalStatus: BswMInitMode=SC_CAL_NOT_STARTED
          SC_CAL_NOT_STARTED (BswMRteMode): BswMModePhysicalValue=0
          SC_CAL_FINISHED (BswMRteMode): BswMModePhysicalValue=1
