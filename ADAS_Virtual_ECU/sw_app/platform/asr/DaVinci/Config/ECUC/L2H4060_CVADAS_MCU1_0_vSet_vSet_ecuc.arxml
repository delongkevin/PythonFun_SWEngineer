AUTOSAR XML (schema 00048)
package /ActiveEcuC
  module config vSet: implementation-config-variant=VARIANT-PRE-COMPILE, module-description=vSet_Impl
    vSetGeneral: vSetDummyStatementKind=SelfAssignment
    vSetPlatform:
      vSetSizeOfRAMPointer = Size32Bit
      vSetSizeOfROMPointer = Size32Bit
      vSetByteOrder = LITTLE_ENDIAN
      vSetBitOrder = LSB_to_MSB
      vSetSizeOfEnum = Size32Bit
      vSetCPUType = CPU32Bit
      vSetSizeOfInt = Size32Bit
    vSetCalibration
    vSetBswInitialization
      70 x vSetInitFunction:
        vBaseEnv_Init: vSetHeader=, vSetModuleRef=vBaseEnv  # /ActiveEcuC/vBaseEnv PLAIN_TEXT Created vBaseEnv_Init by Extended Init XML Service
          vSetInitFunctionInstance: vSetInitPhase=NO_INIT
        Adc_Init: vSetHeader=Adc.h, vSetConfigType=Adc_ConfigType, vSetConfigPtrClass=ADC_PBCFG, vSetModuleRef=Adc  # /ActiveEcuC/Adc PLAIN_TEXT Created Adc_Init by Extended Init XML Service
          vSetInitFunctionInstance: vSetInitPhase=INIT_ONE, vSetConfigPtrName=NULL_PTR
        Dio_Init: vSetHeader=Dio.h, vSetModuleRef=Dio  # /Dio/Dio PLAIN_TEXT Created Dio_Init by Extended Init XML Service
          vSetInitFunctionInstance: vSetInitPhase=NO_INIT
        BswM_PreInit: vSetHeader=BswM.h, vSetConfigType=BswM_ConfigType, vSetConfigPtrClass=BSWM_INIT_DATA, vSetModuleRef=BswM  # /ActiveEcuC/BswM PLAIN_TEXT PreInit function description of BswM in UnfilteredViewInInvariantProject (UnfilteredInvariantProjectModelView) .
          vSetInitFunctionInstance: vSetInitPhase=INIT_ONE, vSetConfigPtrName=BswM_Config_Ptr
        BswM_Init: vSetHeader=BswM.h, vSetConfigType=BswM_ConfigType, vSetConfigPtrClass=BSWM_INIT_DATA, vSetModuleRef=BswM  # /ActiveEcuC/BswM PLAIN_TEXT Init function description of BswM in UnfilteredViewInInvariantProject (UnfilteredInvariantProjectModelView) .
          vSetInitFunctionInstance: vSetInitPhase=NO_INIT, vSetConfigPtrName=BswM_Config_Ptr
        BswM_InitMemory: vSetHeader=BswM.h, vSetModuleRef=BswM  # /ActiveEcuC/BswM PLAIN_TEXT InitMemory function description of BswM in UnfilteredViewInInvariantProject (UnfilteredInvariantProjectModelView) .
          vSetInitFunctionInstance: vSetInitPhase=INIT_MEMORY
        EcuM_Init: vSetHeader=EcuM.h, vSetConfigType=EcuM_PbConfigType, vSetConfigPtrClass=ECUM_INIT_DATA, vSetModuleRef=EcuM  # /ActiveEcuC/EcuM PLAIN_TEXT Init function description of EcuM in UnfilteredViewInInvariantProject (UnfilteredInvariantProjectModelView) .
          vSetInitFunctionInstance: vSetInitPhase=NO_INIT, vSetConfigPtrName=EcuM_Config_Ptr
        IoHwAb_Init: vSetHeader=IoHwAb.h, vSetModuleRef=IoHwAb  # /ActiveEcuC/IoHwAb PLAIN_TEXT Initialization of IO Hardware Abstraction Module
          vSetInitFunctionInstance: vSetInitPhase=INIT_TWO_POST_NVMREADALL
        SchM_StartTiming: vSetHeader=Rte_Main.h, vSetModuleRef=Rte  # /ActiveEcuC/Rte PLAIN_TEXT Automatically generated by BswInitFctConfigurationService.
          vSetInitFunctionInstance: vSetInitPhase=NO_INIT
        SchM_Start: vSetHeader=Rte_Main.h, vSetModuleRef=Rte  # /ActiveEcuC/Rte PLAIN_TEXT Automatically generated by BswInitFctConfigurationService.
          vSetInitFunctionInstance: vSetInitPhase=NO_INIT
        Rte_StartTiming: vSetHeader=Rte_Main.h, vSetModuleRef=Rte  # /ActiveEcuC/Rte PLAIN_TEXT Automatically generated by BswInitFctConfigurationService.
          vSetInitFunctionInstance: vSetInitPhase=NO_INIT
        Rte_InitMemory: vSetHeader=Rte_Main.h, vSetModuleRef=Rte  # /ActiveEcuC/Rte PLAIN_TEXT Automatically generated by BswInitFctConfigurationService.
          vSetInitFunctionInstance: vSetInitPhase=INIT_MEMORY
        Rte_Start: vSetHeader=Rte_Main.h, vSetModuleRef=Rte  # /ActiveEcuC/Rte PLAIN_TEXT Automatically generated by BswInitFctConfigurationService.
          vSetInitFunctionInstance: vSetInitPhase=INIT_THREE
        SchM_Init: vSetHeader=Rte_Main.h, vSetModuleRef=Rte  # /ActiveEcuC/Rte PLAIN_TEXT Automatically generated by BswInitFctConfigurationService.
          vSetInitFunctionInstance: vSetInitPhase=NO_INIT
        vLinkGen_Init: vSetHeader=vLinkGen_Lcfg.h, vSetModuleRef=vLinkGen  # /ActiveEcuC/vLinkGen PLAIN_TEXT Dummy initialization of the vLinkGen
          vSetInitFunctionInstance: vSetInitPhase=NO_INIT
        Det_Init: vSetHeader=Det.h, vSetConfigType=Det_ConfigType, vSetConfigPtrClass=DET_INIT_DATA, vSetModuleRef=Det  # /ActiveEcuC/Det PLAIN_TEXT Init function description of Det in UnfilteredViewInInvariantProject (UnfilteredInvariantProjectModelView) .
          vSetInitFunctionInstance: vSetInitPhase=INIT_ZERO, vSetConfigPtrName=Det_Config_Ptr
        Det_InitMemory: vSetHeader=Det.h, vSetModuleRef=Det  # /ActiveEcuC/Det PLAIN_TEXT InitMemory function description of Det in UnfilteredViewInInvariantProject (UnfilteredInvariantProjectModelView) .
          vSetInitFunctionInstance: vSetInitPhase=INIT_MEMORY
        I2c_Init: vSetHeader=I2c.h, vSetConfigType=I2c_ConfigType, vSetConfigPtrClass=I2C_PBCFG, vSetModuleRef=I2c  # /ActiveEcuC/I2c PLAIN_TEXT Initialization of the I2c
          vSetInitFunctionInstance: vSetInitPhase=INIT_ONE, vSetConfigPtrName=&I2c_ConfigSet[0]
        Ea_Init: vSetHeader=Ea.h, vSetModuleRef=Ea  # /ActiveEcuC/Ea PLAIN_TEXT Initialization of EEPROM Abstraction Module and its internal state machine
          vSetInitFunctionInstance: vSetInitPhase=INIT_TWO_IF
        Eep_30_XXi2c01_InitMemory: vSetHeader=Eep_30_XXi2c01.h, vSetModuleRef=Eep  # /ActiveEcuC/Eep PLAIN_TEXT Initialize memory for EEPROM driver Eep_30_XXi2c01
          vSetInitFunctionInstance: vSetInitPhase=INIT_MEMORY
        Eep_30_XXi2c01_Init: vSetHeader=Eep_30_XXi2c01.h, vSetConfigType=Eep_30_XXi2c01_ConfigType, vSetConfigPtrClass=EEP_30_XXSPI01_PBCFG, vSetModuleRef=Eep  # /ActiveEcuC/Eep PLAIN_TEXT Initialization of EEPROM driver Eep_30_XXi2c01
          vSetInitFunctionInstance: vSetInitPhase=INIT_TWO_DRV, vSetConfigPtrName=&Eep_30_XXi2c01_Runtime
        NvM_Init: vSetHeader=NvM.h, vSetModuleRef=NvM  # /ActiveEcuC/NvM PLAIN_TEXT Initialization of the NVRAM Manager, to make it ready for NvM_ReadAll being requested
          vSetInitFunctionInstance: vSetInitPhase=INIT_TWO_SYS
        vRoE_Init: vSetHeader=vRoE.h, vSetModuleRef=Cdd  # /ActiveEcuC/Cdd PLAIN_TEXT vRoE_Init function description
          vSetInitFunctionInstance: vSetInitPhase=INIT_TWO_POST_NVMREADALL
        vRoE_InitMemory: vSetHeader=vRoE.h, vSetModuleRef=Cdd  # /ActiveEcuC/Cdd PLAIN_TEXT vRoE_InitMemory function description
          vSetInitFunctionInstance: vSetInitPhase=INIT_MEMORY
        Dcm_InitMemory: vSetHeader=Dcm.h, vSetModuleRef=Dcm  # /ActiveEcuC/Dcm PLAIN_TEXT Dcm_InitMemory function description
          vSetInitFunctionInstance: vSetInitPhase=INIT_MEMORY
        Dcm_Init: vSetHeader=Dcm.h, vSetConfigType=Dcm_ConfigType, vSetConfigPtrClass=DCM_CONST, vSetModuleRef=Dcm  # /ActiveEcuC/Dcm PLAIN_TEXT Dcm_Init function description
          vSetInitFunctionInstance: vSetInitPhase=INIT_TWO_POST_NVMREADALL, vSetConfigPtrName=NULL_PTR
        Dem_Init: vSetHeader=Dem.h, vSetConfigType=Dem_ConfigType, vSetConfigPtrClass=DEM_INIT_DATA, vSetModuleRef=Dem  # /ActiveEcuC/Dem PLAIN_TEXT Init function description of Dem in UnfilteredViewInInvariantProject (UnfilteredInvariantProjectModelView) .
          vSetInitFunctionInstance: vSetInitPhase=INIT_TWO_POST_NVMREADALL, vSetConfigPtrName=Dem_Config_Ptr
        Dem_PreInit: vSetHeader=Dem.h, vSetConfigType=Dem_ConfigType, vSetConfigPtrClass=DEM_INIT_DATA, vSetModuleRef=Dem  # /ActiveEcuC/Dem PLAIN_TEXT PreInit function description of Dem in UnfilteredViewInInvariantProject (UnfilteredInvariantProjectModelView) .
          vSetInitFunctionInstance: vSetInitPhase=INIT_ZERO, vSetConfigPtrName=Dem_Config_Ptr
        Dem_InitMemory: vSetHeader=Dem.h, vSetModuleRef=Dem  # /ActiveEcuC/Dem PLAIN_TEXT InitMemory function description of Dem in UnfilteredViewInInvariantProject (UnfilteredInvariantProjectModelView) .
          vSetInitFunctionInstance: vSetInitPhase=INIT_MEMORY
        CanIf_InitMemory: vSetHeader=CanIf.h, vSetModuleRef=CanIf  # /ActiveEcuC/CanIf PLAIN_TEXT InitMemory function description of CanIf in UnfilteredViewInInvariantProject (UnfilteredInvariantProjectModelView) .
          vSetInitFunctionInstance: vSetInitPhase=INIT_MEMORY
        CanIf_Init: vSetHeader=CanIf.h, vSetConfigType=CanIf_ConfigType, vSetConfigPtrClass=CANIF_INIT_DATA, vSetModuleRef=CanIf  # /ActiveEcuC/CanIf PLAIN_TEXT Init function description of CanIf in UnfilteredViewInInvariantProject (UnfilteredInvariantProjectModelView) .
          vSetInitFunctionInstance: vSetInitPhase=INIT_TWO_IF, vSetConfigPtrName=CanIf_Config_Ptr
        CanNm_Init: vSetHeader=CanNm.h, vSetConfigType=CanNm_ConfigType, vSetConfigPtrClass=CANNM_INIT_DATA, vSetModuleRef=CanNm  # /ActiveEcuC/CanNm PLAIN_TEXT Init function description of CanNm in UnfilteredViewInInvariantProject (UnfilteredInvariantProjectModelView) .
          vSetInitFunctionInstance: vSetInitPhase=INIT_TWO_NM, vSetConfigPtrName=CanNm_Config_Ptr
        CanNm_InitMemory: vSetHeader=CanNm.h, vSetModuleRef=CanNm  # /ActiveEcuC/CanNm PLAIN_TEXT InitMemory function description of CanNm in UnfilteredViewInInvariantProject (UnfilteredInvariantProjectModelView) .
          vSetInitFunctionInstance: vSetInitPhase=INIT_MEMORY
        CanSM_InitMemory: vSetHeader=CanSM_EcuM.h, vSetModuleRef=CanSM  # /ActiveEcuC/CanSM PLAIN_TEXT InitMemory function description of CanSM in UnfilteredViewInInvariantProject (UnfilteredInvariantProjectModelView) .
          vSetInitFunctionInstance: vSetInitPhase=INIT_MEMORY
        CanSM_Init: vSetHeader=CanSM_EcuM.h, vSetConfigType=CanSM_ConfigType, vSetConfigPtrClass=CANSM_INIT_DATA, vSetModuleRef=CanSM  # /ActiveEcuC/CanSM PLAIN_TEXT Init function description of CanSM in UnfilteredViewInInvariantProject (UnfilteredInvariantProjectModelView) .
          vSetInitFunctionInstance: vSetInitPhase=INIT_TWO_SM, vSetConfigPtrName=CanSM_Config_Ptr
        CanTp_InitMemory: vSetHeader=CanTp.h, vSetModuleRef=CanTp  # /ActiveEcuC/CanTp PLAIN_TEXT InitMemory function description of CanTp in UnfilteredViewInInvariantProject (UnfilteredInvariantProjectModelView) .
          vSetInitFunctionInstance: vSetInitPhase=INIT_MEMORY
        CanTp_Init: vSetHeader=CanTp.h, vSetConfigType=CanTp_ConfigType, vSetConfigPtrClass=CANTP_INIT_DATA, vSetModuleRef=CanTp  # /ActiveEcuC/CanTp PLAIN_TEXT Init function description of CanTp in UnfilteredViewInInvariantProject (UnfilteredInvariantProjectModelView) .
          vSetInitFunctionInstance: vSetInitPhase=INIT_TWO_TP, vSetConfigPtrName=CanTp_Config_Ptr
        Can_30_Mcan_InitMemory: vSetHeader=Can_30_Mcan.h, vSetModuleRef=Can  # /ActiveEcuC/Can PLAIN_TEXT InitMemory function description of Can_30_Mcan in UnfilteredViewInInvariantProject (UnfilteredInvariantProjectModelView) .
          vSetInitFunctionInstance: vSetInitPhase=INIT_MEMORY
        Can_30_Mcan_Init: vSetHeader=Can_30_Mcan.h, vSetConfigType=Can_30_Mcan_ConfigType, vSetConfigPtrClass=CAN_30_MCAN_INIT_DATA, vSetModuleRef=Can  # /ActiveEcuC/Can PLAIN_TEXT Init function description of Can_30_Mcan in UnfilteredViewInInvariantProject (UnfilteredInvariantProjectModelView) .
          vSetInitFunctionInstance: vSetInitPhase=INIT_TWO_DRV, vSetConfigPtrName=Can_30_Mcan_Config_Ptr
        ComM_InitMemory: vSetHeader=ComM.h, vSetModuleRef=ComM  # /ActiveEcuC/ComM PLAIN_TEXT InitMemory function description of ComM in UnfilteredViewInInvariantProject (UnfilteredInvariantProjectModelView) .
          vSetInitFunctionInstance: vSetInitPhase=INIT_MEMORY
        ComM_Init: vSetHeader=ComM.h, vSetConfigType=ComM_ConfigType, vSetConfigPtrClass=COMM_INIT_DATA, vSetModuleRef=ComM  # /ActiveEcuC/ComM PLAIN_TEXT Init function description of ComM in UnfilteredViewInInvariantProject (UnfilteredInvariantProjectModelView) .
          vSetInitFunctionInstance: vSetInitPhase=INIT_TWO_POST_NVMREADALL, vSetConfigPtrName=ComM_Config_Ptr
        ComM_PreInit: vSetHeader=ComM.h, vSetConfigType=ComM_ConfigType, vSetConfigPtrClass=COMM_INIT_DATA, vSetModuleRef=ComM  # /ActiveEcuC/ComM PLAIN_TEXT PreInit function description of ComM in UnfilteredViewInInvariantProject (UnfilteredInvariantProjectModelView) .
          vSetInitFunctionInstance: vSetInitPhase=INIT_ONE, vSetConfigPtrName=ComM_Config_Ptr
        ComM_PostInit: vSetHeader=ComM.h, vSetModuleRef=ComM  # /ActiveEcuC/ComM PLAIN_TEXT Post-Initialization of the ComM and its internal state machine
          vSetInitFunctionInstance: vSetInitPhase=INIT_THREE
        Com_InitMemory: vSetHeader=Com.h, vSetModuleRef=Com  # /ActiveEcuC/Com PLAIN_TEXT InitMemory function description of Com in UnfilteredViewInInvariantProject (UnfilteredInvariantProjectModelView) .
          vSetInitFunctionInstance: vSetInitPhase=INIT_MEMORY
        Com_Init: vSetHeader=Com.h, vSetConfigType=Com_ConfigType, vSetConfigPtrClass=COM_INIT_DATA, vSetModuleRef=Com  # /ActiveEcuC/Com PLAIN_TEXT Init function description of Com in UnfilteredViewInInvariantProject (UnfilteredInvariantProjectModelView) .
          vSetInitFunctionInstance: vSetInitPhase=INIT_TWO_COM, vSetConfigPtrName=Com_Config_Ptr
        Nm_PreInit: vSetHeader=Nm.h, vSetConfigType=Nm_ConfigType, vSetConfigPtrClass=NM_INIT_DATA, vSetModuleRef=Nm  # /ActiveEcuC/Nm PLAIN_TEXT PreInit function description of Nm in UnfilteredViewInInvariantProject (UnfilteredInvariantProjectModelView) .
          vSetInitFunctionInstance: vSetInitPhase=INIT_ONE, vSetConfigPtrName=Nm_Config_Ptr
        Nm_Init: vSetHeader=Nm.h, vSetConfigType=Nm_ConfigType, vSetConfigPtrClass=NM_INIT_DATA, vSetModuleRef=Nm  # /ActiveEcuC/Nm PLAIN_TEXT Init function description of Nm in UnfilteredViewInInvariantProject (UnfilteredInvariantProjectModelView) .
          vSetInitFunctionInstance: vSetInitPhase=INIT_TWO_NM, vSetConfigPtrName=Nm_Config_Ptr
        Nm_InitMemory: vSetHeader=Nm.h, vSetModuleRef=Nm  # /ActiveEcuC/Nm PLAIN_TEXT InitMemory function description of Nm in UnfilteredViewInInvariantProject (UnfilteredInvariantProjectModelView) .
          vSetInitFunctionInstance: vSetInitPhase=INIT_MEMORY
        Nm_PostInit: vSetHeader=Nm.h, vSetModuleRef=Nm  # /ActiveEcuC/Nm PLAIN_TEXT Post-Initialization of the Network Management and its internal state machine
          vSetInitFunctionInstance: vSetInitPhase=INIT_THREE
        PduR_PreInit: vSetHeader=PduR.h, vSetConfigType=PduR_PBConfigType, vSetConfigPtrClass=PDUR_INIT_DATA, vSetModuleRef=PduR  # /ActiveEcuC/PduR PLAIN_TEXT PreInit function description of PduR in UnfilteredViewInInvariantProject (UnfilteredInvariantProjectModelView) .
          vSetInitFunctionInstance: vSetInitPhase=INIT_ONE, vSetConfigPtrName=PduR_Config_Ptr
        PduR_InitMemory: vSetHeader=PduR.h, vSetModuleRef=PduR  # /ActiveEcuC/PduR PLAIN_TEXT InitMemory function description of PduR in UnfilteredViewInInvariantProject (UnfilteredInvariantProjectModelView) .
          vSetInitFunctionInstance: vSetInitPhase=INIT_MEMORY
        PduR_Init: vSetHeader=PduR.h, vSetConfigType=PduR_PBConfigType, vSetConfigPtrClass=PDUR_INIT_DATA, vSetModuleRef=PduR  # /ActiveEcuC/PduR PLAIN_TEXT Init function description of PduR in UnfilteredViewInInvariantProject (UnfilteredInvariantProjectModelView) .
          vSetInitFunctionInstance: vSetInitPhase=INIT_TWO_COM, vSetConfigPtrName=PduR_Config_Ptr
        CanTrcv_30_Tja1043_InitMemory: vSetHeader=CanTrcv_30_Tja1043.h, vSetModuleRef=CanTrcv  # /ActiveEcuC/CanTrcv PLAIN_TEXT InitMemory function description of CanTrcv_30_Tja1043 in UnfilteredViewInInvariantProject (UnfilteredInvariantProjectModelView) .
          vSetInitFunctionInstance: vSetInitPhase=INIT_MEMORY
        CanTrcv_30_Tja1043_Init: vSetHeader=CanTrcv_30_Tja1043.h, vSetConfigType=CanTrcv_30_Tja1043_ConfigType, vSetConfigPtrClass=CANTRCV_30_TJA1043_INIT_DATA, vSetModuleRef=CanTrcv  # /ActiveEcuC/CanTrcv PLAIN_TEXT Init function description of CanTrcv_30_Tja1043 in UnfilteredViewInInvariantProject (UnfilteredInvariantProjectModelView) .
          vSetInitFunctionInstance: vSetInitPhase=INIT_TWO_TRCV, vSetConfigPtrName=CanTrcv_30_Tja1043_Config_Ptr
        Xcp_InitMemory: vSetHeader=Xcp.h, vSetModuleRef=Xcp  # /ActiveEcuC/Xcp PLAIN_TEXT Memory Initialization function of module Xcp.
          vSetInitFunctionInstance: vSetInitPhase=INIT_MEMORY
        Xcp_Init: vSetHeader=Xcp.h, vSetModuleRef=Xcp  # /ActiveEcuC/Xcp PLAIN_TEXT Module Initialization function of module Xcp.
          vSetInitFunctionInstance: vSetInitPhase=INIT_TWO_TP
        CanXcp_Init: vSetHeader=CanXcp.h, vSetConfigType=CanXcp_ConfigType, vSetConfigPtrClass=CANXCP_CONST, vSetModuleRef=Xcp  # /ActiveEcuC/Xcp PLAIN_TEXT Module Initialization function of module CanXcp.
          vSetInitFunctionInstance: vSetInitPhase=INIT_TWO_TP, vSetConfigPtrName=NULL_PTR
        CanXcp_InitMemory: vSetHeader=CanXcp.h, vSetModuleRef=Xcp  # /ActiveEcuC/Xcp PLAIN_TEXT Memory Initialization function of module CanXcp.
          vSetInitFunctionInstance: vSetInitPhase=INIT_MEMORY
        CryIf_InitMemory: vSetHeader=CryIf.h, vSetModuleRef=CryIf  # /ActiveEcuC/CryIf PLAIN_TEXT Initializes variables of the Crypto Interface
          vSetInitFunctionInstance: vSetInitPhase=INIT_MEMORY
        CryIf_Init: vSetHeader=CryIf.h, vSetModuleRef=CryIf  # /ActiveEcuC/CryIf PLAIN_TEXT Initializes the Crypto Interface
          vSetInitFunctionInstance: vSetInitPhase=INIT_TWO_IF
        Csm_InitMemory: vSetHeader=Csm.h, vSetModuleRef=Csm  # /ActiveEcuC/Csm PLAIN_TEXT Initializes variables of the Crypto Service Manager
          vSetInitFunctionInstance: vSetInitPhase=INIT_MEMORY
        Csm_Init: vSetHeader=Csm.h, vSetModuleRef=Csm  # /ActiveEcuC/Csm PLAIN_TEXT Initializes the Crypto Service Manager
          vSetInitFunctionInstance: vSetInitPhase=INIT_TWO_SYS
        vDiagSecAcc_Init: vSetHeader=vDiagSecAcc.h, vSetModuleRef=vDiagSecAcc  # /ActiveEcuC/vDiagSecAcc PLAIN_TEXT Initializes the MICROSAR vDiagSecAcc
          vSetInitFunctionInstance: vSetInitPhase=INIT_TWO_SYS
        vDiagSecAcc_InitMemory: vSetHeader=vDiagSecAcc.h, vSetModuleRef=vDiagSecAcc  # /ActiveEcuC/vDiagSecAcc PLAIN_TEXT Initializes variables of the MICROSAR vDiagSecAcc
          vSetInitFunctionInstance: vSetInitPhase=INIT_MEMORY
        WdgM_Init: vSetHeader=WdgM.h, vSetConfigType=WdgM_ConfigType, vSetConfigPtrClass=WDGM_APPL_CONST, vSetModuleRef=WdgM  # /ActiveEcuC/WdgM PLAIN_TEXT Initialization of WdgM Module
          vSetInitFunctionInstance: vSetInitPhase=INIT_TWO_IF, vSetConfigPtrName=&WdgMConfig_Mode0_core0
        Wdg_Init: vSetHeader=Wdg.h, vSetConfigType=Wdg_ConfigType, vSetConfigPtrClass=WDG_APPL_CONST, vSetModuleRef=Wdg  # /ActiveEcuC/Wdg PLAIN_TEXT Created Wdg_Init by Extended Init XML Service
          vSetInitFunctionInstance: vSetInitPhase=INIT_ONE, vSetConfigPtrName=NULL_PTR
        Crypto_30_vHsm_Init: vSetHeader=Crypto_30_vHsm.h, vSetModuleRef=Crypto  # /ActiveEcuC/Crypto PLAIN_TEXT Initializes the Crypto Driver
          vSetInitFunctionInstance: vSetInitPhase=INIT_TWO_DRV
        Crypto_30_vHsm_InitMemory: vSetHeader=Crypto_30_vHsm.h, vSetModuleRef=Crypto  # /ActiveEcuC/Crypto PLAIN_TEXT Initializes variables of the Crypto Interface
          vSetInitFunctionInstance: vSetInitPhase=INIT_MEMORY
        vDam_InitMemory: vSetHeader=vDam.h, vSetModuleRef=vDam  # /ActiveEcuC/vDam PLAIN_TEXT InitMemory function description of vDam in UnfilteredViewInInvariantProject (UnfilteredInvariantProjectModelView) .
          vSetInitFunctionInstance: vSetInitPhase=INIT_MEMORY
        vDam_Init: vSetHeader=vDam.h, vSetConfigType=vDam_ConfigType, vSetConfigPtrClass=VDAM_INIT_DATA, vSetModuleRef=vDam  # /ActiveEcuC/vDam PLAIN_TEXT Init function description of vDam in UnfilteredViewInInvariantProject (UnfilteredInvariantProjectModelView) .
          vSetInitFunctionInstance: vSetInitPhase=INIT_TWO_SYS, vSetConfigPtrName=vDam_Config_Ptr
