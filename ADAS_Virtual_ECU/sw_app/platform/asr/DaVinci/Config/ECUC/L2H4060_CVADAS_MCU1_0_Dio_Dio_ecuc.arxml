AUTOSAR XML (schema 00048)
package /Dio
  module config Dio: implementation-config-variant=VARIANT-LINK-TIME, module-description=Dio_Impl
    DioConfig
      3 x DioPort:
        DioPort_WKUP_GPIO0_BANK0: DioPortId=0
          3 x DioChannel:
            DioChannel_pinEN: DioChannelId=15
            DioChannel_PinSTB: DioChannelId=1
            DioChannel_PinERR: DioChannelId=6
          WKUP_GPIO0_B0 (DioChannelGroup): DioChannelGroupIdentification=WKUP_GPIO0_B0_PTR, DioPortMask=4294967295, DioPortOffset=0
          DioChannel_MCU_LED (DioChannel): DioChannelId=31
        DioPort_WKUP_GPIO0_BANK23: DioPortId=1
          18 x DioChannel:
            WKUP_GPIO0_B23_Ch0: DioChannelId=43
            WKUP_GPIO0_B23_Ch1: DioChannelId=44
            WKUP_GPIO0_B23_Ch10: DioChannelId=53
            WKUP_GPIO0_B23_Ch11: DioChannelId=54
            WKUP_GPIO0_B23_Ch12: DioChannelId=55
            pinFDCAN14_Enable: DioChannelId=56
            WKUP_GPIO0_B23_Ch14: DioChannelId=57
            WKUP_GPIO0_B23_Ch15: DioChannelId=58
            WKUP_GPIO0_B23_Ch16: DioChannelId=59
            DioChannel_PINRXD: DioChannelId=61
            WKUP_GPIO0_B23_Ch2: DioChannelId=45
            WKUP_GPIO0_B23_Ch3: DioChannelId=46
            WKUP_GPIO0_B23_Ch4: DioChannelId=47
            WKUP_GPIO0_B23_Ch5: DioChannelId=48
            WKUP_GPIO0_B23_Ch6: DioChannelId=49
            WKUP_GPIO0_B23_Ch7: DioChannelId=50
            WKUP_GPIO0_B23_Ch8: DioChannelId=51
            WKUP_GPIO0_B23_Ch9: DioChannelId=52
          WKUP_GPIO0_B23 (DioChannelGroup): DioChannelGroupIdentification=WKUP_GPIO0_B23_PTR, DioPortMask=4294967295, DioPortOffset=0
        DioPort_GPIO0_BANK23: DioPortId=7
          DioChannel_USSDselPIN (DioChannel): DioChannelId=346
          GPIO0_B23 (DioChannelGroup): DioChannelGroupIdentification=GPIO0_B23_PTR, DioPortMask=4294967295, DioPortOffset=0
    DioDemEventParameterRef
    DioGeneral: DioDevErrorDetect=true, DioDeviceVariant=J721S2, DioFlipChannelApi=true, DioOwnProcId=MCU1_0, DioRegisterReadbackApi=true, DioVersionInfoApi=true
