AUTOSAR XML (schema 00048)
package /ActiveEcuC
  module config Can: implementation-config-variant=VARIANT-PRE-COMPILE, module-description=Can_Impl
    CanGeneral:
      CanIndex = 0
      CanChangeBaudrateApi = false
      CanDevErrorDetection = true
      CanHardwareCancellation = false
      CanIdenticalIdCancellation = false
      CanMainFunctionBusoffPeriod = 0.01
      CanMainFunctionModePeriod = 0.01
      CanMainFunctionWakeupPeriod = 0.01
      CanMultiplexedTransmission = false
      CanSetBaudrateApi = false
      CanTimeoutDuration = 0.01
      CanVersionInfoApi = false
      CanGenericPrecopy = true
      CanHardwareLoopCheck = true
      CanSecureTempBuffer = false
      CanRxFullCANSupport = false
      CanTxFullCANSupport = false
      CanRxBasicCANSupport = true
      CanUseNestedCANInterrupts = false
      CanHardwareCancelByAppl = true
      CanIndividualProcessing = false
      CanGenericConfirmation = false
      CanGenericConfirmationAPI2 = false
      CanRxQueue = false
      CanSupportMixedID = true
      CanRxQueueSize = 10
      CanMultipleBasicCANObjects = false
      CanMultipleBasicCANTxObjects = false
      CanHardwareHandleType = UINT8
      CanOptimizeOneController = false
      CanInterruptCategory = CATEGORY2
      CanGetStatus = false
      CanInterruptLock = DRIVER
      CanWakeupSupport = false
      CanRamCheck = MailboxNotification
      CanOverrunNotification = Application
      CanReinitStart = false
      CanGenericPreTransmit = false
      CanFdSupport = FULL
      CanRuntimeMeasurementSupport = false
      CanMaxRxDataLen = 64
      CanMaxTxDataLen = 64
      CanUsePeripheralAccessApi = false
      CanMirrorModeSupport = false
      CanUseOsInterruptControl = false
      CanSafeBswChecks = false
      CanSilentModeSupport = false
      CanHwTxFifoSupport = false
      CanMcanRevision = M_CAN_REV_315
      CanCheckWakeupCanRetType = false
      CanFdHardwareBufferOptimization = true
      CanEccInit = true
      CanUseVirtualAddressing = false
      CanEnableSecurityEventReporting = false
      CanCounterRef = SystemTimer
      CanMainFunctionRWPeriods
    CanConfigSet
      CT_FDCAN2_c5d3d1a7 (CanController):  # FDCAN2
        CanControllerActivation = true
        CanBusoffProcessing = INTERRUPT
        CanControllerBaseAddress = 1079148544
        CanControllerId = 0
        CanRxProcessing = INTERRUPT
        CanTxProcessing = INTERRUPT
        CanWakeupProcessing = INTERRUPT
        CanWakeupSupport = false
        CanWakeupSourceId = 0
        CanBasisAddressEnum = M_CAN0
        CanTxBufferElementSize = ES_64
        CanRxBufferElementSize = ES_8
        CanRxFifo0ElementSize = ES_64
        CanRxFifo1ElementSize = ES_64
        CanMaxNrOfRxFifo0Elements = 64
        CanMaxNrOfRxFifo1Elements = 64
        CanMaxNrOfRxBuffers = 64
        CanMaxNrOfTxBuffers = 32
        CanIsTTCAN = false
        CanTxEfBufferElementSize = ES_8
        CanControllerDefaultBaudrate = CT_FDCAN2_c5d3d1a7/CanControllerBaudrateConfig
        CanControllerSystemRef = CT_FDCAN2
        CanWakeupSourceRef = CN_FDCAN2_28a8fc44
        CanCpuClockRef = McuClockReferencePoint
        CanControllerBaudrateConfig:
          CanControllerBaudRate = 500
          CanControllerBaudRateConfigID = 0
          CanControllerPropSeg = 5
          CanControllerSeg1 = 2
          CanControllerSeg2 = 2
          CanControllerSyncJumpWidth = 1
          CanBaudrateClock = 80000
          CanBaudratePrescaler = 16
          CanControllerFdBaudrateConfig:
            CanControllerFdBaudRate = 2000
            CanControllerPropSeg = 3
            CanControllerSeg1 = 4
            CanControllerSeg2 = 2
            CanControllerSyncJumpWidth = 2
            CanControllerTxBitRateSwitch = true
            CanBaudratePrescaler = 4
            CanControllerTrcvDelayCompensationFilter = 32
        CanFilterMask: CanFilterMaskValue=0, CanFilterCodeValue=0, IsLocked=false
        CanFilterMask_001 (CanFilterMask): CanFilterMaskValue=2147483648, CanFilterCodeValue=0, IsLocked=false
      4 x CanHardwareObject, all with CanHandleType=BASIC, CanIdType=MIXED, CanIdValue=0, CanHwProcessing=false, CanObjectHwHandle=0, CanMaxDataLen=64, CanFdPaddingValue=0, CanObjectMultiplexedTransmission=false, CanObjectHwFifo=false:
        CN_FDCAN2_4c0547f7_Rx: CanObjectType=RECEIVE, CanObjectId=1, CanObjectHwSize=64, CanControllerRef=CT_FDCAN2_c5d3d1a7, CanFilterMaskRef=CT_FDCAN2_c5d3d1a7/CanFilterMask, CanFilterMaskRef=CT_FDCAN2_c5d3d1a7/CanFilterMask_001
        CN_FDCAN2_28a8fc44_Tx: CanObjectType=TRANSMIT, CanObjectId=0, CanObjectHwSize=1, CanControllerRef=CT_FDCAN2_c5d3d1a7
        CN_FDCAN14_525e7c5e_Rx: CanObjectType=RECEIVE, CanObjectId=3, CanObjectHwSize=64, CanControllerRef=CT_FDCAN14_90ecad61, CanFilterMaskRef=CT_FDCAN14_90ecad61/CanFilterMask_001, CanFilterMaskRef=CT_FDCAN14_90ecad61/CanFilterMask
        CN_FDCAN14_a902658e_Tx: CanObjectType=TRANSMIT, CanObjectId=2, CanObjectHwSize=1, CanControllerRef=CT_FDCAN14_90ecad61
      CT_FDCAN14_90ecad61 (CanController):  # FDCAN14
        CanControllerActivation = true
        CanBusoffProcessing = INTERRUPT
        CanControllerBaseAddress = 1079410688
        CanControllerId = 1
        CanRxProcessing = INTERRUPT
        CanTxProcessing = INTERRUPT
        CanWakeupProcessing = INTERRUPT
        CanWakeupSupport = false
        CanWakeupSourceId = 0
        CanBasisAddressEnum = M_CAN1
        CanTxBufferElementSize = ES_64
        CanRxBufferElementSize = ES_8
        CanRxFifo0ElementSize = ES_64
        CanRxFifo1ElementSize = ES_64
        CanMaxNrOfRxFifo0Elements = 64
        CanMaxNrOfRxFifo1Elements = 64
        CanMaxNrOfRxBuffers = 64
        CanMaxNrOfTxBuffers = 32
        CanIsTTCAN = false
        CanTxEfBufferElementSize = ES_8
        CanControllerDefaultBaudrate = CT_FDCAN14_90ecad61/CanControllerBaudrateConfig
        CanControllerSystemRef = CT_FDCAN14
        CanWakeupSourceRef = CN_FDCAN14_a902658e
        CanCpuClockRef = McuClockReferencePoint
        CanControllerBaudrateConfig:
          CanControllerBaudRate = 500
          CanControllerBaudRateConfigID = 0
          CanControllerPropSeg = 5
          CanControllerSeg1 = 2
          CanControllerSeg2 = 2
          CanControllerSyncJumpWidth = 1
          CanBaudrateClock = 80000
          CanBaudratePrescaler = 16
          CanControllerFdBaudrateConfig:
            CanControllerFdBaudRate = 2000
            CanControllerPropSeg = 2
            CanControllerSeg1 = 1
            CanControllerSeg2 = 1
            CanControllerSyncJumpWidth = 1
            CanControllerTxBitRateSwitch = true
            CanBaudratePrescaler = 8
        CanFilterMask: CanFilterMaskValue=0, CanFilterCodeValue=0, IsLocked=false
        CanFilterMask_001 (CanFilterMask): CanFilterMaskValue=2147483648, CanFilterCodeValue=0, IsLocked=false
