AUTOSAR XML (schema 00048)
package /ActiveEcuC
  module config CanNm: implementation-config-variant=VARIANT-PRE-COMPILE, module-description=CanNm_Impl
    CanNmGlobalConfig:
      CanNmPnEiraCalcEnabled = false
      CanNmBusLoadReductionEnabled = true
      CanNmBusSynchronizationEnabled = false
      CanNmComUserDataSupport = false
      CanNmCoordinatorSyncSupport = false
      CanNmDevErrorDetect = true
      CanNmImmediateTxconfEnabled = true
      CanNmMainFunctionPeriod = 0.01
      CanNmPassiveModeEnabled = false
      CanNmPduRxIndicationEnabled = false
      CanNmRemoteSleepIndEnabled = false
      CanNmStateChangeIndEnabled = true
      CanNmUserDataEnabled = false
      CanNmVersionInfoApi = false
      CanNmDisableTxErrReport = true
      CanNmApiOptimization = false
      CanNmCanIfRangeConfigDLCCheck = false
      CanNmRuntimeMeasurementSupport = false
      CanNmSafeBswChecks = false
      CanNmNodeIdEnabled = true
      CanNmComControlEnabled = true
      FDCAN2_CAN_70a1f111 (CanNmChannelConfig):
        CanNmMsgCycleOffset = 0
        CanNmMsgCycleTime = 1
        CanNmMsgReducedTime = 0.6
        CanNmNodeId = 24
        CanNmPduCbvPosition = CANNM_PDU_BYTE_1
        CanNmPduNidPosition = CANNM_PDU_BYTE_0
        CanNmRepeatMessageTime = 5
        CanNmTimeoutTime = 8
        CanNmWaitBusSleepTime = 1
        CanNmBusLoadReductionActive = true
        CanNmCarWakeUpRxEnabled = false
        CanNmImmediateNmTransmissions = 2
        CanNmMsgTimeoutTime = 0.5
        CanNmRemoteSleepIndTime = 3
        CanNmUserDataLength = 0
        CanNmActiveWakeupBitEnabled = true
        CanNmNodeIdEnabled = true
        CanNmNodeDetectionEnabled = false
        CanNmRepeatMsgIndEnabled = false
        CanNmImmediateRestartEnabled = false
        CanNmComControlEnabled = true
        CanNmCriBitAlwaysEnabled = false
        CanNmAllNmMessagesKeepAwake = true
        CanNmCarWakeUpBytePosition = 0
        CanNmImmediateNmCycleTime = 0.01
        CanNmComMNetworkHandleRef = CN_FDCAN2_28a8fc44
        NM_PAM_oFDCAN2_5dbcd8d2_Tx (CanNmTxPdu): CanNmTxConfirmationPduId=1, CanNmTxPduRef=NM_PAM_oFDCAN2_5dbcd8d2_Tx
        FDCAN2_CAN_70a1f111_Rx (CanNmRxPdu): CanNmRxPduId=1, CanNmRxPduRef=CVADAS_2451c593_Rx
      CanNmGeneration: CanNmOutOfBoundsWriteSanitizer=false, CanNmOutOfBoundsReadSanitizer=false, CanNmInterfacesForDeactivatedData=false
      FDCAN14_CAN_df03166d (CanNmChannelConfig):
        CanNmMsgCycleOffset = 0
        CanNmMsgCycleTime = 1
        CanNmMsgReducedTime = 0.6
        CanNmNodeId = 24
        CanNmPduCbvPosition = CANNM_PDU_BYTE_1
        CanNmPduNidPosition = CANNM_PDU_BYTE_0
        CanNmRepeatMessageTime = 5
        CanNmTimeoutTime = 8
        CanNmWaitBusSleepTime = 1
        CanNmBusLoadReductionActive = true
        CanNmCarWakeUpRxEnabled = false
        CanNmImmediateNmTransmissions = 2
        CanNmMsgTimeoutTime = 0.5
        CanNmRemoteSleepIndTime = 3
        CanNmUserDataLength = 0
        CanNmActiveWakeupBitEnabled = true
        CanNmNodeIdEnabled = true
        CanNmNodeDetectionEnabled = false
        CanNmRepeatMsgIndEnabled = false
        CanNmImmediateRestartEnabled = false
        CanNmComControlEnabled = true
        CanNmCriBitAlwaysEnabled = false
        CanNmAllNmMessagesKeepAwake = true
        CanNmImmediateNmCycleTime = 0.01
        CanNmComMNetworkHandleRef = CN_FDCAN14_a902658e
        FDCAN14_CAN_df03166d_Rx (CanNmRxPdu): CanNmRxPduId=0, CanNmRxPduRef=CVADAS_d79d906c_Rx
        NM_PAM_oFDCAN14_0d1e8b51_Tx (CanNmTxPdu): CanNmTxConfirmationPduId=0, CanNmTxPduRef=NM_PAM_oFDCAN14_0d1e8b51_Tx
