AUTOSAR XML (schema 00048)
package /ActiveEcuC
  module config WdgIf: implementation-config-variant=VARIANT-PRE-COMPILE, module-description=WdgIf_Impl
    WdgIfDevice:
      WdgIfDeviceIndex = 0
      WdgIfDeviceIncludeFile = Wdg.h
      WdgIfDeviceSetMode = Wdg_SetMode
      WdgIfDeviceSetTriggerCondition = Wdg_SetTriggerCondition
      WdgIfDriverRef = WdgGeneral
    WdgIfGeneral: WdgIfDevErrorDetect=false, WdgIfVersionInfoApi=false, WdgIfUseStateCombiner=false
