AUTOSAR XML (schema 00048)
package /ActiveEcuC
  module config CanIf: implementation-config-variant=VARIANT-PRE-COMPILE, module-description=CanIf_Impl
    CanIfCtrlDrvCfg_7d254554 (CanIfCtrlDrvCfg): CanIfCtrlDrvTxCancellation=false, CanIfCtrlDrvInitHohConfigRef=CanIfInitHohCfg, CanIfCtrlDrvNameRef=CanGeneral
      CT_FDCAN2_c5d3d1a7 (CanIfCtrlCfg):
        CanIfCtrlId = 0
        CanIfCtrlWakeupSupport = false
        CanIfCtrlJ1939DynAddrSupport = DISABLED
        CanIfDoubleHashRandom1 = 467721740
        CanIfDoubleHashRandom2 = 2473403458
        CanIfCtrlCanCtrlRef = CT_FDCAN2_c5d3d1a7
        CanIfCtrlTrcvCfgRef = CanIfTrcvCfg
      CT_FDCAN14_90ecad61 (CanIfCtrlCfg):
        CanIfCtrlId = 1
        CanIfCtrlWakeupSupport = false
        CanIfCtrlJ1939DynAddrSupport = DISABLED
        CanIfDoubleHashRandom1 = 3541509428
        CanIfDoubleHashRandom2 = 2647454992
        CanIfCtrlCanCtrlRef = CT_FDCAN14_90ecad61
    CanIfDispatchCfg:
      CanIfDispatchUserCtrlBusOffName = CanSM_ControllerBusOff
      CanIfDispatchUserCtrlBusOffUL = CAN_SM
      CanIfDispatchUserCtrlModeIndicationName = CanSM_ControllerModeIndication
      CanIfDispatchUserCtrlModeIndicationUL = CAN_SM
      CanIfDispatchUserTrcvModeIndicationUL = CAN_SM
      CanIfDispatchUserTrcvModeIndicationName = CanSM_TransceiverModeIndication
    CanIfInitCfg
      10 x CanIfRxPduCfg, all with CanIfRxPduReadData=false, CanIfRxPduReadNotifyStatus=false, CanIfRxPduDlcCheck=false:
        TRANSM_FD_4_oFDCAN2_2b2bdf8f_Rx: CanIfRxPduCanId=1450, CanIfRxPduCanIdType=STANDARD_CAN, CanIfRxPduDlc=32, CanIfRxPduUserRxIndicationName=PduR_CanIfRxIndication, CanIfRxPduUserRxIndicationUL=PDUR, CanIfRxPduId=22, CanIfRxPduHrhIdRef=CN_FDCAN2_4c0547f7_Rx, CanIfRxPduRef=TRANSM_FD_4_oFDCAN2_8222be40_Rx
        DIAGNOSTIC_REQUEST_FD_FUNCTIONAL_Tp_oFDCAN2_75504700_Rx: CanIfRxPduCanId=417070834, CanIfRxPduCanIdType=EXTENDED_FD_CAN, CanIfRxPduDlc=64, CanIfRxPduUserRxIndicationName=CanTp_RxIndication, CanIfRxPduUserRxIndicationType=PDUID_PDUINFOPTR, CanIfRxPduUserRxIndicationUL=CAN_TP, CanIfRxPduId=13, CanIfRxPduHrhIdRef=CN_FDCAN2_794f110f_Rx, CanIfRxPduRef=DIAGNOSTIC_REQUEST_FD_FUNCTIONAL_Tp_oFDCAN2_0dc95674_Rx
        ADAS_FD_INFO_C2_oFDCAN2_b80f734c_Rx: CanIfRxPduCanId=281, CanIfRxPduCanIdType=STANDARD_CAN, CanIfRxPduDlc=32, CanIfRxPduUserRxIndicationName=PduR_CanIfRxIndication, CanIfRxPduUserRxIndicationUL=PDUR, CanIfRxPduId=45, CanIfRxPduHrhIdRef=CN_FDCAN2_4c0547f7_Rx, CanIfRxPduRef=ADAS_FD_INFO_C2_oFDCAN2_3ce9cdd9_Rx
        EPS_FD_2_oFDCAN2_002075f8_Rx: CanIfRxPduCanId=1056, CanIfRxPduCanIdType=STANDARD_CAN, CanIfRxPduDlc=32, CanIfRxPduUserRxIndicationName=PduR_CanIfRxIndication, CanIfRxPduUserRxIndicationUL=PDUR, CanIfRxPduId=34, CanIfRxPduHrhIdRef=CN_FDCAN2_4c0547f7_Rx, CanIfRxPduRef=EPS_FD_2_oFDCAN2_b46a17c9_Rx
        TELEMATIC_FD_14_oFDCAN2_95ebb865_Rx: CanIfRxPduCanId=1465, CanIfRxPduCanIdType=STANDARD_CAN, CanIfRxPduDlc=32, CanIfRxPduUserRxIndicationName=PduR_CanIfRxIndication, CanIfRxPduUserRxIndicationUL=PDUR, CanIfRxPduId=21, CanIfRxPduHrhIdRef=CN_FDCAN2_4c0547f7_Rx, CanIfRxPduRef=TELEMATIC_FD_14_oFDCAN2_f8ab69af_Rx
        PDC_INFO_FD_BCM_oFDCAN2_51e02ec5_Rx: CanIfRxPduCanId=506855424, CanIfRxPduCanIdType=EXTENDED_CAN, CanIfRxPduDlc=48, CanIfRxPduUserRxIndicationName=PduR_CanIfRxIndication, CanIfRxPduUserRxIndicationUL=PDUR, CanIfRxPduId=9, CanIfRxPduHrhIdRef=CN_FDCAN2_794f110f_Rx, CanIfRxPduRef=PDC_INFO_FD_BCM_oFDCAN2_d0394486_Rx
        TELEMATIC_FD_5_oFDCAN2_d3090214_Rx: CanIfRxPduCanId=1428, CanIfRxPduCanIdType=STANDARD_CAN, CanIfRxPduDlc=32, CanIfRxPduUserRxIndicationName=PduR_CanIfRxIndication, CanIfRxPduUserRxIndicationUL=PDUR, CanIfRxPduId=28, CanIfRxPduHrhIdRef=CN_FDCAN2_4c0547f7_Rx, CanIfRxPduRef=TELEMATIC_FD_5_oFDCAN2_39a02182_Rx
        TRSKM_FD_1_oFDCAN2_6974e197_Rx: CanIfRxPduCanId=1476, CanIfRxPduCanIdType=STANDARD_CAN, CanIfRxPduDlc=32, CanIfRxPduUserRxIndicationName=PduR_CanIfRxIndication, CanIfRxPduUserRxIndicationUL=PDUR, CanIfRxPduId=19, CanIfRxPduHrhIdRef=CN_FDCAN2_4c0547f7_Rx, CanIfRxPduRef=TRSKM_FD_1_oFDCAN2_3bc9104a_Rx
        BRAKE_FD_3_oFDCAN2_8da582ba_Rx: CanIfRxPduCanId=259, CanIfRxPduCanIdType=STANDARD_CAN, CanIfRxPduDlc=32, CanIfRxPduUserRxIndicationName=PduR_CanIfRxIndication, CanIfRxPduUserRxIndicationUL=PDUR, CanIfRxPduId=49, CanIfRxPduHrhIdRef=CN_FDCAN2_4c0547f7_Rx, CanIfRxPduRef=BRAKE_FD_3_oFDCAN2_48feb4fd_Rx
        GLOB_NAV_FD_C2_oFDCAN2_7d3f2e2d_Rx: CanIfRxPduCanId=526, CanIfRxPduCanIdType=STANDARD_CAN, CanIfRxPduDlc=32, CanIfRxPduUserRxIndicationName=PduR_CanIfRxIndication, CanIfRxPduUserRxIndicationUL=PDUR, CanIfRxPduId=40, CanIfRxPduHrhIdRef=CN_FDCAN2_4c0547f7_Rx, CanIfRxPduRef=GLOB_NAV_FD_C2_oFDCAN2_93cc1f91_Rx
      CanIfInitHohCfg: CanIfInitRefCfgSet=CanConfigSet
        CN_FDCAN2_4c0547f7_Rx (CanIfHrhCfg): CanIfHrhSoftwareFilter=true, CanIfHrhCanCtrlIdRef=CT_FDCAN2_c5d3d1a7, CanIfHrhIdSymRef=CN_FDCAN2_4c0547f7_Rx
        CN_FDCAN2_794f110f_Rx (CanIfHrhCfg): CanIfHrhSoftwareFilter=true, CanIfHrhCanCtrlIdRef=CT_FDCAN2_c5d3d1a7, CanIfHrhIdSymRef=CN_FDCAN2_4c0547f7_Rx
        CN_FDCAN2_28a8fc44_Tx (CanIfHthCfg): CanIfHthCanCtrlIdRef=CT_FDCAN2_c5d3d1a7, CanIfHthIdSymRef=CN_FDCAN2_28a8fc44_Tx
        CN_FDCAN14_525e7c5e_Rx (CanIfHrhCfg): CanIfHrhSoftwareFilter=true, CanIfHrhCanCtrlIdRef=CT_FDCAN14_90ecad61, CanIfHrhIdSymRef=CN_FDCAN14_525e7c5e_Rx
        CN_FDCAN14_67142aa6_Rx (CanIfHrhCfg): CanIfHrhSoftwareFilter=true, CanIfHrhCanCtrlIdRef=CT_FDCAN14_90ecad61, CanIfHrhIdSymRef=CN_FDCAN14_525e7c5e_Rx
        CN_FDCAN14_a902658e_Tx (CanIfHthCfg): CanIfHthCanCtrlIdRef=CT_FDCAN14_90ecad61, CanIfHthIdSymRef=CN_FDCAN14_a902658e_Tx
      6 x CanIfRxPduCfg, all with CanIfRxPduUserRxIndicationName=PduR_CanIfRxIndication, CanIfRxPduUserRxIndicationUL=PDUR, CanIfRxPduReadData=false, CanIfRxPduReadNotifyStatus=false, CanIfRxPduDlcCheck=false:
        ASCM_FD_2_oFDCAN2_e0d28be9_Rx: CanIfRxPduCanId=1445, CanIfRxPduCanIdType=STANDARD_CAN, CanIfRxPduDlc=32, CanIfRxPduId=24, CanIfRxPduHrhIdRef=CN_FDCAN2_4c0547f7_Rx, CanIfRxPduRef=ASCM_FD_2_oFDCAN2_18540c4a_Rx
        BCM_FD_29_oFDCAN2_a9ee0c40_Rx: CanIfRxPduCanId=1470, CanIfRxPduCanIdType=STANDARD_CAN, CanIfRxPduDlc=32, CanIfRxPduId=20, CanIfRxPduHrhIdRef=CN_FDCAN2_4c0547f7_Rx, CanIfRxPduRef=BCM_FD_29_oFDCAN2_aa0bc9ec_Rx
        CFG_DATA_CODE_REQUEST_oFDCAN2_a6af4d1a_Rx: CanIfRxPduCanId=504446976, CanIfRxPduCanIdType=EXTENDED_CAN, CanIfRxPduDlc=6, CanIfRxPduId=10, CanIfRxPduHrhIdRef=CN_FDCAN2_794f110f_Rx, CanIfRxPduRef=CFG_DATA_CODE_REQUEST_oFDCAN2_f0797e1f_Rx
        BCM_FD_27_oFDCAN2_5243ac07_Rx: CanIfRxPduCanId=1436, CanIfRxPduCanIdType=STANDARD_CAN, CanIfRxPduDlc=32, CanIfRxPduId=26, CanIfRxPduHrhIdRef=CN_FDCAN2_4c0547f7_Rx, CanIfRxPduRef=BCM_FD_27_oFDCAN2_eddb36fd_Rx
        TELEMATIC_FD_11_oFDCAN2_3a2ad576_Rx: CanIfRxPduCanId=608, CanIfRxPduCanIdType=STANDARD_CAN, CanIfRxPduDlc=32, CanIfRxPduId=39, CanIfRxPduHrhIdRef=CN_FDCAN2_4c0547f7_Rx, CanIfRxPduRef=TELEMATIC_FD_11_oFDCAN2_a69db35a_Rx
        TRANSM_FD_2_oFDCAN2_bdde8790_Rx: CanIfRxPduCanId=520, CanIfRxPduCanIdType=STANDARD_CAN, CanIfRxPduDlc=32, CanIfRxPduId=41, CanIfRxPduHrhIdRef=CN_FDCAN2_4c0547f7_Rx, CanIfRxPduRef=TRANSM_FD_2_oFDCAN2_e9f9d2e6_Rx
      CVPAM_FD_Control_oFDCAN2_4eff2f96_Tx (CanIfTxPduCfg):
        CanIfTxPduCanId = 275
        CanIfTxPduCanIdType = STANDARD_FD_CAN
        CanIfTxPduDlc = 32
        CanIfTxPduUserTxConfirmationName = NULL_PTR
        CanIfTxPduUserTxConfirmationUL = NONE
        CanIfTxPduId = 13
        CanIfTxPduReadNotifyStatus = false
        CanIfTxPduType = STATIC
        CanIfTxPduTruncation = true
        CanIfTxPduBufferRef = CHNL_7d164bae
        CanIfTxPduRef = CVPAM_FD_Control_oFDCAN2_b23be072_Tx
      DIAGNOSTIC_REQUEST_FD_PAM_Tp_oFDCAN2_20_b2dd874c_Rx (CanIfRxPduCfg):
        CanIfRxPduCanId = 416981234
        CanIfRxPduCanIdType = EXTENDED_NO_FD_CAN
        CanIfRxPduDlc = 8
        CanIfRxPduUserRxIndicationName = CanTp_RxIndication
        CanIfRxPduUserRxIndicationType = PDUID_PDUINFOPTR
        CanIfRxPduUserRxIndicationUL = CAN_TP
        CanIfRxPduId = 17
        CanIfRxPduReadData = false
        CanIfRxPduReadNotifyStatus = false
        CanIfRxPduDlcCheck = false
        CanIfRxPduHrhIdRef = CN_FDCAN2_794f110f_Rx
        CanIfRxPduRef = DIAGNOSTIC_REQUEST_FD_PAM_Tp_oFDCAN2_20_2351f322_Rx
      DIAGNOSTIC_RESPONSE_FD_PAM_Tp_oFDCAN2_3daa27dc_Tx (CanIfTxPduCfg):
        CanIfTxPduCanId = 417002144
        CanIfTxPduCanIdType = EXTENDED_FD_CAN
        CanIfTxPduDlc = 64
        CanIfTxPduUserTxConfirmationName = CanTp_TxConfirmation
        CanIfTxPduUserTxConfirmationUL = CAN_TP
        CanIfTxPduId = 6
        CanIfTxPduReadNotifyStatus = false
        CanIfTxPduType = STATIC
        CanIfTxPduTruncation = true
        CanIfTxPduBufferRef = CHNL_7d164bae
        CanIfTxPduRef = DIAGNOSTIC_RESPONSE_FD_PAM_Tp_oFDCAN2_5bcd311d_Tx
      5 x CanIfRxPduCfg, all with CanIfRxPduReadData=false, CanIfRxPduReadNotifyStatus=false, CanIfRxPduDlcCheck=false:
        IPC_VEHICLE_SETUP_oFDCAN2_ad6c5915_Rx: CanIfRxPduCanId=1443, CanIfRxPduCanIdType=STANDARD_CAN, CanIfRxPduDlc=48, CanIfRxPduUserRxIndicationName=PduR_CanIfRxIndication, CanIfRxPduUserRxIndicationUL=PDUR, CanIfRxPduId=25, CanIfRxPduHrhIdRef=CN_FDCAN2_4c0547f7_Rx, CanIfRxPduRef=IPC_VEHICLE_SETUP_oFDCAN2_a22ca3c4_Rx
        BCM_FD_10_oFDCAN2_9778e461_Rx: CanIfRxPduCanId=1153, CanIfRxPduCanIdType=STANDARD_CAN, CanIfRxPduDlc=32, CanIfRxPduUserRxIndicationName=PduR_CanIfRxIndication, CanIfRxPduUserRxIndicationUL=PDUR, CanIfRxPduId=31, CanIfRxPduHrhIdRef=CN_FDCAN2_4c0547f7_Rx, CanIfRxPduRef=BCM_FD_10_oFDCAN2_d1dc27ad_Rx
        BCM_FD_3_oFDCAN2_f21ddb5c_Rx: CanIfRxPduCanId=750, CanIfRxPduCanIdType=STANDARD_CAN, CanIfRxPduDlc=32, CanIfRxPduUserRxIndicationName=PduR_CanIfRxIndication, CanIfRxPduUserRxIndicationUL=PDUR, CanIfRxPduId=36, CanIfRxPduHrhIdRef=CN_FDCAN2_4c0547f7_Rx, CanIfRxPduRef=BCM_FD_3_oFDCAN2_95fa4902_Rx
        EPS_FD_1_oFDCAN2_a112af31_Rx: CanIfRxPduCanId=264, CanIfRxPduCanIdType=STANDARD_CAN, CanIfRxPduDlc=32, CanIfRxPduUserRxIndicationName=PduR_CanIfRxIndication, CanIfRxPduUserRxIndicationUL=PDUR, CanIfRxPduId=47, CanIfRxPduHrhIdRef=CN_FDCAN2_4c0547f7_Rx, CanIfRxPduRef=EPS_FD_1_oFDCAN2_8187a19a_Rx
        DIAGNOSTIC_REQUEST_PAM_Tp_oFDCAN2_85a60f0e_Rx: CanIfRxPduCanId=416981233, CanIfRxPduCanIdType=EXTENDED_NO_FD_CAN, CanIfRxPduDlc=8, CanIfRxPduUserRxIndicationName=CanTp_RxIndication, CanIfRxPduUserRxIndicationType=PDUID_PDUINFOPTR, CanIfRxPduUserRxIndicationUL=CAN_TP, CanIfRxPduId=18, CanIfRxPduHrhIdRef=CN_FDCAN2_794f110f_Rx, CanIfRxPduRef=DIAGNOSTIC_REQUEST_PAM_Tp_oFDCAN2_969cba10_Rx
      DIAGNOSTIC_RESPONSE_FD_PAM_Tp_oFDCAN2_20_a02181d6_Tx (CanIfTxPduCfg):
        CanIfTxPduCanId = 417002144
        CanIfTxPduCanIdType = EXTENDED_CAN
        CanIfTxPduDlc = 8
        CanIfTxPduUserTxConfirmationName = CanTp_TxConfirmation
        CanIfTxPduUserTxConfirmationUL = CAN_TP
        CanIfTxPduId = 7
        CanIfTxPduReadNotifyStatus = false
        CanIfTxPduType = STATIC
        CanIfTxPduTruncation = true
        CanIfTxPduBufferRef = CHNL_7d164bae
        CanIfTxPduRef = DIAGNOSTIC_RESPONSE_FD_PAM_Tp_oFDCAN2_20_3d6cb975_Tx
      PDC_INFO_FD_CADM2_oFDCAN2_9d0a5374_Rx (CanIfRxPduCfg):
        CanIfRxPduCanId = 506855566
        CanIfRxPduCanIdType = EXTENDED_CAN
        CanIfRxPduDlc = 12
        CanIfRxPduUserRxIndicationName = PduR_CanIfRxIndication
        CanIfRxPduUserRxIndicationUL = PDUR
        CanIfRxPduId = 4
        CanIfRxPduReadData = false
        CanIfRxPduReadNotifyStatus = false
        CanIfRxPduDlcCheck = false
        CanIfRxPduHrhIdRef = CN_FDCAN2_794f110f_Rx
        CanIfRxPduRef = PDC_INFO_FD_CADM2_oFDCAN2_5b04fff1_Rx
      NM_PAM_oFDCAN2_28cff7c5_Tx (CanIfTxPduCfg):
        CanIfTxPduCanId = 507002904
        CanIfTxPduCanIdType = EXTENDED_FD_CAN
        CanIfTxPduDlc = 2
        CanIfTxPduUserTxConfirmationName = NULL_PTR
        CanIfTxPduUserTxConfirmationUL = NONE
        CanIfTxPduId = 1
        CanIfTxPduReadNotifyStatus = false
        CanIfTxPduType = STATIC
        CanIfTxPduTruncation = true
        CanIfTxPduBufferRef = CHNL_7d164bae
        CanIfTxPduRef = NM_PAM_oFDCAN2_5dbcd8d2_Tx
      3 x CanIfRxPduCfg, all with CanIfRxPduReadData=false, CanIfRxPduReadNotifyStatus=false, CanIfRxPduDlcCheck=false:
        ASCM_FD_1_oFDCAN2_b0efc15e_Rx: CanIfRxPduCanId=1327, CanIfRxPduCanIdType=STANDARD_CAN, CanIfRxPduDlc=32, CanIfRxPduUserRxIndicationName=PduR_CanIfRxIndication, CanIfRxPduUserRxIndicationUL=PDUR, CanIfRxPduId=29, CanIfRxPduHrhIdRef=CN_FDCAN2_4c0547f7_Rx, CanIfRxPduRef=ASCM_FD_1_oFDCAN2_2db9ba19_Rx
        CVADAS_95874157_Rx: CanIfRxPduCanIdType=EXTENDED_CAN, CanIfRxPduDlc=2, CanIfRxPduUserRxIndicationName=CanNm_RxIndication, CanIfRxPduUserRxIndicationUL=CAN_NM, CanIfRxPduId=0, CanIfRxPduHrhIdRef=CN_FDCAN2_794f110f_Rx, CanIfRxPduRef=CVADAS_2451c593_Rx
          CHNL_4aff1d0e (CanIfRxPduCanIdRange): CanIfRxPduCanIdRangeLowerCanId=507002880, CanIfRxPduCanIdRangeUpperCanId=507003135
        BRAKE_FD_5_oFDCAN2_9836b6c3_Rx: CanIfRxPduCanId=1155, CanIfRxPduCanIdType=STANDARD_CAN, CanIfRxPduDlc=32, CanIfRxPduUserRxIndicationName=PduR_CanIfRxIndication, CanIfRxPduUserRxIndicationUL=PDUR, CanIfRxPduId=30, CanIfRxPduHrhIdRef=CN_FDCAN2_4c0547f7_Rx, CanIfRxPduRef=BRAKE_FD_5_oFDCAN2_2325d85b_Rx
      TRSCM_FD_1_oFDCAN2_a03575fe_Tx (CanIfTxPduCfg):
        CanIfTxPduCanId = 1472
        CanIfTxPduCanIdType = STANDARD_FD_CAN
        CanIfTxPduDlc = 32
        CanIfTxPduUserTxConfirmationName = PduR_CanIfTxConfirmation
        CanIfTxPduUserTxConfirmationUL = PDUR
        CanIfTxPduId = 9
        CanIfTxPduReadNotifyStatus = false
        CanIfTxPduType = STATIC
        CanIfTxPduTruncation = true
        CanIfTxPduBufferRef = CHNL_7d164bae
        CanIfTxPduRef = TRSCM_FD_1_oFDCAN2_4cf656c2_Tx
      ORC_FD_1_oFDCAN2_9afbe59f_Rx (CanIfRxPduCfg):
        CanIfRxPduCanId = 611
        CanIfRxPduCanIdType = STANDARD_CAN
        CanIfRxPduDlc = 32
        CanIfRxPduUserRxIndicationName = PduR_CanIfRxIndication
        CanIfRxPduUserRxIndicationUL = PDUR
        CanIfRxPduId = 37
        CanIfRxPduReadData = false
        CanIfRxPduReadNotifyStatus = false
        CanIfRxPduDlcCheck = false
        CanIfRxPduHrhIdRef = CN_FDCAN2_4c0547f7_Rx
        CanIfRxPduRef = ORC_FD_1_oFDCAN2_3775757b_Rx
      DIAGNOSTIC_REQUEST_FD_FUNCTIONAL_Tp_oFDCAN2_20_89fbaae9_Rx (CanIfRxPduCfg):
        CanIfRxPduCanId = 417070834
        CanIfRxPduCanIdType = EXTENDED_NO_FD_CAN
        CanIfRxPduDlc = 8
        CanIfRxPduUserRxIndicationName = CanTp_RxIndication
        CanIfRxPduUserRxIndicationType = PDUID_PDUINFOPTR
        CanIfRxPduUserRxIndicationUL = CAN_TP
        CanIfRxPduId = 14
        CanIfRxPduReadData = false
        CanIfRxPduReadNotifyStatus = false
        CanIfRxPduDlcCheck = false
        CanIfRxPduHrhIdRef = CN_FDCAN2_794f110f_Rx
        CanIfRxPduRef = DIAGNOSTIC_REQUEST_FD_FUNCTIONAL_Tp_oFDCAN2_20_57bb70f5_Rx
      DIAGNOSTIC_ROE_PAM_oFDCAN2_d9a769b3_Tx (CanIfTxPduCfg):
        CanIfTxPduCanId = 417198496
        CanIfTxPduCanIdType = EXTENDED_CAN
        CanIfTxPduDlc = 8
        CanIfTxPduUserTxConfirmationName = NULL_PTR
        CanIfTxPduUserTxConfirmationUL = NONE
        CanIfTxPduId = 5
        CanIfTxPduReadNotifyStatus = false
        CanIfTxPduType = STATIC
        CanIfTxPduTruncation = true
        CanIfTxPduBufferRef = CHNL_7d164bae
        CanIfTxPduRef = DIAGNOSTIC_ROE_PAM_oFDCAN2_ff776c1c_Tx
      6 x CanIfRxPduCfg, all with CanIfRxPduReadData=false, CanIfRxPduReadNotifyStatus=false, CanIfRxPduDlcCheck=false:
        DIAGNOSTIC_REQUEST_FUNCTIONAL_Tp_oFDCAN2_32bd5e48_Rx: CanIfRxPduCanId=417070833, CanIfRxPduCanIdType=EXTENDED_NO_FD_CAN, CanIfRxPduDlc=8, CanIfRxPduUserRxIndicationName=CanTp_RxIndication, CanIfRxPduUserRxIndicationType=PDUID_PDUINFOPTR, CanIfRxPduUserRxIndicationUL=CAN_TP, CanIfRxPduId=15, CanIfRxPduHrhIdRef=CN_FDCAN2_794f110f_Rx, CanIfRxPduRef=DIAGNOSTIC_REQUEST_FUNCTIONAL_Tp_oFDCAN2_220d49df_Rx
        BCM_FD_9_oFDCAN2_82510968_Rx: CanIfRxPduCanId=1066, CanIfRxPduCanIdType=STANDARD_CAN, CanIfRxPduDlc=32, CanIfRxPduUserRxIndicationName=PduR_CanIfRxIndication, CanIfRxPduUserRxIndicationUL=PDUR, CanIfRxPduId=33, CanIfRxPduHrhIdRef=CN_FDCAN2_4c0547f7_Rx, CanIfRxPduRef=BCM_FD_9_oFDCAN2_2997fce8_Rx
        BCM_FD_12_oFDCAN2_f75168bb_Rx: CanIfRxPduCanId=1431, CanIfRxPduCanIdType=STANDARD_CAN, CanIfRxPduDlc=32, CanIfRxPduUserRxIndicationName=PduR_CanIfRxIndication, CanIfRxPduUserRxIndicationUL=PDUR, CanIfRxPduId=27, CanIfRxPduHrhIdRef=CN_FDCAN2_4c0547f7_Rx, CanIfRxPduRef=BCM_FD_12_oFDCAN2_41ba01f0_Rx
        BRAKE_FD_4_oFDCAN2_c519be37_Rx: CanIfRxPduCanId=609, CanIfRxPduCanIdType=STANDARD_CAN, CanIfRxPduDlc=32, CanIfRxPduUserRxIndicationName=PduR_CanIfRxIndication, CanIfRxPduUserRxIndicationUL=PDUR, CanIfRxPduId=38, CanIfRxPduHrhIdRef=CN_FDCAN2_4c0547f7_Rx, CanIfRxPduRef=BRAKE_FD_4_oFDCAN2_86ae4855_Rx
        BRAKE2_FD_1_oFDCAN2_a11783f2_Rx: CanIfRxPduCanId=257, CanIfRxPduCanIdType=STANDARD_CAN, CanIfRxPduDlc=64, CanIfRxPduUserRxIndicationName=PduR_CanIfRxIndication, CanIfRxPduUserRxIndicationUL=PDUR, CanIfRxPduId=51, CanIfRxPduHrhIdRef=CN_FDCAN2_4c0547f7_Rx, CanIfRxPduRef=BRAKE2_FD_1_oFDCAN2_13e6bf8d_Rx
        PDC_INFO_FD_ADCM_oFDCAN2_43f16f06_Rx: CanIfRxPduCanId=506855461, CanIfRxPduCanIdType=EXTENDED_CAN, CanIfRxPduDlc=12, CanIfRxPduUserRxIndicationName=PduR_CanIfRxIndication, CanIfRxPduUserRxIndicationUL=PDUR, CanIfRxPduId=6, CanIfRxPduHrhIdRef=CN_FDCAN2_794f110f_Rx, CanIfRxPduRef=PDC_INFO_FD_ADCM_oFDCAN2_b5d3e253_Rx
      DIAGNOSTIC_RESPONSE_PAM_Tp_oFDCAN2_dc079c65_Tx (CanIfTxPduCfg):
        CanIfTxPduCanId = 417001888
        CanIfTxPduCanIdType = EXTENDED_CAN
        CanIfTxPduDlc = 8
        CanIfTxPduUserTxConfirmationName = CanTp_TxConfirmation
        CanIfTxPduUserTxConfirmationUL = CAN_TP
        CanIfTxPduId = 8
        CanIfTxPduReadNotifyStatus = false
        CanIfTxPduType = STATIC
        CanIfTxPduTruncation = true
        CanIfTxPduBufferRef = CHNL_7d164bae
        CanIfTxPduRef = DIAGNOSTIC_RESPONSE_PAM_Tp_oFDCAN2_7966b8ee_Tx
      4 x CanIfRxPduCfg, all with CanIfRxPduReadData=false, CanIfRxPduReadNotifyStatus=false, CanIfRxPduDlcCheck=false:
        BCM_FD_2_oFDCAN2_24236f24_Rx: CanIfRxPduCanId=256, CanIfRxPduCanIdType=STANDARD_CAN, CanIfRxPduDlc=32, CanIfRxPduUserRxIndicationName=PduR_CanIfRxIndication, CanIfRxPduUserRxIndicationUL=PDUR, CanIfRxPduId=52, CanIfRxPduHrhIdRef=CN_FDCAN2_4c0547f7_Rx, CanIfRxPduRef=BCM_FD_2_oFDCAN2_3071d90c_Rx
        PDC_INFO_FD_BSM2_oFDCAN2_555bedb6_Rx: CanIfRxPduCanId=506855572, CanIfRxPduCanIdType=EXTENDED_CAN, CanIfRxPduDlc=12, CanIfRxPduUserRxIndicationName=PduR_CanIfRxIndication, CanIfRxPduUserRxIndicationUL=PDUR, CanIfRxPduId=3, CanIfRxPduHrhIdRef=CN_FDCAN2_794f110f_Rx, CanIfRxPduRef=PDC_INFO_FD_BSM2_oFDCAN2_e01465fe_Rx
        BRAKE_FD_2_oFDCAN2_d08a8a4e_Rx: CanIfRxPduCanId=258, CanIfRxPduCanIdType=STANDARD_CAN, CanIfRxPduDlc=64, CanIfRxPduUserRxIndicationName=PduR_CanIfRxIndication, CanIfRxPduUserRxIndicationUL=PDUR, CanIfRxPduId=50, CanIfRxPduHrhIdRef=CN_FDCAN2_4c0547f7_Rx, CanIfRxPduRef=BRAKE_FD_2_oFDCAN2_ed7524f3_Rx
        DIAGNOSTIC_REQUEST_FD_PAM_Tp_oFDCAN2_a33697dc_Rx: CanIfRxPduCanId=416981234, CanIfRxPduCanIdType=EXTENDED_FD_CAN, CanIfRxPduDlc=64, CanIfRxPduUserRxIndicationName=CanTp_RxIndication, CanIfRxPduUserRxIndicationType=PDUID_PDUINFOPTR, CanIfRxPduUserRxIndicationUL=CAN_TP, CanIfRxPduId=16, CanIfRxPduHrhIdRef=CN_FDCAN2_794f110f_Rx, CanIfRxPduRef=DIAGNOSTIC_REQUEST_FD_PAM_Tp_oFDCAN2_8bc916a8_Rx
      3 x CanIfTxPduCfg, all with CanIfTxPduReadNotifyStatus=false, CanIfTxPduType=STATIC, CanIfTxPduTruncation=true, CanIfTxPduBufferRef=CHNL_7d164bae:
        CVPAM_FD_Info_oFDCAN2_63faf907_Tx: CanIfTxPduCanId=950, CanIfTxPduCanIdType=STANDARD_FD_CAN, CanIfTxPduDlc=32, CanIfTxPduUserTxConfirmationName=NULL_PTR, CanIfTxPduUserTxConfirmationUL=NONE, CanIfTxPduId=10, CanIfTxPduRef=CVPAM_FD_Info_oFDCAN2_b99cd129_Tx
        CFG_DATA_CODE_RSP_PAM_oFDCAN2_9eaffcee_Tx: CanIfTxPduCanId=504447000, CanIfTxPduCanIdType=EXTENDED_FD_CAN, CanIfTxPduDlc=6, CanIfTxPduUserTxConfirmationName=NULL_PTR, CanIfTxPduUserTxConfirmationUL=NONE, CanIfTxPduId=3, CanIfTxPduRef=CFG_DATA_CODE_RSP_PAM_oFDCAN2_5b222c4a_Tx
        PDC_INFO_FD_PAM_oFDCAN2_f59fee66_Tx: CanIfTxPduCanId=506855448, CanIfTxPduCanIdType=EXTENDED_FD_CAN, CanIfTxPduDlc=12, CanIfTxPduUserTxConfirmationName=PduR_CanIfTxConfirmation, CanIfTxPduUserTxConfirmationUL=PDUR, CanIfTxPduId=2, CanIfTxPduRef=PDC_INFO_FD_PAM_oFDCAN2_461f923e_Tx
      6 x CanIfRxPduCfg, all with CanIfRxPduUserRxIndicationName=PduR_CanIfRxIndication, CanIfRxPduUserRxIndicationUL=PDUR, CanIfRxPduReadData=false, CanIfRxPduReadNotifyStatus=false, CanIfRxPduDlcCheck=false:
        DRIVETRAIN_FD_3_oFDCAN2_d0fa3352_Rx: CanIfRxPduCanId=1068, CanIfRxPduCanIdType=STANDARD_CAN, CanIfRxPduDlc=32, CanIfRxPduId=32, CanIfRxPduHrhIdRef=CN_FDCAN2_4c0547f7_Rx, CanIfRxPduRef=DRIVETRAIN_FD_3_oFDCAN2_a178c37e_Rx
        AGSM_FD_2_oFDCAN2_b4392bd1_Rx: CanIfRxPduCanId=476, CanIfRxPduCanIdType=STANDARD_CAN, CanIfRxPduDlc=32, CanIfRxPduId=44, CanIfRxPduHrhIdRef=CN_FDCAN2_4c0547f7_Rx, CanIfRxPduRef=AGSM_FD_2_oFDCAN2_9af9f599_Rx
        PDC_INFO_FD_SGW_oFDCAN2_8b0ead97_Rx: CanIfRxPduCanId=506855536, CanIfRxPduCanIdType=EXTENDED_CAN, CanIfRxPduDlc=64, CanIfRxPduId=5, CanIfRxPduHrhIdRef=CN_FDCAN2_794f110f_Rx, CanIfRxPduRef=PDC_INFO_FD_SGW_oFDCAN2_2e2ff0c8_Rx
        ENGINE_FD_5_oFDCAN2_071576c3_Rx: CanIfRxPduCanId=518, CanIfRxPduCanIdType=STANDARD_CAN, CanIfRxPduDlc=32, CanIfRxPduId=42, CanIfRxPduHrhIdRef=CN_FDCAN2_4c0547f7_Rx, CanIfRxPduRef=ENGINE_FD_5_oFDCAN2_75e441f4_Rx
        BCM_FD_7_oFDCAN2_1c05063e_Rx: CanIfRxPduCanId=1827, CanIfRxPduCanIdType=STANDARD_CAN, CanIfRxPduDlc=32, CanIfRxPduId=12, CanIfRxPduHrhIdRef=CN_FDCAN2_4c0547f7_Rx, CanIfRxPduRef=BCM_FD_7_oFDCAN2_6e4703f9_Rx
        IPC_FD_1_oFDCAN2_255aca61_Rx: CanIfRxPduCanId=1829, CanIfRxPduCanIdType=STANDARD_CAN, CanIfRxPduDlc=32, CanIfRxPduId=11, CanIfRxPduHrhIdRef=CN_FDCAN2_4c0547f7_Rx, CanIfRxPduRef=IPC_FD_1_oFDCAN2_63f5b3e6_Rx
      CHNL_7d164bae (CanIfBufferCfg):
        CanIfBufferSize = 14
        CanIfTxBufferHandlingType = PRIO_BY_CANID
        CanIfTxBufferMappedTxPdus = 14
        CanIfTxBufferMaxPduLength = 64
        CanIfBufferHthRef = CN_FDCAN2_28a8fc44_Tx
      6 x CanIfRxPduCfg, all with CanIfRxPduUserRxIndicationName=PduR_CanIfRxIndication, CanIfRxPduUserRxIndicationUL=PDUR, CanIfRxPduReadData=false, CanIfRxPduReadNotifyStatus=false, CanIfRxPduDlcCheck=false:
        ENGINE_FD_7_oFDCAN2_75464136_Rx: CanIfRxPduCanId=1448, CanIfRxPduCanIdType=STANDARD_CAN, CanIfRxPduDlc=32, CanIfRxPduId=23, CanIfRxPduHrhIdRef=CN_FDCAN2_4c0547f7_Rx, CanIfRxPduRef=ENGINE_FD_7_oFDCAN2_e58267a9_Rx
        PDC_INFO_FD_TRLR_REV_oFDCAN2_76ae5916_Rx: CanIfRxPduCanId=506855601, CanIfRxPduCanIdType=EXTENDED_CAN, CanIfRxPduDlc=12, CanIfRxPduId=2, CanIfRxPduHrhIdRef=CN_FDCAN2_794f110f_Rx, CanIfRxPduRef=PDC_INFO_FD_TRLR_REV_oFDCAN2_e488d728_Rx
        VIN_oFDCAN2_de66582f_Rx: CanIfRxPduCanId=1053, CanIfRxPduCanIdType=STANDARD_CAN, CanIfRxPduDlc=32, CanIfRxPduId=35, CanIfRxPduHrhIdRef=CN_FDCAN2_4c0547f7_Rx, CanIfRxPduRef=VIN_oFDCAN2_664087b5_Rx
        PDC_INFO_FD_ORC_oFDCAN2_c0f4295b_Rx: CanIfRxPduCanId=506855450, CanIfRxPduCanIdType=EXTENDED_CAN, CanIfRxPduDlc=12, CanIfRxPduId=7, CanIfRxPduHrhIdRef=CN_FDCAN2_794f110f_Rx, CanIfRxPduRef=PDC_INFO_FD_ORC_oFDCAN2_17e9e0f6_Rx
        TRANSM_FD_1_oFDCAN2_1b1ca8bf_Rx: CanIfRxPduCanId=278, CanIfRxPduCanIdType=STANDARD_CAN, CanIfRxPduDlc=64, CanIfRxPduId=46, CanIfRxPduHrhIdRef=CN_FDCAN2_4c0547f7_Rx, CanIfRxPduRef=TRANSM_FD_1_oFDCAN2_dc1464b5_Rx
        BRAKE_FD_1_oFDCAN2_37fb9352_Rx: CanIfRxPduCanId=513, CanIfRxPduCanIdType=STANDARD_CAN, CanIfRxPduDlc=32, CanIfRxPduId=43, CanIfRxPduHrhIdRef=CN_FDCAN2_4c0547f7_Rx, CanIfRxPduRef=BRAKE_FD_1_oFDCAN2_d89892a0_Rx
      DIAGNOSTIC_ROE_FD_PAM_oFDCAN2_5f1d7fc3_Tx (CanIfTxPduCfg):
        CanIfTxPduCanId = 417198752
        CanIfTxPduCanIdType = EXTENDED_FD_CAN
        CanIfTxPduDlc = 64
        CanIfTxPduUserTxConfirmationName = NULL_PTR
        CanIfTxPduUserTxConfirmationUL = NONE
        CanIfTxPduId = 4
        CanIfTxPduReadNotifyStatus = false
        CanIfTxPduType = STATIC
        CanIfTxPduTruncation = true
        CanIfTxPduBufferRef = CHNL_7d164bae
        CanIfTxPduRef = DIAGNOSTIC_ROE_FD_PAM_oFDCAN2_5ecfbbbe_Tx
      5 x CanIfRxPduCfg, all with CanIfRxPduReadData=false, CanIfRxPduReadNotifyStatus=false, CanIfRxPduDlcCheck=false:
        PDC_INFO_FD_EPS_oFDCAN2_0100550f_Rx: CanIfRxPduCanId=506855426, CanIfRxPduCanIdType=EXTENDED_CAN, CanIfRxPduDlc=12, CanIfRxPduUserRxIndicationName=PduR_CanIfRxIndication, CanIfRxPduUserRxIndicationUL=PDUR, CanIfRxPduId=8, CanIfRxPduHrhIdRef=CN_FDCAN2_794f110f_Rx, CanIfRxPduRef=PDC_INFO_FD_EPS_oFDCAN2_452e6cff_Rx
        ENGINE_FD_2_oFDCAN2_45713606_Rx: CanIfRxPduCanId=262, CanIfRxPduCanIdType=STANDARD_CAN, CanIfRxPduDlc=64, CanIfRxPduUserRxIndicationName=PduR_CanIfRxIndication, CanIfRxPduUserRxIndicationUL=PDUR, CanIfRxPduId=48, CanIfRxPduHrhIdRef=CN_FDCAN2_4c0547f7_Rx, CanIfRxPduRef=ENGINE_FD_2_oFDCAN2_bbb4bd5c_Rx
        BRAKE_FD_5_oFDCAN14_2f8081eb_Rx: CanIfRxPduCanId=1155, CanIfRxPduCanIdType=STANDARD_CAN, CanIfRxPduDlc=32, CanIfRxPduUserRxIndicationName=PduR_CanIfRxIndication, CanIfRxPduUserRxIndicationUL=PDUR, CanIfRxPduId=57, CanIfRxPduHrhIdRef=CN_FDCAN14_67142aa6_Rx, CanIfRxPduRef=BRAKE_FD_5_oFDCAN14_e75fd6ca_Rx
        CVADAS_efa31eaf_Rx: CanIfRxPduCanIdType=EXTENDED_CAN, CanIfRxPduDlc=2, CanIfRxPduUserRxIndicationName=CanNm_RxIndication, CanIfRxPduUserRxIndicationUL=CAN_NM, CanIfRxPduId=53, CanIfRxPduHrhIdRef=CN_FDCAN14_525e7c5e_Rx, CanIfRxPduRef=CVADAS_d79d906c_Rx
          CHNL_9cb360c4 (CanIfRxPduCanIdRange): CanIfRxPduCanIdRangeLowerCanId=507002880, CanIfRxPduCanIdRangeUpperCanId=507003135
        PT_TORQUE_FD_1_oFDCAN14_a0affdba_Rx: CanIfRxPduCanId=255, CanIfRxPduCanIdType=STANDARD_CAN, CanIfRxPduDlc=48, CanIfRxPduUserRxIndicationName=PduR_CanIfRxIndication, CanIfRxPduUserRxIndicationUL=PDUR, CanIfRxPduId=69, CanIfRxPduHrhIdRef=CN_FDCAN14_67142aa6_Rx, CanIfRxPduRef=PT_TORQUE_FD_1_oFDCAN14_0134da63_Rx
      NM_PAM_oFDCAN14_636c02e4_Tx (CanIfTxPduCfg):
        CanIfTxPduCanId = 507002904
        CanIfTxPduCanIdType = EXTENDED_FD_CAN
        CanIfTxPduDlc = 2
        CanIfTxPduUserTxConfirmationName = NULL_PTR
        CanIfTxPduUserTxConfirmationUL = NONE
        CanIfTxPduId = 115
        CanIfTxPduReadNotifyStatus = false
        CanIfTxPduType = STATIC
        CanIfTxPduTruncation = true
        CanIfTxPduBufferRef = CHNL_79fa912a
        CanIfTxPduRef = NM_PAM_oFDCAN14_0d1e8b51_Tx
      5 x CanIfRxPduCfg, all with CanIfRxPduCanIdType=STANDARD_CAN, CanIfRxPduUserRxIndicationName=PduR_CanIfRxIndication, CanIfRxPduUserRxIndicationUL=PDUR, CanIfRxPduReadData=false, CanIfRxPduReadNotifyStatus=false, CanIfRxPduDlcCheck=false, CanIfRxPduHrhIdRef=CN_FDCAN14_67142aa6_Rx:
        EPS_FD_1_oFDCAN14_0ff3e6ff_Rx: CanIfRxPduCanId=264, CanIfRxPduDlc=32, CanIfRxPduId=64, CanIfRxPduRef=EPS_FD_1_oFDCAN14_1c675bff_Rx
        ENGINE_FD_2_oFDCAN14_05177771_Rx: CanIfRxPduCanId=262, CanIfRxPduDlc=64, CanIfRxPduId=65, CanIfRxPduRef=ENGINE_FD_2_oFDCAN14_95c64d4b_Rx
        BRAKE_FD_4_oFDCAN14_274e2aee_Rx: CanIfRxPduCanId=609, CanIfRxPduDlc=32, CanIfRxPduId=59, CanIfRxPduRef=BRAKE_FD_4_oFDCAN14_89d3cd8b_Rx
        EPS_FD_2_oFDCAN14_e882ffe3_Rx: CanIfRxPduCanId=1056, CanIfRxPduDlc=32, CanIfRxPduId=58, CanIfRxPduRef=EPS_FD_2_oFDCAN14_aff3763c_Rx
        ENGINE_FD_7_oFDCAN14_6291a34e_Rx: CanIfRxPduCanId=1448, CanIfRxPduDlc=32, CanIfRxPduId=56, CanIfRxPduRef=ENGINE_FD_7_oFDCAN14_9a0b3d4f_Rx
      CVPAM_FD_Control_oFDCAN14_f55d7751_Tx (CanIfTxPduCfg):
        CanIfTxPduCanId = 275
        CanIfTxPduCanIdType = STANDARD_FD_CAN
        CanIfTxPduDlc = 32
        CanIfTxPduUserTxConfirmationName = NULL_PTR
        CanIfTxPduUserTxConfirmationUL = NONE
        CanIfTxPduId = 120
        CanIfTxPduReadNotifyStatus = false
        CanIfTxPduType = STATIC
        CanIfTxPduTruncation = true
        CanIfTxPduBufferRef = CHNL_79fa912a
        CanIfTxPduRef = CVPAM_FD_Control_oFDCAN14_8b1b60a1_Tx
      BRAKE_FD_2_oFDCAN14_15e9d0f0_Rx (CanIfRxPduCfg):
        CanIfRxPduCanId = 258
        CanIfRxPduCanIdType = STANDARD_CAN
        CanIfRxPduDlc = 64
        CanIfRxPduUserRxIndicationName = PduR_CanIfRxIndication
        CanIfRxPduUserRxIndicationUL = PDUR
        CanIfRxPduId = 67
        CanIfRxPduReadData = false
        CanIfRxPduReadNotifyStatus = false
        CanIfRxPduDlcCheck = false
        CanIfRxPduHrhIdRef = CN_FDCAN14_67142aa6_Rx
        CanIfRxPduRef = BRAKE_FD_2_oFDCAN14_358a904c_Rx
      ADAS_FD_INFO_oFDCAN14_23de1d3b_Rx (CanIfRxPduCfg):
        CanIfRxPduCanId = 280
        CanIfRxPduCanIdType = STANDARD_CAN
        CanIfRxPduDlc = 32
        CanIfRxPduUserRxIndicationName = PduR_CanIfRxIndication
        CanIfRxPduUserRxIndicationUL = PDUR
        CanIfRxPduId = 63
        CanIfRxPduReadData = false
        CanIfRxPduReadNotifyStatus = false
        CanIfRxPduDlcCheck = false
        CanIfRxPduHrhIdRef = CN_FDCAN14_67142aa6_Rx
        CanIfRxPduRef = ADAS_FD_INFO_oFDCAN14_a55fd54d_Rx
      TRSCM_FD_1_oFDCAN14_24b0a50e_Tx (CanIfTxPduCfg):
        CanIfTxPduCanId = 1472
        CanIfTxPduCanIdType = STANDARD_FD_CAN
        CanIfTxPduDlc = 32
        CanIfTxPduUserTxConfirmationName = PduR_CanIfTxConfirmation
        CanIfTxPduUserTxConfirmationUL = PDUR
        CanIfTxPduId = 116
        CanIfTxPduReadNotifyStatus = false
        CanIfTxPduType = STATIC
        CanIfTxPduTruncation = true
        CanIfTxPduBufferRef = CHNL_79fa912a
        CanIfTxPduRef = TRSCM_FD_1_oFDCAN14_4ddc266d_Tx
      4 x CanIfRxPduCfg, all with CanIfRxPduCanIdType=STANDARD_CAN, CanIfRxPduUserRxIndicationName=PduR_CanIfRxIndication, CanIfRxPduUserRxIndicationUL=PDUR, CanIfRxPduReadData=false, CanIfRxPduReadNotifyStatus=false, CanIfRxPduDlcCheck=false, CanIfRxPduHrhIdRef=CN_FDCAN14_67142aa6_Rx:
        BRAKE_FD_1_oFDCAN14_0cba2dff_Rx: CanIfRxPduCanId=513, CanIfRxPduDlc=32, CanIfRxPduId=62, CanIfRxPduRef=BRAKE_FD_1_oFDCAN14_861ebd8f_Rx
        ENGINE_FD_5_oFDCAN14_5e6dd4a8_Rx: CanIfRxPduCanId=518, CanIfRxPduDlc=32, CanIfRxPduId=60, CanIfRxPduRef=ENGINE_FD_5_oFDCAN14_47130bcd_Rx
        BRAKE_FD_7_oFDCAN14_3e1dd7e1_Rx: CanIfRxPduCanId=514, CanIfRxPduDlc=32, CanIfRxPduId=61, CanIfRxPduRef=BRAKE_FD_7_oFDCAN14_3a47e048_Rx
        BRAKE_FD_6_oFDCAN14_36d37ce4_Rx: CanIfRxPduCanId=205, CanIfRxPduDlc=64, CanIfRxPduId=70, CanIfRxPduRef=BRAKE_FD_6_oFDCAN14_54cbfb09_Rx
      CHNL_79fa912a (CanIfBufferCfg):
        CanIfBufferSize = 107
        CanIfTxBufferHandlingType = PRIO_BY_CANID
        CanIfTxBufferMappedTxPdus = 107
        CanIfTxBufferMaxPduLength = 64
        CanIfBufferHthRef = CN_FDCAN14_a902658e_Tx
      CVPAM_FD_Info_oFDCAN14_98d10c56_Tx (CanIfTxPduCfg):
        CanIfTxPduCanId = 950
        CanIfTxPduCanIdType = STANDARD_FD_CAN
        CanIfTxPduDlc = 32
        CanIfTxPduUserTxConfirmationName = NULL_PTR
        CanIfTxPduUserTxConfirmationUL = NONE
        CanIfTxPduId = 117
        CanIfTxPduReadNotifyStatus = false
        CanIfTxPduType = STATIC
        CanIfTxPduTruncation = true
        CanIfTxPduBufferRef = CHNL_79fa912a
        CanIfTxPduRef = CVPAM_FD_Info_oFDCAN14_838aefa3_Tx
      BRAKE_FD_3_oFDCAN14_1d277bf5_Rx (CanIfRxPduCfg):
        CanIfRxPduCanId = 259
        CanIfRxPduCanIdType = STANDARD_CAN
        CanIfRxPduDlc = 32
        CanIfRxPduUserRxIndicationName = PduR_CanIfRxIndication
        CanIfRxPduUserRxIndicationUL = PDUR
        CanIfRxPduId = 66
        CanIfRxPduReadData = false
        CanIfRxPduReadNotifyStatus = false
        CanIfRxPduDlcCheck = false
        CanIfRxPduHrhIdRef = CN_FDCAN14_67142aa6_Rx
        CanIfRxPduRef = BRAKE_FD_3_oFDCAN14_5b068b0d_Rx
      XCP_Tx_oFDCAN2_dec73f67_Tx (CanIfTxPduCfg):
        CanIfTxPduCanId = 507330584
        CanIfTxPduCanIdType = EXTENDED_FD_CAN
        CanIfTxPduDlc = 8
        CanIfTxPduId = 0
        CanIfTxPduReadNotifyStatus = false
        CanIfTxPduType = STATIC
        CanIfTxPduUserTxConfirmationUL = XCP
        CanIfTxPduTruncation = true
        CanIfTxPduUserTxConfirmationName = Xcp_CanIfTxConfirmation
        CanIfTxPduBufferRef = CHNL_7d164bae
        CanIfTxPduRef = XCP_Tx_oFDCAN2_538ae81a_Tx
      3 x CanIfRxPduCfg, all with CanIfRxPduReadData=false, CanIfRxPduReadNotifyStatus=false, CanIfRxPduDlcCheck=false:
        XCP_Rx_oFDCAN2_957ff1e4_Rx: CanIfRxPduCanId=507068440, CanIfRxPduCanIdType=EXTENDED_CAN, CanIfRxPduDlc=8, CanIfRxPduId=1, CanIfRxPduUserRxIndicationName=Xcp_CanIfRxIndication, CanIfRxPduUserRxIndicationUL=XCP, CanIfRxPduHrhIdRef=CN_FDCAN2_794f110f_Rx, CanIfRxPduRef=XCP_Rx_oFDCAN2_6c5435ab_Rx
        BRAKE2_FD_1_oFDCAN14_d8d4c6d0_Rx: CanIfRxPduCanId=257, CanIfRxPduCanIdType=STANDARD_CAN, CanIfRxPduDlc=64, CanIfRxPduUserRxIndicationName=PduR_CanIfRxIndication, CanIfRxPduUserRxIndicationUL=PDUR, CanIfRxPduId=68, CanIfRxPduHrhIdRef=CN_FDCAN14_67142aa6_Rx, CanIfRxPduRef=BRAKE2_FD_1_oFDCAN14_e3eb706b_Rx
        SetUSSParkingMode_oFDCAN14_120f62ca_Rx: CanIfRxPduCanId=507068488, CanIfRxPduCanIdType=EXTENDED_CAN, CanIfRxPduDlc=1, CanIfRxPduUserRxIndicationName=NULL_PTR, CanIfRxPduUserRxIndicationUL=NONE, CanIfRxPduId=54, CanIfRxPduHrhIdRef=CN_FDCAN14_525e7c5e_Rx, CanIfRxPduRef=SetUSSParkingMode_oFDCAN14_bb071e4b_Rx
      85 x CanIfTxPduCfg, all with CanIfTxPduReadNotifyStatus=false, CanIfTxPduType=STATIC, CanIfTxPduTruncation=true:
        ADAS_FD_LANES_1_oFDCAN2_60bc77b3_Tx: CanIfTxPduCanId=730, CanIfTxPduCanIdType=STANDARD_FD_CAN, CanIfTxPduDlc=64, CanIfTxPduUserTxConfirmationName=NULL_PTR, CanIfTxPduUserTxConfirmationUL=NONE, CanIfTxPduId=12, CanIfTxPduBufferRef=CHNL_7d164bae, CanIfTxPduRef=ADAS_FD_LANES_1_oFDCAN2_671c0d83_Tx
        ADAS_FD_LANES_2_oFDCAN14_1fc7bdbe_Tx: CanIfTxPduCanId=734, CanIfTxPduCanIdType=STANDARD_FD_CAN, CanIfTxPduDlc=64, CanIfTxPduUserTxConfirmationName=NULL_PTR, CanIfTxPduUserTxConfirmationUL=NONE, CanIfTxPduId=118, CanIfTxPduBufferRef=CHNL_79fa912a, CanIfTxPduRef=ADAS_FD_LANES_2_oFDCAN14_eb93d67c_Tx
        ADAS_FD_LANES_2_oFDCAN2_b32c517d_Tx: CanIfTxPduCanId=734, CanIfTxPduCanIdType=STANDARD_FD_CAN, CanIfTxPduDlc=64, CanIfTxPduUserTxConfirmationName=NULL_PTR, CanIfTxPduUserTxConfirmationUL=NONE, CanIfTxPduId=11, CanIfTxPduBufferRef=CHNL_7d164bae, CanIfTxPduRef=ADAS_FD_LANES_2_oFDCAN2_52f1bbd0_Tx
        HMI_Curr_Requested_Overlays_oFDCAN14_5ad84df2_Tx: CanIfTxPduCanId=507068496, CanIfTxPduCanIdType=EXTENDED_FD_CAN, CanIfTxPduDlc=16, CanIfTxPduUserTxConfirmationName=NULL_PTR, CanIfTxPduUserTxConfirmationUL=NONE, CanIfTxPduId=114, CanIfTxPduBufferRef=CHNL_79fa912a, CanIfTxPduRef=HMI_Curr_Requested_Overlays_oFDCAN14_854dec1c_Tx
        ADAS_FD_LANES_1_oFDCAN14_03fcfef0_Tx: CanIfTxPduCanId=730, CanIfTxPduCanIdType=STANDARD_FD_CAN, CanIfTxPduDlc=64, CanIfTxPduUserTxConfirmationName=NULL_PTR, CanIfTxPduUserTxConfirmationUL=NONE, CanIfTxPduId=119, CanIfTxPduBufferRef=CHNL_79fa912a, CanIfTxPduRef=ADAS_FD_LANES_1_oFDCAN14_5807fbbf_Tx
        Minimum_Sensor_Distance_3_oFDCAN14_29aa616f_Tx: CanIfTxPduCanId=507330624, CanIfTxPduCanIdType=EXTENDED_FD_CAN, CanIfTxPduDlc=7, CanIfTxPduUserTxConfirmationName=PduR_CanIfTxConfirmation, CanIfTxPduUserTxConfirmationUL=PDUR, CanIfTxPduId=20, CanIfTxPduBufferRef=CHNL_79fa912a, CanIfTxPduRef=Minimum_Sensor_Distance_3_oFDCAN14_9131df6e_Tx
        Log_SnrTemperature_oFDCAN14_4577f469_Tx: CanIfTxPduCanId=507330589, CanIfTxPduCanIdType=EXTENDED_FD_CAN, CanIfTxPduDlc=64, CanIfTxPduUserTxConfirmationName=PduR_CanIfTxConfirmation, CanIfTxPduUserTxConfirmationUL=PDUR, CanIfTxPduId=30, CanIfTxPduBufferRef=CHNL_79fa912a, CanIfTxPduRef=Log_SnrTemperature_oFDCAN14_f8c16d66_Tx
        TRSC_Debug_Message3_oFDCAN14_35eb5fb3_Tx: CanIfTxPduCanId=507068518, CanIfTxPduCanIdType=EXTENDED_FD_CAN, CanIfTxPduDlc=64, CanIfTxPduUserTxConfirmationName=PduR_CanIfTxConfirmation, CanIfTxPduUserTxConfirmationUL=PDUR, CanIfTxPduId=98, CanIfTxPduBufferRef=CHNL_79fa912a, CanIfTxPduRef=TRSC_Debug_Message3_oFDCAN14_43f8ea13_Tx
        TRSC_Debug_Message1_oFDCAN14_9fe258bf_Tx: CanIfTxPduCanId=507068503, CanIfTxPduCanIdType=EXTENDED_FD_CAN, CanIfTxPduDlc=64, CanIfTxPduUserTxConfirmationName=PduR_CanIfTxConfirmation, CanIfTxPduUserTxConfirmationUL=PDUR, CanIfTxPduId=107, CanIfTxPduBufferRef=CHNL_79fa912a, CanIfTxPduRef=TRSC_Debug_Message1_oFDCAN14_9ee0dc91_Tx
        Distance_Point_Map_1_oFDCAN14_0f459f4c_Tx: CanIfTxPduCanId=507068548, CanIfTxPduCanIdType=EXTENDED_FD_CAN, CanIfTxPduDlc=64, CanIfTxPduUserTxConfirmationName=PduR_CanIfTxConfirmation, CanIfTxPduUserTxConfirmationUL=PDUR, CanIfTxPduId=80, CanIfTxPduBufferRef=CHNL_79fa912a, CanIfTxPduRef=Distance_Point_Map_1_oFDCAN14_0990ecd1_Tx
        MOT_Obj_4_5_oFDCAN14_cf8dc798_Tx: CanIfTxPduCanId=507068533, CanIfTxPduCanIdType=EXTENDED_FD_CAN, CanIfTxPduDlc=64, CanIfTxPduUserTxConfirmationName=PduR_CanIfTxConfirmation, CanIfTxPduUserTxConfirmationUL=PDUR, CanIfTxPduId=89, CanIfTxPduBufferRef=CHNL_79fa912a, CanIfTxPduRef=MOT_Obj_4_5_oFDCAN14_0e6b1ca1_Tx
        Distance_Point_Map_9_oFDCAN14_ed3689c6_Tx: CanIfTxPduCanId=507068562, CanIfTxPduCanIdType=EXTENDED_FD_CAN, CanIfTxPduDlc=64, CanIfTxPduUserTxConfirmationName=PduR_CanIfTxConfirmation, CanIfTxPduUserTxConfirmationUL=PDUR, CanIfTxPduId=72, CanIfTxPduBufferRef=CHNL_79fa912a, CanIfTxPduRef=Distance_Point_Map_9_oFDCAN14_cb123a5b_Tx
        USSDebugInfo1_oFDCAN14_71151b40_Tx: CanIfTxPduCanId=507068680, CanIfTxPduCanIdType=EXTENDED_FD_CAN, CanIfTxPduDlc=64, CanIfTxPduUserTxConfirmationName=PduR_CanIfTxConfirmation, CanIfTxPduUserTxConfirmationUL=PDUR, CanIfTxPduId=56, CanIfTxPduBufferRef=CHNL_79fa912a, CanIfTxPduRef=USSDebugInfo1_oFDCAN14_3a0946df_Tx
        Minimum_Sensor_Distance_2_oFDCAN14_23601cc6_Tx: CanIfTxPduCanId=507330623, CanIfTxPduCanIdType=EXTENDED_FD_CAN, CanIfTxPduDlc=8, CanIfTxPduUserTxConfirmationName=PduR_CanIfTxConfirmation, CanIfTxPduUserTxConfirmationUL=PDUR, CanIfTxPduId=21, CanIfTxPduBufferRef=CHNL_79fa912a, CanIfTxPduRef=Minimum_Sensor_Distance_2_oFDCAN14_ffbdc42f_Tx
        Distance_Point_Map_0_oFDCAN14_65d7bc0d_Tx: CanIfTxPduCanId=507068547, CanIfTxPduCanIdType=EXTENDED_FD_CAN, CanIfTxPduDlc=64, CanIfTxPduUserTxConfirmationName=PduR_CanIfTxConfirmation, CanIfTxPduUserTxConfirmationUL=PDUR, CanIfTxPduId=81, CanIfTxPduBufferRef=CHNL_79fa912a, CanIfTxPduRef=Distance_Point_Map_0_oFDCAN14_671cf790_Tx
        Debug_TargetData_oFDCAN14_78b5aec6_Tx: CanIfTxPduCanId=507068513, CanIfTxPduCanIdType=EXTENDED_FD_CAN, CanIfTxPduDlc=64, CanIfTxPduUserTxConfirmationName=PduR_CanIfTxConfirmation, CanIfTxPduUserTxConfirmationUL=PDUR, CanIfTxPduId=103, CanIfTxPduBufferRef=CHNL_79fa912a, CanIfTxPduRef=Debug_TargetData_oFDCAN14_2a76e006_Tx
        Diagnostics_Flags_oFDCAN14_82d05e9d_Tx: CanIfTxPduCanId=507330561, CanIfTxPduCanIdType=EXTENDED_FD_CAN, CanIfTxPduDlc=8, CanIfTxPduUserTxConfirmationName=PduR_CanIfTxConfirmation, CanIfTxPduUserTxConfirmationUL=PDUR, CanIfTxPduId=38, CanIfTxPduBufferRef=CHNL_79fa912a, CanIfTxPduRef=Diagnostics_Flags_oFDCAN14_35bb7a38_Tx
        FODDebug_oFDCAN14_0f411cd7_Tx: CanIfTxPduCanId=507068545, CanIfTxPduCanIdType=EXTENDED_FD_CAN, CanIfTxPduDlc=64, CanIfTxPduUserTxConfirmationName=PduR_CanIfTxConfirmation, CanIfTxPduUserTxConfirmationUL=PDUR, CanIfTxPduId=83, CanIfTxPduBufferRef=CHNL_79fa912a, CanIfTxPduRef=FODDebug_oFDCAN14_f1ba2bbb_Tx
        Debug_AP_Variables_oFDCAN14_07efddff_Tx: CanIfTxPduCanId=507068521, CanIfTxPduCanIdType=EXTENDED_FD_CAN, CanIfTxPduDlc=64, CanIfTxPduUserTxConfirmationName=PduR_CanIfTxConfirmation, CanIfTxPduUserTxConfirmationUL=PDUR, CanIfTxPduId=95, CanIfTxPduBufferRef=CHNL_79fa912a, CanIfTxPduRef=Debug_AP_Variables_oFDCAN14_9068652c_Tx
        Log_SnrMeasData_03_oFDCAN14_11beb26e_Tx: CanIfTxPduCanId=507330599, CanIfTxPduCanIdType=EXTENDED_FD_CAN, CanIfTxPduDlc=64, CanIfTxPduUserTxConfirmationName=PduR_CanIfTxConfirmation, CanIfTxPduUserTxConfirmationUL=PDUR, CanIfTxPduId=26, CanIfTxPduBufferRef=CHNL_79fa912a, CanIfTxPduRef=Log_SnrMeasData_03_oFDCAN14_95016334_Tx
        Log_SnrMeasData_02_oFDCAN14_671c2b4e_Tx: CanIfTxPduCanId=507330583, CanIfTxPduCanIdType=EXTENDED_FD_CAN, CanIfTxPduDlc=64, CanIfTxPduUserTxConfirmationName=PduR_CanIfTxConfirmation, CanIfTxPduUserTxConfirmationUL=PDUR, CanIfTxPduId=36, CanIfTxPduBufferRef=CHNL_79fa912a, CanIfTxPduRef=Log_SnrMeasData_02_oFDCAN14_fb8d7875_Tx
        Distance_Point_Map_3_oFDCAN14_da61d9ce_Tx: CanIfTxPduCanId=507068550, CanIfTxPduCanIdType=EXTENDED_FD_CAN, CanIfTxPduDlc=64, CanIfTxPduUserTxConfirmationName=PduR_CanIfTxConfirmation, CanIfTxPduUserTxConfirmationUL=PDUR, CanIfTxPduId=78, CanIfTxPduBufferRef=CHNL_79fa912a, CanIfTxPduRef=Distance_Point_Map_3_oFDCAN14_d488da53_Tx
        Log_SnrMeasData_04_oFDCAN14_8ba27bcf_Tx: CanIfTxPduCanId=507330585, CanIfTxPduCanIdType=EXTENDED_FD_CAN, CanIfTxPduDlc=64, CanIfTxPduUserTxConfirmationName=PduR_CanIfTxConfirmation, CanIfTxPduUserTxConfirmationUL=PDUR, CanIfTxPduId=34, CanIfTxPduBufferRef=CHNL_79fa912a, CanIfTxPduRef=Log_SnrMeasData_04_oFDCAN14_47d425b2_Tx
        HMI_Curr_Displayed_Overlays_oFDCAN14_228998f0_Tx: CanIfTxPduCanId=507068497, CanIfTxPduCanIdType=EXTENDED_FD_CAN, CanIfTxPduDlc=16, CanIfTxPduUserTxConfirmationName=PduR_CanIfTxConfirmation, CanIfTxPduUserTxConfirmationUL=PDUR, CanIfTxPduId=113, CanIfTxPduBufferRef=CHNL_79fa912a, CanIfTxPduRef=HMI_Curr_Displayed_Overlays_oFDCAN14_59fc11fc_Tx
        TRSC_Detection_DebugMessage_oFDCAN14_e6f5f3c5_Tx: CanIfTxPduCanId=507068519, CanIfTxPduCanIdType=EXTENDED_FD_CAN, CanIfTxPduDlc=64, CanIfTxPduUserTxConfirmationName=PduR_CanIfTxConfirmation, CanIfTxPduUserTxConfirmationUL=PDUR, CanIfTxPduId=97, CanIfTxPduBufferRef=CHNL_79fa912a, CanIfTxPduRef=TRSC_Detection_DebugMessage_oFDCAN14_7bfeb44b_Tx
        Firing_Sequence_oFDCAN14_afdc26b0_Tx: CanIfTxPduCanId=507068567, CanIfTxPduCanIdType=EXTENDED_FD_CAN, CanIfTxPduDlc=8, CanIfTxPduUserTxConfirmationName=PduR_CanIfTxConfirmation, CanIfTxPduUserTxConfirmationUL=PDUR, CanIfTxPduId=67, CanIfTxPduBufferRef=CHNL_79fa912a, CanIfTxPduRef=Firing_Sequence_oFDCAN14_ae988165_Tx
        HMI_Curr_Requested_ProxiConfig_oFDCAN14_69d6981b_Tx: CanIfTxPduCanId=507068498, CanIfTxPduCanIdType=EXTENDED_FD_CAN, CanIfTxPduDlc=16, CanIfTxPduUserTxConfirmationName=PduR_CanIfTxConfirmation, CanIfTxPduUserTxConfirmationUL=PDUR, CanIfTxPduId=112, CanIfTxPduBufferRef=CHNL_79fa912a, CanIfTxPduRef=HMI_Curr_Requested_ProxiConfig_oFDCAN14_6d69f768_Tx
        TRSC_Debug_Message2_oFDCAN14_60efdc35_Tx: CanIfTxPduCanId=507068517, CanIfTxPduCanIdType=EXTENDED_FD_CAN, CanIfTxPduDlc=64, CanIfTxPduUserTxConfirmationName=PduR_CanIfTxConfirmation, CanIfTxPduUserTxConfirmationUL=PDUR, CanIfTxPduId=99, CanIfTxPduBufferRef=CHNL_79fa912a, CanIfTxPduRef=TRSC_Debug_Message2_oFDCAN14_2d74f152_Tx
        LMD_LaneLinesDebug_1_oFDCAN14_29eb5310_Tx: CanIfTxPduCanId=507068536, CanIfTxPduCanIdType=EXTENDED_FD_CAN, CanIfTxPduDlc=64, CanIfTxPduUserTxConfirmationName=PduR_CanIfTxConfirmation, CanIfTxPduUserTxConfirmationUL=PDUR, CanIfTxPduId=86, CanIfTxPduBufferRef=CHNL_79fa912a, CanIfTxPduRef=LMD_LaneLinesDebug_1_oFDCAN14_7d65846f_Tx
        Distance_Point_Map_4_oFDCAN14_14ee3748_Tx: CanIfTxPduCanId=507068551, CanIfTxPduCanIdType=EXTENDED_FD_CAN, CanIfTxPduDlc=64, CanIfTxPduUserTxConfirmationName=PduR_CanIfTxConfirmation, CanIfTxPduUserTxConfirmationUL=PDUR, CanIfTxPduId=77, CanIfTxPduBufferRef=CHNL_79fa912a, CanIfTxPduRef=Distance_Point_Map_4_oFDCAN14_065d9cd5_Tx
        HMI_Curr_Displayed_ProxiConfig_oFDCAN14_4ee7a674_Tx: CanIfTxPduCanId=507068499, CanIfTxPduCanIdType=EXTENDED_FD_CAN, CanIfTxPduDlc=16, CanIfTxPduUserTxConfirmationName=PduR_CanIfTxConfirmation, CanIfTxPduUserTxConfirmationUL=PDUR, CanIfTxPduId=111, CanIfTxPduBufferRef=CHNL_79fa912a, CanIfTxPduRef=HMI_Curr_Displayed_ProxiConfig_oFDCAN14_d9ff3bfe_Tx
        PLDDebugInfo2_oFDCAN14_12211571_Tx: CanIfTxPduCanId=507068679, CanIfTxPduCanIdType=EXTENDED_FD_CAN, CanIfTxPduDlc=20, CanIfTxPduUserTxConfirmationName=PduR_CanIfTxConfirmation, CanIfTxPduUserTxConfirmationUL=PDUR, CanIfTxPduId=57, CanIfTxPduBufferRef=CHNL_79fa912a, CanIfTxPduRef=PLDDebugInfo2_oFDCAN14_64c489e5_Tx
        Distance_Point_Map_10_oFDCAN14_4563a97d_Tx: CanIfTxPduCanId=507068563, CanIfTxPduCanIdType=EXTENDED_FD_CAN, CanIfTxPduDlc=64, CanIfTxPduUserTxConfirmationName=PduR_CanIfTxConfirmation, CanIfTxPduUserTxConfirmationUL=PDUR, CanIfTxPduId=71, CanIfTxPduBufferRef=CHNL_79fa912a, CanIfTxPduRef=Distance_Point_Map_10_oFDCAN14_1c0010fe_Tx
        Log_SnrMeasData_07_oFDCAN14_1045d0af_Tx: CanIfTxPduCanId=507330588, CanIfTxPduCanIdType=EXTENDED_FD_CAN, CanIfTxPduDlc=64, CanIfTxPduUserTxConfirmationName=PduR_CanIfTxConfirmation, CanIfTxPduUserTxConfirmationUL=PDUR, CanIfTxPduId=31, CanIfTxPduBufferRef=CHNL_79fa912a, CanIfTxPduRef=Log_SnrMeasData_07_oFDCAN14_f4400871_Tx
        Debug_ErrCodeAlgo_oFDCAN14_78756c50_Tx: CanIfTxPduCanId=507068568, CanIfTxPduCanIdType=EXTENDED_FD_CAN, CanIfTxPduDlc=64, CanIfTxPduUserTxConfirmationName=PduR_CanIfTxConfirmation, CanIfTxPduUserTxConfirmationUL=PDUR, CanIfTxPduId=66, CanIfTxPduBufferRef=CHNL_79fa912a, CanIfTxPduRef=Debug_ErrCodeAlgo_oFDCAN14_8f5e00dc_Tx
        Debug_HMI_Input_Data_oFDCAN14_3b9e1113_Tx: CanIfTxPduCanId=507068501, CanIfTxPduCanIdType=EXTENDED_FD_CAN, CanIfTxPduDlc=64, CanIfTxPduUserTxConfirmationName=PduR_CanIfTxConfirmation, CanIfTxPduUserTxConfirmationUL=PDUR, CanIfTxPduId=109, CanIfTxPduBufferRef=CHNL_79fa912a, CanIfTxPduRef=Debug_HMI_Input_Data_oFDCAN14_f2609efd_Tx
        Log_SnrMeasData_06_oFDCAN14_66e7498f_Tx: CanIfTxPduCanId=507330587, CanIfTxPduCanIdType=EXTENDED_FD_CAN, CanIfTxPduDlc=64, CanIfTxPduUserTxConfirmationName=PduR_CanIfTxConfirmation, CanIfTxPduUserTxConfirmationUL=PDUR, CanIfTxPduId=32, CanIfTxPduBufferRef=CHNL_79fa912a, CanIfTxPduRef=Log_SnrMeasData_06_oFDCAN14_9acc1330_Tx
        FPADebugInfo1_oFDCAN14_ba73bd7c_Tx: CanIfTxPduCanId=507068688, CanIfTxPduCanIdType=EXTENDED_FD_CAN, CanIfTxPduDlc=64, CanIfTxPduUserTxConfirmationName=PduR_CanIfTxConfirmation, CanIfTxPduUserTxConfirmationUL=PDUR, CanIfTxPduId=54, CanIfTxPduBufferRef=CHNL_79fa912a, CanIfTxPduRef=FPADebugInfo1_oFDCAN14_2f618197_Tx
        TRSC_FID_DebugMessage_oFDCAN14_04f18303_Tx: CanIfTxPduCanId=507068520, CanIfTxPduCanIdType=EXTENDED_FD_CAN, CanIfTxPduDlc=64, CanIfTxPduUserTxConfirmationName=PduR_CanIfTxConfirmation, CanIfTxPduUserTxConfirmationUL=PDUR, CanIfTxPduId=96, CanIfTxPduBufferRef=CHNL_79fa912a, CanIfTxPduRef=TRSC_FID_DebugMessage_oFDCAN14_25624ab4_Tx
        Distance_Point_Map_5_oFDCAN14_7e7c1409_Tx: CanIfTxPduCanId=507068552, CanIfTxPduCanIdType=EXTENDED_FD_CAN, CanIfTxPduDlc=64, CanIfTxPduUserTxConfirmationName=PduR_CanIfTxConfirmation, CanIfTxPduUserTxConfirmationUL=PDUR, CanIfTxPduId=76, CanIfTxPduBufferRef=CHNL_79fa912a, CanIfTxPduRef=Distance_Point_Map_5_oFDCAN14_68d18794_Tx
        MOT_Obj_6_7_oFDCAN14_35343c77_Tx: CanIfTxPduCanId=507068534, CanIfTxPduCanIdType=EXTENDED_FD_CAN, CanIfTxPduDlc=64, CanIfTxPduUserTxConfirmationName=PduR_CanIfTxConfirmation, CanIfTxPduUserTxConfirmationUL=PDUR, CanIfTxPduId=88, CanIfTxPduBufferRef=CHNL_79fa912a, CanIfTxPduRef=MOT_Obj_6_7_oFDCAN14_157c986b_Tx
        PntDebugData_0_oFDCAN14_ae19e827_Tx: CanIfTxPduCanId=507330625, CanIfTxPduCanIdType=EXTENDED_FD_CAN, CanIfTxPduDlc=64, CanIfTxPduUserTxConfirmationName=PduR_CanIfTxConfirmation, CanIfTxPduUserTxConfirmationUL=PDUR, CanIfTxPduId=19, CanIfTxPduBufferRef=CHNL_79fa912a, CanIfTxPduRef=PntDebugData_0_oFDCAN14_9851f785_Tx
        ME_DebugMsgUnsigned_oFDCAN14_e8b674cc_Tx: CanIfTxPduCanId=507330592, CanIfTxPduCanIdType=EXTENDED_FD_CAN, CanIfTxPduDlc=8, CanIfTxPduUserTxConfirmationName=PduR_CanIfTxConfirmation, CanIfTxPduUserTxConfirmationUL=PDUR, CanIfTxPduId=28, CanIfTxPduBufferRef=CHNL_79fa912a, CanIfTxPduRef=ME_DebugMsgUnsigned_oFDCAN14_6e07688e_Tx
        Debug_OCCalib_Data_oFDCAN14_99914301_Tx: CanIfTxPduCanId=507068512, CanIfTxPduCanIdType=EXTENDED_FD_CAN, CanIfTxPduDlc=64, CanIfTxPduUserTxConfirmationName=PduR_CanIfTxConfirmation, CanIfTxPduUserTxConfirmationUL=PDUR, CanIfTxPduId=104, CanIfTxPduBufferRef=CHNL_79fa912a, CanIfTxPduRef=Debug_OCCalib_Data_oFDCAN14_a09c1bc6_Tx
        Distance_Point_Map_6_oFDCAN14_c1ca71ca_Tx: CanIfTxPduCanId=507068553, CanIfTxPduCanIdType=EXTENDED_FD_CAN, CanIfTxPduDlc=64, CanIfTxPduUserTxConfirmationName=PduR_CanIfTxConfirmation, CanIfTxPduUserTxConfirmationUL=PDUR, CanIfTxPduId=75, CanIfTxPduBufferRef=CHNL_79fa912a, CanIfTxPduRef=Distance_Point_Map_6_oFDCAN14_db45aa57_Tx
        Debug_ModuleState_oFDCAN14_96e19c7d_Tx: CanIfTxPduCanId=507068672, CanIfTxPduCanIdType=EXTENDED_FD_CAN, CanIfTxPduDlc=64, CanIfTxPduUserTxConfirmationName=PduR_CanIfTxConfirmation, CanIfTxPduUserTxConfirmationUL=PDUR, CanIfTxPduId=64, CanIfTxPduBufferRef=CHNL_79fa912a, CanIfTxPduRef=Debug_ModuleState_oFDCAN14_fcd53415_Tx
        LMD_SegmentDebug_1_oFDCAN14_3a13c4d8_Tx: CanIfTxPduCanId=507068674, CanIfTxPduCanIdType=EXTENDED_FD_CAN, CanIfTxPduDlc=64, CanIfTxPduUserTxConfirmationName=PduR_CanIfTxConfirmation, CanIfTxPduUserTxConfirmationUL=PDUR, CanIfTxPduId=62, CanIfTxPduBufferRef=CHNL_79fa912a, CanIfTxPduRef=LMD_SegmentDebug_1_oFDCAN14_98429779_Tx
        THADebugInfo1_oFDCAN14_d5bcde63_Tx: CanIfTxPduCanId=507068537, CanIfTxPduCanIdType=EXTENDED_FD_CAN, CanIfTxPduDlc=64, CanIfTxPduUserTxConfirmationName=PduR_CanIfTxConfirmation, CanIfTxPduUserTxConfirmationUL=PDUR, CanIfTxPduId=85, CanIfTxPduBufferRef=CHNL_79fa912a, CanIfTxPduRef=THADebugInfo1_oFDCAN14_83163028_Tx
        Distance_Point_Map_7_oFDCAN14_ab58528b_Tx: CanIfTxPduCanId=507068560, CanIfTxPduCanIdType=EXTENDED_FD_CAN, CanIfTxPduDlc=64, CanIfTxPduUserTxConfirmationName=PduR_CanIfTxConfirmation, CanIfTxPduUserTxConfirmationUL=PDUR, CanIfTxPduId=74, CanIfTxPduBufferRef=CHNL_79fa912a, CanIfTxPduRef=Distance_Point_Map_7_oFDCAN14_b5c9b116_Tx
        Debug_NFCD_Obj_0_4_oFDCAN14_a030e1d4_Tx: CanIfTxPduCanId=507068528, CanIfTxPduCanIdType=EXTENDED_FD_CAN, CanIfTxPduDlc=64, CanIfTxPduUserTxConfirmationName=PduR_CanIfTxConfirmation, CanIfTxPduUserTxConfirmationUL=PDUR, CanIfTxPduId=94, CanIfTxPduBufferRef=CHNL_79fa912a, CanIfTxPduRef=Debug_NFCD_Obj_0_4_oFDCAN14_4fc85aea_Tx
        MOT_Obj_2_3_oFDCAN14_1b36cde8_Tx: CanIfTxPduCanId=507068532, CanIfTxPduCanIdType=EXTENDED_FD_CAN, CanIfTxPduDlc=64, CanIfTxPduUserTxConfirmationName=PduR_CanIfTxConfirmation, CanIfTxPduUserTxConfirmationUL=PDUR, CanIfTxPduId=90, CanIfTxPduBufferRef=CHNL_79fa912a, CanIfTxPduRef=MOT_Obj_2_3_oFDCAN14_235391ff_Tx
        Minimum_Sensor_Distance_1_oFDCAN14_3c3e9a3d_Tx: CanIfTxPduCanId=507330622, CanIfTxPduCanIdType=EXTENDED_FD_CAN, CanIfTxPduDlc=8, CanIfTxPduUserTxConfirmationName=PduR_CanIfTxConfirmation, CanIfTxPduUserTxConfirmationUL=PDUR, CanIfTxPduId=22, CanIfTxPduBufferRef=CHNL_79fa912a, CanIfTxPduRef=Minimum_Sensor_Distance_1_oFDCAN14_4c29e9ec_Tx
        Debug_NFCD_Obj_5_9_oFDCAN14_b99541d7_Tx: CanIfTxPduCanId=507068529, CanIfTxPduCanIdType=EXTENDED_FD_CAN, CanIfTxPduDlc=64, CanIfTxPduUserTxConfirmationName=PduR_CanIfTxConfirmation, CanIfTxPduUserTxConfirmationUL=PDUR, CanIfTxPduId=93, CanIfTxPduBufferRef=CHNL_79fa912a, CanIfTxPduRef=Debug_NFCD_Obj_5_9_oFDCAN14_b6ee4791_Tx
        Debug_SCCalib_Data_oFDCAN14_415523bc_Tx: CanIfTxPduCanId=507068505, CanIfTxPduCanIdType=EXTENDED_FD_CAN, CanIfTxPduDlc=64, CanIfTxPduUserTxConfirmationName=PduR_CanIfTxConfirmation, CanIfTxPduUserTxConfirmationUL=PDUR, CanIfTxPduId=105, CanIfTxPduBufferRef=CHNL_79fa912a, CanIfTxPduRef=Debug_SCCalib_Data_oFDCAN14_f9ffef76_Tx
        Log_SnrMeasData_01_oFDCAN14_fcfb802e_Tx: CanIfTxPduCanId=507330582, CanIfTxPduCanIdType=EXTENDED_FD_CAN, CanIfTxPduDlc=64, CanIfTxPduUserTxConfirmationName=PduR_CanIfTxConfirmation, CanIfTxPduUserTxConfirmationUL=PDUR, CanIfTxPduId=37, CanIfTxPduBufferRef=CHNL_79fa912a, CanIfTxPduRef=Log_SnrMeasData_01_oFDCAN14_481955b6_Tx
        LMD_SegmentDebug_1_2_oFDCAN14_6331b408_Tx: CanIfTxPduCanId=507068675, CanIfTxPduCanIdType=EXTENDED_FD_CAN, CanIfTxPduDlc=12, CanIfTxPduUserTxConfirmationName=PduR_CanIfTxConfirmation, CanIfTxPduUserTxConfirmationUL=PDUR, CanIfTxPduId=61, CanIfTxPduBufferRef=CHNL_79fa912a, CanIfTxPduRef=LMD_SegmentDebug_1_2_oFDCAN14_99b37b05_Tx
        MOT_Obj_8_9_oFDCAN14_bd8ad539_Tx: CanIfTxPduCanId=507068535, CanIfTxPduCanIdType=EXTENDED_FD_CAN, CanIfTxPduDlc=64, CanIfTxPduUserTxConfirmationName=PduR_CanIfTxConfirmation, CanIfTxPduUserTxConfirmationUL=PDUR, CanIfTxPduId=87, CanIfTxPduBufferRef=CHNL_79fa912a, CanIfTxPduRef=MOT_Obj_8_9_oFDCAN14_541a061d_Tx
        PntDebugData_2_oFDCAN14_9304bca8_Tx: CanIfTxPduCanId=507330627, CanIfTxPduCanIdType=EXTENDED_FD_CAN, CanIfTxPduDlc=64, CanIfTxPduUserTxConfirmationName=PduR_CanIfTxConfirmation, CanIfTxPduUserTxConfirmationUL=PDUR, CanIfTxPduId=17, CanIfTxPduBufferRef=CHNL_79fa912a, CanIfTxPduRef=PntDebugData_2_oFDCAN14_4549c107_Tx
        LMD_LaneLinesDebug_2_oFDCAN14_965d36d3_Tx: CanIfTxPduCanId=507068673, CanIfTxPduCanIdType=EXTENDED_FD_CAN, CanIfTxPduDlc=64, CanIfTxPduUserTxConfirmationName=PduR_CanIfTxConfirmation, CanIfTxPduUserTxConfirmationUL=PDUR, CanIfTxPduId=63, CanIfTxPduBufferRef=CHNL_79fa912a, CanIfTxPduRef=LMD_LaneLinesDebug_2_oFDCAN14_cef1a9ac_Tx
        Distance_Point_Map_8_oFDCAN14_87a4aa87_Tx: CanIfTxPduCanId=507068561, CanIfTxPduCanIdType=EXTENDED_FD_CAN, CanIfTxPduDlc=64, CanIfTxPduUserTxConfirmationName=PduR_CanIfTxConfirmation, CanIfTxPduUserTxConfirmationUL=PDUR, CanIfTxPduId=73, CanIfTxPduBufferRef=CHNL_79fa912a, CanIfTxPduRef=Distance_Point_Map_8_oFDCAN14_a59e211a_Tx
        PntDebugData_1_oFDCAN14_5d2fc140_Tx: CanIfTxPduCanId=507330626, CanIfTxPduCanIdType=EXTENDED_FD_CAN, CanIfTxPduDlc=64, CanIfTxPduUserTxConfirmationName=PduR_CanIfTxConfirmation, CanIfTxPduUserTxConfirmationUL=PDUR, CanIfTxPduId=18, CanIfTxPduBufferRef=CHNL_79fa912a, CanIfTxPduRef=PntDebugData_1_oFDCAN14_f6ddecc4_Tx
        USS_SectorInfoFB_oFDCAN14_14389c16_Tx: CanIfTxPduCanId=507330630, CanIfTxPduCanIdType=EXTENDED_FD_CAN, CanIfTxPduDlc=4, CanIfTxPduUserTxConfirmationName=PduR_CanIfTxConfirmation, CanIfTxPduUserTxConfirmationUL=PDUR, CanIfTxPduId=15, CanIfTxPduBufferRef=CHNL_79fa912a, CanIfTxPduRef=USS_SectorInfoFB_oFDCAN14_41f44d67_Tx
        Debug_EOLCalib_Data_1_oFDCAN14_ae23bf12_Tx: CanIfTxPduCanId=507068504, CanIfTxPduCanIdType=EXTENDED_FD_CAN, CanIfTxPduDlc=64, CanIfTxPduUserTxConfirmationName=PduR_CanIfTxConfirmation, CanIfTxPduUserTxConfirmationUL=PDUR, CanIfTxPduId=106, CanIfTxPduBufferRef=CHNL_79fa912a, CanIfTxPduRef=Debug_EOLCalib_Data_1_oFDCAN14_e983026d_Tx
        Debug_CalibSts_oFDCAN14_58546a56_Tx: CanIfTxPduCanId=507068569, CanIfTxPduCanIdType=EXTENDED_FD_CAN, CanIfTxPduDlc=64, CanIfTxPduUserTxConfirmationName=PduR_CanIfTxConfirmation, CanIfTxPduUserTxConfirmationUL=PDUR, CanIfTxPduId=65, CanIfTxPduBufferRef=CHNL_79fa912a, CanIfTxPduRef=Debug_CalibSts_oFDCAN14_386fe58e_Tx
        ME_DebugMsgSigned_oFDCAN14_16ce7da0_Tx: CanIfTxPduCanId=507330590, CanIfTxPduCanIdType=EXTENDED_FD_CAN, CanIfTxPduDlc=8, CanIfTxPduUserTxConfirmationName=PduR_CanIfTxConfirmation, CanIfTxPduUserTxConfirmationUL=PDUR, CanIfTxPduId=29, CanIfTxPduBufferRef=CHNL_79fa912a, CanIfTxPduRef=ME_DebugMsgSigned_oFDCAN14_e9329857_Tx
        Debug_FPA_HMI_InfoToVC_oFDCAN14_0eea4eb6_Tx: CanIfTxPduCanId=507068530, CanIfTxPduCanIdType=EXTENDED_FD_CAN, CanIfTxPduDlc=64, CanIfTxPduUserTxConfirmationName=PduR_CanIfTxConfirmation, CanIfTxPduUserTxConfirmationUL=PDUR, CanIfTxPduId=92, CanIfTxPduBufferRef=CHNL_79fa912a, CanIfTxPduRef=Debug_FPA_HMI_InfoToVC_oFDCAN14_250b6023_Tx
        LMD_SegmentDebug_2_2_oFDCAN14_be3e1ae4_Tx: CanIfTxPduCanId=507068677, CanIfTxPduCanIdType=EXTENDED_FD_CAN, CanIfTxPduDlc=48, CanIfTxPduUserTxConfirmationName=PduR_CanIfTxConfirmation, CanIfTxPduUserTxConfirmationUL=PDUR, CanIfTxPduId=59, CanIfTxPduBufferRef=CHNL_79fa912a, CanIfTxPduRef=LMD_SegmentDebug_2_2_oFDCAN14_3cbb1069_Tx
        Debug_FeatureCollection_oFDCAN14_4fc45f26_Tx: CanIfTxPduCanId=507068514, CanIfTxPduCanIdType=EXTENDED_FD_CAN, CanIfTxPduDlc=64, CanIfTxPduUserTxConfirmationName=PduR_CanIfTxConfirmation, CanIfTxPduUserTxConfirmationUL=PDUR, CanIfTxPduId=102, CanIfTxPduBufferRef=CHNL_79fa912a, CanIfTxPduRef=Debug_FeatureCollection_oFDCAN14_c2b58aba_Tx
        Blockage_Flags_oFDCAN14_cd9c3e01_Tx: CanIfTxPduCanId=507330560, CanIfTxPduCanIdType=EXTENDED_CAN, CanIfTxPduDlc=2, CanIfTxPduUserTxConfirmationName=PduR_CanIfTxConfirmation, CanIfTxPduUserTxConfirmationUL=PDUR, CanIfTxPduId=39, CanIfTxPduBufferRef=CHNL_79fa912a, CanIfTxPduRef=Blockage_Flags_oFDCAN14_99421024_Tx
        DebugModelOutput_Feature_KPI_Tx_oFDCAN14_fae6f83c_Tx: CanIfTxPduCanId=507330584, CanIfTxPduCanIdType=EXTENDED_FD_CAN, CanIfTxPduDlc=64, CanIfTxPduUserTxConfirmationName=PduR_CanIfTxConfirmation, CanIfTxPduUserTxConfirmationUL=PDUR, CanIfTxPduId=35, CanIfTxPduBufferRef=CHNL_79fa912a, CanIfTxPduRef=DebugModelOutput_Feature_KPI_Tx_oFDCAN14_2d37299a_Tx
        LMD_SegmentDebug_2_1_oFDCAN14_01887f27_Tx: CanIfTxPduCanId=507068676, CanIfTxPduCanIdType=EXTENDED_FD_CAN, CanIfTxPduDlc=64, CanIfTxPduUserTxConfirmationName=PduR_CanIfTxConfirmation, CanIfTxPduUserTxConfirmationUL=PDUR, CanIfTxPduId=60, CanIfTxPduBufferRef=CHNL_79fa912a, CanIfTxPduRef=LMD_SegmentDebug_2_1_oFDCAN14_8f2f3daa_Tx
        Log_SnrMeasData_05_oFDCAN14_fd00e2ef_Tx: CanIfTxPduCanId=507330586, CanIfTxPduCanIdType=EXTENDED_FD_CAN, CanIfTxPduDlc=64, CanIfTxPduUserTxConfirmationName=PduR_CanIfTxConfirmation, CanIfTxPduUserTxConfirmationUL=PDUR, CanIfTxPduId=33, CanIfTxPduBufferRef=CHNL_79fa912a, CanIfTxPduRef=Log_SnrMeasData_05_oFDCAN14_29583ef3_Tx
        Distance_Point_Map_2_oFDCAN14_b0f3fa8f_Tx: CanIfTxPduCanId=507068549, CanIfTxPduCanIdType=EXTENDED_FD_CAN, CanIfTxPduDlc=64, CanIfTxPduUserTxConfirmationName=PduR_CanIfTxConfirmation, CanIfTxPduUserTxConfirmationUL=PDUR, CanIfTxPduId=79, CanIfTxPduBufferRef=CHNL_79fa912a, CanIfTxPduRef=Distance_Point_Map_2_oFDCAN14_ba04c112_Tx
        THADebugInfo2_oFDCAN14_062cf8ad_Tx: CanIfTxPduCanId=507068544, CanIfTxPduCanIdType=EXTENDED_FD_CAN, CanIfTxPduDlc=64, CanIfTxPduUserTxConfirmationName=PduR_CanIfTxConfirmation, CanIfTxPduUserTxConfirmationUL=PDUR, CanIfTxPduId=84, CanIfTxPduBufferRef=CHNL_79fa912a, CanIfTxPduRef=THADebugInfo2_oFDCAN14_30821deb_Tx
        PLDDebugInfo1_oFDCAN14_c1b133bf_Tx: CanIfTxPduCanId=507068678, CanIfTxPduCanIdType=EXTENDED_FD_CAN, CanIfTxPduDlc=64, CanIfTxPduUserTxConfirmationName=PduR_CanIfTxConfirmation, CanIfTxPduUserTxConfirmationUL=PDUR, CanIfTxPduId=58, CanIfTxPduBufferRef=CHNL_79fa912a, CanIfTxPduRef=PLDDebugInfo1_oFDCAN14_d750a426_Tx
        Firing_Sensors_oFDCAN14_474d0a36_Tx: CanIfTxPduCanId=507068566, CanIfTxPduCanIdType=EXTENDED_FD_CAN, CanIfTxPduDlc=6, CanIfTxPduUserTxConfirmationName=PduR_CanIfTxConfirmation, CanIfTxPduUserTxConfirmationUL=PDUR, CanIfTxPduId=68, CanIfTxPduBufferRef=CHNL_79fa912a, CanIfTxPduRef=Firing_Sensors_oFDCAN14_913f5916_Tx
        ME_SystemStatus_oFDCAN14_3392fde0_Tx: CanIfTxPduCanId=507330595, CanIfTxPduCanIdType=EXTENDED_FD_CAN, CanIfTxPduDlc=8, CanIfTxPduUserTxConfirmationName=PduR_CanIfTxConfirmation, CanIfTxPduUserTxConfirmationUL=PDUR, CanIfTxPduId=27, CanIfTxPduBufferRef=CHNL_79fa912a, CanIfTxPduRef=ME_SystemStatus_oFDCAN14_3ca06526_Tx
        Distance_Point_Map_11_oFDCAN14_2ace4b8f_Tx: CanIfTxPduCanId=507068564, CanIfTxPduCanIdType=EXTENDED_FD_CAN, CanIfTxPduDlc=64, CanIfTxPduUserTxConfirmationName=PduR_CanIfTxConfirmation, CanIfTxPduUserTxConfirmationUL=PDUR, CanIfTxPduId=70, CanIfTxPduBufferRef=CHNL_79fa912a, CanIfTxPduRef=Distance_Point_Map_11_oFDCAN14_728c0bbf_Tx
        MOT_Obj_0_1_oFDCAN14_e18f3607_Tx: CanIfTxPduCanId=507068531, CanIfTxPduCanIdType=EXTENDED_FD_CAN, CanIfTxPduDlc=64, CanIfTxPduUserTxConfirmationName=PduR_CanIfTxConfirmation, CanIfTxPduUserTxConfirmationUL=PDUR, CanIfTxPduId=91, CanIfTxPduBufferRef=CHNL_79fa912a, CanIfTxPduRef=MOT_Obj_0_1_oFDCAN14_38441535_Tx
        DebugModelOutput_oFDCAN14_6b4c9d3e_Tx: CanIfTxPduCanId=507068546, CanIfTxPduCanIdType=EXTENDED_FD_CAN, CanIfTxPduDlc=64, CanIfTxPduUserTxConfirmationName=PduR_CanIfTxConfirmation, CanIfTxPduUserTxConfirmationUL=PDUR, CanIfTxPduId=82, CanIfTxPduBufferRef=CHNL_79fa912a, CanIfTxPduRef=DebugModelOutput_oFDCAN14_1f951e1f_Tx
        USSDebugInfo2_oFDCAN14_a2853d8e_Tx: CanIfTxPduCanId=507068681, CanIfTxPduCanIdType=EXTENDED_FD_CAN, CanIfTxPduDlc=64, CanIfTxPduUserTxConfirmationName=PduR_CanIfTxConfirmation, CanIfTxPduUserTxConfirmationUL=PDUR, CanIfTxPduId=55, CanIfTxPduBufferRef=CHNL_79fa912a, CanIfTxPduRef=USSDebugInfo2_oFDCAN14_899d6b1c_Tx
        Debug_EOLCalib_Data_2_oFDCAN14_1ed59804_Tx: CanIfTxPduCanId=507068516, CanIfTxPduCanIdType=EXTENDED_FD_CAN, CanIfTxPduDlc=64, CanIfTxPduUserTxConfirmationName=PduR_CanIfTxConfirmation, CanIfTxPduUserTxConfirmationUL=PDUR, CanIfTxPduId=100, CanIfTxPduBufferRef=CHNL_79fa912a, CanIfTxPduRef=Debug_EOLCalib_Data_2_oFDCAN14_5a172fae_Tx
        Debug_CurrentCalib_Data_2_oFDCAN14_192cb625_Tx: CanIfTxPduCanId=507068515, CanIfTxPduCanIdType=EXTENDED_FD_CAN, CanIfTxPduDlc=64, CanIfTxPduUserTxConfirmationName=PduR_CanIfTxConfirmation, CanIfTxPduUserTxConfirmationUL=PDUR, CanIfTxPduId=101, CanIfTxPduBufferRef=CHNL_79fa912a, CanIfTxPduRef=Debug_CurrentCalib_Data_2_oFDCAN14_2917323d_Tx
        Firing_Mode_oFDCAN14_60360c0e_Tx: CanIfTxPduCanId=507068565, CanIfTxPduCanIdType=EXTENDED_FD_CAN, CanIfTxPduDlc=5, CanIfTxPduUserTxConfirmationName=PduR_CanIfTxConfirmation, CanIfTxPduUserTxConfirmationUL=PDUR, CanIfTxPduId=69, CanIfTxPduBufferRef=CHNL_79fa912a, CanIfTxPduRef=Firing_Mode_oFDCAN14_9162ab4d_Tx
        PntDebugData_3_oFDCAN14_603295cf_Tx: CanIfTxPduCanId=507330629, CanIfTxPduCanIdType=EXTENDED_FD_CAN, CanIfTxPduDlc=64, CanIfTxPduUserTxConfirmationName=PduR_CanIfTxConfirmation, CanIfTxPduUserTxConfirmationUL=PDUR, CanIfTxPduId=16, CanIfTxPduBufferRef=CHNL_79fa912a, CanIfTxPduRef=PntDebugData_3_oFDCAN14_2bc5da46_Tx
      PntDebugData_Rx_oFDCAN14_6aed7921_Rx (CanIfRxPduCfg):
        CanIfRxPduCanId = 507068487
        CanIfRxPduCanIdType = EXTENDED_CAN
        CanIfRxPduDlc = 8
        CanIfRxPduUserRxIndicationName = PduR_CanIfRxIndication
        CanIfRxPduUserRxIndicationUL = PDUR
        CanIfRxPduId = 55
        CanIfRxPduReadData = false
        CanIfRxPduReadNotifyStatus = false
        CanIfRxPduDlcCheck = false
        CanIfRxPduHrhIdRef = CN_FDCAN14_525e7c5e_Rx
        CanIfRxPduRef = PntDebugData_Rx_oFDCAN14_481d274d_Rx
      20 x CanIfTxPduCfg, all with CanIfTxPduCanIdType=EXTENDED_FD_CAN, CanIfTxPduUserTxConfirmationName=PduR_CanIfTxConfirmation, CanIfTxPduUserTxConfirmationUL=PDUR, CanIfTxPduReadNotifyStatus=false, CanIfTxPduType=STATIC, CanIfTxPduTruncation=true, CanIfTxPduBufferRef=CHNL_79fa912a:
        ME_SnsDat_Rear_Direct_oFDCAN14_6726d174_Tx: CanIfTxPduCanId=507068705, CanIfTxPduDlc=8, CanIfTxPduId=43, CanIfTxPduRef=ME_SnsDat_Rear_Direct_oFDCAN14_caebeaa6_Tx
        Debug_HMI_Trailer_Views_Data_oFDCAN14_a612f060_Tx: CanIfTxPduCanId=507068500, CanIfTxPduDlc=64, CanIfTxPduId=110, CanIfTxPduRef=Debug_HMI_Trailer_Views_Data_oFDCAN14_14db284c_Tx
        ME_Debug_SensorTestData_1_oFDCAN14_ea75124e_Tx: CanIfTxPduCanId=507068689, CanIfTxPduDlc=64, CanIfTxPduId=53, CanIfTxPduRef=ME_Debug_SensorTestData_1_oFDCAN14_74b41d5f_Tx
        ME_SnsDat_Front_Direct_oFDCAN14_92d50a6c_Tx: CanIfTxPduCanId=507068704, CanIfTxPduDlc=8, CanIfTxPduId=44, CanIfTxPduRef=ME_SnsDat_Front_Direct_oFDCAN14_b2df9b13_Tx
        ME_SnsDat_Rear_Indirect_2_oFDCAN14_6ab3d2d0_Tx: CanIfTxPduCanId=507068693, CanIfTxPduDlc=8, CanIfTxPduId=49, CanIfTxPduRef=ME_SnsDat_Rear_Indirect_2_oFDCAN14_4f6ddc97_Tx
        ME_Debug_SensorTestData_2_oFDCAN14_f52b94b5_Tx: CanIfTxPduCanId=507068690, CanIfTxPduDlc=64, CanIfTxPduId=52, CanIfTxPduRef=ME_Debug_SensorTestData_2_oFDCAN14_c720309c_Tx
        Debug_HMI_Internal_Data_oFDCAN14_49de4f3c_Tx: CanIfTxPduCanId=507068502, CanIfTxPduDlc=16, CanIfTxPduId=108, CanIfTxPduRef=Debug_HMI_Internal_Data_oFDCAN14_4a1b027e_Tx
        ME_SnsDat_Front_Indirect_2_oFDCAN14_38edffe1_Tx: CanIfTxPduCanId=507068692, CanIfTxPduDlc=5, CanIfTxPduId=50, CanIfTxPduRef=ME_SnsDat_Front_Indirect_2_oFDCAN14_d5066aa1_Tx
        ME_SnsDat_Front_Direct_2_oFDCAN14_d7e5c444_Tx: CanIfTxPduCanId=507068696, CanIfTxPduDlc=8, CanIfTxPduId=46, CanIfTxPduRef=ME_SnsDat_Front_Direct_2_oFDCAN14_0f179e9e_Tx
        ME_SnsDat_Rear_Indirect_1_oFDCAN14_75ed542b_Tx: CanIfTxPduCanId=507068695, CanIfTxPduDlc=8, CanIfTxPduId=47, CanIfTxPduRef=ME_SnsDat_Rear_Indirect_1_oFDCAN14_fcf9f154_Tx
        ME_Debug_SensorTestData_3_oFDCAN14_ffe1e91c_Tx: CanIfTxPduCanId=507068691, CanIfTxPduDlc=64, CanIfTxPduId=51, CanIfTxPduRef=ME_Debug_SensorTestData_3_oFDCAN14_a9ac2bdd_Tx
        ME_SnsDat_Rear_Direct_2_oFDCAN14_762da0cc_Tx: CanIfTxPduCanId=507068697, CanIfTxPduDlc=8, CanIfTxPduId=45, CanIfTxPduRef=ME_SnsDat_Rear_Direct_2_oFDCAN14_b1a7fdfd_Tx
        ME_SnsDat_Front_Indirect_1_oFDCAN14_a0b9888a_Tx: CanIfTxPduCanId=507068694, CanIfTxPduDlc=8, CanIfTxPduId=48, CanIfTxPduRef=ME_SnsDat_Front_Indirect_1_oFDCAN14_66924762_Tx
        UssCsmStateChangeReasons_oFDCAN14_9fbeef37_Tx: CanIfTxPduCanId=507330631, CanIfTxPduDlc=8, CanIfTxPduId=14, CanIfTxPduRef=UssCsmStateChangeReasons_oFDCAN14_21391911_Tx
        Log_PackedNoiseMeasData_oFDCAN14_32d10e8e_Tx: CanIfTxPduCanId=507330601, CanIfTxPduDlc=64, CanIfTxPduId=24, CanIfTxPduRef=Log_PackedNoiseMeasData_oFDCAN14_967b3578_Tx
        Log_PackedDiagFlagData1_v_oFDCAN14_40a1873d_Tx: CanIfTxPduCanId=507330600, CanIfTxPduDlc=64, CanIfTxPduId=25, CanIfTxPduRef=Log_PackedDiagFlagData1_v_oFDCAN14_a37af45a_Tx
        Log_PackedDiagFlagData2_v_oFDCAN14_b3328600_Tx: CanIfTxPduCanId=507330608, CanIfTxPduDlc=64, CanIfTxPduId=23, CanIfTxPduRef=Log_PackedDiagFlagData2_v_oFDCAN14_06729f36_Tx
        ME_SystemDebugData_1_oFDCAN14_6a0508c3_Tx: CanIfTxPduCanId=507072513, CanIfTxPduDlc=64, CanIfTxPduId=42, CanIfTxPduRef=ME_SystemDebugData_1_oFDCAN14_d1a1dda3_Tx
        ME_MCUOsDebugData1_oFDCAN14_0c92eebd_Tx: CanIfTxPduCanId=507072514, CanIfTxPduDlc=64, CanIfTxPduId=41, CanIfTxPduRef=ME_MCUOsDebugData1_oFDCAN14_137bf977_Tx
        ME_MCUOsDebugData2_oFDCAN14_977545dd_Tx: CanIfTxPduCanId=507072515, CanIfTxPduDlc=64, CanIfTxPduId=40, CanIfTxPduRef=ME_MCUOsDebugData2_oFDCAN14_a0efd4b4_Tx
    CanIfPrivateCfg:
      CanIfPrivateSoftwareFilterType = DOUBLEHASH
      CanIfPrivateDlcCheck = true
      CanIfSupportTTCAN = false
      CanIfTransceiverMapping = false
      CanIfTransceiverHandling = true
      CanIfSupportExtendedIds = true
      CanIfSupportNmOsek = false
      CanIfTxBufferType = BYTE_QUEUE
      CanIfWakeupSupport = true
      CanIfStaticFdTxBufferSupport = true
      CanIfRxSearchConsiderMsgType = true
      CanIfTxBufferFifoSupport = false
      CanIfSetPduReceptionModeSupport = false
      CanIfCheckWakeupCanRetType = false
      CanIfDataChecksumRxSupport = false
      CanIfDataChecksumTxSupport = false
      CanIfDoubleHashAdditionalMemory = 226
      CanIfDoubleHashAdjustCount = 99
    CanIfPublicCfg:
      CanIfPublicPnSupport = false
      CanIfPublicCancelTransmitSupport = false
      CanIfPublicDevErrorDetect = true
      CanIfPublicHandleTypeEnum = UINT8
      CanIfPublicMultipleDrvSupport = false
      CanIfPublicNumberOfCanHwUnits = 1
      CanIfPublicReadRxPduDataApi = false
      CanIfPublicReadRxPduNotifyStatusApi = false
      CanIfPublicReadTxPduNotifyStatusApi = false
      CanIfPublicSetDynamicTxIdApi = false
      CanIfPublicTxBuffering = true
      CanIfPublicTxConfirmPollingSupport = false
      CanIfPublicVersionInfoApi = false
      CanIfPublicWakeupCheckValidSupport = false
      CanIfPnWakeupTxPduFilterSupport = false
      CanIfPnTrcvHandlingSupport = false
      CanIfJ1939DynAddrSupport = DISABLED
      CanIfSafeBswChecks = false
      CanIfBusMirroringSupport = false
      CanIfEnableSecurityEventReporting = false
      CanIfSupportCanDrvAsr440 = false
      CanIfSupportMultipartition = false
      CanIfSetBaudrateApi = false
    CanIfTrcvDrvCfg
      CanIfTrcvCfg: CanIfTrcvId=0, CanIfTrcvWakeupSupport=true, CanIfTrcvCanTrcvRef=CanTrcvChannel
