AUTOSAR XML (schema 00048)
package /ActiveEcuC
  module config vBaseEnv: implementation-config-variant=VARIANT-PRE-COMPILE, module-description=vBaseEnv_Impl
    vBaseEnvGeneral: vBaseEnvTestedDerivativeRef=TDA4VE88
      TDA4VE88 (vBaseEnvDerivativeInformation):
        vBaseEnvAvailableChannels_Can = 2
        vBaseEnvAvailableChannels_Lin = 0
        vBaseEnvAvailableChannels_Ethernet = 1
        vBaseEnvAvailableChannels_Flexray = 0
        vBaseEnvCpuCore = CORTEX_R5F
        vBaseEnvCpuCoreAmount = 6
        vBaseEnvCpuInitCore = 0
        vBaseEnvCpuMaxFrequency = 1000000000
        vBaseEnvTestedDerivative = TDA4VE88
        vBaseEnvTestedDerivativeDescription = TI TDA4VE88
        vBaseEnvAvailableChannels_Hyperbus = 0
        vBaseEnvAvailableChannels_I2c = 0
        vBaseEnvAvailableChannels_Spi = 0
        3 x vBaseEnvMemLayoutHwRegion:
          DDR0: vBaseEnvHwRegionStartAddress=2533359616, vBaseEnvHwRegionSize=16777216
          MCU_MSRAM: vBaseEnvHwRegionStartAddress=1103360000, vBaseEnvHwRegionSize=241408
          MCU_MSRAM_HSM: vBaseEnvHwRegionStartAddress=1103101952, vBaseEnvHwRegionSize=16128
      3 x vBaseEnvMemLayoutHwRegion:
        DDR0
        MCU_MSRAM
        MCU_MSRAM_HSM
