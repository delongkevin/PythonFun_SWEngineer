AUTOSAR XML (schema 00048)
package /ActiveEcuC
  module config Ea: implementation-config-variant=VARIANT-PRE-COMPILE, module-description=Ea_Impl
    EaGeneral:
      EaSetModeSupported = true
      EaDevErrorDetect = true
      EaIndex = 0
      EaPollingMode = true
      EaVersionInfoApi = false
      EaVirtualPageSize = 8
      EaNvMCallbackIncludeFile = NvM_Cbk.h
      EaCorrectSingleBitFlips = true
      EaMainFunctionPeriod = 0.01
      EaMainFunctionTriggering = FixedCycleTime
      EaSafeBswChecks = false
    EaBlockConfiguration:
      EaBlockNumber = 16
      EaBlockSize = 4
      EaImmediateData = false
      EaNumberOfWriteCycles = 10000
      EaNumberOfDatasets = 2
      EaNumberOfInstances = 1
      EaVerifyWrittenData = true
      EaBlockId = 0
      EaDeviceIndex = EepGeneral
      EaPartition = EaPartitionConfiguration_FblApp
    EaPublishedInformation: EaBlockOverhead=2, EaMaximumBlockingTime=0, EaPageOverhead=0
    EaPartitionConfiguration_App (EaPartitionConfiguration):
      EaPartitionStartAddress = 3672
      EaPartitionSize = 2209
      EaPartitionAddressAlignment = 1
      EaPartitionWriteAlignment = 1
      EaPartitionDevice = EepInitConfiguration
    65 x EaBlockConfiguration, all with EaNumberOfWriteCycles=10000, EaNumberOfInstances=1:
      EaBlockDem_AdminData: EaBlockNumber=32, EaBlockSize=14, EaImmediateData=false, EaNumberOfDatasets=1, EaVerifyWrittenData=true, EaBlockId=0, EaPartition=EaPartitionConfiguration_Dem, EaDeviceIndex=EepGeneral
      EaBlockDem_Aging: EaBlockNumber=48, EaBlockSize=134, EaImmediateData=false, EaNumberOfDatasets=1, EaVerifyWrittenData=true, EaBlockId=1, EaPartition=EaPartitionConfiguration_Dem, EaDeviceIndex=EepGeneral
      EaBlockDem_EventStatus: EaBlockNumber=64, EaBlockSize=78, EaImmediateData=false, EaNumberOfDatasets=1, EaVerifyWrittenData=true, EaBlockId=2, EaPartition=EaPartitionConfiguration_Dem, EaDeviceIndex=EepGeneral
      EaBlockDem_Primary0: EaBlockNumber=80, EaBlockSize=86, EaImmediateData=false, EaNumberOfDatasets=1, EaVerifyWrittenData=true, EaBlockId=3, EaPartition=EaPartitionConfiguration_Dem, EaDeviceIndex=EepGeneral
      EaBlockDem_Primary1: EaBlockNumber=96, EaBlockSize=86, EaImmediateData=false, EaNumberOfDatasets=1, EaVerifyWrittenData=true, EaBlockId=4, EaPartition=EaPartitionConfiguration_Dem, EaDeviceIndex=EepGeneral
      EaBlockDem_Primary2: EaBlockNumber=112, EaBlockSize=86, EaImmediateData=false, EaNumberOfDatasets=1, EaVerifyWrittenData=true, EaBlockId=5, EaPartition=EaPartitionConfiguration_Dem, EaDeviceIndex=EepGeneral
      EaBlockDem_Primary3: EaBlockNumber=128, EaBlockSize=86, EaImmediateData=false, EaNumberOfDatasets=1, EaVerifyWrittenData=true, EaBlockId=6, EaPartition=EaPartitionConfiguration_Dem, EaDeviceIndex=EepGeneral
      EaBlockDem_Primary4: EaBlockNumber=144, EaBlockSize=86, EaImmediateData=false, EaNumberOfDatasets=1, EaVerifyWrittenData=true, EaBlockId=7, EaPartition=EaPartitionConfiguration_Dem, EaDeviceIndex=EepGeneral
      EaBlockDem_Primary5: EaBlockNumber=160, EaBlockSize=86, EaImmediateData=false, EaNumberOfDatasets=1, EaVerifyWrittenData=true, EaBlockId=8, EaPartition=EaPartitionConfiguration_Dem, EaDeviceIndex=EepGeneral
      EaBlockDem_Primary6: EaBlockNumber=176, EaBlockSize=86, EaImmediateData=false, EaNumberOfDatasets=1, EaVerifyWrittenData=true, EaBlockId=9, EaPartition=EaPartitionConfiguration_Dem, EaDeviceIndex=EepGeneral
      EaBlockDem_Primary7: EaBlockNumber=192, EaBlockSize=86, EaImmediateData=false, EaNumberOfDatasets=1, EaVerifyWrittenData=true, EaBlockId=10, EaPartition=EaPartitionConfiguration_Dem, EaDeviceIndex=EepGeneral
      EaBlockDem_Primary8: EaBlockNumber=208, EaBlockSize=86, EaImmediateData=false, EaNumberOfDatasets=1, EaVerifyWrittenData=true, EaBlockId=11, EaPartition=EaPartitionConfiguration_Dem, EaDeviceIndex=EepGeneral
      EaBlockDem_Primary9: EaBlockNumber=224, EaBlockSize=86, EaImmediateData=false, EaNumberOfDatasets=1, EaVerifyWrittenData=true, EaBlockId=12, EaPartition=EaPartitionConfiguration_Dem, EaDeviceIndex=EepGeneral
      EaSWC_vRoE_Activation_State: EaBlockNumber=240, EaBlockSize=3, EaImmediateData=false, EaNumberOfDatasets=1, EaVerifyWrittenData=true, EaBlockId=17, EaPartition=EaPartitionConfiguration_App, EaDeviceIndex=EepGeneral
      EaBlockDescriptor_ApplValidity: EaBlockNumber=256, EaBlockSize=3, EaImmediateData=false, EaNumberOfDatasets=1, EaVerifyWrittenData=true, EaBlockId=5, EaPartition=EaPartitionConfiguration_FblApp, EaDeviceIndex=EepGeneral
      EaBlockDescriptor_DID_2002_OdoFlashing: EaBlockNumber=272, EaBlockSize=4, EaImmediateData=false, EaNumberOfDatasets=1, EaVerifyWrittenData=true, EaBlockId=26, EaPartition=EaPartitionConfiguration_FblApp, EaDeviceIndex=EepGeneral
      EaBlockDescriptor_DID_2010_ProgrammingStatus: EaBlockNumber=288, EaBlockSize=4, EaImmediateData=false, EaNumberOfDatasets=1, EaVerifyWrittenData=true, EaBlockId=11, EaPartition=EaPartitionConfiguration_FblApp, EaDeviceIndex=EepGeneral
      EaBlockDescriptor_DID_F110_Ecu_Diag_Id_FlashDefinitionNumber: EaBlockNumber=304, EaBlockSize=8, EaImmediateData=false, EaNumberOfDatasets=1, EaVerifyWrittenData=true, EaBlockId=24, EaPartition=EaPartitionConfiguration_FblApp, EaDeviceIndex=EepGeneral
      EaBlockDescriptor_DID_F132_EBOM_Ecu_PartNum: EaBlockNumber=320, EaBlockSize=12, EaImmediateData=false, EaNumberOfDatasets=1, EaVerifyWrittenData=true, EaBlockId=21, EaPartition=EaPartitionConfiguration_FblApp, EaDeviceIndex=EepGeneral
      EaBlockDescriptor_DID_F133_EBOM_Asm_PartNum: EaBlockNumber=336, EaBlockSize=12, EaImmediateData=false, EaNumberOfDatasets=1, EaVerifyWrittenData=true, EaBlockId=16, EaPartition=EaPartitionConfiguration_FblApp, EaDeviceIndex=EepGeneral
      EaBlockDescriptor_DID_F134_CODEP_Asm_PartNum: EaBlockNumber=352, EaBlockSize=13, EaImmediateData=false, EaNumberOfDatasets=1, EaVerifyWrittenData=true, EaBlockId=20, EaPartition=EaPartitionConfiguration_FblApp, EaDeviceIndex=EepGeneral
      EaBlockDescriptor_DID_F180_Boot_SW_Ver_Info: EaBlockNumber=368, EaBlockSize=15, EaImmediateData=false, EaNumberOfDatasets=1, EaVerifyWrittenData=true, EaBlockId=10, EaPartition=EaPartitionConfiguration_FblApp, EaDeviceIndex=EepGeneral
      EaBlockDescriptor_DID_F187_CODEP_Ecu_PartNum: EaBlockNumber=384, EaBlockSize=13, EaImmediateData=false, EaNumberOfDatasets=1, EaVerifyWrittenData=true, EaBlockId=19, EaPartition=EaPartitionConfiguration_FblApp, EaDeviceIndex=EepGeneral
      EaBlockDescriptor_DID_F188_FCA_ESLM_Ecu_SW_Num: EaBlockNumber=400, EaBlockSize=13, EaImmediateData=false, EaNumberOfDatasets=1, EaVerifyWrittenData=true, EaBlockId=15, EaPartition=EaPartitionConfiguration_FblApp, EaDeviceIndex=EepGeneral
      EaBlockDescriptor_DID_F18A_FCA_ESLM_Ecu_SW_Cal_Num: EaBlockNumber=416, EaBlockSize=12, EaImmediateData=false, EaNumberOfDatasets=1, EaVerifyWrittenData=true, EaBlockId=17, EaPartition=EaPartitionConfiguration_FblApp, EaDeviceIndex=EepGeneral
      EaBlockDescriptor_DID_F18B_FCA_ESLM_ECU_SW_App_Num: EaBlockNumber=432, EaBlockSize=12, EaImmediateData=false, EaNumberOfDatasets=1, EaVerifyWrittenData=true, EaBlockId=18, EaPartition=EaPartitionConfiguration_FblApp, EaDeviceIndex=EepGeneral
      EaBlockDescriptor_DID_F194_Supplier_Ecu_SW_PartNum: EaBlockNumber=448, EaBlockSize=13, EaImmediateData=false, EaNumberOfDatasets=1, EaVerifyWrittenData=true, EaBlockId=22, EaPartition=EaPartitionConfiguration_FblApp, EaDeviceIndex=EepGeneral
      EaBlockDescriptor_DID_F195_Supplier_Ecu_SW_VerNum: EaBlockNumber=464, EaBlockSize=4, EaImmediateData=false, EaNumberOfDatasets=1, EaVerifyWrittenData=true, EaBlockId=23, EaPartition=EaPartitionConfiguration_FblApp, EaDeviceIndex=EepGeneral
      EaBlockDescriptor_DcmDslRxTesterSourceAddr: EaBlockNumber=480, EaBlockSize=4, EaImmediateData=false, EaNumberOfDatasets=1, EaVerifyWrittenData=true, EaBlockId=6, EaPartition=EaPartitionConfiguration_FblApp, EaDeviceIndex=EepGeneral
      EaBlockDescriptor_ExhaustRegulationTan: EaBlockNumber=496, EaBlockSize=8, EaImmediateData=false, EaNumberOfDatasets=1, EaVerifyWrittenData=true, EaBlockId=8, EaPartition=EaPartitionConfiguration_FblApp, EaDeviceIndex=EepGeneral
      EaBlockDescriptor_MetaData: EaBlockNumber=512, EaBlockSize=128, EaImmediateData=false, EaNumberOfDatasets=10, EaVerifyWrittenData=true, EaBlockId=12, EaPartition=EaPartitionConfiguration_FblApp, EaDeviceIndex=EepGeneral
      EaBlockDescriptor_ResetResponseFlag: EaBlockNumber=528, EaBlockSize=3, EaImmediateData=false, EaNumberOfDatasets=1, EaVerifyWrittenData=true, EaBlockId=9, EaPartition=EaPartitionConfiguration_FblApp, EaDeviceIndex=EepGeneral
      EaBlockDescriptor_SecAccessDelayFlag: EaBlockNumber=544, EaBlockSize=3, EaImmediateData=false, EaNumberOfDatasets=1, EaVerifyWrittenData=true, EaBlockId=3, EaPartition=EaPartitionConfiguration_FblApp, EaDeviceIndex=EepGeneral
      EaBlockDescriptor_SecAccessInvalidCount: EaBlockNumber=560, EaBlockSize=3, EaImmediateData=false, EaNumberOfDatasets=1, EaVerifyWrittenData=true, EaBlockId=4, EaPartition=EaPartitionConfiguration_FblApp, EaDeviceIndex=EepGeneral
      EaBlockDescriptor_ValidityFlags: EaBlockNumber=576, EaBlockSize=4, EaImmediateData=false, EaNumberOfDatasets=1, EaVerifyWrittenData=true, EaBlockId=7, EaPartition=EaPartitionConfiguration_FblApp, EaDeviceIndex=EepGeneral
      EaBlock_ApplUpdate: EaBlockNumber=592, EaBlockSize=3, EaImmediateData=false, EaNumberOfDatasets=1, EaVerifyWrittenData=true, EaBlockId=1, EaPartition=EaPartitionConfiguration_FblApp, EaDeviceIndex=EepGeneral
      EaCDD_GenericBswDID_2939_WakeupReason: EaBlockNumber=608, EaBlockSize=20, EaImmediateData=false, EaNumberOfDatasets=1, EaVerifyWrittenData=true, EaBlockId=11, EaPartition=EaPartitionConfiguration_App, EaDeviceIndex=EepGeneral
      EaCDD_GenericBswDID_FDF0_SleepProcess: EaBlockNumber=624, EaBlockSize=1, EaImmediateData=false, EaNumberOfDatasets=1, EaVerifyWrittenData=true, EaBlockId=12, EaPartition=EaPartitionConfiguration_App, EaDeviceIndex=EepGeneral
      EaSWC_ConfigMgrDID_2013_VIN_Lock_Status: EaBlockNumber=640, EaBlockSize=1, EaImmediateData=false, EaNumberOfDatasets=1, EaVerifyWrittenData=true, EaBlockId=15, EaPartition=EaPartitionConfiguration_App, EaDeviceIndex=EepGeneral
      EaSWC_ConfigMgrDID_5201_PlantMode: EaBlockNumber=656, EaBlockSize=1, EaImmediateData=false, EaNumberOfDatasets=1, EaVerifyWrittenData=true, EaBlockId=13, EaPartition=EaPartitionConfiguration_App, EaDeviceIndex=EepGeneral
      EaSWC_ConfigMgrVIN_CurrentVal: EaBlockNumber=672, EaBlockSize=17, EaImmediateData=false, EaNumberOfDatasets=1, EaVerifyWrittenData=true, EaBlockId=14, EaPartition=EaPartitionConfiguration_App, EaDeviceIndex=EepGeneral
      EaSWC_ConfigMgrVIN_OdometerCnt: EaBlockNumber=688, EaBlockSize=1, EaImmediateData=false, EaNumberOfDatasets=1, EaVerifyWrittenData=true, EaBlockId=16, EaPartition=EaPartitionConfiguration_App, EaDeviceIndex=EepGeneral
      EaSWC_ConfigMgrVIN_OriginalVal: EaBlockNumber=704, EaBlockSize=17, EaImmediateData=false, EaNumberOfDatasets=1, EaVerifyWrittenData=false, EaBlockId=25, EaPartition=EaPartitionConfiguration_FblApp, EaDeviceIndex=EepGeneral
      EaSWC_DIDMgrDID_191D_PowerLatch: EaBlockNumber=720, EaBlockSize=3, EaImmediateData=false, EaNumberOfDatasets=1, EaVerifyWrittenData=true, EaBlockId=18, EaPartition=EaPartitionConfiguration_App, EaDeviceIndex=EepGeneral
      EaSWC_DIDMgrDID_2002_ProgReqFlag: EaBlockNumber=736, EaBlockSize=3, EaImmediateData=false, EaNumberOfDatasets=1, EaVerifyWrittenData=true, EaBlockId=2, EaPartition=EaPartitionConfiguration_FblApp, EaDeviceIndex=EepGeneral
      EaSWC_DIDMgrDID_200A_IgOnCounter: EaBlockNumber=752, EaBlockSize=4, EaImmediateData=false, EaNumberOfDatasets=1, EaVerifyWrittenData=true, EaBlockId=19, EaPartition=EaPartitionConfiguration_App, EaDeviceIndex=EepGeneral
      EaSWC_DIDMgrDID_200B_TimeSinceFirstDTC: EaBlockNumber=768, EaBlockSize=6, EaImmediateData=false, EaNumberOfDatasets=1, EaVerifyWrittenData=true, EaBlockId=20, EaPartition=EaPartitionConfiguration_App, EaDeviceIndex=EepGeneral
      EaSWC_DIDMgrDID_200C_TimeSinceIgnOnFirstDTC: EaBlockNumber=784, EaBlockSize=4, EaImmediateData=false, EaNumberOfDatasets=1, EaVerifyWrittenData=true, EaBlockId=21, EaPartition=EaPartitionConfiguration_App, EaDeviceIndex=EepGeneral
      EaSWC_DIDMgrDID_200D_LastClearDTCOdo: EaBlockNumber=800, EaBlockSize=4, EaImmediateData=false, EaNumberOfDatasets=1, EaVerifyWrittenData=true, EaBlockId=22, EaPartition=EaPartitionConfiguration_App, EaDeviceIndex=EepGeneral
      EaSWC_DIDMgrDID_FD33_MagnaTesting: EaBlockNumber=816, EaBlockSize=12, EaImmediateData=false, EaNumberOfDatasets=1, EaVerifyWrittenData=false, EaBlockId=34, EaPartition=EaPartitionConfiguration_App, EaDeviceIndex=EepGeneral
      EaSWC_DIDMgrECU_LifeTime: EaBlockNumber=832, EaBlockSize=6, EaImmediateData=false, EaNumberOfDatasets=1, EaVerifyWrittenData=true, EaBlockId=23, EaPartition=EaPartitionConfiguration_App, EaDeviceIndex=EepGeneral
      EaSWC_PartNumMgrDID_FD31_EOLCodingState: EaBlockNumber=848, EaBlockSize=6, EaImmediateData=false, EaNumberOfDatasets=1, EaVerifyWrittenData=false, EaBlockId=24, EaPartition=EaPartitionConfiguration_App, EaDeviceIndex=EepGeneral
      EaSWC_ProxiMgrProxiConfigTable: EaBlockNumber=864, EaBlockSize=68, EaImmediateData=true, EaNumberOfDatasets=2, EaVerifyWrittenData=true, EaBlockId=0, EaPartition=EaPartitionConfiguration_App, EaDeviceIndex=EepGeneral
      EaSWC_ProxiMgrProxiErrorData: EaBlockNumber=880, EaBlockSize=11, EaImmediateData=false, EaNumberOfDatasets=1, EaVerifyWrittenData=true, EaBlockId=1, EaPartition=EaPartitionConfiguration_App, EaDeviceIndex=EepGeneral
      EaCalDataProviderSVSCamCurrentCalibData: EaBlockNumber=896, EaBlockSize=202, EaImmediateData=false, EaNumberOfDatasets=2, EaVerifyWrittenData=false, EaBlockId=2, EaPartition=EaPartitionConfiguration_App, EaDeviceIndex=EepGeneral
      EaCalDataProviderSVSCamEOLCalibData: EaBlockNumber=912, EaBlockSize=202, EaImmediateData=false, EaNumberOfDatasets=2, EaVerifyWrittenData=false, EaBlockId=3, EaPartition=EaPartitionConfiguration_App, EaDeviceIndex=EepGeneral
      EaCalDataProviderSVSCamOCCalibData: EaBlockNumber=928, EaBlockSize=102, EaImmediateData=false, EaNumberOfDatasets=2, EaVerifyWrittenData=false, EaBlockId=4, EaPartition=EaPartitionConfiguration_App, EaDeviceIndex=EepGeneral
      EaCalDataProviderSVSCamSCCalibData: EaBlockNumber=944, EaBlockSize=102, EaImmediateData=false, EaNumberOfDatasets=2, EaVerifyWrittenData=false, EaBlockId=5, EaPartition=EaPartitionConfiguration_App, EaDeviceIndex=EepGeneral
      EaSWC_PartNumMgrUssSensorMarrData: EaBlockNumber=960, EaBlockSize=58, EaImmediateData=false, EaNumberOfDatasets=1, EaVerifyWrittenData=false, EaBlockId=25, EaPartition=EaPartitionConfiguration_App, EaDeviceIndex=EepGeneral
      EaSWC_DIDMgrDID_FD01_PrevCalibDataCopy: EaBlockNumber=976, EaBlockSize=194, EaImmediateData=false, EaNumberOfDatasets=1, EaVerifyWrittenData=false, EaBlockId=10, EaPartition=EaPartitionConfiguration_App, EaDeviceIndex=EepGeneral
      EaSWC_DIDMgrDID_FD42_FailsafeDebug: EaBlockNumber=992, EaBlockSize=3, EaImmediateData=false, EaNumberOfDatasets=1, EaVerifyWrittenData=false, EaBlockId=31, EaPartition=EaPartitionConfiguration_App
      EaSWC_DIDMgrDID_RearBrakeEvent: EaBlockNumber=1008, EaBlockSize=46, EaImmediateData=false, EaNumberOfDatasets=1, EaVerifyWrittenData=false, EaBlockId=36, EaPartition=EaPartitionConfiguration_App, EaDeviceIndex=EepGeneral
      EaSWC_DIDMgrDID_SPMAbrtEvent: EaBlockNumber=1024, EaBlockSize=58, EaImmediateData=false, EaNumberOfDatasets=1, EaVerifyWrittenData=false, EaBlockId=37, EaPartition=EaPartitionConfiguration_App, EaDeviceIndex=EepGeneral
      EaCDD_IPCHandlerFeatureAP_HMI_NvMData: EaBlockNumber=1040, EaBlockSize=3, EaImmediateData=false, EaNumberOfDatasets=1, EaVerifyWrittenData=false, EaBlockId=26, EaPartition=EaPartitionConfiguration_App, EaDeviceIndex=EepGeneral
      EaBlockConfiguration_SecureLogGroup1: EaBlockNumber=1056, EaImmediateData=false, EaNumberOfDatasets=1, EaVerifyWrittenData=false, EaBlockId=0, EaBlockSize=504, EaPartition=EaPartitionConfiguration_SecureLog
    EaPartitionConfiguration_SecureLog (EaPartitionConfiguration):
      EaPartitionStartAddress = 7168
      EaPartitionSize = 1024
      EaPartitionAddressAlignment = 1
      EaPartitionWriteAlignment = 1
      EaPartitionDevice = EepInitConfiguration
    12 x EaBlockConfiguration, all with EaNumberOfWriteCycles=10000, EaNumberOfInstances=1:
      EaBlockConfiguration_SecureLogGroup2: EaBlockNumber=1072, EaImmediateData=false, EaNumberOfDatasets=1, EaVerifyWrittenData=false, EaBlockId=1, EaBlockSize=504, EaPartition=EaPartitionConfiguration_SecureLog
      EaSWC_DIDMgrDID_FD86_FunctionalSettings: EaBlockNumber=1088, EaBlockSize=10, EaImmediateData=false, EaNumberOfDatasets=1, EaVerifyWrittenData=false, EaBlockId=27, EaPartition=EaPartitionConfiguration_App, EaDeviceIndex=EepGeneral
      EaBlockDescriptor_FileHeader: EaBlockNumber=1104, EaBlockSize=178, EaImmediateData=false, EaNumberOfDatasets=9, EaVerifyWrittenData=true, EaBlockId=13, EaPartition=EaPartitionConfiguration_FblApp, EaDeviceIndex=EepGeneral
      EaBlockDescriptor_SerialNumber: EaBlockNumber=1120, EaBlockSize=48, EaImmediateData=false, EaNumberOfDatasets=10, EaVerifyWrittenData=true, EaBlockId=14, EaPartition=EaPartitionConfiguration_FblApp, EaDeviceIndex=EepGeneral
      EaSWC_DIDMgrDID_CDD_IPCHandlerFPA_SlotData: EaBlockNumber=1136, EaBlockSize=58, EaImmediateData=false, EaNumberOfDatasets=2, EaVerifyWrittenData=false, EaBlockId=35, EaPartition=EaPartitionConfiguration_App, EaDeviceIndex=EepGeneral
      EaSafety_GuardSafeStat2_ResetReason: EaBlockNumber=1152, EaBlockSize=4, EaImmediateData=false, EaNumberOfDatasets=1, EaVerifyWrittenData=false, EaBlockId=32, EaPartition=EaPartitionConfiguration_App, EaDeviceIndex=EepGeneral
      EaCalDataProviderFrontCamSerialNumber: EaBlockNumber=1168, EaBlockSize=12, EaImmediateData=true, EaNumberOfDatasets=2, EaVerifyWrittenData=false, EaBlockId=6, EaPartition=EaPartitionConfiguration_App, EaDeviceIndex=EepGeneral
      EaCalDataProviderLeftCamSerialNumber: EaBlockNumber=1184, EaBlockSize=12, EaImmediateData=true, EaNumberOfDatasets=2, EaVerifyWrittenData=false, EaBlockId=7, EaPartition=EaPartitionConfiguration_App, EaDeviceIndex=EepGeneral
      EaCalDataProviderRearCamSerialNumber: EaBlockNumber=1200, EaBlockSize=12, EaImmediateData=true, EaNumberOfDatasets=2, EaVerifyWrittenData=false, EaBlockId=8, EaPartition=EaPartitionConfiguration_App, EaDeviceIndex=EepGeneral
      EaCalDataProviderRightCamSerialNumber: EaBlockNumber=1216, EaBlockSize=12, EaImmediateData=true, EaNumberOfDatasets=2, EaVerifyWrittenData=false, EaBlockId=9, EaPartition=EaPartitionConfiguration_App, EaDeviceIndex=EepGeneral
      EaBlockDescriptor_SecondCounter: EaBlockNumber=1232, EaBlockSize=6, EaImmediateData=false, EaNumberOfDatasets=1, EaVerifyWrittenData=false, EaBlockId=0, EaPartition=EaPartitionConfiguration_Timetamp
      EaBlockDescriptor_SystemTimestamp: EaBlockNumber=1248, EaBlockSize=17, EaImmediateData=false, EaNumberOfDatasets=1, EaVerifyWrittenData=false, EaBlockId=1, EaPartition=EaPartitionConfiguration_Timetamp
    EaPartitionConfiguration_Timetamp (EaPartitionConfiguration): EaPartitionStartAddress=7113, EaPartitionSize=55, EaPartitionAddressAlignment=1, EaPartitionWriteAlignment=1, EaPartitionDevice=EepInitConfiguration
    4 x EaBlockConfiguration, all with EaNumberOfWriteCycles=10000, EaNumberOfDatasets=1, EaNumberOfInstances=1, EaVerifyWrittenData=false:
      EaBlockDescriptor_CertificateExpired: EaBlockNumber=1264, EaBlockSize=3, EaImmediateData=false, EaBlockId=2, EaPartition=EaPartitionConfiguration_Timetamp
      EaCDD_SafetyCDD_PMICLastResetReason_BISTStatus: EaBlockNumber=1280, EaBlockSize=4, EaImmediateData=true, EaBlockId=33, EaPartition=EaPartitionConfiguration_App, EaDeviceIndex=EepGeneral
      EaSWC_DIDMgrDID_FD74_BuffMarkCompErr: EaBlockNumber=1296, EaBlockSize=4, EaImmediateData=false, EaBlockId=29, EaPartition=EaPartitionConfiguration_App, EaDeviceIndex=EepGeneral
      EaSWC_DIDMgrDID_FD74_PHY_TuningErr: EaBlockNumber=1312, EaBlockSize=4, EaImmediateData=false, EaBlockId=30, EaPartition=EaPartitionConfiguration_App, EaDeviceIndex=EepGeneral
    EaPartitionConfiguration_FblApp (EaPartitionConfiguration): EaPartitionStartAddress=0, EaPartitionSize=3672, EaPartitionAddressAlignment=1, EaPartitionWriteAlignment=1, EaPartitionDevice=EepInitConfiguration
    EaPartitionConfiguration_Dem (EaPartitionConfiguration):
      EaPartitionStartAddress = 5881
      EaPartitionSize = 1232
      EaPartitionAddressAlignment = 1
      EaPartitionWriteAlignment = 1
      EaPartitionDevice = EepInitConfiguration
    EaSWC_DTCMgrDTC_APARequestSts_PAMRequestSts (EaBlockConfiguration):
      EaBlockNumber = 1328
      EaBlockSize = 3
      EaImmediateData = false
      EaNumberOfWriteCycles = 10000
      EaNumberOfDatasets = 1
      EaNumberOfInstances = 1
      EaVerifyWrittenData = false
      EaBlockId = 28
      EaPartition = EaPartitionConfiguration_App
      EaDeviceIndex = EepGeneral
