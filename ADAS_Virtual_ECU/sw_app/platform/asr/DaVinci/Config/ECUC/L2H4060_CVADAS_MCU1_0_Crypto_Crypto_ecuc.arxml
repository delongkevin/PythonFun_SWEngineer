AUTOSAR XML (schema 00048)
package /ActiveEcuC
  module config Crypto: implementation-config-variant=VARIANT-PRE-COMPILE, module-description=Crypto_Impl
    CryptoGeneral: CryptoDevErrorDetect=true, CryptoVersionInfoApi=false, CryptoMainFunctionPeriod=0.01, CryptoSafeBswChecks=false
    CryptoKeyElements
      40 x CryptoKeyElement, all with CryptoKeyElementPersist=false:
        vHsmDummyKeyElement: CryptoKeyElementSize=1, CryptoKeyElementAllowPartialAccess=true, CryptoKeyElementId=0, CryptoKeyElementReadAccess=RA_ALLOWED, CryptoKeyElementWriteAccess=WA_ALLOWED
        Crypto_30_vHsm_LibCv_Signature_Key: CryptoKeyElementAllowPartialAccess=true, CryptoKeyElementId=1, CryptoKeyElementSize=66, CryptoKeyElementReadAccess=RA_ALLOWED, CryptoKeyElementWriteAccess=WA_ALLOWED
        Crypto_30_vHsm_LibCv_Cipher_Key: CryptoKeyElementAllowPartialAccess=false, CryptoKeyElementId=1, CryptoKeyElementSize=16, CryptoKeyElementReadAccess=RA_ALLOWED, CryptoKeyElementWriteAccess=WA_ALLOWED
        Crypto_30_vHsm_LibCv_Cipher_IV: CryptoKeyElementAllowPartialAccess=false, CryptoKeyElementId=5, CryptoKeyElementSize=16, CryptoKeyElementReadAccess=RA_ALLOWED, CryptoKeyElementWriteAccess=WA_ALLOWED
        Crypto_30_vHsm_LibCv_Cipher_Proof: CryptoKeyElementAllowPartialAccess=false, CryptoKeyElementId=6, CryptoKeyElementSize=48, CryptoKeyElementReadAccess=RA_ALLOWED, CryptoKeyElementWriteAccess=WA_ALLOWED
        Crypto_30_vHsm_LibCv_Random_Algorithm_Nist_800_90A_DRBG_AES128: CryptoKeyElementAllowPartialAccess=false, CryptoKeyElementId=4, CryptoKeyElementSize=1, CryptoKeyElementReadAccess=RA_ALLOWED, CryptoKeyElementWriteAccess=WA_ALLOWED
        Crypto_30_vHsm_LibCv_Random_PrivateString: CryptoKeyElementAllowPartialAccess=false, CryptoKeyElementId=3015, CryptoKeyElementSize=16, CryptoKeyElementReadAccess=RA_ALLOWED, CryptoKeyElementWriteAccess=WA_ALLOWED
        Crypto_30_vHsm_LibCv_Random_Reseed_Counter: CryptoKeyElementAllowPartialAccess=false, CryptoKeyElementId=3018, CryptoKeyElementSize=4, CryptoKeyElementReadAccess=RA_ALLOWED, CryptoKeyElementWriteAccess=WA_DENIED
        Crypto_30_vHsm_LibCv_Random_Seed_Nist_800_90A_DRBG_AES128: CryptoKeyElementAllowPartialAccess=false, CryptoKeyElementId=3, CryptoKeyElementSize=32, CryptoKeyElementReadAccess=RA_DENIED, CryptoKeyElementWriteAccess=WA_ALLOWED
        Crypto_30_vHsm_LibCv_Random_AdditionalInput: CryptoKeyElementAllowPartialAccess=false, CryptoKeyElementId=3016, CryptoKeyElementSize=16, CryptoKeyElementReadAccess=RA_ALLOWED, CryptoKeyElementWriteAccess=WA_ALLOWED
        Crypto_30_vHsm_LibCv_vHsm_LazyPersistKey: CryptoKeyElementAllowPartialAccess=false, CryptoKeyElementId=1, CryptoKeyElementSize=16, CryptoKeyElementReadAccess=RA_ALLOWED, CryptoKeyElementWriteAccess=WA_ALLOWED
        Crypto_30_vHsm_LibCv_Mac_Proof: CryptoKeyElementAllowPartialAccess=false, CryptoKeyElementId=2, CryptoKeyElementSize=48, CryptoKeyElementReadAccess=RA_ALLOWED, CryptoKeyElementWriteAccess=WA_ALLOWED
        Crypto_30_vHsm_LibCv_Mac_Key_She: CryptoKeyElementAllowPartialAccess=false, CryptoKeyElementId=1, CryptoKeyElementSize=16, CryptoKeyElementReadAccess=RA_DENIED, CryptoKeyElementWriteAccess=WA_ENCRYPTED
        Crypto_30_vHsm_LibCv_She_Counter: CryptoKeyElementAllowPartialAccess=false, CryptoKeyElementId=3019, CryptoKeyElementSize=4, CryptoKeyElementReadAccess=RA_ALLOWED, CryptoKeyElementWriteAccess=WA_DENIED
        Crypto_30_vHsm_LibCv_Cipher_Key_She: CryptoKeyElementAllowPartialAccess=false, CryptoKeyElementId=1, CryptoKeyElementSize=16, CryptoKeyElementReadAccess=RA_DENIED, CryptoKeyElementWriteAccess=WA_ENCRYPTED
        Crypto_30_vHsm_LibCv_She_UId: CryptoKeyElementAllowPartialAccess=false, CryptoKeyElementId=3021, CryptoKeyElementSize=15, CryptoKeyElementReadAccess=RA_ALLOWED, CryptoKeyElementWriteAccess=WA_DENIED
        Crypto_30_vHsm_LibCv_She_BootProtection: CryptoKeyElementAllowPartialAccess=false, CryptoKeyElementId=3056, CryptoKeyElementSize=1, CryptoKeyElementReadAccess=RA_ALLOWED, CryptoKeyElementWriteAccess=WA_ALLOWED
        Crypto_30_vHsm_LibCv_She_DebuggerProtection: CryptoKeyElementAllowPartialAccess=false, CryptoKeyElementId=3057, CryptoKeyElementSize=1, CryptoKeyElementReadAccess=RA_ALLOWED, CryptoKeyElementWriteAccess=WA_ALLOWED
        Crypto_30_vHsm_vHsm_Core_vHsmInfo_Version: CryptoKeyElementAllowPartialAccess=false, CryptoKeyElementId=3020, CryptoKeyElementSize=3, CryptoKeyElementReadAccess=RA_ALLOWED, CryptoKeyElementWriteAccess=WA_DENIED
        Crypto_30_vHsm_vHsm_Core_vHsmInfo_PerformPersist: CryptoKeyElementAllowPartialAccess=false, CryptoKeyElementId=3022, CryptoKeyElementSize=1, CryptoKeyElementReadAccess=RA_ALLOWED, CryptoKeyElementWriteAccess=WA_DENIED
        Crypto_30_vHsm_vHsm_Core_vHsmInfo_PerformRepersist: CryptoKeyElementAllowPartialAccess=false, CryptoKeyElementId=3036, CryptoKeyElementSize=1, CryptoKeyElementReadAccess=RA_DENIED, CryptoKeyElementWriteAccess=WA_ALLOWED
        Crypto_30_vHsm_vHsm_Core_vHsmInfo_StartFirmwareUpdater: CryptoKeyElementAllowPartialAccess=false, CryptoKeyElementId=3038, CryptoKeyElementSize=1, CryptoKeyElementReadAccess=RA_DENIED, CryptoKeyElementWriteAccess=WA_ALLOWED
        Crypto_30_vHsm_vHsm_Core_vHsmInfo_SecureBootEnd: CryptoKeyElementAllowPartialAccess=false, CryptoKeyElementId=3028, CryptoKeyElementSize=1, CryptoKeyElementReadAccess=RA_ALLOWED, CryptoKeyElementWriteAccess=WA_ALLOWED
        Crypto_30_vHsm_vHsm_Core_vHsmInfo_SecureBootResult: CryptoKeyElementAllowPartialAccess=false, CryptoKeyElementId=3037, CryptoKeyElementSize=1, CryptoKeyElementReadAccess=RA_ALLOWED, CryptoKeyElementWriteAccess=WA_DENIED
        Crypto_30_vHsm_vHsm_Core_vHsmSecureBootInfo_GroupState: CryptoKeyElementAllowPartialAccess=false, CryptoKeyElementId=0, CryptoKeyElementSize=2, CryptoKeyElementReadAccess=RA_ALLOWED, CryptoKeyElementWriteAccess=WA_DENIED
        Crypto_30_vHsm_LibCv_vHsm_KeyDerivation_Algorithm_NIST800108_CMAC: CryptoKeyElementAllowPartialAccess=false, CryptoKeyElementId=15, CryptoKeyElementSize=1, CryptoKeyElementReadAccess=RA_ALLOWED, CryptoKeyElementWriteAccess=WA_DENIED
        Crypto_30_vHsm_LibCv_vHsm_KeyDerivation_Context: CryptoKeyElementAllowPartialAccess=true, CryptoKeyElementId=132, CryptoKeyElementSize=20, CryptoKeyElementReadAccess=RA_ALLOWED, CryptoKeyElementWriteAccess=WA_ALLOWED
        Crypto_30_vHsm_LibCv_vHsm_KeyDerivation_Label: CryptoKeyElementAllowPartialAccess=true, CryptoKeyElementId=130, CryptoKeyElementSize=20, CryptoKeyElementReadAccess=RA_ALLOWED, CryptoKeyElementWriteAccess=WA_ALLOWED
        Crypto_30_vHsm_KeyM_KeyM_Certificate: CryptoKeyElementAllowPartialAccess=true, CryptoKeyElementId=3080, CryptoKeyElementSize=1536, CryptoKeyElementReadAccess=RA_ALLOWED, CryptoKeyElementWriteAccess=WA_ALLOWED
        Crypto_30_vHsm_KeyM_KeyM_GetStatus: CryptoKeyElementAllowPartialAccess=false, CryptoKeyElementId=3081, CryptoKeyElementSize=1, CryptoKeyElementReadAccess=RA_ALLOWED, CryptoKeyElementWriteAccess=WA_DENIED
        Crypto_30_vHsm_KeyM_KeyM_VerifyCertificate: CryptoKeyElementAllowPartialAccess=true, CryptoKeyElementId=3082, CryptoKeyElementSize=1, CryptoKeyElementReadAccess=RA_DENIED, CryptoKeyElementWriteAccess=WA_ALLOWED
        Crypto_30_vHsm_KeyM_KeyM_VerifyCertificates: CryptoKeyElementAllowPartialAccess=false, CryptoKeyElementId=3083, CryptoKeyElementSize=2, CryptoKeyElementReadAccess=RA_DENIED, CryptoKeyElementWriteAccess=WA_ALLOWED
        Crypto_30_vHsm_LibCv_Mac_Key: CryptoKeyElementAllowPartialAccess=false, CryptoKeyElementId=1, CryptoKeyElementSize=16, CryptoKeyElementReadAccess=RA_ALLOWED, CryptoKeyElementWriteAccess=WA_ALLOWED
        Crypto_30_vHsm_LibCv_Rsa_Modulus: CryptoKeyElementAllowPartialAccess=false, CryptoKeyElementId=160, CryptoKeyElementSize=256, CryptoKeyElementReadAccess=RA_ALLOWED, CryptoKeyElementWriteAccess=WA_ALLOWED
        Crypto_30_vHsm_LibCv_Rsa_Pub_Exponent: CryptoKeyElementAllowPartialAccess=false, CryptoKeyElementId=161, CryptoKeyElementSize=3, CryptoKeyElementReadAccess=RA_ALLOWED, CryptoKeyElementWriteAccess=WA_ALLOWED
        Crypto_30_vHsm_LibCv_KeyM_CertificateData: CryptoKeyElementAllowPartialAccess=true, CryptoKeyElementId=0, CryptoKeyElementSize=1536, CryptoKeyElementReadAccess=RA_ALLOWED, CryptoKeyElementWriteAccess=WA_ALLOWED
        Crypto_30_vHsm_LibCv_RoleFlag: CryptoKeyElementAllowPartialAccess=false, CryptoKeyElementId=1, CryptoKeyElementSize=1, CryptoKeyElementReadAccess=RA_ALLOWED, CryptoKeyElementWriteAccess=WA_ALLOWED
        Crypto_30_vHsm_LibCv_Hash_Result_SHA256: CryptoKeyElementAllowPartialAccess=false, CryptoKeyElementId=1, CryptoKeyElementSize=32, CryptoKeyElementReadAccess=RA_ALLOWED, CryptoKeyElementWriteAccess=WA_ALLOWED
        Crypto_30_vHsm_LibCv_CryptoKeyElement_CurrentTimeStamp: CryptoKeyElementAllowPartialAccess=true, CryptoKeyElementId=1, CryptoKeyElementSize=15, CryptoKeyElementReadAccess=RA_ALLOWED, CryptoKeyElementWriteAccess=WA_ALLOWED
        Crypto_30_vHsm_LibCv_CryptoKeyElement_SecondCounter: CryptoKeyElementAllowPartialAccess=true, CryptoKeyElementId=1, CryptoKeyElementSize=4, CryptoKeyElementReadAccess=RA_ALLOWED, CryptoKeyElementWriteAccess=WA_ALLOWED
    CryptoKeys
      52 x CryptoKey, all with CryptoKeyDeriveIterations=1:
        vHsm_SecureBoot_Signature: CryptoKeyId=61, CryptoKeyTypeRef=Crypto_30_vHsm_LibCv_Signature
        SymmetricKey: CryptoKeyId=48, CryptoKeyTypeRef=Crypto_30_vHsm_LibCv_Cipher
        WriteOnceKey: CryptoKeyId=49, CryptoKeyTypeRef=Crypto_30_vHsm_LibCv_WriteOnceKey
        SecureBootProtectedKey: CryptoKeyId=39, CryptoKeyTypeRef=Crypto_30_vHsm_LibCv_SecureBootProtectedKey
        Random: CryptoKeyId=38, CryptoKeyTypeRef=Crypto_30_vHsm_LibCv_Random_Nist_800_90A_DRBG_AES_NoDF
        LazyPersistKey: CryptoKeyId=37, CryptoKeyTypeRef=Crypto_30_vHsm_LibCv_LazyPersistKey
        vHsm_Custom: CryptoKeyId=52, CryptoKeyTypeRef=Crypto_30_vHsm_LibCv_Cipher
        She_Key1: CryptoKeyId=41, CryptoKeyTypeRef=Crypto_30_vHsm_LibCv_MacShe
        She_Key2: CryptoKeyId=42, CryptoKeyTypeRef=Crypto_30_vHsm_LibCv_CipherShe
        She_MasterEcuKey: CryptoKeyId=43, CryptoKeyTypeRef=Crypto_30_vHsm_LibCv_MacShe
        She_SecretKey: CryptoKeyId=44, CryptoKeyTypeRef=Crypto_30_vHsm_LibCv_MacShe
        She_Info: CryptoKeyId=40, CryptoKeyTypeRef=Crypto_30_vHsm_LibCv_SheInfoKey
        vHsm_Info: CryptoKeyId=57, CryptoKeyTypeRef=Crypto_30_vHsm_vHsm_Core_vHsmInfo_Type
        vHsm_Info_SecureBoot: CryptoKeyId=58, CryptoKeyTypeRef=Crypto_30_vHsm_vHsm_Core_vHsmSecureBootGroupInfo_Type
        vHsm_RomKey0: CryptoKeyId=59, CryptoKeyTypeRef=Crypto_30_vHsm_LibCv_Cipher
        vHsm_Aggregated_RomKey0: CryptoKeyId=50, CryptoKeyTypeRef=Crypto_30_vHsm_LibCv_Aggregated_RomKey
        vHsm_Aggregated_RomKey1: CryptoKeyId=51, CryptoKeyTypeRef=Crypto_30_vHsm_LibCv_Aggregated_RomKey
        StartApplication_CryptoKey_vHsm_Dec: CryptoKeyId=45, CryptoKeyTypeRef=Crypto_30_vHsm_LibCv_Cipher
        StartApplication_CryptoKey_vHsm_Enc: CryptoKeyId=46, CryptoKeyTypeRef=Crypto_30_vHsm_LibCv_Cipher
        StartApplication_CryptoKey_vHsm_MAC: CryptoKeyId=47, CryptoKeyTypeRef=Crypto_30_vHsm_LibCv_Mac
        CryIfKey_UserSecureLog_Key: CryptoKeyId=32, CryptoKeyTypeRef=Crypto_30_vHsm_LibCv_UserCMac
        CryIfKey_UserRsaSignVerify_Key: CryptoKeyId=31, CryptoKeyTypeRef=Crypto_30_vHsm_LibCv_Signature_Rsa_Pkcs1_Verify
        CryIfKey_CertData_ADA_L3: CryptoKeyId=1, CryptoKeyTypeRef=Crypto_30_vHsm_LibCv_KeyType_KeyM_Certificate_Type1
        CryIfKey_CertData_ADA_L4: CryptoKeyId=2, CryptoKeyTypeRef=Crypto_30_vHsm_LibCv_KeyType_KeyM_Certificate_Type1
        CryIfKey_CertData_CodeSign_ADA_L1: CryptoKeyId=3, CryptoKeyTypeRef=Crypto_30_vHsm_LibCv_KeyType_KeyM_Certificate_Type1
        CryIfKey_RsaSignatureVerifyKey_ADA_L3: CryptoKeyId=18, CryptoKeyTypeRef=Crypto_30_vHsm_LibCv_Signature_Rsa_Pkcs1_Verify
        CryIfKey_RsaSignatureVerifyKey_ADA_L4: CryptoKeyId=19, CryptoKeyTypeRef=Crypto_30_vHsm_LibCv_Signature_Rsa_Pkcs1_Verify
        CryIfKey_RsaSignatureVerifyKey_CodeSign_ADA_L1: CryptoKeyId=20, CryptoKeyTypeRef=Crypto_30_vHsm_LibCv_Signature_Rsa_Pkcs1_Verify
        CryIfKey_KeyMCertificate_ADA_L4: CryptoKeyId=15, CryptoKeyTypeRef=Crypto_30_vHsm_KeyM_KeyType_KeyM_Certificate
        CryIfKey_RoleFlag: CryptoKeyId=16, CryptoKeyTypeRef=CryptoKeyTypes/Crypto_30_vHsm_LibCv_RoleFlag
        CryIfKey_CertData_CodeSign_App_L4: CryptoKeyId=4, CryptoKeyTypeRef=Crypto_30_vHsm_LibCv_KeyType_KeyM_Certificate_Type1
        CryIfKey_RsaSignatureVerifyKey_CodeSign_App_L4: CryptoKeyId=21, CryptoKeyTypeRef=Crypto_30_vHsm_LibCv_Signature_Rsa_Pkcs1_Verify
        CryIfKey_RsaSignatureVerifyKey_CodeSign_L3: CryptoKeyId=25, CryptoKeyTypeRef=Crypto_30_vHsm_LibCv_Signature_Rsa_Pkcs1_Verify
        CryIfKey_CertData_CodeSign_L3: CryptoKeyId=8, CryptoKeyTypeRef=Crypto_30_vHsm_LibCv_KeyType_KeyM_Certificate_Type1
        CryIfKey_CertData_CodeSign_CertStore_L4: CryptoKeyId=6, CryptoKeyTypeRef=Crypto_30_vHsm_LibCv_KeyType_KeyM_Certificate_Type1
        CryIfKey_CertData_CodeSign_C7X_L4: CryptoKeyId=5, CryptoKeyTypeRef=Crypto_30_vHsm_LibCv_KeyType_KeyM_Certificate_Type1
        CryIfKey_CertData_CodeSign_LateApp1_L4: CryptoKeyId=9, CryptoKeyTypeRef=Crypto_30_vHsm_LibCv_KeyType_KeyM_Certificate_Type1
        CryIfKey_CertData_CodeSign_LateApp2_L4: CryptoKeyId=10, CryptoKeyTypeRef=Crypto_30_vHsm_LibCv_KeyType_KeyM_Certificate_Type1
        CryIfKey_CertData_CodeSign_Qnx_L4: CryptoKeyId=11, CryptoKeyTypeRef=Crypto_30_vHsm_LibCv_KeyType_KeyM_Certificate_Type1
        CryIfKey_RsaSignatureVerifyKey_CodeSign_C7x_L4: CryptoKeyId=22, CryptoKeyTypeRef=Crypto_30_vHsm_LibCv_Signature_Rsa_Pkcs1_Verify
        CryIfKey_RsaSignatureVerifyKey_CodeSign_LateApp1_L4: CryptoKeyId=26, CryptoKeyTypeRef=Crypto_30_vHsm_LibCv_Signature_Rsa_Pkcs1_Verify
        CryIfKey_RsaSignatureVerifyKey_CodeSign_LateApp2_L4: CryptoKeyId=27, CryptoKeyTypeRef=Crypto_30_vHsm_LibCv_Signature_Rsa_Pkcs1_Verify
        CryIfKey_RsaSignatureVerifyKey_CodeSign_Qnx_L4: CryptoKeyId=28, CryptoKeyTypeRef=Crypto_30_vHsm_LibCv_Signature_Rsa_Pkcs1_Verify
        CryIfKey_GVCS_RsaKey: CryptoKeyId=14, CryptoKeyTypeRef=Crypto_30_vHsm_LibCv_Signature_Rsa_Pkcs1_Verify
        CryIfKey_Sha256Result: CryptoKeyId=30, CryptoKeyTypeRef=Crypto_30_vHsm_LibCv_Hash_Sha256Result
        CryIfKey_CertData_ADA_L2: CryptoKeyId=0, CryptoKeyTypeRef=Crypto_30_vHsm_LibCv_KeyType_KeyM_Certificate_Type1
        CryIfKey_RsaSignatureVerifyKey_ADA_L2: CryptoKeyId=17, CryptoKeyTypeRef=Crypto_30_vHsm_LibCv_Signature_Rsa_Pkcs1_Verify
        CryIfKey_RsaSignatureVerifyKey_CodeSign_CertStore_L4: CryptoKeyId=23, CryptoKeyTypeRef=Crypto_30_vHsm_LibCv_Signature_Rsa_Pkcs1_Verify
        CryIfKey_CertData_CodeSign_L2: CryptoKeyId=7, CryptoKeyTypeRef=Crypto_30_vHsm_LibCv_KeyType_KeyM_Certificate_Type1
        CryIfKey_RsaSignatureVerifyKey_CodeSign_L2: CryptoKeyId=24, CryptoKeyTypeRef=Crypto_30_vHsm_LibCv_Signature_Rsa_Pkcs1_Verify
        CryIfKey_CurrentTimeStamp: CryptoKeyId=12, CryptoKeyTypeRef=Crypto_30_vHsm_LibCv_CryptoKeyType_CurrentTimeStamp
        CryIfKey_SecondCounter: CryptoKeyId=29, CryptoKeyTypeRef=Crypto_30_vHsm_LibCv_CryptoKeyType_SecondCounter
    CryptoKeyTypes
      22 x CryptoKeyType:
        Crypto_30_vHsm_LibCv_Signature: CryptoKeyElementRef=Crypto_30_vHsm_LibCv_Signature_Key
        Crypto_30_vHsm_LibCv_Cipher: CryptoKeyElementRef=Crypto_30_vHsm_LibCv_Cipher_Key, CryptoKeyElementRef=Crypto_30_vHsm_LibCv_Cipher_IV, CryptoKeyElementRef=Crypto_30_vHsm_LibCv_Cipher_Proof
        Crypto_30_vHsm_LibCv_WriteOnceKey: CryptoKeyElementRef=Crypto_30_vHsm_LibCv_Cipher_Key
        Crypto_30_vHsm_LibCv_SecureBootProtectedKey: CryptoKeyElementRef=Crypto_30_vHsm_LibCv_Cipher_IV, CryptoKeyElementRef=Crypto_30_vHsm_LibCv_Cipher_Key
        Crypto_30_vHsm_LibCv_Random_Nist_800_90A_DRBG_AES_NoDF: CryptoKeyElementRef=Crypto_30_vHsm_LibCv_Random_Algorithm_Nist_800_90A_DRBG_AES128, CryptoKeyElementRef=Crypto_30_vHsm_LibCv_Random_PrivateString, CryptoKeyElementRef=Crypto_30_vHsm_LibCv_Random_Reseed_Counter, CryptoKeyElementRef=Crypto_30_vHsm_LibCv_Random_Seed_Nist_800_90A_DRBG_AES128, CryptoKeyElementRef=Crypto_30_vHsm_LibCv_Random_AdditionalInput
        Crypto_30_vHsm_LibCv_LazyPersistKey: CryptoKeyElementRef=Crypto_30_vHsm_LibCv_vHsm_LazyPersistKey
        Crypto_30_vHsm_LibCv_MacShe: CryptoKeyElementRef=Crypto_30_vHsm_LibCv_Mac_Proof, CryptoKeyElementRef=Crypto_30_vHsm_LibCv_Mac_Key_She, CryptoKeyElementRef=Crypto_30_vHsm_LibCv_She_Counter
        Crypto_30_vHsm_LibCv_CipherShe: CryptoKeyElementRef=Crypto_30_vHsm_LibCv_Cipher_IV, CryptoKeyElementRef=Crypto_30_vHsm_LibCv_Cipher_Proof, CryptoKeyElementRef=Crypto_30_vHsm_LibCv_Cipher_Key_She, CryptoKeyElementRef=Crypto_30_vHsm_LibCv_She_Counter
        Crypto_30_vHsm_LibCv_SheInfoKey: CryptoKeyElementRef=Crypto_30_vHsm_LibCv_She_UId, CryptoKeyElementRef=Crypto_30_vHsm_LibCv_She_BootProtection, CryptoKeyElementRef=Crypto_30_vHsm_LibCv_She_DebuggerProtection
        Crypto_30_vHsm_vHsm_Core_vHsmInfo_Type: CryptoKeyElementRef=Crypto_30_vHsm_vHsm_Core_vHsmInfo_Version, CryptoKeyElementRef=Crypto_30_vHsm_vHsm_Core_vHsmInfo_PerformPersist, CryptoKeyElementRef=Crypto_30_vHsm_vHsm_Core_vHsmInfo_PerformRepersist, CryptoKeyElementRef=Crypto_30_vHsm_vHsm_Core_vHsmInfo_StartFirmwareUpdater, CryptoKeyElementRef=Crypto_30_vHsm_vHsm_Core_vHsmInfo_SecureBootEnd, CryptoKeyElementRef=Crypto_30_vHsm_vHsm_Core_vHsmInfo_SecureBootResult
        Crypto_30_vHsm_vHsm_Core_vHsmSecureBootGroupInfo_Type: CryptoKeyElementRef=Crypto_30_vHsm_vHsm_Core_vHsmSecureBootInfo_GroupState
        Crypto_30_vHsm_LibCv_Aggregated_RomKey: CryptoKeyElementRef=Crypto_30_vHsm_LibCv_Cipher_IV, CryptoKeyElementRef=Crypto_30_vHsm_LibCv_vHsm_KeyDerivation_Algorithm_NIST800108_CMAC, CryptoKeyElementRef=Crypto_30_vHsm_LibCv_vHsm_KeyDerivation_Context, CryptoKeyElementRef=Crypto_30_vHsm_LibCv_vHsm_KeyDerivation_Label
        Crypto_30_vHsm_KeyM_KeyType_KeyM_Certificate: CryptoKeyElementRef=Crypto_30_vHsm_KeyM_KeyM_Certificate, CryptoKeyElementRef=Crypto_30_vHsm_KeyM_KeyM_GetStatus, CryptoKeyElementRef=Crypto_30_vHsm_KeyM_KeyM_VerifyCertificate, CryptoKeyElementRef=Crypto_30_vHsm_KeyM_KeyM_VerifyCertificates
        Crypto_30_vHsm_LibCv_Mac: CryptoKeyElementRef=Crypto_30_vHsm_LibCv_Mac_Key, CryptoKeyElementRef=Crypto_30_vHsm_LibCv_Mac_Proof, CryptoKeyElementRef=Crypto_30_vHsm_LibCv_Cipher_IV
        Crypto_30_vHsm_LibCv_UserCMac: CryptoKeyElementRef=Crypto_30_vHsm_LibCv_Cipher_Key
        Crypto_30_vHsm_LibCv_Signature_Rsa_Pkcs1_Verify: CryptoKeyElementRef=Crypto_30_vHsm_LibCv_Rsa_Modulus, CryptoKeyElementRef=Crypto_30_vHsm_LibCv_Rsa_Pub_Exponent
        vHsmDummyKeyType: CryptoKeyElementRef=vHsmDummyKeyElement
        Crypto_30_vHsm_LibCv_KeyType_KeyM_Certificate_Type1: CryptoKeyElementRef=Crypto_30_vHsm_LibCv_KeyM_CertificateData
        Crypto_30_vHsm_LibCv_RoleFlag: CryptoKeyElementRef=CryptoKeyElements/Crypto_30_vHsm_LibCv_RoleFlag
        Crypto_30_vHsm_LibCv_Hash_Sha256Result: CryptoKeyElementRef=Crypto_30_vHsm_LibCv_Hash_Result_SHA256
        Crypto_30_vHsm_LibCv_CryptoKeyType_CurrentTimeStamp: CryptoKeyElementRef=Crypto_30_vHsm_LibCv_CryptoKeyElement_CurrentTimeStamp
        Crypto_30_vHsm_LibCv_CryptoKeyType_SecondCounter: CryptoKeyElementRef=Crypto_30_vHsm_LibCv_CryptoKeyElement_SecondCounter
    CryptoDriverObjects
      8 x CryptoDriverObject, all with CryptoDriverObjectQueueSize=1:
        Crypto_30_vHsm_Core: CryptoDriverObjectId=1, CryptoBufferSize=128, CryptoPrimitiveRef=Crypto_30_vHsm_vHsm_Core_vHsmSecureBoot, CryptoPrimitiveRef=Crypto_30_vHsm_vHsm_Core_vHsmFirmwareUpdate, CryptoPrimitiveRef=Crypto_30_vHsm_vHsm_Core_vHsmSecureBootUpdate, CryptoPrimitiveRef=Crypto_30_vHsm_vHsm_Core_vHsmSecureSoftwareDownload, CryptoPrimitiveRef=Crypto_30_vHsm_vHsm_Core_vHsmSecureBootConfirmation, CryptoPrimitiveRef=Crypto_30_vHsm_vHsm_Core_vHsmPersistency
        Crypto_30_vHsm_Hal: CryptoDriverObjectId=3, CryptoBufferSize=512, CryptoPrimitiveRef=Crypto_30_vHsm_Hwa_Trng, CryptoPrimitiveRef=Crypto_30_vHsm_Hwa_AesCmacGenerate, CryptoPrimitiveRef=Crypto_30_vHsm_Hwa_AesCmacVerify, CryptoPrimitiveRef=Crypto_30_vHsm_Hwa_AesDecrypt, CryptoPrimitiveRef=Crypto_30_vHsm_Hwa_AesEncrypt, CryptoPrimitiveRef=Crypto_30_vHsm_Hwa_Sha2_256
        Crypto_30_vHsm_LibCv: CryptoDriverObjectId=7, CryptoBufferSize=1536, CryptoPrimitiveRef=Crypto_30_vHsm_LibCv_SHA256, CryptoPrimitiveRef=Crypto_30_vHsm_LibCv_AesDecrypt, CryptoPrimitiveRef=Crypto_30_vHsm_LibCv_AesEncrypt, CryptoPrimitiveRef=Crypto_30_vHsm_LibCv_AesCmacGenerate, CryptoPrimitiveRef=Crypto_30_vHsm_LibCv_AesCmacVerify, CryptoPrimitiveRef=Crypto_30_vHsm_LibCv_RngDrbgAes128, CryptoPrimitiveRef=Crypto_30_vHsm_LibCv_EccNistP256R1VerifySha256, CryptoPrimitiveRef=Crypto_30_vHsm_LibCv_RsaPkcs1Sha256Verify
        Crypto_30_vHsm_KeyManagement: CryptoDriverObjectId=6, CryptoBufferSize=1536, CryptoPrimitiveRef=vHsmUsageForbidden
        Crypto_30_vHsm_LibCv_HighPrio: CryptoDriverObjectId=9, CryptoBufferSize=128, CryptoPrimitiveRef=Crypto_30_vHsm_LibCv_SHA256, CryptoPrimitiveRef=Crypto_30_vHsm_LibCv_AesDecrypt, CryptoPrimitiveRef=Crypto_30_vHsm_LibCv_AesEncrypt, CryptoPrimitiveRef=Crypto_30_vHsm_LibCv_AesCmacGenerate, CryptoPrimitiveRef=Crypto_30_vHsm_LibCv_AesCmacVerify, CryptoPrimitiveRef=Crypto_30_vHsm_LibCv_RngDrbgAes128
        Crypto_30_vHsm_KeyMRemote: CryptoDriverObjectId=5, CryptoBufferSize=1536, CryptoPrimitiveRef=Crypto_30_vHsm_KeyM_KeyM_ServiceCertificate, CryptoPrimitiveRef=Crypto_30_vHsm_KeyM_KeyM_CertElementGet, CryptoPrimitiveRef=Crypto_30_vHsm_KeyM_KeyM_RemoteHandling
        Crypto_30_vHsm_GVCS: CryptoDriverObjectId=2, CryptoBufferSize=128, CryptoPrimitiveRef=Crypto_30_vHsm_GVCS_UpdateCertificatesAndDcl, CryptoPrimitiveRef=Crypto_30_vHsm_GVCS_ValidateHeader, CryptoPrimitiveRef=Crypto_30_vHsm_GVCS_ValidatevHsmSecureBootUpdate
        Crypto_30_vHsm_Custom: CryptoDriverObjectId=0, CryptoBufferSize=1536, CryptoPrimitiveRef=Crypto_30_vHsm_vHsm_Custom_Dummy
    CryptoPrimitives
      24 x CryptoPrimitive:
        Crypto_30_vHsm_vHsm_Core_vHsmSecureBoot: CryptoPrimitiveService=CRYPTO_MAC_VERIFY, CryptoPrimitiveAlgorithmFamily=CRYPTO_ALGOFAM_CUSTOM_VHSM_SECURE_BOOT, CryptoPrimitiveAlgorithmMode=CRYPTO_ALGOMODE_CMAC, CryptoPrimitiveAlgorithmMode=CRYPTO_ALGOMODE_NOT_SET, CryptoPrimitiveAlgorithmMode=CRYPTO_ALGOMODE_CUSTOM, CryptoPrimitiveAlgorithmSecondaryFamily=CRYPTO_ALGOFAM_NOT_SET, CryptoPrimitiveSupportContext=false, CryptoPrimitiveAlgorithmModeCustomRef=Crypto_30_vHsm_vHsm_Core_ForceSequential, CryptoPrimitiveAlgorithmFamilyCustomRef=Crypto_30_vHsm_vHsm_Core_SecureBoot
        Crypto_30_vHsm_vHsm_Core_vHsmFirmwareUpdate: CryptoPrimitiveService=CRYPTO_AEADENCRYPT, CryptoPrimitiveAlgorithmFamily=CRYPTO_ALGOFAM_CUSTOM_VHSM_FIRMWARE_UPDATE, CryptoPrimitiveAlgorithmMode=CRYPTO_ALGOMODE_GCM, CryptoPrimitiveAlgorithmMode=CRYPTO_ALGOMODE_NOT_SET, CryptoPrimitiveAlgorithmSecondaryFamily=CRYPTO_ALGOFAM_NOT_SET, CryptoPrimitiveSupportContext=false, CryptoPrimitiveAlgorithmFamilyCustomRef=Crypto_30_vHsm_vHsm_Core_FirmwareUpdate
        Crypto_30_vHsm_vHsm_Core_vHsmSecureBootUpdate: CryptoPrimitiveService=CRYPTO_SIGNATURE_VERIFY, CryptoPrimitiveAlgorithmFamily=CRYPTO_ALGOFAM_CUSTOM, CryptoPrimitiveAlgorithmMode=CRYPTO_ALGOMODE_NOT_SET, CryptoPrimitiveAlgorithmSecondaryFamily=CRYPTO_ALGOFAM_NOT_SET, CryptoPrimitiveSupportContext=false, CryptoPrimitiveAlgorithmFamilyCustomRef=Crypto_30_vHsm_vHsm_Core_SecureBootUpdate
        Crypto_30_vHsm_vHsm_Core_vHsmSecureSoftwareDownload: CryptoPrimitiveService=CRYPTO_SIGNATURE_VERIFY, CryptoPrimitiveAlgorithmFamily=CRYPTO_ALGOFAM_CUSTOM_VHSM_SOFTWARE_DOWNLOAD, CryptoPrimitiveAlgorithmMode=CRYPTO_ALGOMODE_NOT_SET, CryptoPrimitiveAlgorithmSecondaryFamily=CRYPTO_ALGOFAM_NOT_SET, CryptoPrimitiveSupportContext=false, CryptoPrimitiveAlgorithmSecondaryFamilyCustomRef=Crypto_30_vHsm_vHsm_Core_SoftwareDownload
        Crypto_30_vHsm_vHsm_Core_vHsmSecureBootConfirmation: CryptoPrimitiveService=CRYPTO_SIGNATURE_VERIFY, CryptoPrimitiveAlgorithmFamily=CRYPTO_ALGOFAM_CUSTOM, CryptoPrimitiveAlgorithmMode=CRYPTO_ALGOMODE_NOT_SET, CryptoPrimitiveAlgorithmSecondaryFamily=CRYPTO_ALGOFAM_NOT_SET, CryptoPrimitiveSupportContext=false, CryptoPrimitiveAlgorithmFamilyCustomRef=Crypto_30_vHsm_vHsm_Core_SecureBootConfirmation
        Crypto_30_vHsm_vHsm_Core_vHsmPersistency: CryptoPrimitiveService=CRYPTO_RANDOM, CryptoPrimitiveAlgorithmFamily=CRYPTO_ALGOFAM_CUSTOM, CryptoPrimitiveAlgorithmMode=CRYPTO_ALGOMODE_CUSTOM, CryptoPrimitiveAlgorithmSecondaryFamily=CRYPTO_ALGOFAM_NOT_SET, CryptoPrimitiveSupportContext=false, CryptoPrimitiveAlgorithmFamilyCustomRef=Crypto_30_vHsm_vHsm_Core_Persistency, CryptoPrimitiveAlgorithmModeCustomRef=Crypto_30_vHsm_vHsm_Core_PersistDeferred, CryptoPrimitiveAlgorithmModeCustomRef=Crypto_30_vHsm_vHsm_Core_Repersist
        Crypto_30_vHsm_Hwa_Trng: CryptoPrimitiveService=CRYPTO_RANDOM, CryptoPrimitiveAlgorithmFamily=CRYPTO_ALGOFAM_RNG, CryptoPrimitiveAlgorithmMode=CRYPTO_ALGOMODE_NOT_SET, CryptoPrimitiveAlgorithmSecondaryFamily=CRYPTO_ALGOFAM_NOT_SET, CryptoPrimitiveSupportContext=false
        Crypto_30_vHsm_Hwa_AesCmacGenerate: CryptoPrimitiveService=CRYPTO_MAC_GENERATE, CryptoPrimitiveAlgorithmFamily=CRYPTO_ALGOFAM_AES, CryptoPrimitiveAlgorithmMode=CRYPTO_ALGOMODE_CMAC, CryptoPrimitiveAlgorithmSecondaryFamily=CRYPTO_ALGOFAM_NOT_SET, CryptoPrimitiveSupportContext=false
        Crypto_30_vHsm_Hwa_AesCmacVerify: CryptoPrimitiveService=CRYPTO_MAC_VERIFY, CryptoPrimitiveAlgorithmFamily=CRYPTO_ALGOFAM_AES, CryptoPrimitiveAlgorithmMode=CRYPTO_ALGOMODE_CMAC, CryptoPrimitiveAlgorithmSecondaryFamily=CRYPTO_ALGOFAM_NOT_SET, CryptoPrimitiveSupportContext=false
        Crypto_30_vHsm_Hwa_AesDecrypt: CryptoPrimitiveService=CRYPTO_DECRYPT, CryptoPrimitiveAlgorithmFamily=CRYPTO_ALGOFAM_AES, CryptoPrimitiveAlgorithmMode=CRYPTO_ALGOMODE_ECB, CryptoPrimitiveAlgorithmMode=CRYPTO_ALGOMODE_CBC, CryptoPrimitiveAlgorithmMode=CRYPTO_ALGOMODE_CTR, CryptoPrimitiveAlgorithmSecondaryFamily=CRYPTO_ALGOFAM_NOT_SET, CryptoPrimitiveSupportContext=false, CryptoPrimitiveAlgorithmSecondaryFamilyCustomRef=Crypto_30_vHsm_Hwa_PaddingPKCS7
        Crypto_30_vHsm_Hwa_AesEncrypt: CryptoPrimitiveService=CRYPTO_ENCRYPT, CryptoPrimitiveAlgorithmFamily=CRYPTO_ALGOFAM_AES, CryptoPrimitiveAlgorithmMode=CRYPTO_ALGOMODE_ECB, CryptoPrimitiveAlgorithmMode=CRYPTO_ALGOMODE_CBC, CryptoPrimitiveAlgorithmMode=CRYPTO_ALGOMODE_CTR, CryptoPrimitiveAlgorithmSecondaryFamily=CRYPTO_ALGOFAM_NOT_SET, CryptoPrimitiveSupportContext=false, CryptoPrimitiveAlgorithmSecondaryFamilyCustomRef=Crypto_30_vHsm_Hwa_PaddingPKCS7
        Crypto_30_vHsm_Hwa_Sha2_256: CryptoPrimitiveService=CRYPTO_HASH, CryptoPrimitiveAlgorithmFamily=CRYPTO_ALGOFAM_SHA2_256, CryptoPrimitiveAlgorithmMode=CRYPTO_ALGOMODE_NOT_SET, CryptoPrimitiveAlgorithmSecondaryFamily=CRYPTO_ALGOFAM_NOT_SET, CryptoPrimitiveSupportContext=false
        Crypto_30_vHsm_LibCv_SHA256: CryptoPrimitiveService=CRYPTO_HASH, CryptoPrimitiveAlgorithmFamily=CRYPTO_ALGOFAM_SHA2_256, CryptoPrimitiveAlgorithmMode=CRYPTO_ALGOMODE_NOT_SET, CryptoPrimitiveAlgorithmSecondaryFamily=CRYPTO_ALGOFAM_NOT_SET, CryptoPrimitiveSupportContext=false
        Crypto_30_vHsm_LibCv_AesDecrypt: CryptoPrimitiveService=CRYPTO_DECRYPT, CryptoPrimitiveAlgorithmFamily=CRYPTO_ALGOFAM_AES, CryptoPrimitiveAlgorithmMode=CRYPTO_ALGOMODE_ECB, CryptoPrimitiveAlgorithmMode=CRYPTO_ALGOMODE_CBC, CryptoPrimitiveAlgorithmMode=CRYPTO_ALGOMODE_CTR, CryptoPrimitiveAlgorithmSecondaryFamily=CRYPTO_ALGOFAM_NOT_SET, CryptoPrimitiveAlgorithmSecondaryFamily=CRYPTO_ALGOFAM_CUSTOM_PADDING_PKCS7, CryptoPrimitiveAlgorithmSecondaryFamily=CRYPTO_ALGOFAM_CUSTOM, CryptoPrimitiveSupportContext=false, CryptoPrimitiveAlgorithmSecondaryFamilyCustomRef=Crypto_30_vHsm_LibCv_PaddingPKCS7
        Crypto_30_vHsm_LibCv_AesEncrypt: CryptoPrimitiveService=CRYPTO_ENCRYPT, CryptoPrimitiveAlgorithmFamily=CRYPTO_ALGOFAM_AES, CryptoPrimitiveAlgorithmMode=CRYPTO_ALGOMODE_ECB, CryptoPrimitiveAlgorithmMode=CRYPTO_ALGOMODE_CBC, CryptoPrimitiveAlgorithmMode=CRYPTO_ALGOMODE_CTR, CryptoPrimitiveAlgorithmSecondaryFamily=CRYPTO_ALGOFAM_NOT_SET, CryptoPrimitiveAlgorithmSecondaryFamily=CRYPTO_ALGOFAM_CUSTOM_PADDING_PKCS7, CryptoPrimitiveAlgorithmSecondaryFamily=CRYPTO_ALGOFAM_CUSTOM, CryptoPrimitiveSupportContext=false, CryptoPrimitiveAlgorithmSecondaryFamilyCustomRef=Crypto_30_vHsm_LibCv_PaddingPKCS7
        Crypto_30_vHsm_LibCv_AesCmacGenerate: CryptoPrimitiveService=CRYPTO_MAC_GENERATE, CryptoPrimitiveAlgorithmFamily=CRYPTO_ALGOFAM_AES, CryptoPrimitiveAlgorithmMode=CRYPTO_ALGOMODE_CMAC, CryptoPrimitiveAlgorithmSecondaryFamily=CRYPTO_ALGOFAM_NOT_SET, CryptoPrimitiveSupportContext=false
        Crypto_30_vHsm_LibCv_AesCmacVerify: CryptoPrimitiveService=CRYPTO_MAC_VERIFY, CryptoPrimitiveAlgorithmFamily=CRYPTO_ALGOFAM_AES, CryptoPrimitiveAlgorithmMode=CRYPTO_ALGOMODE_CMAC, CryptoPrimitiveAlgorithmSecondaryFamily=CRYPTO_ALGOFAM_NOT_SET, CryptoPrimitiveSupportContext=false
        Crypto_30_vHsm_LibCv_RngDrbgAes128: CryptoPrimitiveService=CRYPTO_RANDOM, CryptoPrimitiveAlgorithmFamily=CRYPTO_ALGOFAM_CUSTOM_DRBG, CryptoPrimitiveAlgorithmMode=CRYPTO_ALGOMODE_NOT_SET, CryptoPrimitiveAlgorithmSecondaryFamily=CRYPTO_ALGOFAM_AES, CryptoPrimitiveSupportContext=false, CryptoPrimitiveAlgorithmFamilyCustomRef=Crypto_30_vHsm_LibCv_DRBG
        Crypto_30_vHsm_LibCv_EccNistP256R1VerifySha256: CryptoPrimitiveService=CRYPTO_SIGNATURE_VERIFY, CryptoPrimitiveAlgorithmFamily=CRYPTO_ALGOFAM_ECCNIST, CryptoPrimitiveAlgorithmMode=CRYPTO_ALGOMODE_CUSTOM_P256R1, CryptoPrimitiveAlgorithmSecondaryFamily=CRYPTO_ALGOFAM_SHA2_256, CryptoPrimitiveSupportContext=false, CryptoPrimitiveAlgorithmModeCustomRef=Crypto_30_vHsm_LibCv_P256r1
        Crypto_30_vHsm_LibCv_RsaPkcs1Sha256Verify: CryptoPrimitiveService=CRYPTO_SIGNATURE_VERIFY, CryptoPrimitiveAlgorithmFamily=CRYPTO_ALGOFAM_RSA, CryptoPrimitiveAlgorithmMode=CRYPTO_ALGOMODE_RSASSA_PKCS1_v1_5, CryptoPrimitiveAlgorithmSecondaryFamily=CRYPTO_ALGOFAM_SHA2_256, CryptoPrimitiveSupportContext=false
        Crypto_30_vHsm_KeyM_KeyM_ServiceCertificate: CryptoPrimitiveService=CRYPTO_AEADDECRYPT, CryptoPrimitiveAlgorithmFamily=CRYPTO_ALGOFAM_CUSTOM, CryptoPrimitiveAlgorithmMode=CRYPTO_ALGOMODE_CUSTOM, CryptoPrimitiveAlgorithmSecondaryFamily=CRYPTO_ALGOFAM_NOT_SET, CryptoPrimitiveSupportContext=false, CryptoPrimitiveAlgorithmFamilyCustomRef=Crypto_30_vHsm_KeyM_vHsm_KeyM, CryptoPrimitiveAlgorithmModeCustomRef=Crypto_30_vHsm_KeyM_ServiceCertificate
        Crypto_30_vHsm_KeyM_KeyM_CertElementGet: CryptoPrimitiveService=CRYPTO_AEADENCRYPT, CryptoPrimitiveAlgorithmFamily=CRYPTO_ALGOFAM_CUSTOM, CryptoPrimitiveAlgorithmMode=CRYPTO_ALGOMODE_CUSTOM, CryptoPrimitiveAlgorithmSecondaryFamily=CRYPTO_ALGOFAM_NOT_SET, CryptoPrimitiveSupportContext=false, CryptoPrimitiveAlgorithmModeCustomRef=Crypto_30_vHsm_KeyM_CertElementGet, CryptoPrimitiveAlgorithmModeCustomRef=Crypto_30_vHsm_KeyM_CertElementGetFirst, CryptoPrimitiveAlgorithmFamilyCustomRef=Crypto_30_vHsm_KeyM_vHsm_KeyM, CryptoPrimitiveAlgorithmModeCustomRef=Crypto_30_vHsm_KeyM_CertElementGetNext
        Crypto_30_vHsm_KeyM_KeyM_RemoteHandling: CryptoPrimitiveService=CRYPTO_AEADDECRYPT, CryptoPrimitiveAlgorithmFamily=CRYPTO_ALGOFAM_AES, CryptoPrimitiveAlgorithmMode=CRYPTO_ALGOMODE_GCM, CryptoPrimitiveAlgorithmSecondaryFamily=CRYPTO_ALGOFAM_NOT_SET, CryptoPrimitiveSupportContext=false
        vHsmUsageForbidden: CryptoPrimitiveService=CRYPTO_RANDOM, CryptoPrimitiveAlgorithmFamily=CRYPTO_ALGOFAM_NOT_SET, CryptoPrimitiveAlgorithmMode=CRYPTO_ALGOMODE_NOT_SET, CryptoPrimitiveAlgorithmSecondaryFamily=CRYPTO_ALGOFAM_NOT_SET
      Crypto_30_vHsm_vHsm_Core_SecureBoot (CryptoPrimitiveAlgorithmFamilyCustom): CryptoPrimitiveAlgorithmFamilyCustomId=160
      Crypto_30_vHsm_vHsm_Core_FirmwareUpdate (CryptoPrimitiveAlgorithmFamilyCustom): CryptoPrimitiveAlgorithmFamilyCustomId=163
      Crypto_30_vHsm_vHsm_Core_ForceSequential (CryptoPrimitiveAlgorithmModeCustom): CryptoPrimitiveAlgorithmModeCustomId=133
      Crypto_30_vHsm_vHsm_Core_SecureBootUpdate (CryptoPrimitiveAlgorithmFamilyCustom): CryptoPrimitiveAlgorithmFamilyCustomId=164
      Crypto_30_vHsm_vHsm_Core_PersistDeferred (CryptoPrimitiveAlgorithmModeCustom): CryptoPrimitiveAlgorithmModeCustomId=152
      Crypto_30_vHsm_vHsm_Core_Repersist (CryptoPrimitiveAlgorithmModeCustom): CryptoPrimitiveAlgorithmModeCustomId=153
      Crypto_30_vHsm_vHsm_Core_SoftwareDownload (CryptoPrimitiveAlgorithmFamilyCustom): CryptoPrimitiveAlgorithmFamilyCustomId=161
      Crypto_30_vHsm_LibCv_P256r1 (CryptoPrimitiveAlgorithmModeCustom): CryptoPrimitiveAlgorithmModeCustomId=128
      Crypto_30_vHsm_KeyM_ServiceCertificate (CryptoPrimitiveAlgorithmModeCustom): CryptoPrimitiveAlgorithmModeCustomId=140
      Crypto_30_vHsm_vHsm_Core_SecureBootConfirmation (CryptoPrimitiveAlgorithmFamilyCustom): CryptoPrimitiveAlgorithmFamilyCustomId=165
      Crypto_30_vHsm_vHsm_Core_Persistency (CryptoPrimitiveAlgorithmFamilyCustom): CryptoPrimitiveAlgorithmFamilyCustomId=192
      Crypto_30_vHsm_KeyM_CertElementGet (CryptoPrimitiveAlgorithmModeCustom): CryptoPrimitiveAlgorithmModeCustomId=141
      Crypto_30_vHsm_Hwa_PaddingPKCS7 (CryptoPrimitiveAlgorithmFamilyCustom): CryptoPrimitiveAlgorithmFamilyCustomId=133
      Crypto_30_vHsm_LibCv_PaddingPKCS7 (CryptoPrimitiveAlgorithmFamilyCustom): CryptoPrimitiveAlgorithmFamilyCustomId=133
      Crypto_30_vHsm_KeyM_CertElementGetFirst (CryptoPrimitiveAlgorithmModeCustom): CryptoPrimitiveAlgorithmModeCustomId=142
      Crypto_30_vHsm_KeyM_CertElementGetNext (CryptoPrimitiveAlgorithmModeCustom): CryptoPrimitiveAlgorithmModeCustomId=143
      Crypto_30_vHsm_LibCv_DRBG (CryptoPrimitiveAlgorithmFamilyCustom): CryptoPrimitiveAlgorithmFamilyCustomId=131
      Crypto_30_vHsm_KeyM_vHsm_KeyM (CryptoPrimitiveAlgorithmFamilyCustom): CryptoPrimitiveAlgorithmFamilyCustomId=170
      4 x CryptoPrimitive, all with CryptoPrimitiveAlgorithmFamily=CRYPTO_ALGOFAM_CUSTOM, CryptoPrimitiveAlgorithmMode=CRYPTO_ALGOMODE_NOT_SET, CryptoPrimitiveSupportContext=false:
        Crypto_30_vHsm_GVCS_UpdateCertificatesAndDcl: CryptoPrimitiveService=CRYPTO_SIGNATURE_VERIFY, CryptoPrimitiveAlgorithmSecondaryFamily=CRYPTO_ALGOFAM_CUSTOM
        Crypto_30_vHsm_GVCS_ValidateHeader: CryptoPrimitiveService=CRYPTO_SIGNATURE_VERIFY, CryptoPrimitiveAlgorithmMode=CRYPTO_ALGOMODE_CUSTOM, CryptoPrimitiveAlgorithmMode=CRYPTO_ALGOMODE_CUSTOM, CryptoPrimitiveAlgorithmSecondaryFamily=CRYPTO_ALGOFAM_CUSTOM
        Crypto_30_vHsm_GVCS_ValidatevHsmSecureBootUpdate: CryptoPrimitiveService=CRYPTO_SIGNATURE_VERIFY, CryptoPrimitiveAlgorithmSecondaryFamily=CRYPTO_ALGOFAM_CUSTOM
        Crypto_30_vHsm_vHsm_Custom_Dummy: CryptoPrimitiveService=CRYPTO_RANDOM, CryptoPrimitiveAlgorithmFamily=CRYPTO_ALGOFAM_NOT_SET, CryptoPrimitiveAlgorithmSecondaryFamily=CRYPTO_ALGOFAM_NOT_SET, CryptoPrimitiveAlgorithmMode=CRYPTO_ALGOMODE_CUSTOM
    CryptovHsm:
      CryptoIpcChannels = 4
      CryptoIpcProtocolVersion = 3
      CryptoKeyElementDeleteSupport = true
      CryptoInterruptMode = true
      CryptoRedirection = false
      CryptoIpcMacJobOptimization = false
      CryptoDetInstanceMask = 0
      CryptoKeyDeriveJobSupport = true
      CryptoHost2HsmAddress = 1103104256
      CryptoHsm2HostAddress = 1103104260
      CryptoIpcInstanceId = 0
      CryptoIpcInitialization = true
      CryptoManagementDriverObject = Crypto_30_vHsm_KeyManagement
      CryptoJobRequestInterrupt: CryptoJobRequestInterruptFlagSetAddress=1089470752, CryptoJobRequestInterruptFlagSetMask=1, CryptoJobRequestInterruptFlagSetting=true
      CryptoJobResponseInterrupt:
        CryptoJobResponseInterruptFlagClearAddress = 1089470848
        CryptoJobResponseInterruptFlagClearMask = 1
        CryptoJobResponseInterruptFlagClearValue = 1
        CryptoJobResponseInterruptFlagClearing = true
      TDA4x_MCU_MSRAM_HOST (CryptoMemoryArea):
        CryptoAreaStart = 1103101952
        CryptoAreaStop = 1103117584
        CryptoAreaType = CRYPTO_AREA_HSM_READWRITE_ACCESS
        CryptoAreaPriority = 100
        CryptoAreaEnabled = true
      TDA4x_MCU_MSRAM_HOST_CERTSTORE (CryptoMemoryArea): CryptoAreaStart=1090584576, CryptoAreaStop=1090617344, CryptoAreaType=CRYPTO_AREA_HSM_READ_ACCESS, CryptoAreaPriority=0, CryptoAreaEnabled=true
