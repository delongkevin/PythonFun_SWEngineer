AUTOSAR XML (schema 00048)
package /ActiveEcuC
  module config Nm: implementation-config-variant=VARIANT-PRE-COMPILE, module-description=Nm_Impl
    CN_FDCAN2_28a8fc44 (NmChannelConfig): NmChannelId=1, NmChannelSleepMaster=false, NmStateReportEnabled=false, NmSynchronizingNetwork=false, NmComMChannelRef=CN_FDCAN2_28a8fc44
      FDCAN2_CAN_70a1f111 (NmBusType)
        NmStandardBusNmConfig: NmStandardBusType=NM_BUSNM_CANNM  # FDCAN2_CAN
    NmGlobalConfig
      NmGlobalFeatures:
        NmNodeIdEnabled = true
        NmBusSynchronizationEnabled = false
        NmCarWakeUpRxEnabled = false
        NmComControlEnabled = true
        NmComUserDataSupport = false
        NmCoordinatorSupportEnabled = false
        NmNodeDetectionEnabled = false
        NmPduRxIndicationEnabled = false
        NmRemoteSleepIndEnabled = false
        NmRepeatMsgIndEnabled = false
        NmStateChangeIndEnabled = true
        NmUserDataEnabled = false
        NmMacroLayerEnabled = false
        NmCoordinatorSyncSupport = false
        NmRuntimeMeasurementSupport = false
        NmCoordinatorRequestChannelsInBusSleep = false
        NmCoordinatorPassiveStartUpForwarding = false
        NmPassiveModeEnabled = false
        NmStateChangeIndCallback = BswM_Nm_StateChangeNotification
        NmCallbacksPrototypeHeader = BswM_Nm.h
      NmGeneration:
        NmOutOfBoundsWriteSanitizer = false
        NmOutOfBoundsReadSanitizer = false
        NmShortSymbols = false
        NmInterfacesForDeactivatedData = false
        NmReferringKeysInComments = false
      NmGlobalProperties: NmDevErrorDetect=true, NmVersionInfoApi=false, NmSafeBswChecks=false
      NmGlobalConstants
    CN_FDCAN14_a902658e (NmChannelConfig): NmChannelId=0, NmChannelSleepMaster=false, NmStateReportEnabled=false, NmSynchronizingNetwork=false, NmComMChannelRef=CN_FDCAN14_a902658e
      FDCAN14_CAN_df03166d (NmBusType)
        NmStandardBusNmConfig: NmStandardBusType=NM_BUSNM_CANNM  # FDCAN14_CAN
