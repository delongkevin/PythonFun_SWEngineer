AUTOSAR XML (schema 00048)
package /ActiveEcuC
  module config Wdg: implementation-config-variant=VARIANT-PRE-COMPILE, module-description=Wdg_Impl
    WdgGeneral:
      WdgDevErrorDetect = true
      WdgDisableAllowed = false
      WdgIndex = 0
      WdgInitialTimeout = 10
      WdgMaxTimeout = 65
      WdgRunArea = ROM
      WdgTriggerLocation = Wdg_Trigger
      WdgVersionInfoApi = true
      WdgRegisterReadbackApi = false
      WdgRtiFrequency = 12500000
      WdgDeviceVariant = J721S2
    WdgPublishedInformation: WdgTriggerMode=WDG_WINDOW
    WdgSettingsConfig: WdgDefaultMode=WDGIF_FAST_MODE, WdgInstanceId=0
      WdgSettingsFast: WdgTimeoutValue=10000, WdgWindowSize=WDG_WINDOW_100_PERCENT, WdgReaction=WDG_INTERRUPT_RXN
      WdgSettingsSlow: WdgTimeoutValue=10000, WdgWindowSize=WDG_WINDOW_100_PERCENT, WdgReaction=WDG_INTERRUPT_RXN
