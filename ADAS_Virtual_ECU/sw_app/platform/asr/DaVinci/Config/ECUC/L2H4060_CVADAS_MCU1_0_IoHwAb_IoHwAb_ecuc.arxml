AUTOSAR XML (schema 00048)
package /ActiveEcuC
  module config IoHwAb: implementation-config-variant=VARIANT-PRE-COMPILE, module-description=IoHwAb_Impl
    IoHwAbDatatypes
      9 x IoHwAbBaseType:
        float64: IoHwAbBaseDataType=IOHWAB_FLOAT64
        float32: IoHwAbBaseDataType=IOHWAB_FLOAT32
        sint32: IoHwAbBaseDataType=IOHWAB_SINT32
        sint16: IoHwAbBaseDataType=IOHWAB_SINT16
        sint8: IoHwAbBaseDataType=IOHWAB_SINT8
        uint32: IoHwAbBaseDataType=IOHWAB_UINT32
        uint16: IoHwAbBaseDataType=IOHWAB_UINT16
        uint8: IoHwAbBaseDataType=IOHWAB_UINT8
        boolean: IoHwAbBaseDataType=IOHWAB_BOOL
      IoHwAbImplementationTypes
    IoHwAbGeneral: IoHwAbDevErrorDetect=true, IoHwAbVersionInfoApi=false, IoHwAbUseInitFunction=true
    IF_IoHwAbADCData (IoHwAbCSPortInterface): IoHwAbTemplate=IoHwAb_Template_None
      GetRawValues (IoHwAbOperation)
        Channelndex (IoHwAbOperationArgument): IoHwAbArgDirection=IOHWAB_IN, IoHwAbOperationArgumentPosition=0, IoHwAbArgTypeRef=uint8
        ChannelRawValue (IoHwAbOperationArgument): IoHwAbArgDirection=IOHWAB_OUT, IoHwAbOperationArgumentPosition=1, IoHwAbArgTypeRef=uint16
      IoHwAbApplicationError: IoHwAbErrorCode=1
    IoHwAb_Mainfunction (IoHwAbRunnable): IoHwAbTriggerPeriod=10, IoHwAbTimebase=IoHwAbMSec
    PpIoHwAbAdc (IoHwAbCSPortPrototype): IoHwAbCSDirection=IOHWAB_SERVER, IoHwAbCSPortInterfaceRef=IF_IoHwAbADCData
    IF_IoHwAbUSSDselPin (IoHwAbCSPortInterface): IoHwAbTemplate=IoHwAb_Template_None
      GetUSSDselPinStatus (IoHwAbOperation)
        USSDselPinStatus (IoHwAbOperationArgument): IoHwAbArgDirection=IOHWAB_IN, IoHwAbOperationArgumentPosition=0, IoHwAbArgTypeRef=boolean
      IoHwAbApplicationError: IoHwAbErrorCode=1
    PpUSSDselPin (IoHwAbCSPortPrototype): IoHwAbCSDirection=IOHWAB_SERVER, IoHwAbCSPortInterfaceRef=IF_IoHwAbUSSDselPin
