AUTOSAR XML (schema 00048)
package /ActiveEcuC
  module config Cdd: implementation-config-variant=VARIANT-PRE-COMPILE, module-description=Cdd_Impl
    CddGeneral:
      CddInstanceId = 0
      CddQueueSize = 8
      CddDevErrorDetect = true
      CddVersionInfoApi = false
      CddSafeBswChecks = false
      CddDemClientRef = DemClient
      CddNvMBlockRef = NvM_Dem_STATUS
