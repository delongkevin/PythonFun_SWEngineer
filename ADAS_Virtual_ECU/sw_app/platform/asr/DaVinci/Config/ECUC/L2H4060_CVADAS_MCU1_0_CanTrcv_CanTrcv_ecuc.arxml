AUTOSAR XML (schema 00048)
package /ActiveEcuC
  module config CanTrcv: implementation-config-variant=VARIANT-PRE-COMPILE, module-description=CanTrcv_Impl
    CanTrcvConfigSet
      CanTrcvChannel:
        CanTrcvHwPnSupport = false
        CanTrcvInitState = CANTRCV_OP_MODE_NORMAL
        CanTrcvChannelId = 0
        CanTrcvChannelUsed = true
        CanTrcvControlsPowerSupply = false
        CanTrcvMaxBaudrate = 1000
        CanTrcvWakeupByBusUsed = true
        CanTrcvHardwareVariantGroup = TJA1043_REFERENCE_GROUP
        CanTrcvWakeupSourceRef = CN_FDCAN2_28a8fc44
        CanTrcvAccess
          CanTrcvDioAccess
            4 x CanTrcvDioChannelAccess:
              PinEN: CanTrcvHardwareInterfaceName=PinEN, CanTrcvDioSymNameRef=DioChannel_pinEN
              PinSTB: CanTrcvHardwareInterfaceName=PinSTB, CanTrcvDioSymNameRef=DioChannel_PinSTB
              PinERR: CanTrcvHardwareInterfaceName=PinERR, CanTrcvDioSymNameRef=DioChannel_PinERR
              PinRXD: CanTrcvHardwareInterfaceName=PinRXD, CanTrcvDioSymNameRef=DioChannel_PINRXD
    CanTrcvGeneral:
      CanTrcvDevErrorDetect = true
      CanTrcvGetVersionInfo = false
      CanTrcvWakeUpSupport = CANTRCV_WAKEUP_BY_POLLING
      CanTrcvIndex = 0
      CanTrcvMainFunctionPeriod = 0.01
      CanTrcvSafeBswChecks = false
