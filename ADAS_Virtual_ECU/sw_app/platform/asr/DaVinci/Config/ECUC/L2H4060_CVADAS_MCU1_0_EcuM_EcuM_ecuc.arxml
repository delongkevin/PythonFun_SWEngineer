AUTOSAR XML (schema 00048)
package /ActiveEcuC
  module config EcuM: implementation-config-variant=VARIANT-PRE-COMPILE, module-description=EcuM_Impl
    EcuMConfiguration
      EcuMCommonConfiguration: EcuMConfigConsistencyHash=7574075879525643003, EcuMDefaultAppMode=OSDEFAULTAPPMODE, EcuMOSResource=OsResource
        5 x EcuMWakeupSource, all with EcuMValidationTimeout=0, EcuMCheckWakeupTimeout=0, EcuMWakeupSourcePolling=false:
          ECUM_WKSOURCE_POWER: EcuMWakeupSourceId=0
          ECUM_WKSOURCE_RESET: EcuMWakeupSourceId=1
          ECUM_WKSOURCE_INTERNAL_RESET: EcuMWakeupSourceId=2
          ECUM_WKSOURCE_INTERNAL_WDG: EcuMWakeupSourceId=3
          ECUM_WKSOURCE_EXTERNAL_WDG: EcuMWakeupSourceId=4
        EcuMDefaultShutdownTarget: EcuMDefaultState=EcuMStateOff
        EcuMDriverInitListOne
          7 x EcuMDriverInitItem:
            Dio_init: index=7, EcuMModuleID=Dio, EcuMModuleHeader=Dio.h, EcuMModuleService=Dio_Init
            ADCPowerClk: index=6, EcuMModuleID=Code, EcuMAdditionalInitCode=uint32 regVal; /* Unlock lock key registers for Partition 0: IO PAD configuration registers in MCU_CTRL_MMR */ /* write Partition 0 Lock Key 0 Register */ CSL_REG32_WR(CSL_MCU_CTRL_MMR0_CFG0_BASE + CSL_MCU_CTRL_MMR_CFG0_LOCK2_KICK0, 0x68EF3490U); /* write Partition 1 Lock Key 1 Register */ CSL_REG32_WR(CSL_MCU_CTRL_MMR0_CFG0_BASE + CSL_MCU_CTRL_MMR_CFG0_LOCK2_KICK1, 0xD172BC5AU); /* Check for unlock */ regVal = CSL_REG32_RD(CSL_MCU_CTRL_MMR0_CFG0_BASE + CSL_MCU_CTRL_MMR_CFG0_LOCK2_KICK0); while ((regVal & 0x1U) != 0x1U) { /* Check for unlock */ regVal = CSL_REG32_RD(CSL_MCU_CTRL_MMR0_CFG0_BASE + CSL_MCU_CTRL_MMR_CFG0_LOCK2_KICK0); } /* Select clock frequency 25 MHZ */ CSL_REG32_FINS(CSL_MCU_CTRL_MMR0_CFG0_BASE + CSL_MCU_CTRL_MMR_CFG0_MCU_ADC1_CLKSEL, MCU_CTRL_MMR_CFG0_MCU_ADC1_CLKSEL_PROXY_MCU_ADC1_CLKSEL_CLK_SEL_PROXY, 0U);
            BswM_PreInit: index=3, EcuMModuleID=BswM, EcuMModuleService=BswM_PreInit, EcuMModuleHeader=BswM.h
            Nm_PreInit: index=1, EcuMModuleID=Nm, EcuMModuleService=Nm_PreInit, EcuMModuleHeader=Nm.h
            PduR_PreInit: index=5, EcuMModuleID=PduR, EcuMModuleService=PduR_PreInit, EcuMModuleHeader=PduR.h
            ComM_PreInit: index=4, EcuMModuleID=ComM, EcuMModuleService=ComM_PreInit, EcuMModuleHeader=ComM.h
            I2c_Init: index=0, EcuMModuleID=I2c, EcuMModuleService=I2c_Init, EcuMModuleHeader=I2c.h
        CN_FDCAN2_28a8fc44 (EcuMWakeupSource): EcuMWakeupSourceId=6, EcuMWakeupSourcePolling=false, EcuMValidationTimeout=1, EcuMComMChannelRef=CN_FDCAN2_28a8fc44
        CN_FDCAN14_a902658e (EcuMWakeupSource): EcuMWakeupSourceId=5, EcuMWakeupSourcePolling=false, EcuMComMChannelRef=CN_FDCAN14_a902658e
        EcuMDriverInitListZero
          26 x EcuMDriverInitItem:
            vDam_InitMemory: EcuMModuleID=vDam, EcuMModuleService=vDam_InitMemory, EcuMModuleHeader=vDam.h
            Dcm_InitMemory: index=12, EcuMModuleID=Dcm, EcuMModuleService=Dcm_InitMemory, EcuMModuleHeader=Dcm.h
            CanTrcv_30_Tja1043_InitMemory: index=1, EcuMModuleID=CanTrcv, EcuMModuleService=CanTrcv_30_Tja1043_InitMemory, EcuMModuleHeader=CanTrcv_30_Tja1043.h
            Can_30_Mcan_InitMemory: index=17, EcuMModuleID=Can, EcuMModuleService=Can_30_Mcan_InitMemory, EcuMModuleHeader=Can_30_Mcan.h
            ComM_InitMemory: index=13, EcuMModuleID=ComM, EcuMModuleService=ComM_InitMemory, EcuMModuleHeader=ComM.h
            Nm_InitMemory: index=7, EcuMModuleID=Nm, EcuMModuleService=Nm_InitMemory, EcuMModuleHeader=Nm.h
            PduR_InitMemory: index=0, EcuMModuleID=PduR, EcuMModuleService=PduR_InitMemory, EcuMModuleHeader=PduR.h
            vRoE_InitMemory: index=11, EcuMModuleID=Cdd, EcuMModuleService=vRoE_InitMemory, EcuMModuleHeader=vRoE.h
            CanSM_InitMemory: index=18, EcuMModuleID=CanSM, EcuMModuleService=CanSM_InitMemory, EcuMModuleHeader=CanSM_EcuM.h
            CanNm_InitMemory: index=2, EcuMModuleID=CanNm, EcuMModuleService=CanNm_InitMemory, EcuMModuleHeader=CanNm.h
            CanIf_InitMemory: index=9, EcuMModuleID=CanIf, EcuMModuleService=CanIf_InitMemory, EcuMModuleHeader=CanIf.h
            CanTp_InitMemory: index=6, EcuMModuleID=CanTp, EcuMModuleService=CanTp_InitMemory, EcuMModuleHeader=CanTp.h
            Rte_InitMemory: index=4, EcuMModuleID=Rte, EcuMModuleService=Rte_InitMemory, EcuMModuleHeader=Rte_Main.h
            Det_InitMemory: index=16, EcuMModuleID=Det, EcuMModuleService=Det_InitMemory, EcuMModuleHeader=Det.h
            BswM_InitMemory: index=8, EcuMModuleID=BswM, EcuMModuleService=BswM_InitMemory, EcuMModuleHeader=BswM.h
            Dem_InitMemory: index=15, EcuMModuleID=Dem, EcuMModuleService=Dem_InitMemory, EcuMModuleHeader=Dem.h
            Dem_PreInit: index=5, EcuMModuleID=Dem, EcuMModuleService=Dem_PreInit, EcuMModuleHeader=Dem.h
            Eep_30_XXi2c01_InitMemory: index=14, EcuMModuleID=Eep, EcuMModuleService=Eep_30_XXi2c01_InitMemory, EcuMModuleHeader=Eep_30_XXi2c01.h
            Det_Init: index=10, EcuMModuleID=Det, EcuMModuleService=Det_Init, EcuMModuleHeader=Det.h
            Com_InitMemory: index=3, EcuMModuleID=Com, EcuMModuleService=Com_InitMemory, EcuMModuleHeader=Com.h
            CanXcp_InitMemory: index=19, EcuMModuleID=Xcp, EcuMModuleService=CanXcp_InitMemory, EcuMModuleHeader=CanXcp.h
            Xcp_InitMemory: index=20, EcuMModuleID=Xcp, EcuMModuleService=Xcp_InitMemory, EcuMModuleHeader=Xcp.h
            Csm_InitMemory: index=21, EcuMModuleID=Csm, EcuMModuleService=Csm_InitMemory, EcuMModuleHeader=Csm.h
            CryIf_InitMemory: index=22, EcuMModuleID=CryIf, EcuMModuleService=CryIf_InitMemory, EcuMModuleHeader=CryIf.h
            vDiagSecAcc_InitMemory: index=24, EcuMModuleID=vDiagSecAcc, EcuMModuleService=vDiagSecAcc_InitMemory, EcuMModuleHeader=vDiagSecAcc.h
            Crypto_30_vHsm_InitMemory: index=25, EcuMModuleID=Crypto, EcuMModuleService=Crypto_30_vHsm_InitMemory, EcuMModuleHeader=Crypto_30_vHsm.h
      EcuMFlexConfiguration: EcuMFlexModuleConfigurationRef=CanConfigSet, EcuMNormalMcuModeRef=McuModeSettingConf
        3 x EcuMResetMode:
          ECUM_RESET_MCU: EcuMResetModeId=0
          ECUM_RESET_WDG: EcuMResetModeId=1
          ECUM_RESET_IO: EcuMResetModeId=2
        4 x EcuMShutdownCause:
          ECUM_CAUSE_UNKNOWN: EcuMShutdownCauseId=0
          ECUM_CAUSE_ECU_STATE: EcuMShutdownCauseId=1
          ECUM_CAUSE_WDGM: EcuMShutdownCauseId=2
          ECUM_CAUSE_DCM: EcuMShutdownCauseId=3
        ECUM_RESET_WAKEUP (EcuMResetMode): EcuMResetModeId=3
        ECUM_RESET_BOOT (EcuMResetMode): EcuMResetModeId=4
    EcuMGeneral:
      EcuMDevErrorDetect = true
      EcuMIncludeDem = false
      EcuMIncludeDet = false
      EcuMMainFunctionPeriod = 0.01
      EcuMVersionInfoApi = false
      EcuMDeferredBswMNotification = false
      EcuMSlaveCoreHandling = true
      EcuMEnableFixBehavior = false
      EcuMNonChannelWakeupInRun = false
      EcuMSchMStartInitialization = true
      EcuMSafeBswChecks = false
      EcuMAdditionalIncludes = NM_Callout_Stubs.h
      EcuMGeneration: EcuMOutOfBoundsWriteSanitizer=false, EcuMOutOfBoundsReadSanitizer=false, EcuMInterfacesForDeactivatedData=false
    EcuMFlexGeneral: EcuMAlarmClockPresent=false, EcuMModeHandling=false
