AUTOSAR XML (schema 00048)
package /ActiveEcuC
  module config CanTp: implementation-config-variant=VARIANT-PRE-COMPILE, module-description=CanTp_Impl
    CanTpGeneral:
      CanTpChangeParameterApi = false
      CanTpDevErrorDetect = true
      CanTpPaddingByte = 204
      CanTpReadParameterApi = false
      CanTpVersionInfoApi = false
      CanTpPaddingActive = true
      CanTpHavePaddingByte = true
      CanTpNumRxChannels = 0
      CanTpNumTxChannels = 0
      CanTpEnableSplitMainFunction = false
      CanTpSupportStandardAddressing = true
      CanTpSupportExtendedAddressing = true
      CanTpSupportMixed11Addressing = true
      CanTpSupportMixed29Addressing = true
      CanTpSupportNormalFixedAddressing = true
      CanTpSupportCustomAddressing = false
      CanTpOnlyNotifyInformedAppl = true
      CanTpRc = false
      CanTpTc = true
      CanTpSafeBswChecks = false
      CanTpSupportLongFirstFrames = true
      CanTpFlexibleDataRateSupport = true
      CanTpEnableSynchronousTransmit = true
      CanTpEnableNonStrictLengthCheck = true
    CanTpConfig: CanTpMainFunctionPeriod=0.005
      6 x CanTpChannel, all with CanTpChannelMode=CANTP_MODE_FULL_DUPLEX:
        TPCH_422760f9
          CanTpRxNSdu_7ba98dbc (CanTpRxNSdu):
            CanTpRxAddressingFormat = CANTP_STANDARD
            CanTpRxDl = 8
            CanTpRxTaType = CANTP_FUNCTIONAL
            CanTpNbr = 0.1
            CanTpRxNSduId = 3
            CanTpRxPaddingActivation = CANTP_OFF
            CanTpRxNSduRef = DIAGNOSTIC_REQUEST_FUNCTIONAL_oFDCAN2_fa8f9425_Rx
            CanTpRxNPdu_5d8c5c04 (CanTpRxNPdu): CanTpRxNPduId=5, CanTpRxNPduRef=DIAGNOSTIC_REQUEST_FUNCTIONAL_Tp_oFDCAN2_220d49df_Rx
        TPCH_e908c765
          CanTpRxNSdu_652be4ae (CanTpRxNSdu):
            CanTpRxAddressingFormat = CANTP_STANDARD
            CanTpRxDl = 8
            CanTpRxTaType = CANTP_PHYSICAL
            CanTpNbr = 0.1
            CanTpRxNSduId = 5
            CanTpRxPaddingActivation = CANTP_OFF
            CanTpBs = 8
            CanTpNar = 0.1
            CanTpNcr = 0.15
            CanTpRxWftMax = 15
            CanTpSTmin = 0.02
            CanTpRxNSduRef = DIAGNOSTIC_REQUEST_FD_PAM_oFDCAN2_20_f5723a9b_Rx
            CanTpRxNPdu_84ab9e51 (CanTpRxNPdu): CanTpRxNPduId=1, CanTpRxNPduRef=DIAGNOSTIC_REQUEST_FD_PAM_Tp_oFDCAN2_20_2351f322_Rx
            CanTpTxFcNPdu_84ab9e51 (CanTpTxFcNPdu): CanTpTxFcNPduConfirmationPduId=1, CanTpTxFcNPduRef=DIAGNOSTIC_RESPONSE_FD_PAM_Tp_oFDCAN2_20_3d6cb975_Tx
          CanTpTxNSdu_652be4ae (CanTpTxNSdu):
            CanTpTxAddressingFormat = CANTP_STANDARD
            CanTpTxDl = 8
            CanTpTxTaType = CANTP_PHYSICAL
            CanTpNas = 0.1
            CanTpNcs = 0.15
            CanTpTc = false
            CanTpTxNSduId = 2
            CanTpTxPaddingActivation = CANTP_OFF
            CanTpNbs = 0.1
            CanTpTxNSduRef = DIAGNOSTIC_RESPONSE_FD_PAM_oFDCAN2_20_25761d2e_Tx
            CanTpRxFcNPdu_a6514aa3 (CanTpRxFcNPdu): CanTpRxFcNPduId=1, CanTpRxFcNPduRef=DIAGNOSTIC_REQUEST_FD_PAM_Tp_oFDCAN2_20_2351f322_Rx
            CanTpTxNPdu_a6514aa3 (CanTpTxNPdu): CanTpTxNPduConfirmationPduId=1, CanTpTxNPduRef=DIAGNOSTIC_RESPONSE_FD_PAM_Tp_oFDCAN2_20_3d6cb975_Tx
        TPCH_4e644935
          CanTpRxNSdu_2a48747d (CanTpRxNSdu):
            CanTpRxAddressingFormat = CANTP_STANDARD
            CanTpRxDl = 8
            CanTpRxTaType = CANTP_PHYSICAL
            CanTpNbr = 0.1
            CanTpRxNSduId = 1
            CanTpRxPaddingActivation = CANTP_OFF
            CanTpBs = 8
            CanTpNar = 0.1
            CanTpNcr = 0.15
            CanTpRxWftMax = 15
            CanTpSTmin = 0.02
            CanTpRxNSduRef = DIAGNOSTIC_REQUEST_PAM_oFDCAN2_d3c55b76_Rx
            CanTpTxFcNPdu_70d407dc (CanTpTxFcNPdu): CanTpTxFcNPduConfirmationPduId=2, CanTpTxFcNPduRef=DIAGNOSTIC_RESPONSE_PAM_Tp_oFDCAN2_7966b8ee_Tx
            CanTpRxNPdu_70d407dc (CanTpRxNPdu): CanTpRxNPduId=2, CanTpRxNPduRef=DIAGNOSTIC_REQUEST_PAM_Tp_oFDCAN2_969cba10_Rx
          CanTpTxNSdu_2a48747d (CanTpTxNSdu):
            CanTpTxAddressingFormat = CANTP_STANDARD
            CanTpTxDl = 8
            CanTpTxTaType = CANTP_PHYSICAL
            CanTpNas = 0.1
            CanTpNcs = 0.15
            CanTpTc = false
            CanTpTxNSduId = 1
            CanTpTxPaddingActivation = CANTP_OFF
            CanTpNbs = 0.1
            CanTpTxNSduRef = DIAGNOSTIC_RESPONSE_PAM_oFDCAN2_7c9fd6f9_Tx
            CanTpTxNPdu_522ed32e (CanTpTxNPdu): CanTpTxNPduConfirmationPduId=2, CanTpTxNPduRef=DIAGNOSTIC_RESPONSE_PAM_Tp_oFDCAN2_7966b8ee_Tx
            CanTpRxFcNPdu_522ed32e (CanTpRxFcNPdu): CanTpRxFcNPduId=2, CanTpRxFcNPduRef=DIAGNOSTIC_REQUEST_PAM_Tp_oFDCAN2_969cba10_Rx
        TPCH_1f66bf06
          CanTpRxNSdu_1222086e (CanTpRxNSdu):
            CanTpRxAddressingFormat = CANTP_STANDARD
            CanTpRxDl = 64
            CanTpRxTaType = CANTP_CANFD_PHYSICAL
            CanTpNbr = 0.1
            CanTpRxNSduId = 0
            CanTpRxPaddingActivation = CANTP_OFF
            CanTpBs = 8
            CanTpNar = 0.1
            CanTpNcr = 0.15
            CanTpRxWftMax = 15
            CanTpSTmin = 0.02
            CanTpRxNSduRef = DIAGNOSTIC_REQUEST_FD_PAM_oFDCAN2_aee787f0_Rx
            CanTpTxFcNPdu_d47df513 (CanTpTxFcNPdu): CanTpTxFcNPduConfirmationPduId=0, CanTpTxFcNPduRef=DIAGNOSTIC_RESPONSE_FD_PAM_Tp_oFDCAN2_5bcd311d_Tx
            CanTpRxNPdu_d47df513 (CanTpRxNPdu): CanTpRxNPduId=0, CanTpRxNPduRef=DIAGNOSTIC_REQUEST_FD_PAM_Tp_oFDCAN2_8bc916a8_Rx
          CanTpTxNSdu_1222086e (CanTpTxNSdu):
            CanTpTxAddressingFormat = CANTP_STANDARD
            CanTpTxDl = 64
            CanTpTxTaType = CANTP_CANFD_PHYSICAL
            CanTpNas = 0.1
            CanTpNcs = 0.15
            CanTpTc = false
            CanTpTxNSduId = 0
            CanTpTxPaddingActivation = CANTP_OFF
            CanTpNbs = 0.1
            CanTpTxNSduRef = DIAGNOSTIC_RESPONSE_FD_PAM_oFDCAN2_411d850e_Tx
            CanTpRxFcNPdu_f68721e1 (CanTpRxFcNPdu): CanTpRxFcNPduId=0, CanTpRxFcNPduRef=DIAGNOSTIC_REQUEST_FD_PAM_Tp_oFDCAN2_8bc916a8_Rx
            CanTpTxNPdu_f68721e1 (CanTpTxNPdu): CanTpTxNPduConfirmationPduId=0, CanTpTxNPduRef=DIAGNOSTIC_RESPONSE_FD_PAM_Tp_oFDCAN2_5bcd311d_Tx
        TPCH_cb16faca
          CanTpRxNSdu_02dfa36c (CanTpRxNSdu):
            CanTpRxAddressingFormat = CANTP_STANDARD
            CanTpRxDl = 64
            CanTpRxTaType = CANTP_CANFD_FUNCTIONAL
            CanTpNbr = 0.1
            CanTpRxNSduId = 4
            CanTpRxPaddingActivation = CANTP_OFF
            CanTpRxNSduRef = DIAGNOSTIC_REQUEST_FD_FUNCTIONAL_oFDCAN2_56e1939c_Rx
            CanTpRxNPdu_c5f86a1c (CanTpRxNPdu): CanTpRxNPduId=3, CanTpRxNPduRef=DIAGNOSTIC_REQUEST_FD_FUNCTIONAL_Tp_oFDCAN2_0dc95674_Rx
        TPCH_12d316f0
          CanTpRxNSdu_fc98325d (CanTpRxNSdu):
            CanTpRxAddressingFormat = CANTP_STANDARD
            CanTpRxDl = 8
            CanTpRxTaType = CANTP_FUNCTIONAL
            CanTpNbr = 0.1
            CanTpRxNSduId = 2
            CanTpRxPaddingActivation = CANTP_OFF
            CanTpRxNSduRef = DIAGNOSTIC_REQUEST_FD_FUNCTIONAL_oFDCAN2_20_73727a47_Rx
            CanTpRxNPdu_e5111065 (CanTpRxNPdu): CanTpRxNPduId=4, CanTpRxNPduRef=DIAGNOSTIC_REQUEST_FD_FUNCTIONAL_Tp_oFDCAN2_20_57bb70f5_Rx
