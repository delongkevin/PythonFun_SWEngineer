[part 3 of 3: package /ActiveEcuC]
AUTOSAR XML (schema 00048)
package /ActiveEcuC  (continued)
  module config Rte: implementation-config-variant=VARIANT-PRE-COMPILE, module-description=Rte_Impl  (continued)
    4 x RteSwComponentInstance:  (continued)
      DemSatellite_0_EcuSwComposition: RteSoftwareComponentInstanceRef=DemSatellite_0  (continued)
        1486 x RteEventToTaskMapping, all with RteImmediateRestart=false:  (continued)
          OpEventGetMonitorStatus_GetMonitorStatus_EvtInfo_PTS_Sensor_1_Circuit_Open_B128E13: RteEventRef=OpEventGetMonitorStatus_GetMonitorStatus_EvtInfo_PTS_Sensor_1_Circuit_Open_B128E13
          OpEventGetMonitorStatus_GetMonitorStatus_EvtInfo_Lost_Communication_with_Rear_Camera_U026400: RteEventRef=OpEventGetMonitorStatus_GetMonitorStatus_EvtInfo_Lost_Communication_with_Rear_Camera_U026400
          OpEventGetMonitorStatus_GetMonitorStatus_EvtInfo_HS_FD_CANR_Comm_Bus_Performance_U100B00: RteEventRef=OpEventGetMonitorStatus_GetMonitorStatus_EvtInfo_HS_FD_CANR_Comm_Bus_Performance_U100B00
          OpEventGetMonitorStatus_GetMonitorStatus_EvtInfo_Implausible_Data_Received_From_Body_Control_Module_U042200: RteEventRef=OpEventGetMonitorStatus_GetMonitorStatus_EvtInfo_Implausible_Data_Received_From_Body_Control_Module_U042200
          OpEventGetMonitorStatus_GetMonitorStatus_EvtInfo_Lost_Communication_With_BCM_U014000: RteEventRef=OpEventGetMonitorStatus_GetMonitorStatus_EvtInfo_Lost_Communication_With_BCM_U014000
          OpEventGetMonitorStatus_GetMonitorStatus_EvtInfo_PTS_Sensor_2_Circuit_Open_B128F13: RteEventRef=OpEventGetMonitorStatus_GetMonitorStatus_EvtInfo_PTS_Sensor_2_Circuit_Open_B128F13
          OpEventGetMonitorStatus_GetMonitorStatus_EvtInfo_PTS_Sensor_3_Circuit_Open_B129013: RteEventRef=OpEventGetMonitorStatus_GetMonitorStatus_EvtInfo_PTS_Sensor_3_Circuit_Open_B129013
          OpEventGetMonitorStatus_GetMonitorStatus_EvtInfo_ECU_In_Plant_Mode_C221200: RteEventRef=OpEventGetMonitorStatus_GetMonitorStatus_EvtInfo_ECU_In_Plant_Mode_C221200
          OpEventGetMonitorStatus_GetMonitorStatus_EvtInfo_Implausible_Data_from_ORC_module_U045500: RteEventRef=OpEventGetMonitorStatus_GetMonitorStatus_EvtInfo_Implausible_Data_from_ORC_module_U045500
          OpEventGetMonitorStatus_GetMonitorStatus_EvtInfo_Right_Camera_Performance_or_Incorrect_Operation_B23C792: RteEventRef=OpEventGetMonitorStatus_GetMonitorStatus_EvtInfo_Right_Camera_Performance_or_Incorrect_Operation_B23C792
          OpEventGetMonitorStatus_GetMonitorStatus_EvtInfo_Rear_Sensors_PS_VltgeAboveThreshold_B212B17: RteEventRef=OpEventGetMonitorStatus_GetMonitorStatus_EvtInfo_Rear_Sensors_PS_VltgeAboveThreshold_B212B17
          OpEventSetEventStatus_SetEventStatus_Event_Invalid_Data_Received_From_Power_Steering_Control_Module_U042000: RteEventRef=OpEventSetEventStatus_SetEventStatus_Event_Invalid_Data_Received_From_Power_Steering_Control_Module_U042000
          OpEventSetEventStatus_SetEventStatus_Event_Lost_Communication_with_Left_Camera_U026600: RteEventRef=OpEventSetEventStatus_SetEventStatus_Event_Lost_Communication_with_Left_Camera_U026600
          OpEventSetEventStatus_SetEventStatus_Event_Front_Sensors_PS_VltgeBelowThreshold_B212A16: RteEventRef=OpEventSetEventStatus_SetEventStatus_Event_Front_Sensors_PS_VltgeBelowThreshold_B212A16
          OpEventSetEventStatus_SetEventStatus_Event_Left_Camera_Circuit_Voltage_Out_of_Range_B23C61C: RteEventRef=OpEventSetEventStatus_SetEventStatus_Event_Left_Camera_Circuit_Voltage_Out_of_Range_B23C61C
          OpEventSetEventStatus_SetEventStatus_Event_Rear_Sensors_PS_VltgeBelowThreshold_B212B16: RteEventRef=OpEventSetEventStatus_SetEventStatus_Event_Rear_Sensors_PS_VltgeBelowThreshold_B212B16
          OpEventSetEventStatus_SetEventStatus_Event_Rear_Sensors_PS_Bus_Sig_Msg_Failures_B212B08: RteEventRef=OpEventSetEventStatus_SetEventStatus_Event_Rear_Sensors_PS_Bus_Sig_Msg_Failures_B212B08
          OpEventSetEventStatus_SetEventStatus_Event_Rear_Camera_Circuit_Voltage_Out_of_Range_B217A1C: RteEventRef=OpEventSetEventStatus_SetEventStatus_Event_Rear_Camera_Circuit_Voltage_Out_of_Range_B217A1C
          OpEventSetEventStatus_SetEventStatus_Event_PTS_Sensor_12_Performance_or_Incorrect_Operation_B129992: RteEventRef=OpEventSetEventStatus_SetEventStatus_Event_PTS_Sensor_12_Performance_or_Incorrect_Operation_B129992
          OpEventSetEventStatus_SetEventStatus_Event_Battery_Voltage_Over_Voltage_B210C17: RteEventRef=OpEventSetEventStatus_SetEventStatus_Event_Battery_Voltage_Over_Voltage_B210C17
          OpEventSetEventStatus_SetEventStatus_Event_Front_Sensors_PS_VltgeAboveThreshold_B212A17: RteEventRef=OpEventSetEventStatus_SetEventStatus_Event_Front_Sensors_PS_VltgeAboveThreshold_B212A17
          OpEventSetEventStatus_SetEventStatus_Event_PTS_Sensor_4_Circuit_Open_B129113: RteEventRef=OpEventSetEventStatus_SetEventStatus_Event_PTS_Sensor_4_Circuit_Open_B129113
          OpEventSetEventStatus_SetEventStatus_Event_PTS_Sensor_12_Circuit_Open_B129913: RteEventRef=OpEventSetEventStatus_SetEventStatus_Event_PTS_Sensor_12_Circuit_Open_B129913
          OpEventSetEventStatus_SetEventStatus_Event_PTS_Sensor_11_Performance_or_Incorrect_Operation_B129892: RteEventRef=OpEventSetEventStatus_SetEventStatus_Event_PTS_Sensor_11_Performance_or_Incorrect_Operation_B129892
          OpEventSetEventStatus_SetEventStatus_Event_Lost_Communication_With_Radio_U018400: RteEventRef=OpEventSetEventStatus_SetEventStatus_Event_Lost_Communication_With_Radio_U018400
          OpEventSetEventStatus_SetEventStatus_Event_Park_Assist_PTS_Switch_Stuck_B12852A: RteEventRef=OpEventSetEventStatus_SetEventStatus_Event_Park_Assist_PTS_Switch_Stuck_B12852A
          OpEventSetEventStatus_SetEventStatus_Event_PTS_Sensor_5_Circuit_Open_B129213: RteEventRef=OpEventSetEventStatus_SetEventStatus_Event_PTS_Sensor_5_Circuit_Open_B129213
          OpEventSetEventStatus_SetEventStatus_Event_PTS_Sensor_5_Performance_or_Incorrect_Operation_B129292: RteEventRef=OpEventSetEventStatus_SetEventStatus_Event_PTS_Sensor_5_Performance_or_Incorrect_Operation_B129292
          OpEventSetEventStatus_SetEventStatus_Event_Battery_Voltage_Under_Voltage_B210C16: RteEventRef=OpEventSetEventStatus_SetEventStatus_Event_Battery_Voltage_Under_Voltage_B210C16
          OpEventSetEventStatus_SetEventStatus_Event_PTS_Sensor_4_Performance_or_Incorrect_Operation_B129192: RteEventRef=OpEventSetEventStatus_SetEventStatus_Event_PTS_Sensor_4_Performance_or_Incorrect_Operation_B129192
          OpEventSetEventStatus_SetEventStatus_Event_HS_FD_CAN2_Comm_Bus_Performance_U104E00: RteEventRef=OpEventSetEventStatus_SetEventStatus_Event_HS_FD_CAN2_Comm_Bus_Performance_U104E00
          OpEventSetEventStatus_SetEventStatus_Event_PTS_Sensor_9_Circuit_Open_B129613: RteEventRef=OpEventSetEventStatus_SetEventStatus_Event_PTS_Sensor_9_Circuit_Open_B129613
          OpEventSetEventStatus_SetEventStatus_Event_Loss_of_Comm_With_Engine_Control_Module_U010000: RteEventRef=OpEventSetEventStatus_SetEventStatus_Event_Loss_of_Comm_With_Engine_Control_Module_U010000
          OpEventSetEventStatus_SetEventStatus_Event_Lost_Communication_with_Right_Camera_U026700: RteEventRef=OpEventSetEventStatus_SetEventStatus_Event_Lost_Communication_with_Right_Camera_U026700
          OpEventSetEventStatus_SetEventStatus_Event_PTS_Sensor_1_Performance_or_Incorrect_Operation_B128E92: RteEventRef=OpEventSetEventStatus_SetEventStatus_Event_PTS_Sensor_1_Performance_or_Incorrect_Operation_B128E92
          OpEventSetEventStatus_SetEventStatus_Event_Rear_Camera_Performance_or_Incorrect_Operation_B217A92: RteEventRef=OpEventSetEventStatus_SetEventStatus_Event_Rear_Camera_Performance_or_Incorrect_Operation_B217A92
          OpEventSetEventStatus_SetEventStatus_Event_PTS_Sensor_2_Performance_or_Incorrect_Operation_B128F92: RteEventRef=OpEventSetEventStatus_SetEventStatus_Event_PTS_Sensor_2_Performance_or_Incorrect_Operation_B128F92
          OpEventSetEventStatus_SetEventStatus_Event_Right_Camera_Circuit_Voltage_Out_of_Range_B23C71C: RteEventRef=OpEventSetEventStatus_SetEventStatus_Event_Right_Camera_Circuit_Voltage_Out_of_Range_B23C71C
          OpEventSetEventStatus_SetEventStatus_Event_PTS_Sensor_8_Circuit_Open_B129513: RteEventRef=OpEventSetEventStatus_SetEventStatus_Event_PTS_Sensor_8_Circuit_Open_B129513
          OpEventSetEventStatus_SetEventStatus_Event_Implausible_Data_Received_from_Radio_U048500: RteEventRef=OpEventSetEventStatus_SetEventStatus_Event_Implausible_Data_Received_from_Radio_U048500
          OpEventSetEventStatus_SetEventStatus_Event_Implausible_Data_received_from_TRSKM_module_U14A000: RteEventRef=OpEventSetEventStatus_SetEventStatus_Event_Implausible_Data_received_from_TRSKM_module_U14A000
          OpEventSetEventStatus_SetEventStatus_Event_Front_Camera_Performance_or_Incorrect_Operation_B23C592: RteEventRef=OpEventSetEventStatus_SetEventStatus_Event_Front_Camera_Performance_or_Incorrect_Operation_B23C592
          OpEventSetEventStatus_SetEventStatus_Event_Loss_Communication_with_TRS_Knob_Module_U12B900: RteEventRef=OpEventSetEventStatus_SetEventStatus_Event_Loss_Communication_with_TRS_Knob_Module_U12B900
          OpEventSetEventStatus_SetEventStatus_Event_PTS_Sensor_7_Circuit_Open_B129413: RteEventRef=OpEventSetEventStatus_SetEventStatus_Event_PTS_Sensor_7_Circuit_Open_B129413
          OpEventSetEventStatus_SetEventStatus_Event_Front_Sensors_PS_Bus_Sig_Msg_Failures_B212A08: RteEventRef=OpEventSetEventStatus_SetEventStatus_Event_Front_Sensors_PS_Bus_Sig_Msg_Failures_B212A08
          OpEventSetEventStatus_SetEventStatus_Event_Lost_Communication_With_PSC_Module_A_U013100: RteEventRef=OpEventSetEventStatus_SetEventStatus_Event_Lost_Communication_With_PSC_Module_A_U013100
          OpEventSetEventStatus_SetEventStatus_Event_Lost_Communication_with_Front_Camera_U026500: RteEventRef=OpEventSetEventStatus_SetEventStatus_Event_Lost_Communication_with_Front_Camera_U026500
          OpEventSetEventStatus_SetEventStatus_Event_PTS_Sensor_3_Performance_or_Incorrect_Operation_B129092: RteEventRef=OpEventSetEventStatus_SetEventStatus_Event_PTS_Sensor_3_Performance_or_Incorrect_Operation_B129092
          OpEventSetEventStatus_SetEventStatus_Event_PTS_Sensor_8_Performance_or_Incorrect_Operation_B129592: RteEventRef=OpEventSetEventStatus_SetEventStatus_Event_PTS_Sensor_8_Performance_or_Incorrect_Operation_B129592
          OpEventSetEventStatus_SetEventStatus_Event_PPP_Assist_Switch_Stuck_B12B22A: RteEventRef=OpEventSetEventStatus_SetEventStatus_Event_PPP_Assist_Switch_Stuck_B12B22A
          OpEventSetEventStatus_SetEventStatus_Event_Implausible_data_received_from_ECM_U040100: RteEventRef=OpEventSetEventStatus_SetEventStatus_Event_Implausible_data_received_from_ECM_U040100
          OpEventSetEventStatus_SetEventStatus_Event_PTS_Sensor_10_Circuit_Open_B129713: RteEventRef=OpEventSetEventStatus_SetEventStatus_Event_PTS_Sensor_10_Circuit_Open_B129713
          OpEventSetEventStatus_SetEventStatus_Event_Lost_Communication_With_BSC_module_1_U012900: RteEventRef=OpEventSetEventStatus_SetEventStatus_Event_Lost_Communication_With_BSC_module_1_U012900
          OpEventSetEventStatus_SetEventStatus_Event_PTS_Sensor_7_Performance_or_Incorrect_Operation_B129492: RteEventRef=OpEventSetEventStatus_SetEventStatus_Event_PTS_Sensor_7_Performance_or_Incorrect_Operation_B129492
          OpEventSetEventStatus_SetEventStatus_Event_Left_Camera_Performance_or_Incorrect_Operation_B23C692: RteEventRef=OpEventSetEventStatus_SetEventStatus_Event_Left_Camera_Performance_or_Incorrect_Operation_B23C692
          OpEventSetEventStatus_SetEventStatus_Event_Vehicle_Configuration_Mismatch_B223B00: RteEventRef=OpEventSetEventStatus_SetEventStatus_Event_Vehicle_Configuration_Mismatch_B223B00
          OpEventSetEventStatus_SetEventStatus_Event_PTS_Sensor_6_Circuit_Open_B129313: RteEventRef=OpEventSetEventStatus_SetEventStatus_Event_PTS_Sensor_6_Circuit_Open_B129313
          OpEventSetEventStatus_SetEventStatus_Event_Front_Camera_Circuit_Voltage_Out_of_Range_B23C51C: RteEventRef=OpEventSetEventStatus_SetEventStatus_Event_Front_Camera_Circuit_Voltage_Out_of_Range_B23C51C
          OpEventSetEventStatus_SetEventStatus_Event_Implausible_Data_From_BSC_Module_1_U041800: RteEventRef=OpEventSetEventStatus_SetEventStatus_Event_Implausible_Data_From_BSC_Module_1_U041800
          OpEventSetEventStatus_SetEventStatus_Event_PTS_Sensor_10_Performance_or_Incorrect_Operation_B129792: RteEventRef=OpEventSetEventStatus_SetEventStatus_Event_PTS_Sensor_10_Performance_or_Incorrect_Operation_B129792
          OpEventSetEventStatus_SetEventStatus_Event_PTS_Sensor_11_Circuit_Open_B129813: RteEventRef=OpEventSetEventStatus_SetEventStatus_Event_PTS_Sensor_11_Circuit_Open_B129813
          OpEventSetEventStatus_SetEventStatus_Event_ECU_Internal_Performance_B22A900: RteEventRef=OpEventSetEventStatus_SetEventStatus_Event_ECU_Internal_Performance_B22A900
          OpEventSetEventStatus_SetEventStatus_Event_PTS_Sensor_9_Performance_or_Incorrect_Operation_B129692: RteEventRef=OpEventSetEventStatus_SetEventStatus_Event_PTS_Sensor_9_Performance_or_Incorrect_Operation_B129692
          OpEventSetEventStatus_SetEventStatus_Event_Calibration_Not_Learned_Lost_Calibration_B228600: RteEventRef=OpEventSetEventStatus_SetEventStatus_Event_Calibration_Not_Learned_Lost_Calibration_B228600
          OpEventSetEventStatus_SetEventStatus_Event_Lost_Communication_with_ORC_U015100: RteEventRef=OpEventSetEventStatus_SetEventStatus_Event_Lost_Communication_with_ORC_U015100
          OpEventSetEventStatus_SetEventStatus_Event_PTS_Sensor_1_Circuit_Open_B128E13: RteEventRef=OpEventSetEventStatus_SetEventStatus_Event_PTS_Sensor_1_Circuit_Open_B128E13
          OpEventSetEventStatus_SetEventStatus_Event_Lost_Communication_with_Rear_Camera_U026400: RteEventRef=OpEventSetEventStatus_SetEventStatus_Event_Lost_Communication_with_Rear_Camera_U026400
          OpEventSetEventStatus_SetEventStatus_Event_HS_FD_CANR_Comm_Bus_Performance_U100B00: RteEventRef=OpEventSetEventStatus_SetEventStatus_Event_HS_FD_CANR_Comm_Bus_Performance_U100B00
          OpEventSetEventStatus_SetEventStatus_Event_Implausible_Data_Received_From_Body_Control_Module_U042200: RteEventRef=OpEventSetEventStatus_SetEventStatus_Event_Implausible_Data_Received_From_Body_Control_Module_U042200
          OpEventSetEventStatus_SetEventStatus_Event_Lost_Communication_With_BCM_U014000: RteEventRef=OpEventSetEventStatus_SetEventStatus_Event_Lost_Communication_With_BCM_U014000
          OpEventSetEventStatus_SetEventStatus_Event_PTS_Sensor_2_Circuit_Open_B128F13: RteEventRef=OpEventSetEventStatus_SetEventStatus_Event_PTS_Sensor_2_Circuit_Open_B128F13
          OpEventSetEventStatus_SetEventStatus_Event_PTS_Sensor_3_Circuit_Open_B129013: RteEventRef=OpEventSetEventStatus_SetEventStatus_Event_PTS_Sensor_3_Circuit_Open_B129013
          OpEventSetEventStatus_SetEventStatus_Event_ECU_In_Plant_Mode_C221200: RteEventRef=OpEventSetEventStatus_SetEventStatus_Event_ECU_In_Plant_Mode_C221200
          OpEventSetEventStatus_SetEventStatus_Event_Implausible_Data_from_ORC_module_U045500: RteEventRef=OpEventSetEventStatus_SetEventStatus_Event_Implausible_Data_from_ORC_module_U045500
          OpEventSetEventStatus_SetEventStatus_Event_Right_Camera_Performance_or_Incorrect_Operation_B23C792: RteEventRef=OpEventSetEventStatus_SetEventStatus_Event_Right_Camera_Performance_or_Incorrect_Operation_B23C792
          OpEventSetEventStatus_SetEventStatus_Event_Rear_Sensors_PS_VltgeAboveThreshold_B212B17: RteEventRef=OpEventSetEventStatus_SetEventStatus_Event_Rear_Sensors_PS_VltgeAboveThreshold_B212B17
          OpEventResetEventStatus_ResetEventStatus_Event_Invalid_Data_Received_From_Power_Steering_Control_Module_U042000: RteEventRef=OpEventResetEventStatus_ResetEventStatus_Event_Invalid_Data_Received_From_Power_Steering_Control_Module_U042000
          OpEventResetEventStatus_ResetEventStatus_Event_Lost_Communication_with_Left_Camera_U026600: RteEventRef=OpEventResetEventStatus_ResetEventStatus_Event_Lost_Communication_with_Left_Camera_U026600
          OpEventResetEventStatus_ResetEventStatus_Event_Front_Sensors_PS_VltgeBelowThreshold_B212A16: RteEventRef=OpEventResetEventStatus_ResetEventStatus_Event_Front_Sensors_PS_VltgeBelowThreshold_B212A16
          OpEventResetEventStatus_ResetEventStatus_Event_Left_Camera_Circuit_Voltage_Out_of_Range_B23C61C: RteEventRef=OpEventResetEventStatus_ResetEventStatus_Event_Left_Camera_Circuit_Voltage_Out_of_Range_B23C61C
          OpEventResetEventStatus_ResetEventStatus_Event_Rear_Sensors_PS_VltgeBelowThreshold_B212B16: RteEventRef=OpEventResetEventStatus_ResetEventStatus_Event_Rear_Sensors_PS_VltgeBelowThreshold_B212B16
          OpEventResetEventStatus_ResetEventStatus_Event_Rear_Sensors_PS_Bus_Sig_Msg_Failures_B212B08: RteEventRef=OpEventResetEventStatus_ResetEventStatus_Event_Rear_Sensors_PS_Bus_Sig_Msg_Failures_B212B08
          OpEventResetEventStatus_ResetEventStatus_Event_Rear_Camera_Circuit_Voltage_Out_of_Range_B217A1C: RteEventRef=OpEventResetEventStatus_ResetEventStatus_Event_Rear_Camera_Circuit_Voltage_Out_of_Range_B217A1C
          OpEventResetEventStatus_ResetEventStatus_Event_PTS_Sensor_12_Performance_or_Incorrect_Operation_B129992: RteEventRef=OpEventResetEventStatus_ResetEventStatus_Event_PTS_Sensor_12_Performance_or_Incorrect_Operation_B129992
          OpEventResetEventStatus_ResetEventStatus_Event_Battery_Voltage_Over_Voltage_B210C17: RteEventRef=OpEventResetEventStatus_ResetEventStatus_Event_Battery_Voltage_Over_Voltage_B210C17
          OpEventResetEventStatus_ResetEventStatus_Event_Front_Sensors_PS_VltgeAboveThreshold_B212A17: RteEventRef=OpEventResetEventStatus_ResetEventStatus_Event_Front_Sensors_PS_VltgeAboveThreshold_B212A17
          OpEventResetEventStatus_ResetEventStatus_Event_PTS_Sensor_4_Circuit_Open_B129113: RteEventRef=OpEventResetEventStatus_ResetEventStatus_Event_PTS_Sensor_4_Circuit_Open_B129113
          OpEventResetEventStatus_ResetEventStatus_Event_PTS_Sensor_12_Circuit_Open_B129913: RteEventRef=OpEventResetEventStatus_ResetEventStatus_Event_PTS_Sensor_12_Circuit_Open_B129913
          OpEventResetEventStatus_ResetEventStatus_Event_PTS_Sensor_11_Performance_or_Incorrect_Operation_B129892: RteEventRef=OpEventResetEventStatus_ResetEventStatus_Event_PTS_Sensor_11_Performance_or_Incorrect_Operation_B129892
          OpEventResetEventStatus_ResetEventStatus_Event_Lost_Communication_With_Radio_U018400: RteEventRef=OpEventResetEventStatus_ResetEventStatus_Event_Lost_Communication_With_Radio_U018400
          OpEventResetEventStatus_ResetEventStatus_Event_Park_Assist_PTS_Switch_Stuck_B12852A: RteEventRef=OpEventResetEventStatus_ResetEventStatus_Event_Park_Assist_PTS_Switch_Stuck_B12852A
          OpEventResetEventStatus_ResetEventStatus_Event_PTS_Sensor_5_Circuit_Open_B129213: RteEventRef=OpEventResetEventStatus_ResetEventStatus_Event_PTS_Sensor_5_Circuit_Open_B129213
          OpEventResetEventStatus_ResetEventStatus_Event_PTS_Sensor_5_Performance_or_Incorrect_Operation_B129292: RteEventRef=OpEventResetEventStatus_ResetEventStatus_Event_PTS_Sensor_5_Performance_or_Incorrect_Operation_B129292
          OpEventResetEventStatus_ResetEventStatus_Event_Battery_Voltage_Under_Voltage_B210C16: RteEventRef=OpEventResetEventStatus_ResetEventStatus_Event_Battery_Voltage_Under_Voltage_B210C16
          OpEventResetEventStatus_ResetEventStatus_Event_PTS_Sensor_4_Performance_or_Incorrect_Operation_B129192: RteEventRef=OpEventResetEventStatus_ResetEventStatus_Event_PTS_Sensor_4_Performance_or_Incorrect_Operation_B129192
          OpEventResetEventStatus_ResetEventStatus_Event_HS_FD_CAN2_Comm_Bus_Performance_U104E00: RteEventRef=OpEventResetEventStatus_ResetEventStatus_Event_HS_FD_CAN2_Comm_Bus_Performance_U104E00
          OpEventResetEventStatus_ResetEventStatus_Event_PTS_Sensor_9_Circuit_Open_B129613: RteEventRef=OpEventResetEventStatus_ResetEventStatus_Event_PTS_Sensor_9_Circuit_Open_B129613
          OpEventResetEventStatus_ResetEventStatus_Event_Loss_of_Comm_With_Engine_Control_Module_U010000: RteEventRef=OpEventResetEventStatus_ResetEventStatus_Event_Loss_of_Comm_With_Engine_Control_Module_U010000
          OpEventResetEventStatus_ResetEventStatus_Event_Lost_Communication_with_Right_Camera_U026700: RteEventRef=OpEventResetEventStatus_ResetEventStatus_Event_Lost_Communication_with_Right_Camera_U026700
          OpEventResetEventStatus_ResetEventStatus_Event_PTS_Sensor_1_Performance_or_Incorrect_Operation_B128E92: RteEventRef=OpEventResetEventStatus_ResetEventStatus_Event_PTS_Sensor_1_Performance_or_Incorrect_Operation_B128E92
          OpEventResetEventStatus_ResetEventStatus_Event_Rear_Camera_Performance_or_Incorrect_Operation_B217A92: RteEventRef=OpEventResetEventStatus_ResetEventStatus_Event_Rear_Camera_Performance_or_Incorrect_Operation_B217A92
          OpEventResetEventStatus_ResetEventStatus_Event_PTS_Sensor_2_Performance_or_Incorrect_Operation_B128F92: RteEventRef=OpEventResetEventStatus_ResetEventStatus_Event_PTS_Sensor_2_Performance_or_Incorrect_Operation_B128F92
          OpEventResetEventStatus_ResetEventStatus_Event_Right_Camera_Circuit_Voltage_Out_of_Range_B23C71C: RteEventRef=OpEventResetEventStatus_ResetEventStatus_Event_Right_Camera_Circuit_Voltage_Out_of_Range_B23C71C
          OpEventResetEventStatus_ResetEventStatus_Event_PTS_Sensor_8_Circuit_Open_B129513: RteEventRef=OpEventResetEventStatus_ResetEventStatus_Event_PTS_Sensor_8_Circuit_Open_B129513
          OpEventResetEventStatus_ResetEventStatus_Event_Implausible_Data_Received_from_Radio_U048500: RteEventRef=OpEventResetEventStatus_ResetEventStatus_Event_Implausible_Data_Received_from_Radio_U048500
          OpEventResetEventStatus_ResetEventStatus_Event_Implausible_Data_received_from_TRSKM_module_U14A000: RteEventRef=OpEventResetEventStatus_ResetEventStatus_Event_Implausible_Data_received_from_TRSKM_module_U14A000
          OpEventResetEventStatus_ResetEventStatus_Event_Front_Camera_Performance_or_Incorrect_Operation_B23C592: RteEventRef=OpEventResetEventStatus_ResetEventStatus_Event_Front_Camera_Performance_or_Incorrect_Operation_B23C592
          OpEventResetEventStatus_ResetEventStatus_Event_Loss_Communication_with_TRS_Knob_Module_U12B900: RteEventRef=OpEventResetEventStatus_ResetEventStatus_Event_Loss_Communication_with_TRS_Knob_Module_U12B900
          OpEventResetEventStatus_ResetEventStatus_Event_PTS_Sensor_7_Circuit_Open_B129413: RteEventRef=OpEventResetEventStatus_ResetEventStatus_Event_PTS_Sensor_7_Circuit_Open_B129413
          OpEventResetEventStatus_ResetEventStatus_Event_Front_Sensors_PS_Bus_Sig_Msg_Failures_B212A08: RteEventRef=OpEventResetEventStatus_ResetEventStatus_Event_Front_Sensors_PS_Bus_Sig_Msg_Failures_B212A08
          OpEventResetEventStatus_ResetEventStatus_Event_Lost_Communication_With_PSC_Module_A_U013100: RteEventRef=OpEventResetEventStatus_ResetEventStatus_Event_Lost_Communication_With_PSC_Module_A_U013100
          OpEventResetEventStatus_ResetEventStatus_Event_Lost_Communication_with_Front_Camera_U026500: RteEventRef=OpEventResetEventStatus_ResetEventStatus_Event_Lost_Communication_with_Front_Camera_U026500
          OpEventResetEventStatus_ResetEventStatus_Event_PTS_Sensor_3_Performance_or_Incorrect_Operation_B129092: RteEventRef=OpEventResetEventStatus_ResetEventStatus_Event_PTS_Sensor_3_Performance_or_Incorrect_Operation_B129092
          OpEventResetEventStatus_ResetEventStatus_Event_PTS_Sensor_8_Performance_or_Incorrect_Operation_B129592: RteEventRef=OpEventResetEventStatus_ResetEventStatus_Event_PTS_Sensor_8_Performance_or_Incorrect_Operation_B129592
          OpEventResetEventStatus_ResetEventStatus_Event_PPP_Assist_Switch_Stuck_B12B22A: RteEventRef=OpEventResetEventStatus_ResetEventStatus_Event_PPP_Assist_Switch_Stuck_B12B22A
          OpEventResetEventStatus_ResetEventStatus_Event_Implausible_data_received_from_ECM_U040100: RteEventRef=OpEventResetEventStatus_ResetEventStatus_Event_Implausible_data_received_from_ECM_U040100
          OpEventResetEventStatus_ResetEventStatus_Event_PTS_Sensor_10_Circuit_Open_B129713: RteEventRef=OpEventResetEventStatus_ResetEventStatus_Event_PTS_Sensor_10_Circuit_Open_B129713
          OpEventResetEventStatus_ResetEventStatus_Event_Lost_Communication_With_BSC_module_1_U012900: RteEventRef=OpEventResetEventStatus_ResetEventStatus_Event_Lost_Communication_With_BSC_module_1_U012900
          OpEventResetEventStatus_ResetEventStatus_Event_PTS_Sensor_7_Performance_or_Incorrect_Operation_B129492: RteEventRef=OpEventResetEventStatus_ResetEventStatus_Event_PTS_Sensor_7_Performance_or_Incorrect_Operation_B129492
          OpEventResetEventStatus_ResetEventStatus_Event_Left_Camera_Performance_or_Incorrect_Operation_B23C692: RteEventRef=OpEventResetEventStatus_ResetEventStatus_Event_Left_Camera_Performance_or_Incorrect_Operation_B23C692
          OpEventResetEventStatus_ResetEventStatus_Event_Vehicle_Configuration_Mismatch_B223B00: RteEventRef=OpEventResetEventStatus_ResetEventStatus_Event_Vehicle_Configuration_Mismatch_B223B00
          OpEventResetEventStatus_ResetEventStatus_Event_PTS_Sensor_6_Circuit_Open_B129313: RteEventRef=OpEventResetEventStatus_ResetEventStatus_Event_PTS_Sensor_6_Circuit_Open_B129313
          OpEventResetEventStatus_ResetEventStatus_Event_Front_Camera_Circuit_Voltage_Out_of_Range_B23C51C: RteEventRef=OpEventResetEventStatus_ResetEventStatus_Event_Front_Camera_Circuit_Voltage_Out_of_Range_B23C51C
          OpEventResetEventStatus_ResetEventStatus_Event_Implausible_Data_From_BSC_Module_1_U041800: RteEventRef=OpEventResetEventStatus_ResetEventStatus_Event_Implausible_Data_From_BSC_Module_1_U041800
          OpEventResetEventStatus_ResetEventStatus_Event_PTS_Sensor_10_Performance_or_Incorrect_Operation_B129792: RteEventRef=OpEventResetEventStatus_ResetEventStatus_Event_PTS_Sensor_10_Performance_or_Incorrect_Operation_B129792
          OpEventResetEventStatus_ResetEventStatus_Event_PTS_Sensor_11_Circuit_Open_B129813: RteEventRef=OpEventResetEventStatus_ResetEventStatus_Event_PTS_Sensor_11_Circuit_Open_B129813
          OpEventResetEventStatus_ResetEventStatus_Event_ECU_Internal_Performance_B22A900: RteEventRef=OpEventResetEventStatus_ResetEventStatus_Event_ECU_Internal_Performance_B22A900
          OpEventResetEventStatus_ResetEventStatus_Event_PTS_Sensor_9_Performance_or_Incorrect_Operation_B129692: RteEventRef=OpEventResetEventStatus_ResetEventStatus_Event_PTS_Sensor_9_Performance_or_Incorrect_Operation_B129692
          OpEventResetEventStatus_ResetEventStatus_Event_Calibration_Not_Learned_Lost_Calibration_B228600: RteEventRef=OpEventResetEventStatus_ResetEventStatus_Event_Calibration_Not_Learned_Lost_Calibration_B228600
          OpEventResetEventStatus_ResetEventStatus_Event_Lost_Communication_with_ORC_U015100: RteEventRef=OpEventResetEventStatus_ResetEventStatus_Event_Lost_Communication_with_ORC_U015100
          OpEventResetEventStatus_ResetEventStatus_Event_PTS_Sensor_1_Circuit_Open_B128E13: RteEventRef=OpEventResetEventStatus_ResetEventStatus_Event_PTS_Sensor_1_Circuit_Open_B128E13
          OpEventResetEventStatus_ResetEventStatus_Event_Lost_Communication_with_Rear_Camera_U026400: RteEventRef=OpEventResetEventStatus_ResetEventStatus_Event_Lost_Communication_with_Rear_Camera_U026400
          OpEventResetEventStatus_ResetEventStatus_Event_HS_FD_CANR_Comm_Bus_Performance_U100B00: RteEventRef=OpEventResetEventStatus_ResetEventStatus_Event_HS_FD_CANR_Comm_Bus_Performance_U100B00
          OpEventResetEventStatus_ResetEventStatus_Event_Implausible_Data_Received_From_Body_Control_Module_U042200: RteEventRef=OpEventResetEventStatus_ResetEventStatus_Event_Implausible_Data_Received_From_Body_Control_Module_U042200
          OpEventResetEventStatus_ResetEventStatus_Event_Lost_Communication_With_BCM_U014000: RteEventRef=OpEventResetEventStatus_ResetEventStatus_Event_Lost_Communication_With_BCM_U014000
          OpEventResetEventStatus_ResetEventStatus_Event_PTS_Sensor_2_Circuit_Open_B128F13: RteEventRef=OpEventResetEventStatus_ResetEventStatus_Event_PTS_Sensor_2_Circuit_Open_B128F13
          OpEventResetEventStatus_ResetEventStatus_Event_PTS_Sensor_3_Circuit_Open_B129013: RteEventRef=OpEventResetEventStatus_ResetEventStatus_Event_PTS_Sensor_3_Circuit_Open_B129013
          OpEventResetEventStatus_ResetEventStatus_Event_ECU_In_Plant_Mode_C221200: RteEventRef=OpEventResetEventStatus_ResetEventStatus_Event_ECU_In_Plant_Mode_C221200
          OpEventResetEventStatus_ResetEventStatus_Event_Implausible_Data_from_ORC_module_U045500: RteEventRef=OpEventResetEventStatus_ResetEventStatus_Event_Implausible_Data_from_ORC_module_U045500
          OpEventResetEventStatus_ResetEventStatus_Event_Right_Camera_Performance_or_Incorrect_Operation_B23C792: RteEventRef=OpEventResetEventStatus_ResetEventStatus_Event_Right_Camera_Performance_or_Incorrect_Operation_B23C792
          OpEventResetEventStatus_ResetEventStatus_Event_Rear_Sensors_PS_VltgeAboveThreshold_B212B17: RteEventRef=OpEventResetEventStatus_ResetEventStatus_Event_Rear_Sensors_PS_VltgeAboveThreshold_B212B17
          OpEventResetEventDebounceStatus_ResetEventDebounceStatus_Event_Invalid_Data_Received_From_Power_Steering_Control_Module_U042000: RteEventRef=OpEventResetEventDebounceStatus_ResetEventDebounceStatus_Event_Invalid_Data_Received_From_Power_Steering_Control_Module_U042000
          OpEventResetEventDebounceStatus_ResetEventDebounceStatus_Event_Lost_Communication_with_Left_Camera_U026600: RteEventRef=OpEventResetEventDebounceStatus_ResetEventDebounceStatus_Event_Lost_Communication_with_Left_Camera_U026600
          OpEventResetEventDebounceStatus_ResetEventDebounceStatus_Event_Front_Sensors_PS_VltgeBelowThreshold_B212A16: RteEventRef=OpEventResetEventDebounceStatus_ResetEventDebounceStatus_Event_Front_Sensors_PS_VltgeBelowThreshold_B212A16
          OpEventResetEventDebounceStatus_ResetEventDebounceStatus_Event_Left_Camera_Circuit_Voltage_Out_of_Range_B23C61C: RteEventRef=OpEventResetEventDebounceStatus_ResetEventDebounceStatus_Event_Left_Camera_Circuit_Voltage_Out_of_Range_B23C61C
          OpEventResetEventDebounceStatus_ResetEventDebounceStatus_Event_Rear_Sensors_PS_VltgeBelowThreshold_B212B16: RteEventRef=OpEventResetEventDebounceStatus_ResetEventDebounceStatus_Event_Rear_Sensors_PS_VltgeBelowThreshold_B212B16
          OpEventResetEventDebounceStatus_ResetEventDebounceStatus_Event_Rear_Sensors_PS_Bus_Sig_Msg_Failures_B212B08: RteEventRef=OpEventResetEventDebounceStatus_ResetEventDebounceStatus_Event_Rear_Sensors_PS_Bus_Sig_Msg_Failures_B212B08
          OpEventResetEventDebounceStatus_ResetEventDebounceStatus_Event_Rear_Camera_Circuit_Voltage_Out_of_Range_B217A1C: RteEventRef=OpEventResetEventDebounceStatus_ResetEventDebounceStatus_Event_Rear_Camera_Circuit_Voltage_Out_of_Range_B217A1C
          OpEventResetEventDebounceStatus_ResetEventDebounceStatus_Event_PTS_Sensor_12_Performance_or_Incorrect_Operation_B129992: RteEventRef=OpEventResetEventDebounceStatus_ResetEventDebounceStatus_Event_PTS_Sensor_12_Performance_or_Incorrect_Operation_B129992
          OpEventResetEventDebounceStatus_ResetEventDebounceStatus_Event_Battery_Voltage_Over_Voltage_B210C17: RteEventRef=OpEventResetEventDebounceStatus_ResetEventDebounceStatus_Event_Battery_Voltage_Over_Voltage_B210C17
          OpEventResetEventDebounceStatus_ResetEventDebounceStatus_Event_Front_Sensors_PS_VltgeAboveThreshold_B212A17: RteEventRef=OpEventResetEventDebounceStatus_ResetEventDebounceStatus_Event_Front_Sensors_PS_VltgeAboveThreshold_B212A17
          OpEventResetEventDebounceStatus_ResetEventDebounceStatus_Event_PTS_Sensor_4_Circuit_Open_B129113: RteEventRef=OpEventResetEventDebounceStatus_ResetEventDebounceStatus_Event_PTS_Sensor_4_Circuit_Open_B129113
          OpEventResetEventDebounceStatus_ResetEventDebounceStatus_Event_PTS_Sensor_12_Circuit_Open_B129913: RteEventRef=OpEventResetEventDebounceStatus_ResetEventDebounceStatus_Event_PTS_Sensor_12_Circuit_Open_B129913
          OpEventResetEventDebounceStatus_ResetEventDebounceStatus_Event_PTS_Sensor_11_Performance_or_Incorrect_Operation_B129892: RteEventRef=OpEventResetEventDebounceStatus_ResetEventDebounceStatus_Event_PTS_Sensor_11_Performance_or_Incorrect_Operation_B129892
          OpEventResetEventDebounceStatus_ResetEventDebounceStatus_Event_Lost_Communication_With_Radio_U018400: RteEventRef=OpEventResetEventDebounceStatus_ResetEventDebounceStatus_Event_Lost_Communication_With_Radio_U018400
          OpEventResetEventDebounceStatus_ResetEventDebounceStatus_Event_Park_Assist_PTS_Switch_Stuck_B12852A: RteEventRef=OpEventResetEventDebounceStatus_ResetEventDebounceStatus_Event_Park_Assist_PTS_Switch_Stuck_B12852A
          OpEventResetEventDebounceStatus_ResetEventDebounceStatus_Event_PTS_Sensor_5_Circuit_Open_B129213: RteEventRef=OpEventResetEventDebounceStatus_ResetEventDebounceStatus_Event_PTS_Sensor_5_Circuit_Open_B129213
          OpEventResetEventDebounceStatus_ResetEventDebounceStatus_Event_PTS_Sensor_5_Performance_or_Incorrect_Operation_B129292: RteEventRef=OpEventResetEventDebounceStatus_ResetEventDebounceStatus_Event_PTS_Sensor_5_Performance_or_Incorrect_Operation_B129292
          OpEventResetEventDebounceStatus_ResetEventDebounceStatus_Event_Battery_Voltage_Under_Voltage_B210C16: RteEventRef=OpEventResetEventDebounceStatus_ResetEventDebounceStatus_Event_Battery_Voltage_Under_Voltage_B210C16
          OpEventResetEventDebounceStatus_ResetEventDebounceStatus_Event_PTS_Sensor_4_Performance_or_Incorrect_Operation_B129192: RteEventRef=OpEventResetEventDebounceStatus_ResetEventDebounceStatus_Event_PTS_Sensor_4_Performance_or_Incorrect_Operation_B129192
          OpEventResetEventDebounceStatus_ResetEventDebounceStatus_Event_HS_FD_CAN2_Comm_Bus_Performance_U104E00: RteEventRef=OpEventResetEventDebounceStatus_ResetEventDebounceStatus_Event_HS_FD_CAN2_Comm_Bus_Performance_U104E00
          OpEventResetEventDebounceStatus_ResetEventDebounceStatus_Event_PTS_Sensor_9_Circuit_Open_B129613: RteEventRef=OpEventResetEventDebounceStatus_ResetEventDebounceStatus_Event_PTS_Sensor_9_Circuit_Open_B129613
          OpEventResetEventDebounceStatus_ResetEventDebounceStatus_Event_Loss_of_Comm_With_Engine_Control_Module_U010000: RteEventRef=OpEventResetEventDebounceStatus_ResetEventDebounceStatus_Event_Loss_of_Comm_With_Engine_Control_Module_U010000
          OpEventResetEventDebounceStatus_ResetEventDebounceStatus_Event_Lost_Communication_with_Right_Camera_U026700: RteEventRef=OpEventResetEventDebounceStatus_ResetEventDebounceStatus_Event_Lost_Communication_with_Right_Camera_U026700
          OpEventResetEventDebounceStatus_ResetEventDebounceStatus_Event_PTS_Sensor_1_Performance_or_Incorrect_Operation_B128E92: RteEventRef=OpEventResetEventDebounceStatus_ResetEventDebounceStatus_Event_PTS_Sensor_1_Performance_or_Incorrect_Operation_B128E92
          OpEventResetEventDebounceStatus_ResetEventDebounceStatus_Event_Rear_Camera_Performance_or_Incorrect_Operation_B217A92: RteEventRef=OpEventResetEventDebounceStatus_ResetEventDebounceStatus_Event_Rear_Camera_Performance_or_Incorrect_Operation_B217A92
          OpEventResetEventDebounceStatus_ResetEventDebounceStatus_Event_PTS_Sensor_2_Performance_or_Incorrect_Operation_B128F92: RteEventRef=OpEventResetEventDebounceStatus_ResetEventDebounceStatus_Event_PTS_Sensor_2_Performance_or_Incorrect_Operation_B128F92
          OpEventResetEventDebounceStatus_ResetEventDebounceStatus_Event_Right_Camera_Circuit_Voltage_Out_of_Range_B23C71C: RteEventRef=OpEventResetEventDebounceStatus_ResetEventDebounceStatus_Event_Right_Camera_Circuit_Voltage_Out_of_Range_B23C71C
          OpEventResetEventDebounceStatus_ResetEventDebounceStatus_Event_PTS_Sensor_8_Circuit_Open_B129513: RteEventRef=OpEventResetEventDebounceStatus_ResetEventDebounceStatus_Event_PTS_Sensor_8_Circuit_Open_B129513
          OpEventResetEventDebounceStatus_ResetEventDebounceStatus_Event_Implausible_Data_Received_from_Radio_U048500: RteEventRef=OpEventResetEventDebounceStatus_ResetEventDebounceStatus_Event_Implausible_Data_Received_from_Radio_U048500
          OpEventResetEventDebounceStatus_ResetEventDebounceStatus_Event_Implausible_Data_received_from_TRSKM_module_U14A000: RteEventRef=OpEventResetEventDebounceStatus_ResetEventDebounceStatus_Event_Implausible_Data_received_from_TRSKM_module_U14A000
          OpEventResetEventDebounceStatus_ResetEventDebounceStatus_Event_Front_Camera_Performance_or_Incorrect_Operation_B23C592: RteEventRef=OpEventResetEventDebounceStatus_ResetEventDebounceStatus_Event_Front_Camera_Performance_or_Incorrect_Operation_B23C592
          OpEventResetEventDebounceStatus_ResetEventDebounceStatus_Event_Loss_Communication_with_TRS_Knob_Module_U12B900: RteEventRef=OpEventResetEventDebounceStatus_ResetEventDebounceStatus_Event_Loss_Communication_with_TRS_Knob_Module_U12B900
          OpEventResetEventDebounceStatus_ResetEventDebounceStatus_Event_PTS_Sensor_7_Circuit_Open_B129413: RteEventRef=OpEventResetEventDebounceStatus_ResetEventDebounceStatus_Event_PTS_Sensor_7_Circuit_Open_B129413
          OpEventResetEventDebounceStatus_ResetEventDebounceStatus_Event_Front_Sensors_PS_Bus_Sig_Msg_Failures_B212A08: RteEventRef=OpEventResetEventDebounceStatus_ResetEventDebounceStatus_Event_Front_Sensors_PS_Bus_Sig_Msg_Failures_B212A08
          OpEventResetEventDebounceStatus_ResetEventDebounceStatus_Event_Lost_Communication_With_PSC_Module_A_U013100: RteEventRef=OpEventResetEventDebounceStatus_ResetEventDebounceStatus_Event_Lost_Communication_With_PSC_Module_A_U013100
          OpEventResetEventDebounceStatus_ResetEventDebounceStatus_Event_Lost_Communication_with_Front_Camera_U026500: RteEventRef=OpEventResetEventDebounceStatus_ResetEventDebounceStatus_Event_Lost_Communication_with_Front_Camera_U026500
          OpEventResetEventDebounceStatus_ResetEventDebounceStatus_Event_PTS_Sensor_3_Performance_or_Incorrect_Operation_B129092: RteEventRef=OpEventResetEventDebounceStatus_ResetEventDebounceStatus_Event_PTS_Sensor_3_Performance_or_Incorrect_Operation_B129092
          OpEventResetEventDebounceStatus_ResetEventDebounceStatus_Event_PTS_Sensor_8_Performance_or_Incorrect_Operation_B129592: RteEventRef=OpEventResetEventDebounceStatus_ResetEventDebounceStatus_Event_PTS_Sensor_8_Performance_or_Incorrect_Operation_B129592
          OpEventResetEventDebounceStatus_ResetEventDebounceStatus_Event_PPP_Assist_Switch_Stuck_B12B22A: RteEventRef=OpEventResetEventDebounceStatus_ResetEventDebounceStatus_Event_PPP_Assist_Switch_Stuck_B12B22A
          OpEventResetEventDebounceStatus_ResetEventDebounceStatus_Event_Implausible_data_received_from_ECM_U040100: RteEventRef=OpEventResetEventDebounceStatus_ResetEventDebounceStatus_Event_Implausible_data_received_from_ECM_U040100
          OpEventResetEventDebounceStatus_ResetEventDebounceStatus_Event_PTS_Sensor_10_Circuit_Open_B129713: RteEventRef=OpEventResetEventDebounceStatus_ResetEventDebounceStatus_Event_PTS_Sensor_10_Circuit_Open_B129713
          OpEventResetEventDebounceStatus_ResetEventDebounceStatus_Event_Lost_Communication_With_BSC_module_1_U012900: RteEventRef=OpEventResetEventDebounceStatus_ResetEventDebounceStatus_Event_Lost_Communication_With_BSC_module_1_U012900
          OpEventResetEventDebounceStatus_ResetEventDebounceStatus_Event_PTS_Sensor_7_Performance_or_Incorrect_Operation_B129492: RteEventRef=OpEventResetEventDebounceStatus_ResetEventDebounceStatus_Event_PTS_Sensor_7_Performance_or_Incorrect_Operation_B129492
          OpEventResetEventDebounceStatus_ResetEventDebounceStatus_Event_Left_Camera_Performance_or_Incorrect_Operation_B23C692: RteEventRef=OpEventResetEventDebounceStatus_ResetEventDebounceStatus_Event_Left_Camera_Performance_or_Incorrect_Operation_B23C692
          OpEventResetEventDebounceStatus_ResetEventDebounceStatus_Event_Vehicle_Configuration_Mismatch_B223B00: RteEventRef=OpEventResetEventDebounceStatus_ResetEventDebounceStatus_Event_Vehicle_Configuration_Mismatch_B223B00
          OpEventResetEventDebounceStatus_ResetEventDebounceStatus_Event_PTS_Sensor_6_Circuit_Open_B129313: RteEventRef=OpEventResetEventDebounceStatus_ResetEventDebounceStatus_Event_PTS_Sensor_6_Circuit_Open_B129313
          OpEventResetEventDebounceStatus_ResetEventDebounceStatus_Event_Front_Camera_Circuit_Voltage_Out_of_Range_B23C51C: RteEventRef=OpEventResetEventDebounceStatus_ResetEventDebounceStatus_Event_Front_Camera_Circuit_Voltage_Out_of_Range_B23C51C
          OpEventResetEventDebounceStatus_ResetEventDebounceStatus_Event_Implausible_Data_From_BSC_Module_1_U041800: RteEventRef=OpEventResetEventDebounceStatus_ResetEventDebounceStatus_Event_Implausible_Data_From_BSC_Module_1_U041800
          OpEventResetEventDebounceStatus_ResetEventDebounceStatus_Event_PTS_Sensor_10_Performance_or_Incorrect_Operation_B129792: RteEventRef=OpEventResetEventDebounceStatus_ResetEventDebounceStatus_Event_PTS_Sensor_10_Performance_or_Incorrect_Operation_B129792
          OpEventResetEventDebounceStatus_ResetEventDebounceStatus_Event_PTS_Sensor_11_Circuit_Open_B129813: RteEventRef=OpEventResetEventDebounceStatus_ResetEventDebounceStatus_Event_PTS_Sensor_11_Circuit_Open_B129813
          OpEventResetEventDebounceStatus_ResetEventDebounceStatus_Event_ECU_Internal_Performance_B22A900: RteEventRef=OpEventResetEventDebounceStatus_ResetEventDebounceStatus_Event_ECU_Internal_Performance_B22A900
          OpEventResetEventDebounceStatus_ResetEventDebounceStatus_Event_PTS_Sensor_9_Performance_or_Incorrect_Operation_B129692: RteEventRef=OpEventResetEventDebounceStatus_ResetEventDebounceStatus_Event_PTS_Sensor_9_Performance_or_Incorrect_Operation_B129692
          OpEventResetEventDebounceStatus_ResetEventDebounceStatus_Event_Calibration_Not_Learned_Lost_Calibration_B228600: RteEventRef=OpEventResetEventDebounceStatus_ResetEventDebounceStatus_Event_Calibration_Not_Learned_Lost_Calibration_B228600
          OpEventResetEventDebounceStatus_ResetEventDebounceStatus_Event_Lost_Communication_with_ORC_U015100: RteEventRef=OpEventResetEventDebounceStatus_ResetEventDebounceStatus_Event_Lost_Communication_with_ORC_U015100
          OpEventResetEventDebounceStatus_ResetEventDebounceStatus_Event_PTS_Sensor_1_Circuit_Open_B128E13: RteEventRef=OpEventResetEventDebounceStatus_ResetEventDebounceStatus_Event_PTS_Sensor_1_Circuit_Open_B128E13
          OpEventResetEventDebounceStatus_ResetEventDebounceStatus_Event_Lost_Communication_with_Rear_Camera_U026400: RteEventRef=OpEventResetEventDebounceStatus_ResetEventDebounceStatus_Event_Lost_Communication_with_Rear_Camera_U026400
          OpEventResetEventDebounceStatus_ResetEventDebounceStatus_Event_HS_FD_CANR_Comm_Bus_Performance_U100B00: RteEventRef=OpEventResetEventDebounceStatus_ResetEventDebounceStatus_Event_HS_FD_CANR_Comm_Bus_Performance_U100B00
          OpEventResetEventDebounceStatus_ResetEventDebounceStatus_Event_Implausible_Data_Received_From_Body_Control_Module_U042200: RteEventRef=OpEventResetEventDebounceStatus_ResetEventDebounceStatus_Event_Implausible_Data_Received_From_Body_Control_Module_U042200
          OpEventResetEventDebounceStatus_ResetEventDebounceStatus_Event_Lost_Communication_With_BCM_U014000: RteEventRef=OpEventResetEventDebounceStatus_ResetEventDebounceStatus_Event_Lost_Communication_With_BCM_U014000
          OpEventResetEventDebounceStatus_ResetEventDebounceStatus_Event_PTS_Sensor_2_Circuit_Open_B128F13: RteEventRef=OpEventResetEventDebounceStatus_ResetEventDebounceStatus_Event_PTS_Sensor_2_Circuit_Open_B128F13
          OpEventResetEventDebounceStatus_ResetEventDebounceStatus_Event_PTS_Sensor_3_Circuit_Open_B129013: RteEventRef=OpEventResetEventDebounceStatus_ResetEventDebounceStatus_Event_PTS_Sensor_3_Circuit_Open_B129013
          OpEventResetEventDebounceStatus_ResetEventDebounceStatus_Event_ECU_In_Plant_Mode_C221200: RteEventRef=OpEventResetEventDebounceStatus_ResetEventDebounceStatus_Event_ECU_In_Plant_Mode_C221200
          OpEventResetEventDebounceStatus_ResetEventDebounceStatus_Event_Implausible_Data_from_ORC_module_U045500: RteEventRef=OpEventResetEventDebounceStatus_ResetEventDebounceStatus_Event_Implausible_Data_from_ORC_module_U045500
          OpEventResetEventDebounceStatus_ResetEventDebounceStatus_Event_Right_Camera_Performance_or_Incorrect_Operation_B23C792: RteEventRef=OpEventResetEventDebounceStatus_ResetEventDebounceStatus_Event_Right_Camera_Performance_or_Incorrect_Operation_B23C792
          OpEventResetEventDebounceStatus_ResetEventDebounceStatus_Event_Rear_Sensors_PS_VltgeAboveThreshold_B212B17: RteEventRef=OpEventResetEventDebounceStatus_ResetEventDebounceStatus_Event_Rear_Sensors_PS_VltgeAboveThreshold_B212B17
          OpEventGetEventUdsStatus_GetEventUdsStatus_EvtInfo_PTS_Sensor_6_Performance_or_Incorrect_Operation_B129392: RteEventRef=OpEventGetEventUdsStatus_GetEventUdsStatus_EvtInfo_PTS_Sensor_6_Performance_or_Incorrect_Operation_B129392
          OpEventGetEventUdsStatus_GetEventUdsStatus_Event_PTS_Sensor_6_Performance_or_Incorrect_Operation_B129392: RteEventRef=OpEventGetEventUdsStatus_GetEventUdsStatus_Event_PTS_Sensor_6_Performance_or_Incorrect_Operation_B129392
          OpEventGetEventStatus_GetEventStatus_EvtInfo_PTS_Sensor_6_Performance_or_Incorrect_Operation_B129392: RteEventRef=OpEventGetEventStatus_GetEventStatus_EvtInfo_PTS_Sensor_6_Performance_or_Incorrect_Operation_B129392
          OpEventGetEventStatus_GetEventStatus_Event_PTS_Sensor_6_Performance_or_Incorrect_Operation_B129392: RteEventRef=OpEventGetEventStatus_GetEventStatus_Event_PTS_Sensor_6_Performance_or_Incorrect_Operation_B129392
          OpEventGetEventFailed_GetEventFailed_EvtInfo_PTS_Sensor_6_Performance_or_Incorrect_Operation_B129392: RteEventRef=OpEventGetEventFailed_GetEventFailed_EvtInfo_PTS_Sensor_6_Performance_or_Incorrect_Operation_B129392
          OpEventGetEventFailed_GetEventFailed_Event_PTS_Sensor_6_Performance_or_Incorrect_Operation_B129392: RteEventRef=OpEventGetEventFailed_GetEventFailed_Event_PTS_Sensor_6_Performance_or_Incorrect_Operation_B129392
          OpEventGetEventTested_GetEventTested_EvtInfo_PTS_Sensor_6_Performance_or_Incorrect_Operation_B129392: RteEventRef=OpEventGetEventTested_GetEventTested_EvtInfo_PTS_Sensor_6_Performance_or_Incorrect_Operation_B129392
          OpEventGetEventTested_GetEventTested_Event_PTS_Sensor_6_Performance_or_Incorrect_Operation_B129392: RteEventRef=OpEventGetEventTested_GetEventTested_Event_PTS_Sensor_6_Performance_or_Incorrect_Operation_B129392
          OpEventGetDTCOfEvent_GetDTCOfEvent_EvtInfo_PTS_Sensor_6_Performance_or_Incorrect_Operation_B129392: RteEventRef=OpEventGetDTCOfEvent_GetDTCOfEvent_EvtInfo_PTS_Sensor_6_Performance_or_Incorrect_Operation_B129392
          OpEventGetDTCOfEvent_GetDTCOfEvent_Event_PTS_Sensor_6_Performance_or_Incorrect_Operation_B129392: RteEventRef=OpEventGetDTCOfEvent_GetDTCOfEvent_Event_PTS_Sensor_6_Performance_or_Incorrect_Operation_B129392
          OpEventGetFaultDetectionCounter_GetFaultDetectionCounter_EvtInfo_PTS_Sensor_6_Performance_or_Incorrect_Operation_B129392: RteEventRef=OpEventGetFaultDetectionCounter_GetFaultDetectionCounter_EvtInfo_PTS_Sensor_6_Performance_or_Incorrect_Operation_B129392
          OpEventGetFaultDetectionCounter_GetFaultDetectionCounter_Event_PTS_Sensor_6_Performance_or_Incorrect_Operation_B129392: RteEventRef=OpEventGetFaultDetectionCounter_GetFaultDetectionCounter_Event_PTS_Sensor_6_Performance_or_Incorrect_Operation_B129392
          OpEventGetEventFreezeFrameDataEx_GetEventFreezeFrameDataEx_EvtInfo_PTS_Sensor_6_Performance_or_Incorrect_Operation_B129392: RteEventRef=OpEventGetEventFreezeFrameDataEx_GetEventFreezeFrameDataEx_EvtInfo_PTS_Sensor_6_Performance_or_Incorrect_Operation_B129392
          OpEventGetEventFreezeFrameDataEx_GetEventFreezeFrameDataEx_Event_PTS_Sensor_6_Performance_or_Incorrect_Operation_B129392: RteEventRef=OpEventGetEventFreezeFrameDataEx_GetEventFreezeFrameDataEx_Event_PTS_Sensor_6_Performance_or_Incorrect_Operation_B129392
          OpEventGetEventExtendedDataRecordEx_GetEventExtendedDataRecordEx_EvtInfo_PTS_Sensor_6_Performance_or_Incorrect_Operation_B129392: RteEventRef=OpEventGetEventExtendedDataRecordEx_GetEventExtendedDataRecordEx_EvtInfo_PTS_Sensor_6_Performance_or_Incorrect_Operation_B129392
          OpEventGetEventExtendedDataRecordEx_GetEventExtendedDataRecordEx_Event_PTS_Sensor_6_Performance_or_Incorrect_Operation_B129392: RteEventRef=OpEventGetEventExtendedDataRecordEx_GetEventExtendedDataRecordEx_Event_PTS_Sensor_6_Performance_or_Incorrect_Operation_B129392
          OpEventGetEventEnableCondition_GetEventEnableCondition_EvtInfo_PTS_Sensor_6_Performance_or_Incorrect_Operation_B129392: RteEventRef=OpEventGetEventEnableCondition_GetEventEnableCondition_EvtInfo_PTS_Sensor_6_Performance_or_Incorrect_Operation_B129392
          OpEventGetDebouncingOfEvent_GetDebouncingOfEvent_EvtInfo_PTS_Sensor_6_Performance_or_Incorrect_Operation_B129392: RteEventRef=OpEventGetDebouncingOfEvent_GetDebouncingOfEvent_EvtInfo_PTS_Sensor_6_Performance_or_Incorrect_Operation_B129392
          OpEventGetMonitorStatus_GetMonitorStatus_EvtInfo_PTS_Sensor_6_Performance_or_Incorrect_Operation_B129392: RteEventRef=OpEventGetMonitorStatus_GetMonitorStatus_EvtInfo_PTS_Sensor_6_Performance_or_Incorrect_Operation_B129392
          OpEventSetEventStatus_SetEventStatus_Event_PTS_Sensor_6_Performance_or_Incorrect_Operation_B129392: RteEventRef=OpEventSetEventStatus_SetEventStatus_Event_PTS_Sensor_6_Performance_or_Incorrect_Operation_B129392
          OpEventResetEventStatus_ResetEventStatus_Event_PTS_Sensor_6_Performance_or_Incorrect_Operation_B129392: RteEventRef=OpEventResetEventStatus_ResetEventStatus_Event_PTS_Sensor_6_Performance_or_Incorrect_Operation_B129392
          OpEventResetEventDebounceStatus_ResetEventDebounceStatus_Event_PTS_Sensor_6_Performance_or_Incorrect_Operation_B129392: RteEventRef=OpEventResetEventDebounceStatus_ResetEventDebounceStatus_Event_PTS_Sensor_6_Performance_or_Incorrect_Operation_B129392
      vRoE_EcuSwComposition: RteSoftwareComponentInstanceRef=vRoE
        3 x RteEventToTaskMapping, all with RteImmediateRestart=false:
          Timer_vRoE_MainFunction: RtePositionInTask=1, RteEventRef=Timer_vRoE_MainFunction, RteMappedToTaskRef=QM_Task_200ms, RteUsedOsEventRef=Rte_Ev_Cyclic2_QM_Task_200ms_0_200ms, RteUsedOsAlarmRef=Rte_Al_TE2_QM_Task_200ms_0_200ms
          OpEventSetActivationState_WriteData_RoEActivation: RteEventRef=OpEventSetActivationState_WriteData_RoEActivation
          OpEventGetActivationState_ReadData_RoEActivation: RteEventRef=OpEventGetActivationState_ReadData_RoEActivation
      ComM_EcuSwComposition: RteSoftwareComponentInstanceRef=ComM
        22 x RteEventToTaskMapping, all with RteImmediateRestart=false:
          Timer_ComM_MainFunction_0: RtePositionInTask=2, RteEventRef=Timer_ComM_MainFunction_0, RteMappedToTaskRef=QM_ComTask_10ms, RteUsedOsAlarmRef=Rte_Al_TE2_QM_ComTask_10ms_0_10ms, RteUsedOsEventRef=Rte_Ev_Cyclic2_QM_ComTask_10ms_0_10ms
          OpEventGetInhibitionStatus_GetInhibitionStatus_CL_CN_FDCAN2_28a8fc44: RteEventRef=OpEventGetInhibitionStatus_GetInhibitionStatus_CL_CN_FDCAN2_28a8fc44
          OpEventGetInhibitionStatus_GetInhibitionStatus_CW_CN_FDCAN2_28a8fc44: RteEventRef=OpEventGetInhibitionStatus_GetInhibitionStatus_CW_CN_FDCAN2_28a8fc44
          OpEventLimitECUToNoComMode_LimitECUToNoComMode_modeLimitation: RteEventRef=OpEventLimitECUToNoComMode_LimitECUToNoComMode_modeLimitation
          OpEventReadInhibitCounter_ReadInhibitCounter_modeLimitation: RteEventRef=OpEventReadInhibitCounter_ReadInhibitCounter_modeLimitation
          OpEventResetInhibitCounter_ResetInhibitCounter_modeLimitation: RteEventRef=OpEventResetInhibitCounter_ResetInhibitCounter_modeLimitation
          OpEventSetECUGroupClassification_SetECUGroupClassification_modeLimitation: RteEventRef=OpEventSetECUGroupClassification_SetECUGroupClassification_modeLimitation
          OpEventLimitChannelToNoComMode_LimitChannelToNoComMode_CL_CN_FDCAN2_28a8fc44: RteEventRef=OpEventLimitChannelToNoComMode_LimitChannelToNoComMode_CL_CN_FDCAN2_28a8fc44
          OpEventPreventWakeUp_PreventWakeUp_CW_CN_FDCAN2_28a8fc44: RteEventRef=OpEventPreventWakeUp_PreventWakeUp_CW_CN_FDCAN2_28a8fc44
          OpEventRequestComMode_RequestComMode_UR_CN_FDCAN2_3de30c40: RteEventRef=OpEventRequestComMode_RequestComMode_UR_CN_FDCAN2_3de30c40
          OpEventGetCurrentComMode_GetCurrentComMode_UR_CN_FDCAN2_3de30c40: RteEventRef=OpEventGetCurrentComMode_GetCurrentComMode_UR_CN_FDCAN2_3de30c40
          OpEventGetMaxComMode_GetMaxComMode_UR_CN_FDCAN2_3de30c40: RteEventRef=OpEventGetMaxComMode_GetMaxComMode_UR_CN_FDCAN2_3de30c40
          OpEventGetRequestedComMode_GetRequestedComMode_UR_CN_FDCAN2_3de30c40: RteEventRef=OpEventGetRequestedComMode_GetRequestedComMode_UR_CN_FDCAN2_3de30c40
          Timer_ComM_MainFunction_1: RtePositionInTask=3, RteEventRef=Timer_ComM_MainFunction_1, RteMappedToTaskRef=QM_ComTask_10ms, RteUsedOsAlarmRef=Rte_Al_TE2_QM_ComTask_10ms_0_10ms, RteUsedOsEventRef=Rte_Ev_Cyclic2_QM_ComTask_10ms_0_10ms
          OpEventGetInhibitionStatus_GetInhibitionStatus_CL_CN_FDCAN14_a902658e: RteEventRef=OpEventGetInhibitionStatus_GetInhibitionStatus_CL_CN_FDCAN14_a902658e
          OpEventGetInhibitionStatus_GetInhibitionStatus_CW_CN_FDCAN14_a902658e: RteEventRef=OpEventGetInhibitionStatus_GetInhibitionStatus_CW_CN_FDCAN14_a902658e
          OpEventLimitChannelToNoComMode_LimitChannelToNoComMode_CL_CN_FDCAN14_a902658e: RteEventRef=OpEventLimitChannelToNoComMode_LimitChannelToNoComMode_CL_CN_FDCAN14_a902658e
          OpEventPreventWakeUp_PreventWakeUp_CW_CN_FDCAN14_a902658e: RteEventRef=OpEventPreventWakeUp_PreventWakeUp_CW_CN_FDCAN14_a902658e
          OpEventRequestComMode_RequestComMode_UR_CN_FDCAN14_16f26111: RteEventRef=OpEventRequestComMode_RequestComMode_UR_CN_FDCAN14_16f26111
          OpEventGetCurrentComMode_GetCurrentComMode_UR_CN_FDCAN14_16f26111: RteEventRef=OpEventGetCurrentComMode_GetCurrentComMode_UR_CN_FDCAN14_16f26111
          OpEventGetMaxComMode_GetMaxComMode_UR_CN_FDCAN14_16f26111: RteEventRef=OpEventGetMaxComMode_GetMaxComMode_UR_CN_FDCAN14_16f26111
          OpEventGetRequestedComMode_GetRequestedComMode_UR_CN_FDCAN14_16f26111: RteEventRef=OpEventGetRequestedComMode_GetRequestedComMode_UR_CN_FDCAN14_16f26111
    9 x RteBswModuleInstance:
      Can: RteBswImplementationRef=Can_Impl, RteBswModuleConfigurationRef=Can
        3 x RteBswEventToTaskMapping, all with RteBswImmediateRestart=false, RteBswMappedToTaskRef=QM_ComTask_10ms, RteBswUsedOsAlarmRef=Rte_Al_TE2_QM_ComTask_10ms_0_10ms, RteBswUsedOsEventRef=Rte_Ev_Cyclic2_QM_ComTask_10ms_0_10ms:
          Can_30_Mcan_MainFunction_BusOffTimingEvent0: RteBswPositionInTask=7, RteBswEventRef=Can_30_Mcan_MainFunction_BusOffTimingEvent0
          Can_30_Mcan_MainFunction_WakeupTimingEvent0: RteBswPositionInTask=9, RteBswEventRef=Can_30_Mcan_MainFunction_WakeupTimingEvent0
          Can_30_Mcan_MainFunction_ModeTimingEvent0: RteBswPositionInTask=8, RteBswEventRef=Can_30_Mcan_MainFunction_ModeTimingEvent0
        8 x RteBswExclusiveAreaImpl, all with RteExclusiveAreaImplMechanism=ALL_INTERRUPT_BLOCKING:
          CAN_30_MCAN_EXCLUSIVE_AREA_{0..7}: RteBswExclusiveAreaRef=CAN_30_MCAN_EXCLUSIVE_AREA_{0..7}
      CanIf: RteBswImplementationRef=CanIf_Impl, RteBswModuleConfigurationRef=CanIf
        8 x RteBswExclusiveAreaImpl, all with RteExclusiveAreaImplMechanism=ALL_INTERRUPT_BLOCKING:
          CANIF_EXCLUSIVE_AREA_{0..7}: RteBswExclusiveAreaRef=CANIF_EXCLUSIVE_AREA_{0..7}
      CanNm: RteBswImplementationRef=CanNm_Impl, RteBswModuleConfigurationRef=CanNm
        CanNm_MainFunctionTimingEvent0 (RteBswEventToTaskMapping):
          RteBswImmediateRestart = false
          RteBswPositionInTask = 6
          RteBswEventRef = CanNm_MainFunctionTimingEvent0
          RteBswMappedToTaskRef = QM_ComTask_10ms
          RteBswUsedOsAlarmRef = Rte_Al_TE2_QM_ComTask_10ms_0_10ms
          RteBswUsedOsEventRef = Rte_Ev_Cyclic2_QM_ComTask_10ms_0_10ms
        7 x RteBswExclusiveAreaImpl, all with RteExclusiveAreaImplMechanism=ALL_INTERRUPT_BLOCKING:
          CANNM_EXCLUSIVE_AREA_{0..6}: RteBswExclusiveAreaRef=CANNM_EXCLUSIVE_AREA_{0..6}
      CanSM: RteBswImplementationRef=CanSM_Impl, RteBswModuleConfigurationRef=CanSM
        CanSM_MainFunctionTimingEvent0 (RteBswEventToTaskMapping):
          RteBswImmediateRestart = false
          RteBswPositionInTask = 4
          RteBswEventRef = CanSM_MainFunctionTimingEvent0
          RteBswMappedToTaskRef = QM_ComTask_10ms
          RteBswUsedOsAlarmRef = Rte_Al_TE2_QM_ComTask_10ms_0_10ms
          RteBswUsedOsEventRef = Rte_Ev_Cyclic2_QM_ComTask_10ms_0_10ms
        6 x RteBswExclusiveAreaImpl, all with RteExclusiveAreaImplMechanism=ALL_INTERRUPT_BLOCKING:
          CANSM_EXCLUSIVE_AREA_{1..6}: RteBswExclusiveAreaRef=CANSM_EXCLUSIVE_AREA_{1..6}
      CanTp: RteBswImplementationRef=CanTp_Impl, RteBswModuleConfigurationRef=CanTp
        CanTp_MainFunctionTimingEvent0 (RteBswEventToTaskMapping):
          RteBswImmediateRestart = false
          RteBswPositionInTask = 3
          RteBswActivationOffset = 0.005
          RteBswEventRef = CanTp_MainFunctionTimingEvent0
          RteBswMappedToTaskRef = QM_ComTask_5ms
          RteBswUsedOsAlarmRef = Rte_Al_TE2_QM_ComTask_5ms_5_5ms
          RteBswUsedOsEventRef = Rte_Ev_Cyclic2_QM_ComTask_5ms_5_5ms
        CANTP_EXCLUSIVE_AREA_0 (RteBswExclusiveAreaImpl): RteExclusiveAreaImplMechanism=ALL_INTERRUPT_BLOCKING, RteBswExclusiveAreaRef=CANTP_EXCLUSIVE_AREA_0
      Com: RteBswImplementationRef=Com_Impl, RteBswModuleConfigurationRef=Com
        3 x RteBswExclusiveAreaImpl, all with RteExclusiveAreaImplMechanism=ALL_INTERRUPT_BLOCKING:
          COM_EXCLUSIVE_AREA_TX: RteBswExclusiveAreaRef=COM_EXCLUSIVE_AREA_TX
          COM_EXCLUSIVE_AREA_RX: RteBswExclusiveAreaRef=COM_EXCLUSIVE_AREA_RX
          COM_EXCLUSIVE_AREA_BOTH: RteBswExclusiveAreaRef=COM_EXCLUSIVE_AREA_BOTH
        Com_MainFunctionRx_ComMainFunctionRxTimingEvent0 (RteBswEventToTaskMapping):
          RteBswImmediateRestart = false
          RteBswPositionInTask = 13
          RteBswEventRef = Com_MainFunctionRx_ComMainFunctionRxTimingEvent0
          RteBswMappedToTaskRef = QM_ComTask_10ms
          RteBswUsedOsAlarmRef = Rte_Al_TE2_QM_ComTask_10ms_0_10ms
          RteBswUsedOsEventRef = Rte_Ev_Cyclic2_QM_ComTask_10ms_0_10ms
        Com_MainFunctionTx_ComMainFunctionTxTimingEvent0 (RteBswEventToTaskMapping):
          RteBswImmediateRestart = false
          RteBswPositionInTask = 1
          RteBswActivationOffset = 0.005
          RteBswEventRef = Com_MainFunctionTx_ComMainFunctionTxTimingEvent0
          RteBswMappedToTaskRef = QM_ComTask_5ms
          RteBswUsedOsAlarmRef = Rte_Al_TE2_QM_ComTask_5ms_5_5ms
          RteBswUsedOsEventRef = Rte_Ev_Cyclic2_QM_ComTask_5ms_5_5ms
      ComM: RteBswImplementationRef=ComM_Impl, RteBswModuleConfigurationRef=ComM
        ComM_MainFunction_0TimingEvent0 (RteBswEventToTaskMapping):
          RteBswImmediateRestart = false
          RteBswPositionInTask = 2
          RteBswEventRef = ComM_MainFunction_0TimingEvent0
          RteBswMappedToTaskRef = QM_ComTask_10ms
          RteBswUsedOsAlarmRef = Rte_Al_TE2_QM_ComTask_10ms_0_10ms
          RteBswUsedOsEventRef = Rte_Ev_Cyclic2_QM_ComTask_10ms_0_10ms
        7 x RteBswExclusiveAreaImpl:
          COMM_EXCLUSIVE_AREA_0: RteExclusiveAreaImplMechanism=ALL_INTERRUPT_BLOCKING, RteBswExclusiveAreaRef=COMM_EXCLUSIVE_AREA_0
          COMM_EXCLUSIVE_AREA_1: RteExclusiveAreaImplMechanism=ALL_INTERRUPT_BLOCKING, RteBswExclusiveAreaRef=COMM_EXCLUSIVE_AREA_1
          COMM_EXCLUSIVE_AREA_{2..6}: RteExclusiveAreaImplMechanism=NONE, RteBswExclusiveAreaRef=COMM_EXCLUSIVE_AREA_{2..6}
        ComM_MainFunction_1TimingEvent0 (RteBswEventToTaskMapping):
          RteBswImmediateRestart = false
          RteBswPositionInTask = 3
          RteBswEventRef = ComM_MainFunction_1TimingEvent0
          RteBswMappedToTaskRef = QM_ComTask_10ms
          RteBswUsedOsAlarmRef = Rte_Al_TE2_QM_ComTask_10ms_0_10ms
          RteBswUsedOsEventRef = Rte_Ev_Cyclic2_QM_ComTask_10ms_0_10ms
      Nm: RteBswImplementationRef=Nm_Impl, RteBswModuleConfigurationRef=Nm
        4 x RteBswExclusiveAreaImpl, all with RteExclusiveAreaImplMechanism=ALL_INTERRUPT_BLOCKING:
          NM_EXCLUSIVE_AREA_{0..3}: RteBswExclusiveAreaRef=NM_EXCLUSIVE_AREA_{0..3}
      PduR: RteBswImplementationRef=PduR_Impl, RteBswModuleConfigurationRef=PduR
        PDUR_EXCLUSIVE_AREA_0 (RteBswExclusiveAreaImpl): RteExclusiveAreaImplMechanism=ALL_INTERRUPT_BLOCKING, RteBswExclusiveAreaRef=PDUR_EXCLUSIVE_AREA_0
    Dcm_EcuSwComposition (RteSwComponentInstance): RteSoftwareComponentInstanceRef=Dcm
      7 x RteEventToTaskMapping, all with RteImmediateRestart=false:
        Timer_Dcm_MainFunction: RtePositionInTask=1, RteEventRef=Timer_Dcm_MainFunction, RteMappedToTaskRef=QM_DiagTask_10ms, RteUsedOsAlarmRef=Rte_Al_TE2_QM_DiagTask_10ms_0_10ms, RteUsedOsEventRef=Rte_Ev_Cyclic2_QM_DiagTask_10ms_0_10ms
        OpEventGetActiveProtocol_GetActiveProtocol_DCMServices: RteEventRef=OpEventGetActiveProtocol_GetActiveProtocol_DCMServices
        OpEventGetSesCtrlType_GetSesCtrlType_DCMServices: RteEventRef=OpEventGetSesCtrlType_GetSesCtrlType_DCMServices
        OpEventResetToDefaultSession_ResetToDefaultSession_DCMServices: RteEventRef=OpEventResetToDefaultSession_ResetToDefaultSession_DCMServices
        OpEventGetSecurityLevel_GetSecurityLevel_DCMServices: RteEventRef=OpEventGetSecurityLevel_GetSecurityLevel_DCMServices
        OpEventSetActiveDiagnostic_SetActiveDiagnostic_DCMServices: RteEventRef=OpEventSetActiveDiagnostic_SetActiveDiagnostic_DCMServices
        OpEventGetRequestKind_GetRequestKind_DCMServices: RteEventRef=OpEventGetRequestKind_GetRequestKind_DCMServices
    CanTrcv (RteBswModuleInstance): RteBswImplementationRef=CanTrcv_Impl, RteBswModuleConfigurationRef=CanTrcv
      CanTrcv_30_Tja1043_MainFunctionTimingEvent0 (RteBswEventToTaskMapping):
        RteBswImmediateRestart = false
        RteBswPositionInTask = 5
        RteBswEventRef = CanTrcv_30_Tja1043_MainFunctionTimingEvent0
        RteBswMappedToTaskRef = QM_ComTask_10ms
        RteBswUsedOsAlarmRef = Rte_Al_TE2_QM_ComTask_10ms_0_10ms
        RteBswUsedOsEventRef = Rte_Ev_Cyclic2_QM_ComTask_10ms_0_10ms
      CANTRCV_30_TJA1043_EXCLUSIVE_AREA_0 (RteBswExclusiveAreaImpl): RteExclusiveAreaImplMechanism=ALL_INTERRUPT_BLOCKING, RteBswExclusiveAreaRef=CANTRCV_30_TJA1043_EXCLUSIVE_AREA_0
    CDD_PMIC_EcuSwComposition (RteSwComponentInstance): RteSoftwareComponentInstanceRef=CDD_PMIC
      5 x RteEventToTaskMapping, all with RteImmediateRestart=false:
        InitEvent: RtePositionInTask=10, RteEventRef=InitEvent, RteMappedToTaskRef=Safety_Task_Init
        TMT_RE_PMIC_Main: RtePositionInTask=4, RteEventRef=TMT_RE_PMIC_Main, RteMappedToTaskRef=Safety_Task_00_10ms, RteUsedOsAlarmRef=Rte_Al_TE_Safety_Task_00_10ms_0_10ms
        OIT_RE_MCUReadDeviceReg_PpMCUDeviceRegReadWrite_MCUReadDeviceReg: RteEventRef=OIT_RE_MCUReadDeviceReg_PpMCUDeviceRegReadWrite_MCUReadDeviceReg
        OIT_RE_MCUReadDeviceRegData_PpMCUDeviceRegReadWrite_MCUReadDeviceRegData: RteEventRef=OIT_RE_MCUReadDeviceRegData_PpMCUDeviceRegReadWrite_MCUReadDeviceRegData
        OIT_RE_MCUWriteDeviceReg_PpMCUDeviceRegReadWrite_MCUWriteDeviceReg: RteEventRef=OIT_RE_MCUWriteDeviceReg_PpMCUDeviceRegReadWrite_MCUWriteDeviceReg
    CDD_E2EWrapper (RteSwComponentType): RteComponentTypeRef=CDD_E2EWrapper, RteImplementationRef=CDD_E2EWrapper_Implementation
      ComponentTypeCalibration (RteComponentTypeCalibration): RteCalibrationSupportEnabled=false
    CDD_PMIC (RteSwComponentType): RteComponentTypeRef=CDD_PMIC, RteImplementationRef=CDD_PMIC_Implementation
      ComponentTypeCalibration (RteComponentTypeCalibration): RteCalibrationSupportEnabled=false
    5 x RteSwComponentInstance:
      SWC_DIDMgr_EcuSwComposition: RteSoftwareComponentInstanceRef=SWC_DIDMgr
        76 x RteEventToTaskMapping, all with RteImmediateRestart=false:
          InitEvent: RtePositionInTask=9, RteEventRef=InitEvent, RteMappedToTaskRef=QM_Task_Init
          TMT_RE_DIDMgr_Main: RtePositionInTask=6, RteEventRef=TMT_RE_DIDMgr_Main, RteMappedToTaskRef=QM_Task_00_10ms, RteUsedOsAlarmRef=Rte_Al_TE_QM_Task_00_10ms_0_10ms
          OIT_DataServices_Data_22FD0A_SC_Data_Read_WriteData_DataServices_Data_22FD0A_SC_Data_Read_WriteData: RteEventRef=OIT_DataServices_Data_22FD0A_SC_Data_Read_WriteData_DataServices_Data_22FD0A_SC_Data_Read_WriteData
          OIT_DataServices_Data_22FD0A_SC_Data_Read_ReadData_DataServices_Data_22FD0A_SC_Data_Read_ReadData: RteEventRef=OIT_DataServices_Data_22FD0A_SC_Data_Read_ReadData_DataServices_Data_22FD0A_SC_Data_Read_ReadData
          OIT_DataServices_Data_225500_Trailer_Sense_and_Drive_Function_Data_Read_ReadData_DataServices_Data_225500_Trailer_Sense_E83018E8: RteEventRef=OIT_DataServices_Data_225500_Trailer_Sense_and_Drive_Function_Data_Read_ReadData_DataServices_Data_225500_Trailer_Sense_E83018E8
          OIT_DataServices_Data_222945_Flow_Control_Test_WriteData_DataServices_Data_222945_Flow_Control_Test_WriteData: RteEventRef=OIT_DataServices_Data_222945_Flow_Control_Test_WriteData_DataServices_Data_222945_Flow_Control_Test_WriteData
          OIT_DataServices_Data_222945_Flow_Control_Test_ReadData_DataServices_Data_222945_Flow_Control_Test_ReadData: RteEventRef=OIT_DataServices_Data_222945_Flow_Control_Test_ReadData_DataServices_Data_222945_Flow_Control_Test_ReadData
          OIT_DataServices_Data_225303_SPM_Event_Abort_1_Read_ReadData_DataServices_Data_225303_SPM_Event_Abort_1_Read_ReadData: RteEventRef=OIT_DataServices_Data_225303_SPM_Event_Abort_1_Read_ReadData_DataServices_Data_225303_SPM_Event_Abort_1_Read_ReadData
          OIT_DataServices_Data_22191D_Time_of_Power_Latch_ReadData_DataServices_Data_22191D_Time_of_Power_Latch_ReadData: RteEventRef=OIT_DataServices_Data_22191D_Time_of_Power_Latch_ReadData_DataServices_Data_22191D_Time_of_Power_Latch_ReadData
          OIT_DataServices_Data_22100B_Diagnostic_Tool_and_Session_Status_ReadData_DataServices_Data_22100B_Diagnostic_Tool_and_SeEC373C63: RteEventRef=OIT_DataServices_Data_22100B_Diagnostic_Tool_and_Session_Status_ReadData_DataServices_Data_22100B_Diagnostic_Tool_and_SeEC373C63
          OIT_DataServices_Data_224451_EOL_Calibration_State_Read_ReadData_DataServices_Data_224451_EOL_Calibration_State_Read_ReadData: RteEventRef=OIT_DataServices_Data_224451_EOL_Calibration_State_Read_ReadData_DataServices_Data_224451_EOL_Calibration_State_Read_ReadData
          OIT_DataServices_Data_22FD1C_Current_Camera_Calibration_Data_Read_ReadData_DataServices_Data_22FD1C_Current_Camera_Calib7322D735: RteEventRef=OIT_DataServices_Data_22FD1C_Current_Camera_Calibration_Data_Read_ReadData_DataServices_Data_22FD1C_Current_Camera_Calib7322D735
          OIT_DataServices_Data_225304_SPM_Event_Abort_2_Read_ReadData_DataServices_Data_225304_SPM_Event_Abort_2_Read_ReadData: RteEventRef=OIT_DataServices_Data_225304_SPM_Event_Abort_2_Read_ReadData_DataServices_Data_225304_SPM_Event_Abort_2_Read_ReadData
          OIT_DataServices_Data_22FD2D_USS_Sensor_ID_IME_SN_Read_ReadData_DataServices_Data_22FD2D_USS_Sensor_ID_IME_SN_Read_ReadData: RteEventRef=OIT_DataServices_Data_22FD2D_USS_Sensor_ID_IME_SN_Read_ReadData_DataServices_Data_22FD2D_USS_Sensor_ID_IME_SN_Read_ReadData
          OIT_DataServices_Data_22FD0D_Left_Camera_Data_EEPROM_Read_ReadData_DataServices_Data_22FD0D_Left_Camera_Data_EEPROM_Read4E8FB1F6: RteEventRef=OIT_DataServices_Data_22FD0D_Left_Camera_Data_EEPROM_Read_ReadData_DataServices_Data_22FD0D_Left_Camera_Data_EEPROM_Read4E8FB1F6
          OIT_DataServices_Data_22200D_Odometer_Last_Clear_Data_Trouble_Code_DTC_ReadData_DataServices_Data_22200D_Odometer_Last_CAB3EB535: RteEventRef=OIT_DataServices_Data_22200D_Odometer_Last_Clear_Data_Trouble_Code_DTC_ReadData_DataServices_Data_22200D_Odometer_Last_CAB3EB535
          OIT_DataServices_Data_22FD0F_Right_Camera_Data_EEPROM_Read_ReadData_DataServices_Data_22FD0F_Right_Camera_Data_EEPROM_ReEFE5497E: RteEventRef=OIT_DataServices_Data_22FD0F_Right_Camera_Data_EEPROM_Read_ReadData_DataServices_Data_22FD0F_Right_Camera_Data_EEPROM_ReEFE5497E
          OIT_DataServices_Data_225301_Rear_Braking_Event_2_Read_ReadData_DataServices_Data_225301_Rear_Braking_Event_2_Read_ReadData: RteEventRef=OIT_DataServices_Data_225301_Rear_Braking_Event_2_Read_ReadData_DataServices_Data_225301_Rear_Braking_Event_2_Read_ReadData
          OIT_DataServices_Data_225302_Rear_Braking_Event_3_Read_ReadData_DataServices_Data_225302_Rear_Braking_Event_3_Read_ReadData: RteEventRef=OIT_DataServices_Data_225302_Rear_Braking_Event_3_Read_ReadData_DataServices_Data_225302_Rear_Braking_Event_3_Read_ReadData
          OIT_DataServices_Data_22FD08_OC_Data_Read_WriteData_DataServices_Data_22FD08_OC_Data_Read_WriteData: RteEventRef=OIT_DataServices_Data_22FD08_OC_Data_Read_WriteData_DataServices_Data_22FD08_OC_Data_Read_WriteData
          OIT_DataServices_Data_22FD08_OC_Data_Read_ReadData_DataServices_Data_22FD08_OC_Data_Read_ReadData: RteEventRef=OIT_DataServices_Data_22FD08_OC_Data_Read_ReadData_DataServices_Data_22FD08_OC_Data_Read_ReadData
          OIT_DataServices_Data_220107_RoE_Activation_State_WriteData_DataServices_Data_220107_RoE_Activation_State_WriteData: RteEventRef=OIT_DataServices_Data_220107_RoE_Activation_State_WriteData_DataServices_Data_220107_RoE_Activation_State_WriteData
          OIT_DataServices_Data_220107_RoE_Activation_State_ReadData_DataServices_Data_220107_RoE_Activation_State_ReadData: RteEventRef=OIT_DataServices_Data_220107_RoE_Activation_State_ReadData_DataServices_Data_220107_RoE_Activation_State_ReadData
          OIT_DataServices_Data_224423_USS_Sensor_3_Part_Number_Read_ReadData_DataServices_Data_224423_USS_Sensor_3_Part_Number_Re657984F2: RteEventRef=OIT_DataServices_Data_224423_USS_Sensor_3_Part_Number_Read_ReadData_DataServices_Data_224423_USS_Sensor_3_Part_Number_Re657984F2
          OIT_DataServices_Data_222010_Programming_Status_ReadData_DataServices_Data_222010_Programming_Status_ReadData: RteEventRef=OIT_DataServices_Data_222010_Programming_Status_ReadData_DataServices_Data_222010_Programming_Status_ReadData
          OIT_DataServices_Data_221008_ECU_Life_Time_ReadData_DataServices_Data_221008_ECU_Life_Time_ReadData: RteEventRef=OIT_DataServices_Data_221008_ECU_Life_Time_ReadData_DataServices_Data_221008_ECU_Life_Time_ReadData
          OIT_DataServices_Data_22FD2C_USS_Temperature_Read_ReadData_DataServices_Data_22FD2C_USS_Temperature_Read_ReadData: RteEventRef=OIT_DataServices_Data_22FD2C_USS_Temperature_Read_ReadData_DataServices_Data_22FD2C_USS_Temperature_Read_ReadData
          OIT_DataServices_Data_22FD2B_USS_Direct_Distance_0xFD2B_Read_ReadData_DataServices_Data_22FD2B_USS_Direct_Distance_0xFD24FFDB917: RteEventRef=OIT_DataServices_Data_22FD2B_USS_Direct_Distance_0xFD2B_Read_ReadData_DataServices_Data_22FD2B_USS_Direct_Distance_0xFD24FFDB917
          OIT_DataServices_Data_22FD0E_Rear_Camera_Data_EEPROM_Read_ReadData_DataServices_Data_22FD0E_Rear_Camera_Data_EEPROM_Read8502B56C: RteEventRef=OIT_DataServices_Data_22FD0E_Rear_Camera_Data_EEPROM_Read_ReadData_DataServices_Data_22FD0E_Rear_Camera_Data_EEPROM_Read8502B56C
          OIT_DataServices_Data_22FD42_Failsafe_Behaviour_Read_WriteData_DataServices_Data_22FD42_Failsafe_Behaviour_Read_WriteData: RteEventRef=OIT_DataServices_Data_22FD42_Failsafe_Behaviour_Read_WriteData_DataServices_Data_22FD42_Failsafe_Behaviour_Read_WriteData
          OIT_DataServices_Data_22FD42_Failsafe_Behaviour_Read_ReadData_DataServices_Data_22FD42_Failsafe_Behaviour_Read_ReadData: RteEventRef=OIT_DataServices_Data_22FD42_Failsafe_Behaviour_Read_ReadData_DataServices_Data_22FD42_Failsafe_Behaviour_Read_ReadData
          OIT_DataServices_Data_22F186_Active_Diagnostic_Session_ReadData_DataServices_Data_22F186_Active_Diagnostic_Session_ReadData: RteEventRef=OIT_DataServices_Data_22F186_Active_Diagnostic_Session_ReadData_DataServices_Data_22F186_Active_Diagnostic_Session_ReadData
          OIT_DataServices_Data_22FDF1_CPU_Load_Read_ReadData_DataServices_Data_22FDF1_CPU_Load_Read_ReadData: RteEventRef=OIT_DataServices_Data_22FDF1_CPU_Load_Read_ReadData_DataServices_Data_22FDF1_CPU_Load_Read_ReadData
          OIT_DataServices_Data_22442A_USS_Sensor_10_Part_Number_Read_ReadData_DataServices_Data_22442A_USS_Sensor_10_Part_Number_0A97BE9D: RteEventRef=OIT_DataServices_Data_22442A_USS_Sensor_10_Part_Number_Read_ReadData_DataServices_Data_22442A_USS_Sensor_10_Part_Number_0A97BE9D
          OIT_DataServices_Data_22FD07_OC_Result_Read_ReadData_DataServices_Data_22FD07_OC_Result_Read_ReadData: RteEventRef=OIT_DataServices_Data_22FD07_OC_Result_Read_ReadData_DataServices_Data_22FD07_OC_Result_Read_ReadData
          OIT_DataServices_Data_22FD2E_USS_Sensor_ID_Murata_SN_Read_ReadData_DataServices_Data_22FD2E_USS_Sensor_ID_Murata_SN_Read372370D9: RteEventRef=OIT_DataServices_Data_22FD2E_USS_Sensor_ID_Murata_SN_Read_ReadData_DataServices_Data_22FD2E_USS_Sensor_ID_Murata_SN_Read372370D9
          OIT_DataServices_Data_225300_Rear_Braking_Event_1_Read_ReadData_DataServices_Data_225300_Rear_Braking_Event_1_Read_ReadData: RteEventRef=OIT_DataServices_Data_225300_Rear_Braking_Event_1_Read_ReadData_DataServices_Data_225300_Rear_Braking_Event_1_Read_ReadData
          OIT_DataServices_Data_22442B_USS_Sensor_11_Part_Number_Read_ReadData_DataServices_Data_22442B_USS_Sensor_11_Part_Number_0694F5BE: RteEventRef=OIT_DataServices_Data_22442B_USS_Sensor_11_Part_Number_Read_ReadData_DataServices_Data_22442B_USS_Sensor_11_Part_Number_0694F5BE
          OIT_DataServices_Data_224429_USS_Sensor_9_Part_Number_Read_ReadData_DataServices_Data_224429_USS_Sensor_9_Part_Number_Re165ED398: RteEventRef=OIT_DataServices_Data_224429_USS_Sensor_9_Part_Number_Read_ReadData_DataServices_Data_224429_USS_Sensor_9_Part_Number_Re165ED398
          OIT_DataServices_Data_22FD0C_Front_Camera_Data_EEPROM_Read_ReadData_DataServices_Data_22FD0C_Front_Camera_Data_EEPROM_Re37809C69: RteEventRef=OIT_DataServices_Data_22FD0C_Front_Camera_Data_EEPROM_Read_ReadData_DataServices_Data_22FD0C_Front_Camera_Data_EEPROM_Re37809C69
          OIT_DataServices_Data_225100_SPM_status_Read_ReadData_DataServices_Data_225100_SPM_status_Read_ReadData: RteEventRef=OIT_DataServices_Data_225100_SPM_status_Read_ReadData_DataServices_Data_225100_SPM_status_Read_ReadData
          OIT_DataServices_Data_22200B_Time_First_DTC_Detection_ReadData_DataServices_Data_22200B_Time_First_DTC_Detection_ReadData: RteEventRef=OIT_DataServices_Data_22200B_Time_First_DTC_Detection_ReadData_DataServices_Data_22200B_Time_First_DTC_Detection_ReadData
          OIT_DataServices_Data_224425_USS_Sensor_5_Part_Number_Read_ReadData_DataServices_Data_224425_USS_Sensor_5_Part_Number_Re4B9B49D4: RteEventRef=OIT_DataServices_Data_224425_USS_Sensor_5_Part_Number_Read_ReadData_DataServices_Data_224425_USS_Sensor_5_Part_Number_Re4B9B49D4
          OIT_DataServices_Data_22FD33_Magna_Testing_2_Read_WriteData_DataServices_Data_22FD33_Magna_Testing_2_Read_WriteData: RteEventRef=OIT_DataServices_Data_22FD33_Magna_Testing_2_Read_WriteData_DataServices_Data_22FD33_Magna_Testing_2_Read_WriteData
          OIT_DataServices_Data_22FD33_Magna_Testing_2_Read_ReadData_DataServices_Data_22FD33_Magna_Testing_2_Read_ReadData: RteEventRef=OIT_DataServices_Data_22FD33_Magna_Testing_2_Read_ReadData_DataServices_Data_22FD33_Magna_Testing_2_Read_ReadData
          OIT_DataServices_Data_22200C_Time_Since_Ignition_ON_of_first_DTC_Detection_ReadData_DataServices_Data_22200C_Time_Since_D8BD46AA: RteEventRef=OIT_DataServices_Data_22200C_Time_Since_Ignition_ON_of_first_DTC_Detection_ReadData_DataServices_Data_22200C_Time_Since_D8BD46AA
          OIT_DataServices_Data_224421_USS_Sensor_1_Part_Number_Read_ReadData_DataServices_Data_224421_USS_Sensor_1_Part_Number_Re7F27C010: RteEventRef=OIT_DataServices_Data_224421_USS_Sensor_1_Part_Number_Read_ReadData_DataServices_Data_224421_USS_Sensor_1_Part_Number_Re7F27C010
          OIT_DataServices_Data_225501_Trailer_coupler_sense_detection_Function_Data_Read_ReadData_DataServices_Data_225501_TraileBF8A44A3: RteEventRef=OIT_DataServices_Data_225501_Trailer_coupler_sense_detection_Function_Data_Read_ReadData_DataServices_Data_225501_TraileBF8A44A3
          OIT_DataServices_Data_221002_Vehicle_Speed_ReadData_DataServices_Data_221002_Vehicle_Speed_ReadData: RteEventRef=OIT_DataServices_Data_221002_Vehicle_Speed_ReadData_DataServices_Data_221002_Vehicle_Speed_ReadData
          OIT_DataServices_Data_22FD48_PCBA_Temperature_Read_ReadData_DataServices_Data_22FD48_PCBA_Temperature_Read_ReadData: RteEventRef=OIT_DataServices_Data_22FD48_PCBA_Temperature_Read_ReadData_DataServices_Data_22FD48_PCBA_Temperature_Read_ReadData
          OIT_DataServices_Data_221004_Battery_Voltage_ReadData_DataServices_Data_221004_Battery_Voltage_ReadData: RteEventRef=OIT_DataServices_Data_221004_Battery_Voltage_ReadData_DataServices_Data_221004_Battery_Voltage_ReadData
          OIT_DataServices_Data_221921_Operational_Mode_Status_ReadData_DataServices_Data_221921_Operational_Mode_Status_ReadData: RteEventRef=OIT_DataServices_Data_221921_Operational_Mode_Status_ReadData_DataServices_Data_221921_Operational_Mode_Status_ReadData
          OIT_DataServices_Data_2EF185_Application_Data_Software_Fingerprint_Writing_Information_WriteData_DataServices_Data_2EF181B96142F: RteEventRef=OIT_DataServices_Data_2EF185_Application_Data_Software_Fingerprint_Writing_Information_WriteData_DataServices_Data_2EF181B96142F
          OIT_DataServices_Data_22FD20_ECU_PinStates_Read_ReadData_DataServices_Data_22FD20_ECU_PinStates_Read_ReadData: RteEventRef=OIT_DataServices_Data_22FD20_ECU_PinStates_Read_ReadData_DataServices_Data_22FD20_ECU_PinStates_Read_ReadData
          OIT_DataServices_Data_22FDF2_Reset_Reason_Read_ReadData_DataServices_Data_22FDF2_Reset_Reason_Read_ReadData: RteEventRef=OIT_DataServices_Data_22FDF2_Reset_Reason_Read_ReadData_DataServices_Data_22FDF2_Reset_Reason_Read_ReadData
          OIT_DataServices_Data_224426_USS_Sensor_6_Part_Number_Read_ReadData_DataServices_Data_224426_USS_Sensor_6_Part_Number_Re5CEA2F47: RteEventRef=OIT_DataServices_Data_224426_USS_Sensor_6_Part_Number_Read_ReadData_DataServices_Data_224426_USS_Sensor_6_Part_Number_Re5CEA2F47
          OIT_DataServices_Data_22FD2A_USS_Ringing_Time_Read_ReadData_DataServices_Data_22FD2A_USS_Ringing_Time_Read_ReadData: RteEventRef=OIT_DataServices_Data_22FD2A_USS_Ringing_Time_Read_ReadData_DataServices_Data_22FD2A_USS_Ringing_Time_Read_ReadData
          OIT_DataServices_Data_224428_USS_Sensor_8_Part_Number_Read_ReadData_DataServices_Data_224428_USS_Sensor_8_Part_Number_Re1B71F1E9: RteEventRef=OIT_DataServices_Data_224428_USS_Sensor_8_Part_Number_Read_ReadData_DataServices_Data_224428_USS_Sensor_8_Part_Number_Re1B71F1E9
          OIT_DataServices_Data_22200A_Ignition_ON_Counter_ReadData_DataServices_Data_22200A_Ignition_ON_Counter_ReadData: RteEventRef=OIT_DataServices_Data_22200A_Ignition_ON_Counter_ReadData_DataServices_Data_22200A_Ignition_ON_Counter_ReadData
          OIT_DataServices_Data_222001_Odometer_ReadData_DataServices_Data_222001_Odometer_ReadData: RteEventRef=OIT_DataServices_Data_222001_Odometer_ReadData_DataServices_Data_222001_Odometer_ReadData
          OIT_DataServices_Data_22F1A6_Message_Matrix_ReadData_DataServices_Data_22F1A6_Message_Matrix_ReadData: RteEventRef=OIT_DataServices_Data_22F1A6_Message_Matrix_ReadData_DataServices_Data_22F1A6_Message_Matrix_ReadData
          OIT_DataServices_Data_22442C_USS_Sensor_12_Part_Number_Read_ReadData_DataServices_Data_22442C_USS_Sensor_12_Part_Number_1D8D6E20: RteEventRef=OIT_DataServices_Data_22442C_USS_Sensor_12_Part_Number_Read_ReadData_DataServices_Data_22442C_USS_Sensor_12_Part_Number_1D8D6E20
          OIT_DataServices_Data_224427_USS_Sensor_7_Part_Number_Read_ReadData_DataServices_Data_224427_USS_Sensor_7_Part_Number_Re51C50D36: RteEventRef=OIT_DataServices_Data_224427_USS_Sensor_7_Part_Number_Read_ReadData_DataServices_Data_224427_USS_Sensor_7_Part_Number_Re51C50D36
          OIT_DataServices_Data_222008_ECU_Life_Time_Not_Volatile_Memory_ReadData_DataServices_Data_222008_ECU_Life_Time_Not_Volat846BD55C: RteEventRef=OIT_DataServices_Data_222008_ECU_Life_Time_Not_Volatile_Memory_ReadData_DataServices_Data_222008_ECU_Life_Time_Not_Volat846BD55C
          OIT_DataServices_Data_22FD28_USS_Ringing_Frequency_Read_ReadData_DataServices_Data_22FD28_USS_Ringing_Frequency_Read_ReadData: RteEventRef=OIT_DataServices_Data_22FD28_USS_Ringing_Frequency_Read_ReadData_DataServices_Data_22FD28_USS_Ringing_Frequency_Read_ReadData
          OIT_DataServices_Data_222002_Odometer_at_last_Flash_programming_ReadData_DataServices_Data_222002_Odometer_at_last_Flash4ADEEA66: RteEventRef=OIT_DataServices_Data_222002_Odometer_at_last_Flash_programming_ReadData_DataServices_Data_222002_Odometer_at_last_Flash4ADEEA66
          OIT_DataServices_Data_2EF184_Application_Software_Fingerprint_writing_information_WriteData_DataServices_Data_2EF184_App7A639748: RteEventRef=OIT_DataServices_Data_2EF184_Application_Software_Fingerprint_writing_information_WriteData_DataServices_Data_2EF184_App7A639748
          OIT_DataServices_Data_22FD1E_Calibration_Status_Read_ReadData_DataServices_Data_22FD1E_Calibration_Status_Read_ReadData: RteEventRef=OIT_DataServices_Data_22FD1E_Calibration_Status_Read_ReadData_DataServices_Data_22FD1E_Calibration_Status_Read_ReadData
          OIT_DataServices_Data_224424_USS_Sensor_4_Part_Number_Read_ReadData_DataServices_Data_224424_USS_Sensor_4_Part_Number_Re46B46BA5: RteEventRef=OIT_DataServices_Data_224424_USS_Sensor_4_Part_Number_Read_ReadData_DataServices_Data_224424_USS_Sensor_4_Part_Number_Re46B46BA5
          OIT_DataServices_Data_221009_ECU_Time_Since_Ignition_ON_ReadData_DataServices_Data_221009_ECU_Time_Since_Ignition_ON_ReadData: RteEventRef=OIT_DataServices_Data_221009_ECU_Time_Since_Ignition_ON_ReadData_DataServices_Data_221009_ECU_Time_Since_Ignition_ON_ReadData
          OIT_DataServices_Data_22FD29_USS_Driving_Frequency_Read_ReadData_DataServices_Data_22FD29_USS_Driving_Frequency_Read_ReadData: RteEventRef=OIT_DataServices_Data_22FD29_USS_Driving_Frequency_Read_ReadData_DataServices_Data_22FD29_USS_Driving_Frequency_Read_ReadData
          OIT_DataServices_Data_224422_USS_Sensor2_Part_Number_Read_ReadData_DataServices_Data_224422_USS_Sensor2_Part_Number_Read28F5A20D: RteEventRef=OIT_DataServices_Data_224422_USS_Sensor2_Part_Number_Read_ReadData_DataServices_Data_224422_USS_Sensor2_Part_Number_Read28F5A20D
          OIT_DataServices_Data_225305_SPM_Event_Abort_3_Read_ReadData_DataServices_Data_225305_SPM_Event_Abort_3_Read_ReadData: RteEventRef=OIT_DataServices_Data_225305_SPM_Event_Abort_3_Read_ReadData_DataServices_Data_225305_SPM_Event_Abort_3_Read_ReadData
          OIT_DataServices_Data_22FD01_Previous_Camera_Calibration_Data_ReadData_DataServices_Data_22FD01_Previous_Camera_Calibrat30A23EA2: RteEventRef=OIT_DataServices_Data_22FD01_Previous_Camera_Calibration_Data_ReadData_DataServices_Data_22FD01_Previous_Camera_Calibrat30A23EA2
          OIT_DataServices_Data_22FD00_Plant_Camera_Calibration_Data_WriteData_DataServices_Data_22FD00_Plant_Camera_Calibration_DDFED2A6F: RteEventRef=OIT_DataServices_Data_22FD00_Plant_Camera_Calibration_Data_WriteData_DataServices_Data_22FD00_Plant_Camera_Calibration_DDFED2A6F
          OIT_DataServices_Data_22FD00_Plant_Camera_Calibration_Data_ReadData_DataServices_Data_22FD00_Plant_Camera_Calibration_Da707E5122: RteEventRef=OIT_DataServices_Data_22FD00_Plant_Camera_Calibration_Data_ReadData_DataServices_Data_22FD00_Plant_Camera_Calibration_Da707E5122
        14 x RteNvRamAllocation:
          NvmBlock_SWC_DIDMgr_DID_FD33_MagnaTesting: RteNvmRamBlockLocationSymbol=Rte_SWC_DIDMgr_DID_FD33_MagnaTesting_MirrorBlock, RteNvmRomBlockLocationSymbol=Rte_SWC_DIDMgr_DID_FD33_MagnaTesting_DefaultValue, RteNvmBlockRef=SWC_DIDMgrDID_FD33_MagnaTesting, RteSwNvRamMappingRef=DID_FD33_MagnaTesting
          NvmBlock_SWC_DIDMgr_DID_2002_ProgReqFlag: RteNvmRamBlockLocationSymbol=Rte_SWC_DIDMgr_DID_2002_ProgReqFlag_MirrorBlock, RteNvmRomBlockLocationSymbol=Rte_SWC_DIDMgr_DID_2002_ProgReqFlag_DefaultValue, RteNvmBlockRef=SWC_DIDMgrDID_2002_ProgReqFlag, RteSwNvRamMappingRef=DID_2002_ProgReqFlag
          NvmBlock_SWC_DIDMgr_DID_2002_OdoFlashing: RteNvmRamBlockLocationSymbol=Rte_SWC_DIDMgr_DID_2002_OdoFlashing_MirrorBlock, RteNvmRomBlockLocationSymbol=Rte_SWC_DIDMgr_DID_2002_OdoFlashing_DefaultValue, RteNvmBlockRef=SWC_DIDMgrDID_2002_OdoFlashing, RteSwNvRamMappingRef=DID_2002_OdoFlashing
          NvmBlock_SWC_DIDMgr_DID_200D_LastClearDTCOdo: RteNvmRamBlockLocationSymbol=Rte_SWC_DIDMgr_DID_200D_LastClearDTCOdo_MirrorBlock, RteNvmRomBlockLocationSymbol=Rte_SWC_DIDMgr_DID_200D_LastClearDTCOdo_DefaultValue, RteNvmBlockRef=SWC_DIDMgrDID_200D_LastClearDTCOdo, RteSwNvRamMappingRef=DID_200D_LastClearDTCOdo
          NvmBlock_SWC_DIDMgr_DID_200C_TimeSinceIgnOnFirstDTC: RteNvmRamBlockLocationSymbol=Rte_SWC_DIDMgr_DID_200C_TimeSinceIgnOnFirstDTC_MirrorBlock, RteNvmRomBlockLocationSymbol=Rte_SWC_DIDMgr_DID_200C_TimeSinceIgnOnFirstDTC_DefaultValue, RteNvmBlockRef=SWC_DIDMgrDID_200C_TimeSinceIgnOnFirstDTC, RteSwNvRamMappingRef=DID_200C_TimeSinceIgnOnFirstDTC
          NvmBlock_SWC_DIDMgr_DID_200B_TimeSinceFirstDTC: RteNvmRamBlockLocationSymbol=Rte_SWC_DIDMgr_DID_200B_TimeSinceFirstDTC_MirrorBlock, RteNvmRomBlockLocationSymbol=Rte_SWC_DIDMgr_DID_200B_TimeSinceFirstDTC_DefaultValue, RteNvmBlockRef=SWC_DIDMgrDID_200B_TimeSinceFirstDTC, RteSwNvRamMappingRef=DID_200B_TimeSinceFirstDTC
          NvmBlock_SWC_DIDMgr_DID_191D_PowerLatch: RteNvmRamBlockLocationSymbol=Rte_SWC_DIDMgr_DID_191D_PowerLatch_MirrorBlock, RteNvmRomBlockLocationSymbol=Rte_SWC_DIDMgr_DID_191D_PowerLatch_DefaultValue, RteNvmBlockRef=SWC_DIDMgrDID_191D_PowerLatch, RteSwNvRamMappingRef=DID_191D_PowerLatch
          NvmBlock_SWC_DIDMgr_DID_200A_IgOnCounter: RteNvmRamBlockLocationSymbol=Rte_SWC_DIDMgr_DID_200A_IgOnCounter_MirrorBlock, RteNvmRomBlockLocationSymbol=Rte_SWC_DIDMgr_DID_200A_IgOnCounter_DefaultValue, RteNvmBlockRef=SWC_DIDMgrDID_200A_IgOnCounter, RteSwNvRamMappingRef=DID_200A_IgOnCounter
          NvmBlock_SWC_DIDMgr_ECU_LifeTime: RteNvmRamBlockLocationSymbol=Rte_SWC_DIDMgr_ECU_LifeTime_MirrorBlock, RteNvmRomBlockLocationSymbol=Rte_SWC_DIDMgr_ECU_LifeTime_DefaultValue, RteNvmBlockRef=SWC_DIDMgrECU_LifeTime, RteSwNvRamMappingRef=ECU_LifeTime
          NvmBlock_SWC_DIDMgr_vRoE_Activation_State: RteNvmRamBlockLocationSymbol=Rte_SWC_DIDMgr_vRoE_Activation_State_MirrorBlock, RteNvmRomBlockLocationSymbol=Rte_SWC_DIDMgr_vRoE_Activation_State_DefaultValue, RteNvmBlockRef=SWC_DIDMgr_vRoE_Activation_State, RteSwNvRamMappingRef=vRoE_Activation_State
          NvmBlock_SWC_DIDMgr_DID_FD01_PrevCalibDataCopy: RteNvmRamBlockLocationSymbol=Rte_SWC_DIDMgr_DID_FD01_PrevCalibDataCopy_MirrorBlock, RteNvmRomBlockLocationSymbol=Rte_SWC_DIDMgr_DID_FD01_PrevCalibDataCopy_DefaultValue, RteNvmBlockRef=SWC_DIDMgrDID_FD01_PrevCalibDataCopy, RteSwNvRamMappingRef=DID_FD01_PrevCalibDataCopy
          NvmBlock_SWC_DIDMgr_DID_FD42_FailsafeDebug: RteNvmRamBlockLocationSymbol=Rte_SWC_DIDMgr_DID_FD42_FailsafeDebug_MirrorBlock, RteNvmRomBlockLocationSymbol=Rte_SWC_DIDMgr_DID_FD42_FailsafeDebug_DefaultValue, RteNvmBlockRef=SWC_DIDMgrDID_FD42_FailsafeDebug, RteSwNvRamMappingRef=DID_FD42_FailsafeDebug
          NvmBlock_SWC_DIDMgr_DID_RearBrakeEvent: RteNvmRamBlockLocationSymbol=Rte_SWC_DIDMgr_DID_RearBrakeEvent_MirrorBlock, RteNvmRomBlockLocationSymbol=Rte_SWC_DIDMgr_DID_RearBrakeEvent_DefaultValue, RteNvmBlockRef=SWC_DIDMgrDID_RearBrakeEvent, RteSwNvRamMappingRef=DID_RearBrakeEvent
          NvmBlock_SWC_DIDMgr_DID_SPMAbrtEvent: RteNvmRamBlockLocationSymbol=Rte_SWC_DIDMgr_DID_SPMAbrtEvent_MirrorBlock, RteNvmRomBlockLocationSymbol=Rte_SWC_DIDMgr_DID_SPMAbrtEvent_DefaultValue, RteNvmBlockRef=SWC_DIDMgrDID_SPMAbrtEvent, RteSwNvRamMappingRef=DID_SPMAbrtEvent
        OIT_DataServices_Data_22FD86_Functional_Settings_Read_WriteData_DataServices_Data_22FD86_Functional_Settings_Read_WriteData (RteEventToTaskMapping):
          RteImmediateRestart = false
          RteEventRef = OIT_DataServices_Data_22FD86_Functional_Settings_Read_WriteData_DataServices_Data_22FD86_Functional_Settings_Read_WriteData
        OIT_DataServices_Data_22FD86_Functional_Settings_Read_ReadData_DataServices_Data_22FD86_Functional_Settings_Read_ReadData (RteEventToTaskMapping):
          RteImmediateRestart = false
          RteEventRef = OIT_DataServices_Data_22FD86_Functional_Settings_Read_ReadData_DataServices_Data_22FD86_Functional_Settings_Read_ReadData
        NvmBlock_SWC_DIDMgr_DID_FD86_FunctionalSettings (RteNvRamAllocation):
          RteNvmRamBlockLocationSymbol = Rte_SWC_DIDMgr_DID_FD86_FunctionalSettings_MirrorBlock
          RteNvmRomBlockLocationSymbol = Rte_SWC_DIDMgr_DID_FD86_FunctionalSettings_DefaultValue
          RteNvmBlockRef = SWC_DIDMgrDID_FD86_FunctionalSettings
          RteSwNvRamMappingRef = DID_FD86_FunctionalSettings
        31 x RteEventToTaskMapping, all with RteImmediateRestart=false:
          OIT_DataServices_Data_22FD46_Camera_Power_Supply_Read_ReadData_DataServices_Data_22FD46_Camera_Power_Supply_Read_ReadData: RteEventRef=OIT_DataServices_Data_22FD46_Camera_Power_Supply_Read_ReadData_DataServices_Data_22FD46_Camera_Power_Supply_Read_ReadData
          OIT_DataServices_Data_225102_FD_CAN14_Rx_Signals_Read_ReadData_DataServices_Data_225102_FD_CAN14_Rx_Signals_Read_ReadData: RteEventRef=OIT_DataServices_Data_225102_FD_CAN14_Rx_Signals_Read_ReadData_DataServices_Data_225102_FD_CAN14_Rx_Signals_Read_ReadData
          OIT_DataServices_Data_2F5001_Gear_Position_Read_ShortTermAdjustment_DataServices_Data_2F5001_Gear_Position_Read_ShortTer0D8CE892: RteEventRef=OIT_DataServices_Data_2F5001_Gear_Position_Read_ShortTermAdjustment_DataServices_Data_2F5001_Gear_Position_Read_ShortTer0D8CE892
          OIT_DataServices_Data_2F5001_Gear_Position_Read_ReturnControlToECU_DataServices_Data_2F5001_Gear_Position_Read_ReturnConC4BEAF84: RteEventRef=OIT_DataServices_Data_2F5001_Gear_Position_Read_ReturnControlToECU_DataServices_Data_2F5001_Gear_Position_Read_ReturnConC4BEAF84
          OIT_DataServices_Data_2F5001_Gear_Position_Read_ReadData_DataServices_Data_2F5001_Gear_Position_Read_ReadData: RteEventRef=OIT_DataServices_Data_2F5001_Gear_Position_Read_ReadData_DataServices_Data_2F5001_Gear_Position_Read_ReadData
          OIT_DataServices_Data_225105_FD_CAN2_Tx_Signals_Read_ReadData_DataServices_Data_225105_FD_CAN2_Tx_Signals_Read_ReadData: RteEventRef=OIT_DataServices_Data_225105_FD_CAN2_Tx_Signals_Read_ReadData_DataServices_Data_225105_FD_CAN2_Tx_Signals_Read_ReadData
          OIT_DataServices_Data_225103_FD_CAN2_Rx_Signals_Read_ReadData_DataServices_Data_225103_FD_CAN2_Rx_Signals_Read_ReadData: RteEventRef=OIT_DataServices_Data_225103_FD_CAN2_Rx_Signals_Read_ReadData_DataServices_Data_225103_FD_CAN2_Rx_Signals_Read_ReadData
          OIT_DataServices_Data_225104_FD_CAN14_Tx_Signals_Read_ReadData_DataServices_Data_225104_FD_CAN14_Tx_Signals_Read_ReadData: RteEventRef=OIT_DataServices_Data_225104_FD_CAN14_Tx_Signals_Read_ReadData_DataServices_Data_225104_FD_CAN14_Tx_Signals_Read_ReadData
          OIT_DataServices_Data_22FD62_ASIL_QM_Fault_Status_Read_ReadData_DataServices_Data_22FD62_ASIL_QM_Fault_Status_Read_ReadData: RteEventRef=OIT_DataServices_Data_22FD62_ASIL_QM_Fault_Status_Read_ReadData_DataServices_Data_22FD62_ASIL_QM_Fault_Status_Read_ReadData
          OIT_DataServices_Data_222939_FDCAN2_BUS_Network_WakeUp_Reason_ReadData_DataServices_Data_222939_FDCAN2_BUS_Network_WakeU283EDE76: RteEventRef=OIT_DataServices_Data_222939_FDCAN2_BUS_Network_WakeUp_Reason_ReadData_DataServices_Data_222939_FDCAN2_BUS_Network_WakeU283EDE76
          OIT_DataServices_Data_22FD47_SoC_Temperature_0xFD47_Read_ReadData_DataServices_Data_22FD47_SoC_Temperature_0xFD47_Read_ReadData: RteEventRef=OIT_DataServices_Data_22FD47_SoC_Temperature_0xFD47_Read_ReadData_DataServices_Data_22FD47_SoC_Temperature_0xFD47_Read_ReadData
          OIT_DataServices_Data_22FD60_ECU_Software_Status_Read_ReadData_DataServices_Data_22FD60_ECU_Software_Status_Read_ReadData: RteEventRef=OIT_DataServices_Data_22FD60_ECU_Software_Status_Read_ReadData_DataServices_Data_22FD60_ECU_Software_Status_Read_ReadData
          OIT_DataServices_Data_22FD64_ASIL_B_Fault_Status_Read_ReadData_DataServices_Data_22FD64_ASIL_B_Fault_Status_Read_ReadData: RteEventRef=OIT_DataServices_Data_22FD64_ASIL_B_Fault_Status_Read_ReadData_DataServices_Data_22FD64_ASIL_B_Fault_Status_Read_ReadData
          OIT_DataServices_Data_2EFD4E_Reset_NVM_Write_WriteData_DataServices_Data_2EFD4E_Reset_NVM_Write_WriteData: RteEventRef=OIT_DataServices_Data_2EFD4E_Reset_NVM_Write_WriteData_DataServices_Data_2EFD4E_Reset_NVM_Write_WriteData
          OIT_DataServices_Data_22FD49_SoC_Die_Temperature_ID_0xFD49_Read_ReadData_DataServices_Data_22FD49_SoC_Die_Temperature_ID94F3268C: RteEventRef=OIT_DataServices_Data_22FD49_SoC_Die_Temperature_ID_0xFD49_Read_ReadData_DataServices_Data_22FD49_SoC_Die_Temperature_ID94F3268C
          OIT_DataServices_Data_22FDF0_ECU_shutdown_process_Read_WriteData_DataServices_Data_22FDF0_ECU_shutdown_process_Read_WriteData: RteEventRef=OIT_DataServices_Data_22FDF0_ECU_shutdown_process_Read_WriteData_DataServices_Data_22FDF0_ECU_shutdown_process_Read_WriteData
          OIT_DataServices_Data_22FDF0_ECU_shutdown_process_Read_ReadData_DataServices_Data_22FDF0_ECU_shutdown_process_Read_ReadData: RteEventRef=OIT_DataServices_Data_22FDF0_ECU_shutdown_process_Read_ReadData_DataServices_Data_22FDF0_ECU_shutdown_process_Read_ReadData
          OIT_DataServices_Data_222026_CAN_Overrun_Counters_ReadData_DataServices_Data_222026_CAN_Overrun_Counters_ReadData: RteEventRef=OIT_DataServices_Data_222026_CAN_Overrun_Counters_ReadData_DataServices_Data_222026_CAN_Overrun_Counters_ReadData
          OIT_DataServices_Data_22102A_Check_EOL_Configuration_Data_ReadData_DataServices_Data_22102A_Check_EOL_Configuration_DataE77BC232: RteEventRef=OIT_DataServices_Data_22102A_Check_EOL_Configuration_Data_ReadData_DataServices_Data_22102A_Check_EOL_Configuration_DataE77BC232
          OIT_DataServices_Data_225201_Plant_Mode_Status_Read_ReadData_DataServices_Data_225201_Plant_Mode_Status_Read_ReadData: RteEventRef=OIT_DataServices_Data_225201_Plant_Mode_Status_Read_ReadData_DataServices_Data_225201_Plant_Mode_Status_Read_ReadData
          OIT_DataServices_Data_2E2023_PROXI_Data_WriteData_DataServices_Data_2E2023_PROXI_Data_WriteData: RteEventRef=OIT_DataServices_Data_2E2023_PROXI_Data_WriteData_DataServices_Data_2E2023_PROXI_Data_WriteData
          OIT_DataServices_Data_220103_VIN_Lock_Status_ReadData_DataServices_Data_220103_VIN_Lock_Status_ReadData: RteEventRef=OIT_DataServices_Data_220103_VIN_Lock_Status_ReadData_DataServices_Data_220103_VIN_Lock_Status_ReadData
          OIT_DataServices_Data_222013_VIN_Lock_State_Read_ReadData_DataServices_Data_222013_VIN_Lock_State_Read_ReadData: RteEventRef=OIT_DataServices_Data_222013_VIN_Lock_State_Read_ReadData_DataServices_Data_222013_VIN_Lock_State_Read_ReadData
          OIT_DataServices_Data_22F1A1_Configuration_Code_ReadData_DataServices_Data_22F1A1_Configuration_Code_ReadData: RteEventRef=OIT_DataServices_Data_22F1A1_Configuration_Code_ReadData_DataServices_Data_22F1A1_Configuration_Code_ReadData
          OIT_DataServices_Data_22F190_VIN_Original_ReadData_DataServices_Data_22F190_VIN_Original_ReadData: RteEventRef=OIT_DataServices_Data_22F190_VIN_Original_ReadData_DataServices_Data_22F190_VIN_Original_ReadData
          OIT_DataServices_Data_22FD61_Vehicle_Variant_Coding_Data_Read_ReadData_DataServices_Data_22FD61_Vehicle_Variant_Coding_D2830F7CB: RteEventRef=OIT_DataServices_Data_22FD61_Vehicle_Variant_Coding_Data_Read_ReadData_DataServices_Data_22FD61_Vehicle_Variant_Coding_D2830F7CB
          OIT_DataServices_Data_22F1B0_VIN_Current_ReadData_DataServices_Data_22F1B0_VIN_Current_ReadData: RteEventRef=OIT_DataServices_Data_22F1B0_VIN_Current_ReadData_DataServices_Data_22F1B0_VIN_Current_ReadData
          OIT_DataServices_Data_222024_Read_ECU_PROXI_Data_ReadDataLength_DataServices_Data_222024_Read_ECU_PROXI_Data_ReadDataLength: RteEventRef=OIT_DataServices_Data_222024_Read_ECU_PROXI_Data_ReadDataLength_DataServices_Data_222024_Read_ECU_PROXI_Data_ReadDataLength
          OIT_DataServices_Data_222024_Read_ECU_PROXI_Data_ReadData_DataServices_Data_222024_Read_ECU_PROXI_Data_ReadData: RteEventRef=OIT_DataServices_Data_222024_Read_ECU_PROXI_Data_ReadData_DataServices_Data_222024_Read_ECU_PROXI_Data_ReadData
          OIT_DataServices_Data_22292E_PROXI_Write_Counter_ReadData_DataServices_Data_22292E_PROXI_Write_Counter_ReadData: RteEventRef=OIT_DataServices_Data_22292E_PROXI_Write_Counter_ReadData_DataServices_Data_22292E_PROXI_Write_Counter_ReadData
          OIT_DataServices_Data_22F10B_ECU_Qualification_ReadData_DataServices_Data_22F10B_ECU_Qualification_ReadData: RteEventRef=OIT_DataServices_Data_22F10B_ECU_Qualification_ReadData_DataServices_Data_22F10B_ECU_Qualification_ReadData
        NvmBlock_SWC_DIDMgr_DID_FDF0_SleepProcess (RteNvRamAllocation):
          RteNvmRamBlockLocationSymbol = Rte_SWC_DIDMgr_DID_FDF0_SleepProcess_MirrorBlock
          RteNvmRomBlockLocationSymbol = Rte_SWC_DIDMgr_DID_FDF0_SleepProcess_DefaultValue
          RteNvmBlockRef = SWC_DIDMgrDID_FDF0_SleepProcess
          RteSwNvRamMappingRef = DID_FDF0_SleepProcess
        NvmBlock_SWC_DIDMgr_DID_2939_WakeupReason (RteNvRamAllocation):
          RteNvmRamBlockLocationSymbol = Rte_SWC_DIDMgr_DID_2939_WakeupReason_MirrorBlock
          RteNvmRomBlockLocationSymbol = Rte_SWC_DIDMgr_DID_2939_WakeupReason_DefaultValue
          RteNvmBlockRef = SWC_DIDMgrDID_2939_WakeupReason
          RteSwNvRamMappingRef = DID_2939_WakeupReason
        10 x RteEventToTaskMapping, all with RteImmediateRestart=false:
          OIT_DataServices_Data_22FD4A_Ultrasonic_Sensors_Power_supply_and_Current_Level_Read_ReadData_DataServices_Data_22FD4A_Ul8AA28754: RteEventRef=OIT_DataServices_Data_22FD4A_Ultrasonic_Sensors_Power_supply_and_Current_Level_Read_ReadData_DataServices_Data_22FD4A_Ul8AA28754
          OIT_DataServices_Data_225109_Rear_Sensor_HealthBlockage_LiveDetection_Check_Read_ReadData_DataServices_Data_225109_Rear_C4072654: RteEventRef=OIT_DataServices_Data_225109_Rear_Sensor_HealthBlockage_LiveDetection_Check_Read_ReadData_DataServices_Data_225109_Rear_C4072654
          OIT_DataServices_Data_225107_Front_Sensor_HealthBlockage_LiveDetection_Check_Read_ReadData_DataServices_Data_225107_FronE68E76DA: RteEventRef=OIT_DataServices_Data_225107_Front_Sensor_HealthBlockage_LiveDetection_Check_Read_ReadData_DataServices_Data_225107_FronE68E76DA
          OIT_DataServices_Data_22FD65_FuSa_Module_Status_Read_ReadData_DataServices_Data_22FD65_FuSa_Module_Status_Read_ReadData: RteEventRef=OIT_DataServices_Data_22FD65_FuSa_Module_Status_Read_ReadData_DataServices_Data_22FD65_FuSa_Module_Status_Read_ReadData
          OIT_Pp_NVM_Write_ProxiConfigTable_ProxiconfigTable_Nvm_write_confirmation_Pp_NVM_Write_ProxiConfigTable_ProxiconfigTable9D6E03A4: RteEventRef=OIT_Pp_NVM_Write_ProxiConfigTable_ProxiconfigTable_Nvm_write_confirmation_Pp_NVM_Write_ProxiConfigTable_ProxiconfigTable9D6E03A4
          OIT_DataServices_Data_22FD43_Active_Safe_State_Read_DataServices_Data_22FD43_Active_Safe_State_Read_ReadData: RteEventRef=OIT_DataServices_Data_22FD43_Active_Safe_State_Read_DataServices_Data_22FD43_Active_Safe_State_Read_ReadData
          OIT_Runnable_DataServices_Data_22FD44_Error_Flags_Read_ReadData: RteEventRef=OIT_Runnable_DataServices_Data_22FD44_Error_Flags_Read_ReadData
          OIT_DataServices_Data_22FD66_Camera_occlusion_and_low_light_status_Read_DataServices_Data_22FD66_Camera_occlusion_and_lo4CA3D059: RteEventRef=OIT_DataServices_Data_22FD66_Camera_occlusion_and_low_light_status_Read_DataServices_Data_22FD66_Camera_occlusion_and_lo4CA3D059
          OIT_DataServices_Data_22FD67_Camera_DLD_Status_Read_DataServices_Data_22FD67_Camera_DLD_Status_Read_ReadData: RteEventRef=OIT_DataServices_Data_22FD67_Camera_DLD_Status_Read_DataServices_Data_22FD67_Camera_DLD_Status_Read_ReadData
          TMT_RE_periodic_CPU_Load: RtePositionInTask=6, RteEventRef=TMT_RE_periodic_CPU_Load, RteMappedToTaskRef=QM_Task_200ms, RteUsedOsEventRef=Rte_Ev_Cyclic_QM_Task_200ms_0_200ms, RteUsedOsAlarmRef=Rte_Al_TE_QM_Task_200ms_0_200ms
        NvmBlock_SWC_DIDMgr_DID_FD74_PHY_TuningErr (RteNvRamAllocation):
          RteNvmRamBlockLocationSymbol = Rte_SWC_DIDMgr_DID_FD74_PHY_TuningErr_MirrorBlock
          RteNvmRomBlockLocationSymbol = Rte_SWC_DIDMgr_DID_FD74_PHY_TuningErr_DefaultValue
          RteNvmBlockRef = SWC_DIDMgrDID_FD74_PHY_TuningErr
          RteSwNvRamMappingRef = DID_FD74_PHY_TuningErr
        NvmBlock_SWC_DIDMgr_DID_FD74_BuffMarkCompErr (RteNvRamAllocation):
          RteNvmRamBlockLocationSymbol = Rte_SWC_DIDMgr_DID_FD74_BuffMarkCompErr_MirrorBlock
          RteNvmRomBlockLocationSymbol = Rte_SWC_DIDMgr_DID_FD74_BuffMarkCompErr_DefaultValue
          RteNvmBlockRef = SWC_DIDMgrDID_FD74_BuffMarkCompErr
          RteSwNvRamMappingRef = DID_FD74_BuffMarkCompErr
        9 x RteEventToTaskMapping, all with RteImmediateRestart=false:
          OIT_DataServices_Data_22FD74_PHY_Tunning_Error_And_Buffer_Mark_Error_Read_ReadData_DataServices_Data_22FD74_PHY_Tunning_6B125AB5: RteEventRef=OIT_DataServices_Data_22FD74_PHY_Tunning_Error_And_Buffer_Mark_Error_Read_ReadData_DataServices_Data_22FD74_PHY_Tunning_6B125AB5
          OIT_DataServices_Data_22FDF6_RunTimeStatsData_Read_ReadData_DataServices_Data_22FDF6_RunTimeStatsData_Read_ReadData: RteEventRef=OIT_DataServices_Data_22FDF6_RunTimeStatsData_Read_ReadData_DataServices_Data_22FDF6_RunTimeStatsData_Read_ReadData
          OIT_DataServices_Data_22FDF7_Intrinsic_Camera_NvM_Data_Read_ReadData_DataServices_Data_22FDF7_Intrinsic_Camera_NvM_Data_7AB8FFD0: RteEventRef=OIT_DataServices_Data_22FDF7_Intrinsic_Camera_NvM_Data_Read_ReadData_DataServices_Data_22FDF7_Intrinsic_Camera_NvM_Data_7AB8FFD0
          OIT_DataServices_Data_22FD04_USS_Sensor_tuning_values_Read_WriteData_DataServices_Data_22FD04_USS_Sensor_tuning_values_R2092B5D3: RteEventRef=OIT_DataServices_Data_22FD04_USS_Sensor_tuning_values_Read_WriteData_DataServices_Data_22FD04_USS_Sensor_tuning_values_R2092B5D3
          OIT_DataServices_Data_22FD04_USS_Sensor_tuning_values_Read_ReadDataLength_DataServices_Data_22FD04_USS_Sensor_tuning_val2E882436: RteEventRef=OIT_DataServices_Data_22FD04_USS_Sensor_tuning_values_Read_ReadDataLength_DataServices_Data_22FD04_USS_Sensor_tuning_val2E882436
          OIT_DataServices_Data_22FD04_USS_Sensor_tuning_values_Read_ReadData_DataServices_Data_22FD04_USS_Sensor_tuning_values_ReB9D99541: RteEventRef=OIT_DataServices_Data_22FD04_USS_Sensor_tuning_values_Read_ReadData_DataServices_Data_22FD04_USS_Sensor_tuning_values_ReB9D99541
          OIT_DataServices_Data_22FDF8_StackUsage_Read_ReadData_DataServices_Data_22FDF8_StackUsage_Read_ReadData: RteEventRef=OIT_DataServices_Data_22FDF8_StackUsage_Read_ReadData_DataServices_Data_22FDF8_StackUsage_Read_ReadData
          OIT_DataServices_Data_22FDF5_PerformanceStatEnable_Read_WriteData_DataServices_Data_22FDF5_PerformanceStatEnable_Read_WriteData: RteEventRef=OIT_DataServices_Data_22FDF5_PerformanceStatEnable_Read_WriteData_DataServices_Data_22FDF5_PerformanceStatEnable_Read_WriteData
          OIT_DataServices_Data_22FDF5_PerformanceStatEnable_Read_ReadData_DataServices_Data_22FDF5_PerformanceStatEnable_Read_ReadData: RteEventRef=OIT_DataServices_Data_22FDF5_PerformanceStatEnable_Read_ReadData_DataServices_Data_22FDF5_PerformanceStatEnable_Read_ReadData
      SWC_DTCManager_EcuSwComposition: RteSoftwareComponentInstanceRef=SWC_DTCMgr
        40 x RteEventToTaskMapping, all with RteImmediateRestart=false:
          InitEvent: RtePositionInTask=2, RteEventRef=InitEvent, RteMappedToTaskRef=QM_Task_Init
          TMT_RE_DTCMgr_Main: RtePositionInTask=7, RteEventRef=TMT_RE_DTCMgr_Main, RteMappedToTaskRef=QM_Task_00_10ms, RteUsedOsAlarmRef=Rte_Al_TE_QM_Task_00_10ms_0_10ms
          OIT_CSDataServices_Data_DID_0x1008_ECU_Life_Time_24_ReadData_CSDataServices_Data_DID_0x1008_ECU_Life_Time_24_ReadData: RteEventRef=OIT_CSDataServices_Data_DID_0x1008_ECU_Life_Time_24_ReadData_CSDataServices_Data_DID_0x1008_ECU_Life_Time_24_ReadData
          OIT_CSDataServices_Data_DID_0x1002_Vehicle_Speed_24_ReadData_CSDataServices_Data_DID_0x1002_Vehicle_Speed_24_ReadData: RteEventRef=OIT_CSDataServices_Data_DID_0x1002_Vehicle_Speed_24_ReadData_CSDataServices_Data_DID_0x1002_Vehicle_Speed_24_ReadData
          OIT_CSDataServices_Data_DID_0x1009_ECU_Time_Since_Ignition_ON_ReadData_CSDataServices_Data_DID_0x1009_ECU_Time_Since_Ign975E9003: RteEventRef=OIT_CSDataServices_Data_DID_0x1009_ECU_Time_Since_Ignition_ON_ReadData_CSDataServices_Data_DID_0x1009_ECU_Time_Since_Ign975E9003
          OIT_CSDataServices_Data_DID_0x200a_Ignition_ON_Counter_24_ReadData_CSDataServices_Data_DID_0x200a_Ignition_ON_Counter_2498E7759A: RteEventRef=OIT_CSDataServices_Data_DID_0x200a_Ignition_ON_Counter_24_ReadData_CSDataServices_Data_DID_0x200a_Ignition_ON_Counter_2498E7759A
          OIT_CSDataServices_Data_DID_0x2001_Odometer_24_ReadData_CSDataServices_Data_DID_0x2001_Odometer_24_ReadData: RteEventRef=OIT_CSDataServices_Data_DID_0x2001_Odometer_24_ReadData_CSDataServices_Data_DID_0x2001_Odometer_24_ReadData
          OIT_CSDataServices_Data_DID_0x1004_Battery_Voltage_24_ReadData_CSDataServices_Data_DID_0x1004_Battery_Voltage_24_ReadData: RteEventRef=OIT_CSDataServices_Data_DID_0x1004_Battery_Voltage_24_ReadData_CSDataServices_Data_DID_0x1004_Battery_Voltage_24_ReadData
          DRT_RE_DTCMgr_EtROEMessage_RoEMessageSRI_Data: RtePositionInTask=2, RteEventRef=DRT_RE_DTCMgr_EtROEMessage_RoEMessageSRI_Data, RteMappedToTaskRef=QM_Task_200ms, RteUsedOsEventRef=Rte_Ev_InternalEventHandling
          OIT_RE_PpClearDTCSettingStatus_ClearDTCSettingStatus_PpClearDTCSettingStatus_ClearDTCSettingStatus: RteEventRef=OIT_RE_PpClearDTCSettingStatus_ClearDTCSettingStatus_PpClearDTCSettingStatus_ClearDTCSettingStatus
          OIT_CSDataServices_Data_OccurrenceCounter_Camera_Occlusion_ReadData_CSDataServices_Data_OccurrenceCounter_Camera_Occlusi824ABDF0: RteEventRef=OIT_CSDataServices_Data_OccurrenceCounter_Camera_Occlusion_ReadData_CSDataServices_Data_OccurrenceCounter_Camera_Occlusi824ABDF0
          OIT_CSDataServices_Data_OccurrenceCounter_Current_Gear_ReadData_CSDataServices_Data_OccurrenceCounter_Current_Gear_ReadData: RteEventRef=OIT_CSDataServices_Data_OccurrenceCounter_Current_Gear_ReadData_CSDataServices_Data_OccurrenceCounter_Current_Gear_ReadData
          OIT_CSDataServices_Data_OccurrenceCounter_DisplayStatus_ReadData_CSDataServices_Data_OccurrenceCounter_DisplayStatus_ReadData: RteEventRef=OIT_CSDataServices_Data_OccurrenceCounter_DisplayStatus_ReadData_CSDataServices_Data_OccurrenceCounter_DisplayStatus_ReadData
          OIT_CSDataServices_Data_OccurrenceCounter_Door_Status_ReadData_CSDataServices_Data_OccurrenceCounter_Door_Status_ReadData: RteEventRef=OIT_CSDataServices_Data_OccurrenceCounter_Door_Status_ReadData_CSDataServices_Data_OccurrenceCounter_Door_Status_ReadData
          OIT_CSDataServices_Data_OccurrenceCounter_ECU_Voltage_ReadData_CSDataServices_Data_OccurrenceCounter_ECU_Voltage_ReadData: RteEventRef=OIT_CSDataServices_Data_OccurrenceCounter_ECU_Voltage_ReadData_CSDataServices_Data_OccurrenceCounter_ECU_Voltage_ReadData
          OIT_CSDataServices_Data_OccurrenceCounter_External_Temperature_ReadData_CSDataServices_Data_OccurrenceCounter_External_T80EFF9E8: RteEventRef=OIT_CSDataServices_Data_OccurrenceCounter_External_Temperature_ReadData_CSDataServices_Data_OccurrenceCounter_External_T80EFF9E8
          OIT_CSDataServices_Data_OccurrenceCounter_Odometer_Value_ReadData_CSDataServices_Data_OccurrenceCounter_Odometer_Value_ReadData: RteEventRef=OIT_CSDataServices_Data_OccurrenceCounter_Odometer_Value_ReadData_CSDataServices_Data_OccurrenceCounter_Odometer_Value_ReadData
          OIT_CSDataServices_Data_OccurrenceCounter_Supplier_Internal_Code_ReadData_CSDataServices_Data_OccurrenceCounter_Supplier10DE76A6: RteEventRef=OIT_CSDataServices_Data_OccurrenceCounter_Supplier_Internal_Code_ReadData_CSDataServices_Data_OccurrenceCounter_Supplier10DE76A6
          OIT_CSDataServices_Data_OccurrenceCounter_THA_state_ReadData_CSDataServices_Data_OccurrenceCounter_THA_state_ReadData: RteEventRef=OIT_CSDataServices_Data_OccurrenceCounter_THA_state_ReadData_CSDataServices_Data_OccurrenceCounter_THA_state_ReadData
          OIT_CSDataServices_Data_OccurrenceCounter_TireLines_ReadData_CSDataServices_Data_OccurrenceCounter_TireLines_ReadData: RteEventRef=OIT_CSDataServices_Data_OccurrenceCounter_TireLines_ReadData_CSDataServices_Data_OccurrenceCounter_TireLines_ReadData
          OIT_CSDataServices_Data_OccurrenceCounter_Touch_Screen_Status_ReadData_CSDataServices_Data_OccurrenceCounter_Touch_Scree768239EB: RteEventRef=OIT_CSDataServices_Data_OccurrenceCounter_Touch_Screen_Status_ReadData_CSDataServices_Data_OccurrenceCounter_Touch_Scree768239EB
          OIT_CSDataServices_Data_OccurrenceCounter_Touch_Screen_X_Coordinate_ReadData_CSDataServices_Data_OccurrenceCounter_Touch59BB1B9D: RteEventRef=OIT_CSDataServices_Data_OccurrenceCounter_Touch_Screen_X_Coordinate_ReadData_CSDataServices_Data_OccurrenceCounter_Touch59BB1B9D
          OIT_CSDataServices_Data_OccurrenceCounter_Touch_Screen_Y_Coordinate_ReadData_CSDataServices_Data_OccurrenceCounter_TouchA25BFED9: RteEventRef=OIT_CSDataServices_Data_OccurrenceCounter_Touch_Screen_Y_Coordinate_ReadData_CSDataServices_Data_OccurrenceCounter_TouchA25BFED9
          OIT_CSDataServices_Data_OccurrenceCounter_TRSC_Stat_ReadData_CSDataServices_Data_OccurrenceCounter_TRSC_Stat_ReadData: RteEventRef=OIT_CSDataServices_Data_OccurrenceCounter_TRSC_Stat_ReadData_CSDataServices_Data_OccurrenceCounter_TRSC_Stat_ReadData
          OIT_CSDataServices_Data_OccurrenceCounter_Vehicle_Speed_ReadData_CSDataServices_Data_OccurrenceCounter_Vehicle_Speed_ReadData: RteEventRef=OIT_CSDataServices_Data_OccurrenceCounter_Vehicle_Speed_ReadData_CSDataServices_Data_OccurrenceCounter_Vehicle_Speed_ReadData
          OIT_CSDataServices_Data_OccurrenceCounter_Aging_Counter_ID_ReadData_CSDataServices_Data_OccurrenceCounter_Aging_Counter_836DD2DC: RteEventRef=OIT_CSDataServices_Data_OccurrenceCounter_Aging_Counter_ID_ReadData_CSDataServices_Data_OccurrenceCounter_Aging_Counter_836DD2DC
          OIT_CSDataServices_Data_OccurrenceCounter_Frequency_Counter_ID_ReadData_CSDataServices_Data_OccurrenceCounter_Frequency_8AA32A91: RteEventRef=OIT_CSDataServices_Data_OccurrenceCounter_Frequency_Counter_ID_ReadData_CSDataServices_Data_OccurrenceCounter_Frequency_8AA32A91
          OIT_CSDataServices_Data_OccurrenceCounter_Radio_Display_Status_ReadData_CSDataServices_Data_OccurrenceCounter_Radio_DispC23FCC69: RteEventRef=OIT_CSDataServices_Data_OccurrenceCounter_Radio_Display_Status_ReadData_CSDataServices_Data_OccurrenceCounter_Radio_DispC23FCC69
          OIT_CSDataServices_Data_OccurrenceCounter_TRSKM_and_USS_status_ReadData_CSDataServices_Data_OccurrenceCounter_TRSKM_and_92E0C426: RteEventRef=OIT_CSDataServices_Data_OccurrenceCounter_TRSKM_and_USS_status_ReadData_CSDataServices_Data_OccurrenceCounter_TRSKM_and_92E0C426
          OIT_CSDataServices_Data_OccurrenceCounter_Steering_Wheel_Angle_ReadData_CSDataServices_Data_OccurrenceCounter_Steering_W3AE030A7: RteEventRef=OIT_CSDataServices_Data_OccurrenceCounter_Steering_Wheel_Angle_ReadData_CSDataServices_Data_OccurrenceCounter_Steering_W3AE030A7
          OIT_CSDataServices_Data_OccurrenceCounter_Calibration_Not_Started_ReadData_CSDataServices_Data_OccurrenceCounter_Calibra7D502084: RteEventRef=OIT_CSDataServices_Data_OccurrenceCounter_Calibration_Not_Started_ReadData_CSDataServices_Data_OccurrenceCounter_Calibra7D502084
          OIT_CSDataServices_Data_OccurrenceCounter_Calibration_Pending_ReadData_CSDataServices_Data_OccurrenceCounter_CalibrationCD73D052: RteEventRef=OIT_CSDataServices_Data_OccurrenceCounter_Calibration_Pending_ReadData_CSDataServices_Data_OccurrenceCounter_CalibrationCD73D052
          OIT_CSDataServices_Data_OccurrenceCounter_Calibration_Aborted_Failed_ReadData_CSDataServices_Data_OccurrenceCounter_Cali0145BA5D: RteEventRef=OIT_CSDataServices_Data_OccurrenceCounter_Calibration_Aborted_Failed_ReadData_CSDataServices_Data_OccurrenceCounter_Cali0145BA5D
          OIT_CSDataServices_Data_OccurrenceCounter_LiftgateAjar_ReadData_CSDataServices_Data_OccurrenceCounter_LiftgateAjar_ReadData: RteEventRef=OIT_CSDataServices_Data_OccurrenceCounter_LiftgateAjar_ReadData_CSDataServices_Data_OccurrenceCounter_LiftgateAjar_ReadData
          OIT_CSDataServices_Data_OccurrenceCounter_Calibrated_Successfully_ReadData_CSDataServices_Data_OccurrenceCounter_Calibra0DFFCB72: RteEventRef=OIT_CSDataServices_Data_OccurrenceCounter_Calibrated_Successfully_ReadData_CSDataServices_Data_OccurrenceCounter_Calibra0DFFCB72
          OIT_CSDataServices_Data_OccurrenceCounter_New_Bit_Field_ReadData_CSDataServices_Data_OccurrenceCounter_New_Bit_Field_ReadData: RteEventRef=OIT_CSDataServices_Data_OccurrenceCounter_New_Bit_Field_ReadData_CSDataServices_Data_OccurrenceCounter_New_Bit_Field_ReadData
          OIT_CSDataServices_Data_OccurrenceCounter_Calibration_Running_ReadData_CSDataServices_Data_OccurrenceCounter_CalibrationC16779BD: RteEventRef=OIT_CSDataServices_Data_OccurrenceCounter_Calibration_Running_ReadData_CSDataServices_Data_OccurrenceCounter_CalibrationC16779BD
          OIT_CSDataServices_Data_OccurrenceCounter_Reserved_1_ReadData_CSDataServices_Data_OccurrenceCounter_Reserved_1_ReadData: RteEventRef=OIT_CSDataServices_Data_OccurrenceCounter_Reserved_1_ReadData_CSDataServices_Data_OccurrenceCounter_Reserved_1_ReadData
          OIT_CSDataServices_Data_OccurrenceCounter_Reserved_ReadData_CSDataServices_Data_OccurrenceCounter_Reserved_ReadData: RteEventRef=OIT_CSDataServices_Data_OccurrenceCounter_Reserved_ReadData_CSDataServices_Data_OccurrenceCounter_Reserved_ReadData
          OIT_CSDataServices_Data_OccurrenceCounter_Cycles_to_Switch_off_the_Warning_Indication_ID_ReadData_CSDataServices_Data_OcAAD1BA9D: RteEventRef=OIT_CSDataServices_Data_OccurrenceCounter_Cycles_to_Switch_off_the_Warning_Indication_ID_ReadData_CSDataServices_Data_OcAAD1BA9D
        NvmBlock_SWC_DTCMgr_DTC_APARequestSts_PAMRequestSts (RteNvRamAllocation):
          RteNvmRamBlockLocationSymbol = Rte_SWC_DTCMgr_DTC_APARequestSts_PAMRequestSts_MirrorBlock
          RteNvmRomBlockLocationSymbol = Rte_SWC_DTCMgr_DTC_APARequestSts_PAMRequestSts_DefaultValue
          RteNvmBlockRef = SWC_DTCMgrDTC_APARequestSts_PAMRequestSts
          RteSwNvRamMappingRef = DTC_APARequestSts_PAMRequestSts
        OIT_CSDataServices_Data_OccurrenceCounter_Reserved_2_ReadData_CSDataServices_Data_OccurrenceCounter_Reserved_2_ReadData (RteEventToTaskMapping):
          RteImmediateRestart = false
          RteEventRef = OIT_CSDataServices_Data_OccurrenceCounter_Reserved_2_ReadData_CSDataServices_Data_OccurrenceCounter_Reserved_2_ReadData
        OIT_CSDataServices_Data_DID_0x1921_CombinedSignal_ReadData_CSDataServices_Data_DID_0x1921_CombinedSignal_ReadData (RteEventToTaskMapping):
          RteImmediateRestart = false
          RteEventRef = OIT_CSDataServices_Data_DID_0x1921_CombinedSignal_ReadData_CSDataServices_Data_DID_0x1921_CombinedSignal_ReadData
      SWC_PartNumMgr_EcuSwComposition: RteSoftwareComponentInstanceRef=SWC_PartNumMgr
        41 x RteEventToTaskMapping, all with RteImmediateRestart=false:
          InitEvent: RtePositionInTask=1, RteEventRef=InitEvent, RteMappedToTaskRef=QM_Task_Init
          TMT_RE_PartNumMgr_Main: RtePositionInTask=5, RteEventRef=TMT_RE_PartNumMgr_Main, RteMappedToTaskRef=QM_Task_00_10ms, RteUsedOsAlarmRef=Rte_Al_TE_QM_Task_00_10ms_0_10ms
          OIT_DataServices_Data_222003_Boot_Software_Programming_Attempt_Counter_ReadData_DataServices_Data_222003_Boot_Software_P7618A5A4: RteEventRef=OIT_DataServices_Data_222003_Boot_Software_Programming_Attempt_Counter_ReadData_DataServices_Data_222003_Boot_Software_P7618A5A4
          OIT_DataServices_Data_22F180_Boot_Software_Version_Information_ReadData_DataServices_Data_22F180_Boot_Software_Version_IFD2EFA80: RteEventRef=OIT_DataServices_Data_22F180_Boot_Software_Version_Information_ReadData_DataServices_Data_22F180_Boot_Software_Version_IFD2EFA80
          OIT_DataServices_Data_22F18A_FCA_ESLM_ECU_Software_Calibration_Number_ReadData_DataServices_Data_22F18A_FCA_ESLM_ECU_SofDF68DFA8: RteEventRef=OIT_DataServices_Data_22F18A_FCA_ESLM_ECU_Software_Calibration_Number_ReadData_DataServices_Data_22F18A_FCA_ESLM_ECU_SofDF68DFA8
          OIT_DataServices_Data_22FD16_Magna_Production_ICT_Data_Read_ReadData_DataServices_Data_22FD16_Magna_Production_ICT_Data_1B05D7E7: RteEventRef=OIT_DataServices_Data_22FD16_Magna_Production_ICT_Data_Read_ReadData_DataServices_Data_22FD16_Magna_Production_ICT_Data_1B05D7E7
          OIT_DataServices_Data_22F188_FCA_ESLM_ECU_Software_Number_ReadData_DataServices_Data_22F188_FCA_ESLM_ECU_Software_Number457EFB64: RteEventRef=OIT_DataServices_Data_22F188_FCA_ESLM_ECU_Software_Number_ReadData_DataServices_Data_22F188_FCA_ESLM_ECU_Software_Number457EFB64
          OIT_DataServices_Data_22F182_Application_Data_Identification_ReadData_DataServices_Data_22F182_Application_Data_IdentifiB7E15006: RteEventRef=OIT_DataServices_Data_22F182_Application_Data_Identification_ReadData_DataServices_Data_22F182_Application_Data_IdentifiB7E15006
          OIT_DataServices_Data_22F192_Supplier_ECU_Hardware_Part_Number_ReadData_DataServices_Data_22F192_Supplier_ECU_Hardware_P8807FD4D: RteEventRef=OIT_DataServices_Data_22F192_Supplier_ECU_Hardware_Part_Number_ReadData_DataServices_Data_22F192_Supplier_ECU_Hardware_P8807FD4D
          OIT_DataServices_Data_22F10D_Diagnostic_Specification_Information_ReadData_DataServices_Data_22F10D_Diagnostic_Specifica91CF8A26: RteEventRef=OIT_DataServices_Data_22F10D_Diagnostic_Specification_Information_ReadData_DataServices_Data_22F10D_Diagnostic_Specifica91CF8A26
          OIT_DataServices_Data_22FD17_Magna_Production_HW_Version_information_Read_ReadData_DataServices_Data_22FD17_Magna_Produc06BFFE9B: RteEventRef=OIT_DataServices_Data_22FD17_Magna_Production_HW_Version_information_Read_ReadData_DataServices_Data_22FD17_Magna_Produc06BFFE9B
          OIT_DataServices_Data_22F191_FCA_ESLM_ECU_Hardware_Number_ReadData_DataServices_Data_22F191_FCA_ESLM_ECU_Hardware_Number5EEDE70D: RteEventRef=OIT_DataServices_Data_22F191_FCA_ESLM_ECU_Hardware_Number_ReadData_DataServices_Data_22F191_FCA_ESLM_ECU_Hardware_Number5EEDE70D
          OIT_DataServices_Data_22F1B5_Application_Data_Software_Fingerprint_Reading_Information_ReadData_DataServices_Data_22F1B51DE0B2F4: RteEventRef=OIT_DataServices_Data_22F1B5_Application_Data_Software_Fingerprint_Reading_Information_ReadData_DataServices_Data_22F1B51DE0B2F4
          OIT_DataServices_Data_22FD15_Magna_Production_HW_Number_Read_ReadData_DataServices_Data_22FD15_Magna_Production_HW_Numbe6743EEE1: RteEventRef=OIT_DataServices_Data_22FD15_Magna_Production_HW_Number_Read_ReadData_DataServices_Data_22FD15_Magna_Production_HW_Numbe6743EEE1
          OIT_DataServices_Data_22F154_Hardware_Supplier_Identification_ReadData_DataServices_Data_22F154_Hardware_Supplier_Identi565FF852: RteEventRef=OIT_DataServices_Data_22F154_Hardware_Supplier_Identification_ReadData_DataServices_Data_22F154_Hardware_Supplier_Identi565FF852
          OIT_DataServices_Data_22F132_EBOM_ECU_Part_Number_ReadData_DataServices_Data_22F132_EBOM_ECU_Part_Number_ReadData: RteEventRef=OIT_DataServices_Data_22F132_EBOM_ECU_Part_Number_ReadData_DataServices_Data_22F132_EBOM_ECU_Part_Number_ReadData
          OIT_DataServices_Data_22F110_ECU_Diagnostic_Identification_ReadData_DataServices_Data_22F110_ECU_Diagnostic_IdentificatiE46CBB4A: RteEventRef=OIT_DataServices_Data_22F110_ECU_Diagnostic_Identification_ReadData_DataServices_Data_22F110_ECU_Diagnostic_IdentificatiE46CBB4A
          OIT_DataServices_Data_22F133_EBOM_Assembly_Part_Number_ReadData_DataServices_Data_22F133_EBOM_Assembly_Part_Number_ReadData: RteEventRef=OIT_DataServices_Data_22F133_EBOM_Assembly_Part_Number_ReadData_DataServices_Data_22F133_EBOM_Assembly_Part_Number_ReadData
          OIT_DataServices_Data_22F134_CODEP_assembly_part_number_ReadData_DataServices_Data_22F134_CODEP_assembly_part_number_ReadData: RteEventRef=OIT_DataServices_Data_22F134_CODEP_assembly_part_number_ReadData_DataServices_Data_22F134_CODEP_assembly_part_number_ReadData
          OIT_DataServices_Data_22F112_PTESLM_Hardware_Number_ReadData_DataServices_Data_22F112_PTESLM_Hardware_Number_ReadData: RteEventRef=OIT_DataServices_Data_22F112_PTESLM_Hardware_Number_ReadData_DataServices_Data_22F112_PTESLM_Hardware_Number_ReadData
          OIT_DataServices_Data_22201A_Application_Software_Programming_Attempt_Counter_ReadData_DataServices_Data_22201A_ApplicatCDDECFD6: RteEventRef=OIT_DataServices_Data_22201A_Application_Software_Programming_Attempt_Counter_ReadData_DataServices_Data_22201A_ApplicatCDDECFD6
          OIT_DataServices_Data_22F194_Supplier_ECU_Software_Part_Number_ReadData_DataServices_Data_22F194_Supplier_ECU_Software_PF5FA3120: RteEventRef=OIT_DataServices_Data_22F194_Supplier_ECU_Software_Part_Number_ReadData_DataServices_Data_22F194_Supplier_ECU_Software_PF5FA3120
          OIT_DataServices_Data_22F181_Application_Software_Identification_ReadData_DataServices_Data_22F181_Application_Software_D66047AC: RteEventRef=OIT_DataServices_Data_22F181_Application_Software_Identification_ReadData_DataServices_Data_22F181_Application_Software_D66047AC
          OIT_DataServices_Data_22F195_Supplier_ECU_Software_Version_Number_ReadData_DataServices_Data_22F195_Supplier_ECU_SoftwarD5BB4A4E: RteEventRef=OIT_DataServices_Data_22F195_Supplier_ECU_Software_Version_Number_ReadData_DataServices_Data_22F195_Supplier_ECU_SoftwarD5BB4A4E
          OIT_DataServices_Data_22F18C_ECU_Serial_Number_ReadData_DataServices_Data_22F18C_ECU_Serial_Number_ReadData: RteEventRef=OIT_DataServices_Data_22F18C_ECU_Serial_Number_ReadData_DataServices_Data_22F18C_ECU_Serial_Number_ReadData
          OIT_DataServices_Data_22F193_Supplier_ECU_Hardware_Version_Number_ReadData_DataServices_Data_22F193_Supplier_ECU_Hardwar33F2C41C: RteEventRef=OIT_DataServices_Data_22F193_Supplier_ECU_Hardware_Version_Number_ReadData_DataServices_Data_22F193_Supplier_ECU_Hardwar33F2C41C
          OIT_DataServices_Data_22F155_Software_Supplier_Identification_ReadData_DataServices_Data_22F155_Software_Supplier_Identi5611B37E: RteEventRef=OIT_DataServices_Data_22F155_Software_Supplier_Identification_ReadData_DataServices_Data_22F155_Software_Supplier_Identi5611B37E
          OIT_DataServices_Data_22F1A0_System_Identification_Data_ReadData_DataServices_Data_22F1A0_System_Identification_Data_ReadData: RteEventRef=OIT_DataServices_Data_22F1A0_System_Identification_Data_ReadData_DataServices_Data_22F1A0_System_Identification_Data_ReadData
          OIT_DataServices_Data_22F1B3_Boot_Software_Fingerprint_Reading_Information_ReadData_DataServices_Data_22F1B3_Boot_Softwa5F5B6A24: RteEventRef=OIT_DataServices_Data_22F1B3_Boot_Software_Fingerprint_Reading_Information_ReadData_DataServices_Data_22F1B3_Boot_Softwa5F5B6A24
          OIT_DataServices_Data_22F18B_FCA_ESLM_ECU_Software_Application_Number_ReadData_DataServices_Data_22F18B_FCA_ESLM_ECU_Sof869D5A40: RteEventRef=OIT_DataServices_Data_22F18B_FCA_ESLM_ECU_Software_Application_Number_ReadData_DataServices_Data_22F18B_FCA_ESLM_ECU_Sof869D5A40
          OIT_DataServices_Data_22F187_CODEP_ECU_Part_Number_ReadData_DataServices_Data_22F187_CODEP_ECU_Part_Number_ReadData: RteEventRef=OIT_DataServices_Data_22F187_CODEP_ECU_Part_Number_ReadData_DataServices_Data_22F187_CODEP_ECU_Part_Number_ReadData
          OIT_DataServices_Data_22201B_Application_Data_Software_Programming_Attempt_Counter_ReadData_DataServices_Data_22201B_App20424928: RteEventRef=OIT_DataServices_Data_22201B_Application_Data_Software_Programming_Attempt_Counter_ReadData_DataServices_Data_22201B_App20424928
          OIT_DataServices_Data_22F1B4_Application_Software_Fingerprint_Reading_Information_ReadData_DataServices_Data_22F1B4_Appl1F41231D: RteEventRef=OIT_DataServices_Data_22F1B4_Application_Software_Fingerprint_Reading_Information_ReadData_DataServices_Data_22F1B4_Appl1F41231D
          OIT_DataServices_Data_22FD31_Magna_EOL_Coding_State_Read_WriteData_DataServices_Data_22FD31_Magna_EOL_Coding_State_Read_6E34A382: RteEventRef=OIT_DataServices_Data_22FD31_Magna_EOL_Coding_State_Read_WriteData_DataServices_Data_22FD31_Magna_EOL_Coding_State_Read_6E34A382
          OIT_DataServices_Data_22FD31_Magna_EOL_Coding_State_Read_ReadData_DataServices_Data_22FD31_Magna_EOL_Coding_State_Read_ReadData: RteEventRef=OIT_DataServices_Data_22FD31_Magna_EOL_Coding_State_Read_ReadData_DataServices_Data_22FD31_Magna_EOL_Coding_State_Read_ReadData
          OIT_DataServices_Data_22F122_Software_EBOM_Part_Number_ReadData_DataServices_Data_22F122_Software_EBOM_Part_Number_ReadData: RteEventRef=OIT_DataServices_Data_22F122_Software_EBOM_Part_Number_ReadData_DataServices_Data_22F122_Software_EBOM_Part_Number_ReadData
          OIT_DataServices_Data_22F1A2_Vector_Delivery_ID_ReadData_DataServices_Data_22F1A2_Vector_Delivery_ID_ReadData: RteEventRef=OIT_DataServices_Data_22F1A2_Vector_Delivery_ID_ReadData_DataServices_Data_22F1A2_Vector_Delivery_ID_ReadData
          OIT_DataServices_Data_22FD13_Magna_Software_Version_ReadData_1_DataServices_Data_22FD13_Magna_Software_Version_ReadData: RteEventRef=OIT_DataServices_Data_22FD13_Magna_Software_Version_ReadData_1_DataServices_Data_22FD13_Magna_Software_Version_ReadData
          OIT_DataServices_Data_22FD14_FD14_Magna_Production_Date_Read_ReadData_1_DataServices_Data_22FD14_FD14_Magna_Production_DC024ADC0: RteEventRef=OIT_DataServices_Data_22FD14_FD14_Magna_Production_Date_Read_ReadData_1_DataServices_Data_22FD14_FD14_Magna_Production_DC024ADC0
          OIT_DataServices_Data_22FD38_Programmed_Assembly_ReadData_1_DataServices_Data_22FD38_Programmed_Assembly_ReadData: RteEventRef=OIT_DataServices_Data_22FD38_Programmed_Assembly_ReadData_1_DataServices_Data_22FD38_Programmed_Assembly_ReadData
          OIT_DataServices_Data_22FD1D_PCB_Serial_Number_ReadData_1_DataServices_Data_22FD1D_PCB_Serial_Number_ReadData: RteEventRef=OIT_DataServices_Data_22FD1D_PCB_Serial_Number_ReadData_1_DataServices_Data_22FD1D_PCB_Serial_Number_ReadData
        12 x RteNvRamAllocation:
          NvmBlock_SWC_PartNumMgr_DID_FD31_EOLCodingState: RteNvmRamBlockLocationSymbol=Rte_SWC_PartNumMgr_DID_FD31_EOLCodingState_MirrorBlock, RteNvmRomBlockLocationSymbol=Rte_SWC_PartNumMgr_DID_FD31_EOLCodingState_DefaultValue, RteNvmBlockRef=SWC_PartNumMgrDID_FD31_EOLCodingState, RteSwNvRamMappingRef=DID_FD31_EOLCodingState
          NvmBlock_SWC_PartNumMgr_DID_F195_Supplier_Ecu_SW_VerNum: RteNvmRamBlockLocationSymbol=Rte_SWC_PartNumMgr_DID_F195_Supplier_Ecu_SW_VerNum_MirrorBlock, RteNvmRomBlockLocationSymbol=Rte_SWC_PartNumMgr_DID_F195_Supplier_Ecu_SW_VerNum_DefaultValue, RteNvmBlockRef=SWC_PartNumMgrDID_F195_Supplier_Ecu_SW_VerNum, RteSwNvRamMappingRef=DID_F195_Supplier_Ecu_SW_VerNum
          NvmBlock_SWC_PartNumMgr_DID_F194_Supplier_Ecu_SW_PartNum: RteNvmRamBlockLocationSymbol=Rte_SWC_PartNumMgr_DID_F194_Supplier_Ecu_SW_PartNum_MirrorBlock, RteNvmRomBlockLocationSymbol=Rte_SWC_PartNumMgr_DID_F194_Supplier_Ecu_SW_PartNum_DefaultValue, RteNvmBlockRef=SWC_PartNumMgrDID_F194_Supplier_Ecu_SW_PartNum, RteSwNvRamMappingRef=DID_F194_Supplier_Ecu_SW_PartNum
          NvmBlock_SWC_PartNumMgr_DID_F18B_FCA_ESLM_ECU_SW_App_Num: RteNvmRamBlockLocationSymbol=Rte_SWC_PartNumMgr_DID_F18B_FCA_ESLM_ECU_SW_App_Num_MirrorBlock, RteNvmRomBlockLocationSymbol=Rte_SWC_PartNumMgr_DID_F18B_FCA_ESLM_ECU_SW_App_Num_DefaultValue, RteNvmBlockRef=SWC_PartNumMgrDID_F18B_FCA_ESLM_ECU_SW_App_Num, RteSwNvRamMappingRef=DID_F18B_FCA_ESLM_ECU_SW_App_Num
          NvmBlock_SWC_PartNumMgr_DID_F18A_FCA_ESLM_Ecu_SW_Cal_Num: RteNvmRamBlockLocationSymbol=Rte_SWC_PartNumMgr_DID_F18A_FCA_ESLM_Ecu_SW_Cal_Num_MirrorBlock, RteNvmRomBlockLocationSymbol=Rte_SWC_PartNumMgr_DID_F18A_FCA_ESLM_Ecu_SW_Cal_Num_DefaultValue, RteNvmBlockRef=SWC_PartNumMgrDID_F18A_FCA_ESLM_Ecu_SW_Cal_Num, RteSwNvRamMappingRef=DID_F18A_FCA_ESLM_Ecu_SW_Cal_Num
          NvmBlock_SWC_PartNumMgr_DID_F188_FCA_ESLM_Ecu_SW_Num: RteNvmRamBlockLocationSymbol=Rte_SWC_PartNumMgr_DID_F188_FCA_ESLM_Ecu_SW_Num_MirrorBlock, RteNvmRomBlockLocationSymbol=Rte_SWC_PartNumMgr_DID_F188_FCA_ESLM_Ecu_SW_Num_DefaultValue, RteNvmBlockRef=SWC_PartNumMgrDID_F188_FCA_ESLM_Ecu_SW_Num, RteSwNvRamMappingRef=DID_F188_FCA_ESLM_Ecu_SW_Num
          NvmBlock_SWC_PartNumMgr_DID_F187_CODEP_Ecu_PartNum: RteNvmRamBlockLocationSymbol=Rte_SWC_PartNumMgr_DID_F187_CODEP_Ecu_PartNum_MirrorBlock, RteNvmRomBlockLocationSymbol=Rte_SWC_PartNumMgr_DID_F187_CODEP_Ecu_PartNum_DefaultValue, RteNvmBlockRef=SWC_PartNumMgrDID_F187_CODEP_Ecu_PartNum, RteSwNvRamMappingRef=DID_F187_CODEP_Ecu_PartNum
          NvmBlock_SWC_PartNumMgr_DID_F180_Boot_SW_Ver_Info: RteNvmRamBlockLocationSymbol=Rte_SWC_PartNumMgr_DID_F180_Boot_SW_Ver_Info_MirrorBlock, RteNvmRomBlockLocationSymbol=Rte_SWC_PartNumMgr_DID_F180_Boot_SW_Ver_Info_DefaultValue, RteNvmBlockRef=SWC_PartNumMgrDID_F180_Boot_SW_Ver_Info, RteSwNvRamMappingRef=DID_F180_Boot_SW_Ver_Info
          NvmBlock_SWC_PartNumMgr_DID_F134_CODEP_Asm_PartNum: RteNvmRamBlockLocationSymbol=Rte_SWC_PartNumMgr_DID_F134_CODEP_Asm_PartNum_MirrorBlock, RteNvmRomBlockLocationSymbol=Rte_SWC_PartNumMgr_DID_F134_CODEP_Asm_PartNum_DefaultValue, RteNvmBlockRef=SWC_PartNumMgrDID_F134_CODEP_Asm_PartNum, RteSwNvRamMappingRef=DID_F134_CODEP_Asm_PartNum
          NvmBlock_SWC_PartNumMgr_DID_F133_EBOM_Asm_PartNum: RteNvmRamBlockLocationSymbol=Rte_SWC_PartNumMgr_DID_F133_EBOM_Asm_PartNum_MirrorBlock, RteNvmRomBlockLocationSymbol=Rte_SWC_PartNumMgr_DID_F133_EBOM_Asm_PartNum_DefaultValue, RteNvmBlockRef=SWC_PartNumMgrDID_F133_EBOM_Asm_PartNum, RteSwNvRamMappingRef=DID_F133_EBOM_Asm_PartNum
          NvmBlock_SWC_PartNumMgr_DID_F132_EBOM_Ecu_PartNum: RteNvmRamBlockLocationSymbol=Rte_SWC_PartNumMgr_DID_F132_EBOM_Ecu_PartNum_MirrorBlock, RteNvmRomBlockLocationSymbol=Rte_SWC_PartNumMgr_DID_F132_EBOM_Ecu_PartNum_DefaultValue, RteNvmBlockRef=SWC_PartNumMgrDID_F132_EBOM_Ecu_PartNum, RteSwNvRamMappingRef=DID_F132_EBOM_Ecu_PartNum
          NvmBlock_SWC_PartNumMgr_DID_F110_Ecu_Diag_Info: RteNvmRamBlockLocationSymbol=Rte_SWC_PartNumMgr_DID_F110_Ecu_Diag_Info_MirrorBlock, RteNvmRomBlockLocationSymbol=Rte_SWC_PartNumMgr_DID_F110_Ecu_Diag_Info_DefaultValue, RteNvmBlockRef=SWC_PartNumMgrDID_F110_Ecu_Diag_Info, RteSwNvRamMappingRef=DID_F110_Ecu_Diag_Info
        OIT_RE_NvM_RpNotifyJobEnd_NvMBlockDescriptor_MetaData_JobFinished_NvM_RpNotifyJobEnd_NvMBlockDescriptor_MetaData_JobFinished (RteEventToTaskMapping):
          RteImmediateRestart = false
          RteEventRef = OIT_RE_NvM_RpNotifyJobEnd_NvMBlockDescriptor_MetaData_JobFinished_NvM_RpNotifyJobEnd_NvMBlockDescriptor_MetaData_JobFinished
        NvmBlock_SWC_PartNumMgr_UssSensorMarrData (RteNvRamAllocation):
          RteNvmRamBlockLocationSymbol = Rte_SWC_PartNumMgr_UssSensorMarrData_MirrorBlock
          RteNvmRomBlockLocationSymbol = Rte_SWC_PartNumMgr_UssSensorMarrData_DefaultValue
          RteNvmBlockRef = SWC_PartNumMgrUssSensorMarrData
          RteSwNvRamMappingRef = UssSensorMarrData
      SWC_ProxiConfigMgr_EcuSwComposition: RteSoftwareComponentInstanceRef=SWC_ProxiConfigMgr
        InitEvent (RteEventToTaskMapping): RteImmediateRestart=false, RtePositionInTask=4, RteEventRef=InitEvent, RteMappedToTaskRef=Safety_Task_Init
        TMT_RE_ProxiConfigMgr_Main (RteEventToTaskMapping):
          RteImmediateRestart = false
          RtePositionInTask = 5
          RteEventRef = TMT_RE_ProxiConfigMgr_Main
          RteMappedToTaskRef = Safety_Task_00_10ms
          RteUsedOsAlarmRef = Rte_Al_TE_Safety_Task_00_10ms_0_10ms
        NvmBlock_SWC_ProxiConfigMgr_ProxiConfigTable (RteNvRamAllocation): RteNvmBlockRef=SWC_ProxiConfigMgrProxiConfigTable, RteSwNvRamMappingRef=ProxiConfigTable
        NvmBlock_SWC_ProxiConfigMgr_ProxiErrorData (RteNvRamAllocation): RteNvmBlockRef=SWC_ProxiConfigMgrProxiErrorData, RteSwNvRamMappingRef=ProxiErrorData
        OIT_RE_DID2023_ProxiData_Pp_2023_ProxiData_WriteData (RteEventToTaskMapping): RteImmediateRestart=false, RteEventRef=OIT_RE_DID2023_ProxiData_Pp_2023_ProxiData_WriteData
        DRT_RE_ProxiMgr_ConfigDataRSP_RpFromComFD02Rx_Digit_01 (RteEventToTaskMapping):
          RteImmediateRestart = false
          RtePositionInTask = 2
          RteEventRef = DRT_RE_ProxiMgr_ConfigDataRSP_RpFromComFD02Rx_Digit_01
          RteMappedToTaskRef = Safety_Task_200ms
          RteUsedOsEventRef = Rte_Ev_Run_SWC_ProxiConfigMgr_RE_ProxiMgr_ConfigDataRSP
      SWC_RIDManager_EcuSwComposition: RteSoftwareComponentInstanceRef=SWC_RIDMgr
        22 x RteEventToTaskMapping, all with RteImmediateRestart=false:
          InitEvent: RtePositionInTask=13, RteEventRef=InitEvent, RteMappedToTaskRef=QM_Task_Init
          TMT_RE_RIDMgr_Main: RtePositionInTask=8, RteEventRef=TMT_RE_RIDMgr_Main, RteMappedToTaskRef=QM_Task_00_10ms, RteUsedOsAlarmRef=Rte_Al_TE_QM_Task_00_10ms_0_10ms
          OIT_RoutineServices_Routine_31015401_Camera_Service_Calibration_Start_RequestResults_RoutineServices_Routine_31015401_Ca69CD58AC: RteEventRef=OIT_RoutineServices_Routine_31015401_Camera_Service_Calibration_Start_RequestResults_RoutineServices_Routine_31015401_Ca69CD58AC
          OIT_RoutineServices_Routine_31015401_Camera_Service_Calibration_Start_Start_RoutineServices_Routine_31015401_Camera_Serv0FB43942: RteEventRef=OIT_RoutineServices_Routine_31015401_Camera_Service_Calibration_Start_Start_RoutineServices_Routine_31015401_Camera_Serv0FB43942
          OIT_RoutineServices_Routine_3101FE02_Test_Write_PMIC_Register_Start_Start_RoutineServices_Routine_3101FE02_Test_Write_PMC3ED047F: RteEventRef=OIT_RoutineServices_Routine_3101FE02_Test_Write_PMIC_Register_Start_Start_RoutineServices_Routine_3101FE02_Test_Write_PMC3ED047F
          OIT_RoutineServices_Routine_3101D002_Check_Programming_Preconditions_Start_Start_RoutineServices_Routine_3101D002_Check_C7D56839: RteEventRef=OIT_RoutineServices_Routine_3101D002_Check_Programming_Preconditions_Start_Start_RoutineServices_Routine_3101D002_Check_C7D56839
          OIT_RoutineServices_Routine_3101FE01_Calibration_Data_Reset_Start_Start_RoutineServices_Routine_3101FE01_Calibration_Dat507DEF71: RteEventRef=OIT_RoutineServices_Routine_3101FE01_Calibration_Data_Reset_Start_Start_RoutineServices_Routine_3101FE01_Calibration_Dat507DEF71
          OIT_RoutineServices_Routine_31015400_Camera_EOL_Calibration_Start_RequestResults_RoutineServices_Routine_31015400_Camera5A023B1D: RteEventRef=OIT_RoutineServices_Routine_31015400_Camera_EOL_Calibration_Start_RequestResults_RoutineServices_Routine_31015400_Camera5A023B1D
          OIT_RoutineServices_Routine_31015400_Camera_EOL_Calibration_Start_Start_RoutineServices_Routine_31015400_Camera_EOL_CaliD5BE38B6: RteEventRef=OIT_RoutineServices_Routine_31015400_Camera_EOL_Calibration_Start_Start_RoutineServices_Routine_31015400_Camera_EOL_CaliD5BE38B6
          OIT_RoutineServices_Routine_3101D001_Disable_Fail_safe_reaction_Start_Stop_RoutineServices_Routine_3101D001_Disable_Fail2F69EAF9: RteEventRef=OIT_RoutineServices_Routine_3101D001_Disable_Fail_safe_reaction_Start_Stop_RoutineServices_Routine_3101D001_Disable_Fail2F69EAF9
          OIT_RoutineServices_Routine_3101D001_Disable_Fail_safe_reaction_Start_Start_RoutineServices_Routine_3101D001_Disable_Fai3D5C2E21: RteEventRef=OIT_RoutineServices_Routine_3101D001_Disable_Fail_safe_reaction_Start_Start_RoutineServices_Routine_3101D001_Disable_Fai3D5C2E21
          OIT_RoutineServices_Routine_3101FE0E_Test_Pattern_Control_Start_Stop_RoutineServices_Routine_3101FE0E_Test_Pattern_ContrE8513346: RteEventRef=OIT_RoutineServices_Routine_3101FE0E_Test_Pattern_Control_Start_Stop_RoutineServices_Routine_3101FE0E_Test_Pattern_ContrE8513346
          OIT_RoutineServices_Routine_3101FE0E_Test_Pattern_Control_Start_Start_RoutineServices_Routine_3101FE0E_Test_Pattern_Cont02E14D23: RteEventRef=OIT_RoutineServices_Routine_3101FE0E_Test_Pattern_Control_Start_Start_RoutineServices_Routine_3101FE0E_Test_Pattern_Cont02E14D23
          OIT_RoutineServices_Routine_31015000_Park_Assist_ON_OFF_State_Start_Start_RoutineServices_Routine_31015000_Park_Assist_O8F767708: RteEventRef=OIT_RoutineServices_Routine_31015000_Park_Assist_ON_OFF_State_Start_Start_RoutineServices_Routine_31015000_Park_Assist_O8F767708
          OIT_RoutineServices_Routine_31015101_Sensor_Functional_Test_Start_Start_RoutineServices_Routine_31015101_Sensor_Function13ED820E: RteEventRef=OIT_RoutineServices_Routine_31015101_Sensor_Functional_Test_Start_Start_RoutineServices_Routine_31015101_Sensor_Function13ED820E
          OIT_RoutineServices_Routine_3101FF03_Test_Read_PMIC_Register_Start_Start_RoutineServices_Routine_3101FF03_Test_Read_PMIC2631FDF8: RteEventRef=OIT_RoutineServices_Routine_3101FF03_Test_Read_PMIC_Register_Start_Start_RoutineServices_Routine_3101FF03_Test_Read_PMIC2631FDF8
          OIT_RoutineServices_Routine_31011000_USS_Debug_Signals_Enable_Disable_Start_Start_RoutineServices_Routine_31011000_USS_D9FD5E355: RteEventRef=OIT_RoutineServices_Routine_31011000_USS_Debug_Signals_Enable_Disable_Start_Start_RoutineServices_Routine_31011000_USS_D9FD5E355
          OIT_RoutineServices_Routine_31013000_XCP_Enable_Disable_Start_Start_RoutineServices_Routine_31013000_XCP_Enable_Disable_C573A1F8: RteEventRef=OIT_RoutineServices_Routine_31013000_XCP_Enable_Disable_Start_Start_RoutineServices_Routine_31013000_XCP_Enable_Disable_C573A1F8
          OIT_RoutineServices_Routine_31012000_Original_VIN_Lock_Start_RoutineServices_Routine_31012000_Original_VIN_Lock_Start: RteEventRef=OIT_RoutineServices_Routine_31012000_Original_VIN_Lock_Start_RoutineServices_Routine_31012000_Original_VIN_Lock_Start
          OIT_RoutineServices_Routine_31012001_Original_VIN_Unlock_Start_RoutineServices_Routine_31012001_Original_VIN_Unlock_Start: RteEventRef=OIT_RoutineServices_Routine_31012001_Original_VIN_Unlock_Start_RoutineServices_Routine_31012001_Original_VIN_Unlock_Start
          OIT_RoutineServices_Routine_31015200_Plant_Mode_Routine_Start_RequestResults_RoutineServices_Routine_31015200_Plant_Mode9795A8F2: RteEventRef=OIT_RoutineServices_Routine_31015200_Plant_Mode_Routine_Start_RequestResults_RoutineServices_Routine_31015200_Plant_Mode9795A8F2
          OIT_RoutineServices_Routine_31015200_Plant_Mode_Routine_Start_Start_RoutineServices_Routine_31015200_Plant_Mode_Routine_4849FA1C: RteEventRef=OIT_RoutineServices_Routine_31015200_Plant_Mode_Routine_Start_Start_RoutineServices_Routine_31015200_Plant_Mode_Routine_4849FA1C
        5 x RteNvRamAllocation:
          NvmBlock_SWC_RIDMgr_VIN_Lock: RteNvmRamBlockLocationSymbol=Rte_SWC_RIDMgr_VIN_Lock_MirrorBlock, RteNvmRomBlockLocationSymbol=Rte_SWC_RIDMgr_VIN_Lock_DefaultValue, RteNvmBlockRef=SWC_RIDMgrVIN_Lock, RteSwNvRamMappingRef=VIN_Lock
          NvmBlock_SWC_RIDMgr_VIN_OdometerCnt: RteNvmRamBlockLocationSymbol=Rte_SWC_RIDMgr_VIN_OdometerCnt_MirrorBlock, RteNvmRomBlockLocationSymbol=Rte_SWC_RIDMgr_VIN_OdometerCnt_DefaultValue, RteNvmBlockRef=SWC_RIDMgrVIN_OdometerCnt, RteSwNvRamMappingRef=VIN_OdometerCnt
          NvmBlock_SWC_RIDMgr_VIN_OriginalVal: RteNvmRamBlockLocationSymbol=Rte_SWC_RIDMgr_VIN_OriginalVal_MirrorBlock, RteNvmRomBlockLocationSymbol=Rte_SWC_RIDMgr_VIN_OriginalVal_DefaultValue, RteNvmBlockRef=SWC_RIDMgrVIN_OriginalVal, RteSwNvRamMappingRef=VIN_OriginalVal
          NvmBlock_SWC_RIDMgr_VIN_CurrentVal: RteNvmRamBlockLocationSymbol=Rte_SWC_RIDMgr_VIN_CurrentVal_MirrorBlock, RteNvmRomBlockLocationSymbol=Rte_SWC_RIDMgr_VIN_CurrentVal_DefaultValue, RteNvmBlockRef=SWC_RIDMgrVIN_CurrentVal, RteSwNvRamMappingRef=VIN_CurrentVal
          NvmBlock_SWC_RIDMgr_DID_5201_PlantModeStatus: RteNvmRamBlockLocationSymbol=Rte_SWC_RIDMgr_DID_5201_PlantModeStatus_MirrorBlock, RteNvmRomBlockLocationSymbol=Rte_SWC_RIDMgr_DID_5201_PlantModeStatus_DefaultValue, RteNvmBlockRef=SWC_RIDMgrDID_5201_PlantModeStatus, RteSwNvRamMappingRef=DID_5201_PlantModeStatus
        OIT_RoutineServices_Routine_31015502_TRSC_Trailer_Calibration_Memory_Clear_Start_RequestResults_RoutineServices_Routine_7EF2C9E4 (RteEventToTaskMapping):
          RteImmediateRestart = false
          RteEventRef = OIT_RoutineServices_Routine_31015502_TRSC_Trailer_Calibration_Memory_Clear_Start_RequestResults_RoutineServices_Routine_7EF2C9E4
        OIT_RoutineServices_Routine_31015502_TRSC_Trailer_Calibration_Memory_Clear_Start_Start_RoutineServices_Routine_31015502_0D41E251 (RteEventToTaskMapping):
          RteImmediateRestart = false
          RteEventRef = OIT_RoutineServices_Routine_31015502_TRSC_Trailer_Calibration_Memory_Clear_Start_Start_RoutineServices_Routine_31015502_0D41E251
    5 x RteSwComponentType:
      SWC_DIDMgr: RteComponentTypeRef=SWC_DIDMgr, RteImplementationRef=SWC_DIDMgr_Implementation
        ComponentTypeCalibration (RteComponentTypeCalibration): RteCalibrationSupportEnabled=false
      SWC_DTCManager: RteComponentTypeRef=SWC_DTCMgr, RteImplementationRef=SWC_DTCMgr_Implementation
        ComponentTypeCalibration (RteComponentTypeCalibration): RteCalibrationSupportEnabled=false
      SWC_PartNumMgr: RteComponentTypeRef=SWC_PartNumMgr, RteImplementationRef=SWC_PartNumMgr_Implementation
        ComponentTypeCalibration (RteComponentTypeCalibration): RteCalibrationSupportEnabled=false
      SWC_ProxiConfigMgr: RteComponentTypeRef=SWC_ProxiConfigMgr, RteImplementationRef=SWC_ProxiConfigMgr_Implementation
        ComponentTypeCalibration (RteComponentTypeCalibration): RteCalibrationSupportEnabled=false
      SWC_RIDManager: RteComponentTypeRef=SWC_RIDMgr, RteImplementationRef=SWC_RIDMgr_Implementation
        ComponentTypeCalibration (RteComponentTypeCalibration): RteCalibrationSupportEnabled=false
    SWC_VoltageManager_EcuSwComposition (RteSwComponentInstance): RteSoftwareComponentInstanceRef=SWC_VoltageMgr
      3 x RteEventToTaskMapping, all with RteImmediateRestart=false:
        InitEvent: RtePositionInTask=3, RteEventRef=InitEvent, RteMappedToTaskRef=QM_Task_Init
        TMT_RE_VoltageMgr_Main: RtePositionInTask=2, RteEventRef=TMT_RE_VoltageMgr_Main, RteMappedToTaskRef=QM_Task_00_10ms, RteUsedOsAlarmRef=Rte_Al_TE_QM_Task_00_10ms_0_10ms
        OIT_RE_VoltageMgr_EtGetADCVoltageInfo_PpReadVoltInfo_GetVoltageInfo: RteEventRef=OIT_RE_VoltageMgr_EtGetADCVoltageInfo_PpReadVoltInfo_GetVoltageInfo
    SWC_VoltageManager (RteSwComponentType): RteComponentTypeRef=SWC_VoltageMgr, RteImplementationRef=SWC_VoltageMgr_Implementation
      ComponentTypeCalibration (RteComponentTypeCalibration): RteCalibrationSupportEnabled=false
    SWC_KinematicModule_EcuSwComposition (RteSwComponentInstance): RteSoftwareComponentInstanceRef=SWC_KinematicModule
      InitEvent (RteEventToTaskMapping): RteImmediateRestart=false, RtePositionInTask=14, RteEventRef=InitEvent, RteMappedToTaskRef=QM_Task_Init
      TMT_RE_KinematicModule_Main (RteEventToTaskMapping):
        RteImmediateRestart = false
        RtePositionInTask = 11
        RteEventRef = TMT_RE_KinematicModule_Main
        RteMappedToTaskRef = QM_Task_00_10ms
        RteUsedOsAlarmRef = Rte_Al_TE_QM_Task_00_10ms_0_10ms
    SWC_KinematicModule (RteSwComponentType): RteComponentTypeRef=SWC_KinematicModule, RteImplementationRef=SWC_KinematicModule_Implementation
      ComponentTypeCalibration (RteComponentTypeCalibration): RteCalibrationSupportEnabled=false
    CDD_GenericBswM_EcuSwComposition (RteSwComponentInstance): RteSoftwareComponentInstanceRef=CDD_GenericBswM
      10 x RteEventToTaskMapping, all with RteImmediateRestart=false:
        InitEvent: RtePositionInTask=5, RteEventRef=InitEvent, RteMappedToTaskRef=QM_Task_Init
        TMT_RE_GenBswSysMgr_Main: RtePositionInTask=13, RteEventRef=TMT_RE_GenBswSysMgr_Main, RteMappedToTaskRef=QM_Task_00_10ms, RteUsedOsAlarmRef=Rte_Al_TE_QM_Task_00_10ms_0_10ms
        MST_RE_GenericBswM_HARDResetReq_0: RtePositionInTask=3, RteEventRef=MST_RE_GenericBswM_HARDResetReq_0, RteMappedToTaskRef=QM_Task_200ms, RteUsedOsEventRef=Rte_Ev_InternalEventHandling
        MST_RE_GenericBswM_JumpToBootReq_0: RtePositionInTask=4, RteEventRef=MST_RE_GenericBswM_JumpToBootReq_0, RteMappedToTaskRef=QM_Task_200ms, RteUsedOsEventRef=Rte_Ev_InternalEventHandling
        MST_RE_UpdateNMState_{0..5}: RtePositionInTask=5, RteEventRef=MST_RE_UpdateNMState_{0..5}, RteMappedToTaskRef=QM_Task_200ms, RteUsedOsEventRef=Rte_Ev_InternalEventHandling
    CDD_GenericBswM (RteSwComponentType): RteComponentTypeRef=CDD_GenericBswM, RteImplementationRef=CDD_GenericBswM_Implementation
      ComponentTypeCalibration (RteComponentTypeCalibration): RteCalibrationSupportEnabled=false
    CDD_E2EWrapper_EcuSwComposition (RteSwComponentInstance): RteSoftwareComponentInstanceRef=CDD_E2EWrapper
      3 x RteEventToTaskMapping, all with RteImmediateRestart=false:
        InitEvent: RtePositionInTask=6, RteEventRef=InitEvent, RteMappedToTaskRef=Safety_Task_Init
        OIT_RE_E2EWrapperCheck_PpE2EServices_ME_E2E_Check: RteEventRef=OIT_RE_E2EWrapperCheck_PpE2EServices_ME_E2E_Check
        OIT_RE_E2EWrapperProtect_PpE2EServices_ME_E2E_Protect: RteEventRef=OIT_RE_E2EWrapperProtect_PpE2EServices_ME_E2E_Protect
    CDD_IPCHandler_EcuSwComposition (RteSwComponentInstance): RteSoftwareComponentInstanceRef=CDD_IPCHandler
      3 x RteEventToTaskMapping, all with RteImmediateRestart=false:
        TMT_RE_IPCHandler_Main: RtePositionInTask=2, RteEventRef=TMT_RE_IPCHandler_Main, RteMappedToTaskRef=Safety_Task_01_10ms, RteUsedOsAlarmRef=Rte_Al_TE_Safety_Task_01_10ms_0_10ms
        OIT_RE_IpcTxData_PpIpcTxData_IPC_Write_v: RteEventRef=OIT_RE_IpcTxData_PpIpcTxData_IPC_Write_v
        CDD_IPCHandler_InitEvent: RtePositionInTask=3, RteEventRef=CDD_IPCHandler_InitEvent, RteMappedToTaskRef=Safety_Task_Init
      NvmBlock_CDD_IPCHandler_FeatureAP_HMI_NvMData (RteNvRamAllocation): RteNvmBlockRef=CDD_IPCHandlerFeatureAP_HMI_NvMData, RteSwNvRamMappingRef=FeatureAP_HMI_NvMData
      NvmBlock_CDD_IPCHandler_FPA_Slot_Data (RteNvRamAllocation): RteNvmBlockRef=CDD_IPCHandlerFPA_SlotData, RteSwNvRamMappingRef=FPA_SlotData
    CDD_IPCHandler (RteSwComponentType): RteComponentTypeRef=CDD_IPCHandler, RteImplementationRef=CDD_IPCHandler_Implementation
      ComponentTypeCalibration (RteComponentTypeCalibration): RteCalibrationSupportEnabled=false
    6 x RteSwComponentInstance:
      DegManager_B_EcuSwComposition: RteSoftwareComponentInstanceRef=DegManager_B
        TMT_RE_Periodic_DegManager_B (RteEventToTaskMapping):
          RteImmediateRestart = false
          RtePositionInTask = 5
          RteEventRef = TMT_RE_Periodic_DegManager_B
          RteUsedOsAlarmRef = Rte_Al_TE_Safety_Task_01_10ms_0_10ms
          RteMappedToTaskRef = Safety_Task_01_10ms
        InitEvent (RteEventToTaskMapping): RteImmediateRestart=false, RtePositionInTask=9, RteEventRef=InitEvent, RteMappedToTaskRef=Safety_Task_Init
      DegManager_QM_EcuSwComposition: RteSoftwareComponentInstanceRef=DegManager_QM
        TMT_RE_Periodic_DegManager_QM (RteEventToTaskMapping):
          RteImmediateRestart = false
          RtePositionInTask = 3
          RteEventRef = TMT_RE_Periodic_DegManager_QM
          RteMappedToTaskRef = QM_Task_01_10ms
          RteUsedOsAlarmRef = Rte_Al_TE_QM_Task_01_10ms_0_10ms
        InitEvent (RteEventToTaskMapping): RteImmediateRestart=false, RtePositionInTask=12, RteEventRef=InitEvent, RteMappedToTaskRef=QM_Task_Init
      ErrorMgrAgg_1_0_B_EcuSwComposition: RteSoftwareComponentInstanceRef=ErrorMgrAgg_1_0_B
        TMT_RE_Periodic_ErrorMgrAgg_1_0_B (RteEventToTaskMapping):
          RteImmediateRestart = false
          RtePositionInTask = 4
          RteEventRef = TMT_RE_Periodic_ErrorMgrAgg_1_0_B
          RteMappedToTaskRef = Safety_Task_01_10ms
          RteUsedOsAlarmRef = Rte_Al_TE_Safety_Task_01_10ms_0_10ms
        InitEvent (RteEventToTaskMapping): RteImmediateRestart=false, RtePositionInTask=7, RteEventRef=InitEvent, RteMappedToTaskRef=Safety_Task_Init
      ErrorMgrAgg_1_0_QM_EcuSwComposition: RteSoftwareComponentInstanceRef=ErrorMgrAgg_1_0_QM
        TMT_RE_Periodic_ErrorMgrAgg_1_0_QM (RteEventToTaskMapping):
          RteImmediateRestart = false
          RtePositionInTask = 2
          RteEventRef = TMT_RE_Periodic_ErrorMgrAgg_1_0_QM
          RteMappedToTaskRef = QM_Task_01_10ms
          RteUsedOsAlarmRef = Rte_Al_TE_QM_Task_01_10ms_0_10ms
        InitEvent (RteEventToTaskMapping): RteImmediateRestart=false, RtePositionInTask=6, RteEventRef=InitEvent, RteMappedToTaskRef=QM_Task_Init
      ErrorMgrSat_1_0_B_EcuSwComposition: RteSoftwareComponentInstanceRef=ErrorMgrSat_1_0_B
        3 x RteEventToTaskMapping, all with RteImmediateRestart=false:
          TMT_RE_Periodic_ErrorMgrSat_1_0_B: RtePositionInTask=3, RteEventRef=TMT_RE_Periodic_ErrorMgrSat_1_0_B, RteMappedToTaskRef=Safety_Task_01_10ms, RteUsedOsAlarmRef=Rte_Al_TE_Safety_Task_01_10ms_0_10ms
          InitEvent: RtePositionInTask=5, RteEventRef=InitEvent, RteMappedToTaskRef=Safety_Task_Init
          OIT_RE_ReportErrorStatus1_0_B_P_Error_ReportErrorStatus1_0_B: RteEventRef=OIT_RE_ReportErrorStatus1_0_B_P_Error_ReportErrorStatus1_0_B
      ErrorMgrSat_1_0_QM_EcuSwComposition: RteSoftwareComponentInstanceRef=ErrorMgrSat_1_0_QM
        3 x RteEventToTaskMapping, all with RteImmediateRestart=false:
          TMT_RE_Periodic_ErrorMgrSat_1_0_QM: RtePositionInTask=1, RteEventRef=TMT_RE_Periodic_ErrorMgrSat_1_0_QM, RteMappedToTaskRef=QM_Task_01_10ms, RteUsedOsAlarmRef=Rte_Al_TE_QM_Task_01_10ms_0_10ms
          InitEvent: RtePositionInTask=4, RteEventRef=InitEvent, RteMappedToTaskRef=QM_Task_Init
          OIT_RE_ReportErrorStatus1_0_QM_P_Error_ReportErrorStatus1_0_QM: RteEventRef=OIT_RE_ReportErrorStatus1_0_QM_P_Error_ReportErrorStatus1_0_QM
    6 x RteSwComponentType:
      DegManager_B: RteComponentTypeRef=DegManager_B, RteImplementationRef=DegManager_B_Implementation
        ComponentTypeCalibration (RteComponentTypeCalibration): RteCalibrationSupportEnabled=false
      DegManager_QM: RteComponentTypeRef=DegManager_QM, RteImplementationRef=DegManager_QM_Implementation
        ComponentTypeCalibration (RteComponentTypeCalibration): RteCalibrationSupportEnabled=false
      ErrorMgrAgg_1_0_B: RteComponentTypeRef=ErrorMgrAgg_1_0_B, RteImplementationRef=ErrorMgrAgg_1_0_B_Implementation
        ComponentTypeCalibration (RteComponentTypeCalibration): RteCalibrationSupportEnabled=false
      ErrorMgrAgg_1_0_QM: RteComponentTypeRef=ErrorMgrAgg_1_0_QM, RteImplementationRef=ErrorMgrAgg_1_0_QM_Implementation
        ComponentTypeCalibration (RteComponentTypeCalibration): RteCalibrationSupportEnabled=false
      ErrorMgrSat_1_0_B: RteComponentTypeRef=ErrorMgrSat_1_0_B, RteImplementationRef=ErrorMgrSat_1_0_B_Implementation
        ComponentTypeCalibration (RteComponentTypeCalibration): RteCalibrationSupportEnabled=false
      ErrorMgrSat_1_0_QM: RteComponentTypeRef=ErrorMgrSat_1_0_QM, RteImplementationRef=ErrorMgrSat_1_0_QM_Implementation
        ComponentTypeCalibration (RteComponentTypeCalibration): RteCalibrationSupportEnabled=false
    SSM_Master_EcuSwComposition (RteSwComponentInstance): RteSoftwareComponentInstanceRef=SSM_Master
      TMT_RE_Periodic_SSM_Master (RteEventToTaskMapping):
        RteImmediateRestart = false
        RtePositionInTask = 9
        RteEventRef = TMT_RE_Periodic_SSM_Master
        RteMappedToTaskRef = QM_Task_00_10ms
        RteUsedOsAlarmRef = Rte_Al_TE_QM_Task_00_10ms_0_10ms
      InitEvent (RteEventToTaskMapping): RteImmediateRestart=false, RtePositionInTask=10, RteEventRef=InitEvent, RteMappedToTaskRef=QM_Task_Init
    SSM_Slave_1_0_EcuSwComposition (RteSwComponentInstance): RteSoftwareComponentInstanceRef=SSM_Slave_1_0
      TMT_RE_Periodic_SSM_Slave (RteEventToTaskMapping):
        RteImmediateRestart = false
        RtePositionInTask = 10
        RteEventRef = TMT_RE_Periodic_SSM_Slave
        RteMappedToTaskRef = QM_Task_00_10ms
        RteUsedOsAlarmRef = Rte_Al_TE_QM_Task_00_10ms_0_10ms
      InitEvent (RteEventToTaskMapping): RteImmediateRestart=false, RtePositionInTask=11, RteEventRef=InitEvent, RteMappedToTaskRef=QM_Task_Init
    SSM_Master (RteSwComponentType): RteComponentTypeRef=SSM_Master, RteImplementationRef=SSM_Master_Implementation
      ComponentTypeCalibration (RteComponentTypeCalibration): RteCalibrationSupportEnabled=false
    SSM_Slave_1_0 (RteSwComponentType): RteComponentTypeRef=SSM_Slave_1_0, RteImplementationRef=SSM_Slave_1_0_Implementation
      ComponentTypeCalibration (RteComponentTypeCalibration): RteCalibrationSupportEnabled=false
    CalDataProvider_EcuSwComposition (RteSwComponentInstance): RteSoftwareComponentInstanceRef=CalDataProvider
      4 x RteNvRamAllocation:
        NvmBlock_CalDataProvider_SVSCamEOLCalibData: RteNvmBlockRef=CalDataProviderSVSCamEOLCalibData, RteSwNvRamMappingRef=SVSCamEOLCalibData
        NvmBlock_CalDataProvider_SVSCamSCCalibData: RteNvmBlockRef=CalDataProviderSVSCamSCCalibData, RteSwNvRamMappingRef=SVSCamSCCalibData
        NvmBlock_CalDataProvider_SVSCamOCCalibData: RteNvmBlockRef=CalDataProviderSVSCamOCCalibData, RteSwNvRamMappingRef=SVSCamOCCalibData
        NvmBlock_CalDataProvider_SVSCamCurrentCalibData: RteNvmBlockRef=CalDataProviderSVSCamCurrentCalibData, RteSwNvRamMappingRef=SVSCamCurrentCalibData
      7 x RteEventToTaskMapping, all with RteImmediateRestart=false:
        TMT_RE_Periodic_CalDataProvider: RtePositionInTask=6, RteEventRef=TMT_RE_Periodic_CalDataProvider, RteMappedToTaskRef=Safety_Task_00_10ms, RteUsedOsAlarmRef=Rte_Al_TE_Safety_Task_00_10ms_0_10ms
        InitEvent: RtePositionInTask=8, RteEventRef=InitEvent, RteMappedToTaskRef=Safety_Task_Init
        OIT_RE_P_CalDataProvider_Nvm_SVSCamSCCalibData_WriteBlock_P_CalDataProvider_Nvm_SVSCamSCCalibData_WriteBlock: RteEventRef=OIT_RE_P_CalDataProvider_Nvm_SVSCamSCCalibData_WriteBlock_P_CalDataProvider_Nvm_SVSCamSCCalibData_WriteBlock
        OIT_RE_P_CalDataProvider_Nvm_SVSCamOCCalibData_WriteBlock_P_CalDataProvider_Nvm_SVSCamOCCalibData_WriteBlock: RteEventRef=OIT_RE_P_CalDataProvider_Nvm_SVSCamOCCalibData_WriteBlock_P_CalDataProvider_Nvm_SVSCamOCCalibData_WriteBlock
        OIT_RE_P_CalDataProvider_Nvm_SVSCamCurrentCalibData_WriteBlock_P_CalDataProvider_Nvm_SVSCamCurrentCalibData_WriteBlock: RteEventRef=OIT_RE_P_CalDataProvider_Nvm_SVSCamCurrentCalibData_WriteBlock_P_CalDataProvider_Nvm_SVSCamCurrentCalibData_WriteBlock
        OIT_RE_P_CalDataProvider_Nvm_SVSCamEOLCalibData_WriteBlock_P_CalDataProvider_Nvm_SVSCamEOLCalibData_WriteBlock: RteEventRef=OIT_RE_P_CalDataProvider_Nvm_SVSCamEOLCalibData_WriteBlock_P_CalDataProvider_Nvm_SVSCamEOLCalibData_WriteBlock
        OIT_RE_P_SVSCamCalibReset_WriteBlock_P_SVSCamCalibReset_WriteBlock: RteEventRef=OIT_RE_P_SVSCamCalibReset_WriteBlock_P_SVSCamCalibReset_WriteBlock
      4 x RteNvRamAllocation:
        NvmBlock_CalDataProvider_FrontCamSerialNumber: RteNvmBlockRef=CalDataProviderFrontCamSerialNumber, RteSwNvRamMappingRef=FrontCamSerialNumber
        NvmBlock_CalDataProvider_LeftCamSerialNumber: RteNvmBlockRef=CalDataProviderLeftCamSerialNumber, RteSwNvRamMappingRef=LeftCamSerialNumber
        NvmBlock_CalDataProvider_RearCamSerialNumber: RteNvmBlockRef=CalDataProviderRearCamSerialNumber, RteSwNvRamMappingRef=RearCamSerialNumber
        NvmBlock_CalDataProvider_RightCamSerialNumber: RteNvmBlockRef=CalDataProviderRightCamSerialNumber, RteSwNvRamMappingRef=RightCamSerialNumber
      OIT_PpIntrinsicCameraSN_Readblock_PpIntrinsicCameraSN_Readblock (RteEventToTaskMapping): RteImmediateRestart=false, RteEventRef=OIT_PpIntrinsicCameraSN_Readblock_PpIntrinsicCameraSN_Readblock
    CalDataProvider (RteSwComponentType): RteComponentTypeRef=CalDataProvider, RteImplementationRef=CalDataProvider_Implementation
      ComponentTypeCalibration (RteComponentTypeCalibration): RteCalibrationSupportEnabled=false
    CDD_WDG_EcuSwComposition (RteSwComponentInstance): RteSoftwareComponentInstanceRef=CDD_WDG
      CDD_WDG_InitEvent (RteEventToTaskMapping): RteImmediateRestart=false, RtePositionInTask=11, RteEventRef=CDD_WDG_InitEvent, RteMappedToTaskRef=Safety_Task_Init
      TMT_RE_WDG_Main (RteEventToTaskMapping):
        RteImmediateRestart = false
        RtePositionInTask = 2
        RteEventRef = TMT_RE_WDG_Main
        RteMappedToTaskRef = Safety_WdgTask_10ms
        RteUsedOsAlarmRef = Rte_Al_TE_Safety_WdgTask_10ms_0_10ms
        RteUsedOsEventRef = Rte_Ev_Cyclic_Safety_WdgTask_10ms_0_10ms
    CDD_WDG (RteSwComponentType): RteComponentTypeRef=CDD_WDG, RteImplementationRef=CDD_WDG_Implementation
      ComponentTypeCalibration (RteComponentTypeCalibration): RteCalibrationSupportEnabled=false
    CDD_CryptoMgr_EcuSwComposition (RteSwComponentInstance): RteSoftwareComponentInstanceRef=CDD_CryptoMgr
      17 x RteEventToTaskMapping, all with RteImmediateRestart=false:
        CDD_CryptoMgr_InitEvent: RtePositionInTask=15, RteEventRef=CDD_CryptoMgr_InitEvent, RteMappedToTaskRef=QM_Task_Init
        TMT_RE_CryptoMgr_Main: RtePositionInTask=12, RteEventRef=TMT_RE_CryptoMgr_Main, RteMappedToTaskRef=QM_Task_00_10ms, RteUsedOsAlarmRef=Rte_Al_TE_QM_Task_00_10ms_0_10ms
        OIT_DataServices_Data_222032_Secure_Log_Read_ReadData_DataServices_Data_222032_Secure_Log_Read_ReadData: RteEventRef=OIT_DataServices_Data_222032_Secure_Log_Read_ReadData_DataServices_Data_222032_Secure_Log_Read_ReadData
        OIT_DataServices_Data_22295A_Hosted_App_Firmware_Cal_Config_Data_Header_UUID_Read_ReadData_DataServices_Data_22295A_Host0363ECC3: RteEventRef=OIT_DataServices_Data_22295A_Hosted_App_Firmware_Cal_Config_Data_Header_UUID_Read_ReadData_DataServices_Data_22295A_Host0363ECC3
        OIT_DataServices_Data_222031_Disallowed_Certificate_List_Read_ReadData_DataServices_Data_222031_Disallowed_Certificate_LC9ECC53E: RteEventRef=OIT_DataServices_Data_222031_Disallowed_Certificate_List_Read_ReadData_DataServices_Data_222031_Disallowed_Certificate_LC9ECC53E
        OIT_DataServices_Data_222957_Hosted_App_Firmware_Header_Info_Read_ReadData_DataServices_Data_222957_Hosted_App_Firmware_59835101: RteEventRef=OIT_DataServices_Data_222957_Hosted_App_Firmware_Header_Info_Read_ReadData_DataServices_Data_222957_Hosted_App_Firmware_59835101
        OIT_DataServices_Data_220108_Authenticated_Diagnostics_Active_Role_Read_ReadData_DataServices_Data_220108_Authenticated_1848ABFC: RteEventRef=OIT_DataServices_Data_220108_Authenticated_Diagnostics_Active_Role_Read_ReadData_DataServices_Data_220108_Authenticated_1848ABFC
        OIT_DataServices_Data_22295F_DCL_and_Cerstore_Header_Info_Read_ReadData_DataServices_Data_22295F_DCL_and_Cerstore_Header5E694DD0: RteEventRef=OIT_DataServices_Data_22295F_DCL_and_Cerstore_Header_Info_Read_ReadData_DataServices_Data_22295F_DCL_and_Cerstore_Header5E694DD0
        OIT_DataServices_Data_22F111_Public_Certificates_Regional_Support_Read_ReadData_DataServices_Data_22F111_Public_Certific9DA6A63E: RteEventRef=OIT_DataServices_Data_22F111_Public_Certificates_Regional_Support_Read_ReadData_DataServices_Data_22F111_Public_Certific9DA6A63E
        OIT_DataServices_Data_22100C_Security_Status_Read_ReadData_DataServices_Data_22100C_Security_Status_Read_ReadData: RteEventRef=OIT_DataServices_Data_22100C_Security_Status_Read_ReadData_DataServices_Data_22100C_Security_Status_Read_ReadData
        OIT_DataServices_Data_222958_Hosted_App_firmware_Header_UUID_Read_ReadData_DataServices_Data_222958_Hosted_App_firmware_60C8C4CE: RteEventRef=OIT_DataServices_Data_222958_Hosted_App_firmware_Header_UUID_Read_ReadData_DataServices_Data_222958_Hosted_App_firmware_60C8C4CE
        OIT_DataServices_Data_222954_Policy_Type_Read_ReadData_DataServices_Data_222954_Policy_Type_Read_ReadData: RteEventRef=OIT_DataServices_Data_222954_Policy_Type_Read_ReadData_DataServices_Data_222954_Policy_Type_Read_ReadData
        OIT_DataServices_Data_222030_Authenticated_Diagnostic_Previous_Access_Read_ReadData_DataServices_Data_222030_Authenticat5BBDD058: RteEventRef=OIT_DataServices_Data_222030_Authenticated_Diagnostic_Previous_Access_Read_ReadData_DataServices_Data_222030_Authenticat5BBDD058
        OIT_PpCryptoArray_CryptoArray_PpCryptoArray_CryptoArray: RteEventRef=OIT_PpCryptoArray_CryptoArray_PpCryptoArray_CryptoArray
        OIT_DataServices_Data_22201F_Boot_Failure_Reason_Read_ReadData_DataServices_Data_22201F_Boot_Failure_Reason_Read_ReadData: RteEventRef=OIT_DataServices_Data_22201F_Boot_Failure_Reason_Read_ReadData_DataServices_Data_22201F_Boot_Failure_Reason_Read_ReadData
        OIT_DataServices_Data_222959_Hosted_App_Firmware_Cal_Config_Data_Header_Info_Read_ReadData_DataServices_Data_222959_Host82557262: RteEventRef=OIT_DataServices_Data_222959_Hosted_App_Firmware_Cal_Config_Data_Header_Info_Read_ReadData_DataServices_Data_222959_Host82557262
        OIT_RE_NvM_RpNotifyJobEnd_NvMBlockDescriptor_FileHeader_JobFinished_NvM_RpNotifyJobEnd_NvMBlockDescriptor_FileHeader_JobFinished: RteEventRef=OIT_RE_NvM_RpNotifyJobEnd_NvMBlockDescriptor_FileHeader_JobFinished_NvM_RpNotifyJobEnd_NvMBlockDescriptor_FileHeader_JobFinished
      NvmBlock_CDD_CryptoMgr_NvMBlockDescriptor_SecAccessDelayFlag (RteNvRamAllocation):
        RteNvmRamBlockLocationSymbol = Rte_CDD_CryptoMgr_Rte_CDD_CryptoMgr_Rte_SWC_CDD_CryptoMngr_SecAccessDelayFlag_MirrorBlock
        RteNvmRomBlockLocationSymbol = Rte_CDD_CryptoMgr_Rte_CDD_CryptoMgr_Rte_SWC_CDD_CryptoMngr_SecAccessDelayFlag_DefaultValue
        RteNvmBlockRef = CDD_CryptoMgrNvMBlockDescriptor_SecAccessDelayFlag
        RteSwNvRamMappingRef = NvMBlockDescriptor_SecAccessDelayFlag
      NvmBlock_CDD_CryptoMgr_NvMBlockDescriptor_SecAccessInvalidCount (RteNvRamAllocation):
        RteNvmRamBlockLocationSymbol = Rte_CDD_CryptoMgr_Rte_CDD_CryptoMgr_Rte_SWC_CDD_CryptoMngr_SecAccessInvalidCount_MirrorBlock
        RteNvmRomBlockLocationSymbol = Rte_CDD_CryptoMgr_Rte_CDD_CryptoMgr_Rte_SWC_CDD_CryptoMngr_SecAccessInvalidCount_DefaultValue
        RteNvmBlockRef = CDD_CryptoMgrNvMBlockDescriptor_SecAccessInvalidCount
        RteSwNvRamMappingRef = NvMBlockDescriptor_SecAccessInvalidCount
      3 x RteEventToTaskMapping, all with RteImmediateRestart=false:
        OIT_DataServices_Data_222951_Certificate_Store_UUID_Read_ReadData_DataServices_Data_222951_Certificate_Store_UUID_Read_ReadData: RteEventRef=OIT_DataServices_Data_222951_Certificate_Store_UUID_Read_ReadData_DataServices_Data_222951_Certificate_Store_UUID_Read_ReadData
        OIT_NvM_RpNotifyJobEnd_NvMBlockDescriptor_CertAccessInfo_JobFinished_NvM_RpNotifyJobEnd_NvMBlockDescriptor_CertAccessInf1353BA01: RteEventRef=OIT_NvM_RpNotifyJobEnd_NvMBlockDescriptor_CertAccessInfo_JobFinished_NvM_RpNotifyJobEnd_NvMBlockDescriptor_CertAccessInf1353BA01
        OIT_PpSecureAuthenticationStatus_Get_SecureAuthenticationStatus_PpSecureAuthenticationStatus_Get_SecureAuthenticationStatus: RteEventRef=OIT_PpSecureAuthenticationStatus_Get_SecureAuthenticationStatus_PpSecureAuthenticationStatus_Get_SecureAuthenticationStatus
      NvmBlock_CDD_CryptoMgr_NvMBlockDescriptor_SecureLogGroup1 (RteNvRamAllocation): RteNvmBlockRef=CDD_CryptoMgrNvMBlockDescriptor_SecureLogGroup1, RteSwNvRamMappingRef=NvMBlockDescriptor_SecureLogGroup1
      NvmBlock_CDD_CryptoMgr_NvMBlockDescriptor_SecureLogGroup2 (RteNvRamAllocation): RteNvmBlockRef=CDD_CryptoMgrNvMBlockDescriptor_SecureLogGroup2, RteSwNvRamMappingRef=NvMBlockDescriptor_SecureLogGroup2
      3 x RteEventToTaskMapping, all with RteImmediateRestart=false:
        OIT_Runnable_DataServices_Data_22295E_DCL_Header_UUID_Read_ReadData: RteEventRef=OIT_Runnable_DataServices_Data_22295E_DCL_Header_UUID_Read_ReadData
        OIT_DataServices_Data_22295B_HTA_Header_Info_Read_DataServices_Data_22295B_HTA_Header_Info_Read_ReadData: RteEventRef=OIT_DataServices_Data_22295B_HTA_Header_Info_Read_DataServices_Data_22295B_HTA_Header_Info_Read_ReadData
        OIT_Runnable_DataServices_Data_22295C_HTA_Header_UUID_Read_ReadData: RteEventRef=OIT_Runnable_DataServices_Data_22295C_HTA_Header_UUID_Read_ReadData
      3 x RteNvRamAllocation:
        NvmBlock_CDD_CryptoMgr_NvMBlockDescriptor_TimestampCounter: RteNvmRamBlockLocationSymbol=Rte_CDD_CryptoMgr_NvMBlockDescriptor_SecondCounter_MirrorBlock, RteNvmRomBlockLocationSymbol=Rte_CDD_CryptoMgr_NvMBlockDescriptor_SecondCounter_DefaultValue, RteNvmBlockRef=CDD_CryptoMgrNvMBlockDescriptor_SecondCounter, RteSwNvRamMappingRef=NvMBlockDescriptor_SecondCounter
        NvmBlock_CDD_CryptoMgr_NvMBlockDescriptor_SystemTimestamp: RteNvmRamBlockLocationSymbol=Rte_CDD_CryptoMgr_NvMBlockDescriptor_SystemTimestamp_MirrorBlock, RteNvmRomBlockLocationSymbol=Rte_CDD_CryptoMgr_NvMBlockDescriptor_SystemTimestamp_DefaultValue, RteNvmBlockRef=CDD_CryptoMgrNvMBlockDescriptor_SystemTimestamp, RteSwNvRamMappingRef=NvMBlockDescriptor_SystemTimestamp
        NvmBlock_CDD_CryptoMgr_NvMBlockDescriptor_CertificateExpired: RteNvmRamBlockLocationSymbol=Rte_CDD_CryptoMgr_NvMBlockDescriptor_CertificateExpired_MirrorBlock, RteNvmRomBlockLocationSymbol=Rte_CDD_CryptoMgr_NvMBlockDescriptor_CertificateExpired_DefaultValue, RteNvmBlockRef=CDD_CryptoMgrNvMBlockDescriptor_CertificateExpired, RteSwNvRamMappingRef=NvMBlockDescriptor_CertificateExpired
    CDD_CryptoMgr (RteSwComponentType): RteComponentTypeRef=CDD_CryptoMgr, RteImplementationRef=CDD_CryptoMgr_Implementation
      ComponentTypeCalibration (RteComponentTypeCalibration): RteCalibrationSupportEnabled=false
    Xcp (RteBswModuleInstance): RteBswImplementationRef=Xcp_Impl, RteBswModuleConfigurationRef=Xcp
      Xcp_MainFunctionTimingEvent0 (RteBswEventToTaskMapping):
        RteBswImmediateRestart = false
        RteBswPositionInTask = 12
        RteBswEventRef = Xcp_MainFunctionTimingEvent0
        RteBswMappedToTaskRef = QM_ComTask_10ms
        RteBswUsedOsAlarmRef = Rte_Al_TE2_QM_ComTask_10ms_0_10ms
        RteBswUsedOsEventRef = Rte_Ev_Cyclic2_QM_ComTask_10ms_0_10ms
      8 x RteBswExclusiveAreaImpl, all with RteExclusiveAreaImplMechanism=ALL_INTERRUPT_BLOCKING:
        XCP_EXCLUSIVE_AREA_{0..2}: RteBswExclusiveAreaRef=XCP_EXCLUSIVE_AREA_{0..2}
        CANXCP_EXCLUSIVE_AREA_0: RteBswExclusiveAreaRef=CANXCP_EXCLUSIVE_AREA_0
        FRXCP_EXCLUSIVE_AREA_{0..2}: RteBswExclusiveAreaRef=FRXCP_EXCLUSIVE_AREA_{0..2}
        TCPIPXCP_EXCLUSIVE_AREA_0: RteBswExclusiveAreaRef=TCPIPXCP_EXCLUSIVE_AREA_0
      CanXcp_MainFunctionTimingEvent0 (RteBswEventToTaskMapping):
        RteBswImmediateRestart = false
        RteBswPositionInTask = 11
        RteBswEventRef = CanXcp_MainFunctionTimingEvent0
        RteBswMappedToTaskRef = QM_ComTask_10ms
        RteBswUsedOsAlarmRef = Rte_Al_TE2_QM_ComTask_10ms_0_10ms
        RteBswUsedOsEventRef = Rte_Ev_Cyclic2_QM_ComTask_10ms_0_10ms
    Csm (RteBswModuleInstance): RteBswImplementationRef=Csm_Impl, RteBswModuleConfigurationRef=Csm
      Csm_MainFunctionTimingEvent0 (RteBswEventToTaskMapping):
        RteBswImmediateRestart = false
        RteBswPositionInTask = 14
        RteBswEventRef = Csm_MainFunctionTimingEvent0
        RteBswMappedToTaskRef = QM_ComTask_10ms
        RteBswUsedOsAlarmRef = Rte_Al_TE2_QM_ComTask_10ms_0_10ms
        RteBswUsedOsEventRef = Rte_Ev_Cyclic2_QM_ComTask_10ms_0_10ms
      CSM_EXCLUSIVE_AREA_0 (RteBswExclusiveAreaImpl): RteExclusiveAreaImplMechanism=ALL_INTERRUPT_BLOCKING, RteBswExclusiveAreaRef=CSM_EXCLUSIVE_AREA_0
    Csm_EcuSwComposition (RteSwComponentInstance): RteSoftwareComponentInstanceRef=Csm
      Timer_Csm_MainFunction (RteEventToTaskMapping):
        RteImmediateRestart = false
        RtePositionInTask = 14
        RteEventRef = Timer_Csm_MainFunction
        RteMappedToTaskRef = QM_ComTask_10ms
        RteUsedOsAlarmRef = Rte_Al_TE2_QM_ComTask_10ms_0_10ms
        RteUsedOsEventRef = Rte_Ev_Cyclic2_QM_ComTask_10ms_0_10ms
    Wdg (RteBswModuleInstance): RteBswImplementationRef=Wdg_Impl, RteBswModuleConfigurationRef=Wdg
      WDG_EXCLUSIVE_AREA_0 (RteBswExclusiveAreaImpl): RteExclusiveAreaImplMechanism=ALL_INTERRUPT_BLOCKING, RteBswExclusiveAreaRef=WDG_EXCLUSIVE_AREA_0
    WdgM (RteBswModuleInstance): RteBswImplementationRef=WdgM_Impl, RteBswModuleConfigurationRef=WdgM
      WDGM_EXCLUSIVE_AREA_0 (RteBswExclusiveAreaImpl): RteExclusiveAreaImplMechanism=ALL_INTERRUPT_BLOCKING, RteBswExclusiveAreaRef=WDGM_EXCLUSIVE_AREA_0
      WdgM_MainFunctionTimingEvent0 (RteBswEventToTaskMapping):
        RteBswImmediateRestart = false
        RteBswPositionInTask = 5
        RteBswEventRef = WdgM_MainFunctionTimingEvent0
        RteBswMappedToTaskRef = Safety_WdgTask_10ms
        RteBswUsedOsEventRef = Rte_Ev_Cyclic2_Safety_WdgTask_10ms_0_10ms
        RteBswUsedOsAlarmRef = Rte_Al_TE2_Safety_WdgTask_10ms_0_10ms
    WdgM_SystemApplication_OsCore0_EcuSwComposition (RteSwComponentInstance): RteSoftwareComponentInstanceRef=WdgM_SystemApplication_OsCore0
      23 x RteEventToTaskMapping, all with RteImmediateRestart=false:
        Timer_WdgM_MainFunction: RtePositionInTask=5, RteEventRef=Timer_WdgM_MainFunction, RteMappedToTaskRef=Safety_WdgTask_10ms, RteUsedOsEventRef=Rte_Ev_Cyclic2_Safety_WdgTask_10ms_0_10ms, RteUsedOsAlarmRef=Rte_Al_TE2_Safety_WdgTask_10ms_0_10ms
        OpEventCheckpointReached_CheckpointReached_alive_WdgM_SE_MCU1_0: RteEventRef=OpEventCheckpointReached_CheckpointReached_alive_WdgM_SE_MCU1_0
        OpEventCheckpointReached_CheckpointReached_alive_WdgM_SE_MCU2_0: RteEventRef=OpEventCheckpointReached_CheckpointReached_alive_WdgM_SE_MCU2_0
        OpEventCheckpointReached_CheckpointReached_alive_WdgM_SE_MCU2_1: RteEventRef=OpEventCheckpointReached_CheckpointReached_alive_WdgM_SE_MCU2_1
        OpEventCheckpointReached_CheckpointReached_alive_WdgM_SE_MPU1_0: RteEventRef=OpEventCheckpointReached_CheckpointReached_alive_WdgM_SE_MPU1_0
        OpEventGetLocalStatus_GetLocalStatus_localStatus_WdgM_SE_MCU1_0: RteEventRef=OpEventGetLocalStatus_GetLocalStatus_localStatus_WdgM_SE_MCU1_0
        OpEventGetLocalStatus_GetLocalStatus_localStatus_WdgM_SE_MCU2_0: RteEventRef=OpEventGetLocalStatus_GetLocalStatus_localStatus_WdgM_SE_MCU2_0
        OpEventGetLocalStatus_GetLocalStatus_localStatus_WdgM_SE_MCU2_1: RteEventRef=OpEventGetLocalStatus_GetLocalStatus_localStatus_WdgM_SE_MCU2_1
        OpEventGetLocalStatus_GetLocalStatus_localStatus_WdgM_SE_MPU1_0: RteEventRef=OpEventGetLocalStatus_GetLocalStatus_localStatus_WdgM_SE_MPU1_0
        OpEventGetLocalStatus_GetLocalStatus_general_Core0: RteEventRef=OpEventGetLocalStatus_GetLocalStatus_general_Core0
        OpEventGetMode_GetMode_general_Core0: RteEventRef=OpEventGetMode_GetMode_general_Core0
        OpEventGetGlobalStatus_GetGlobalStatus_general_Core0: RteEventRef=OpEventGetGlobalStatus_GetGlobalStatus_general_Core0
        OpEventPerformReset_PerformReset_general_Core0: RteEventRef=OpEventPerformReset_PerformReset_general_Core0
        OpEventSetMode_SetMode_general_Core0: RteEventRef=OpEventSetMode_SetMode_general_Core0
        OpEventGetFirstExpiredSEID_GetFirstExpiredSEID_general_Core0: RteEventRef=OpEventGetFirstExpiredSEID_GetFirstExpiredSEID_general_Core0
        OpEventCheckpointReached_CheckpointReached_alive_WdgM_SE_Safety_Task_01_10ms: RteEventRef=OpEventCheckpointReached_CheckpointReached_alive_WdgM_SE_Safety_Task_01_10ms
        OpEventCheckpointReached_CheckpointReached_alive_WdgM_SE_Safety_Task_00_10ms: RteEventRef=OpEventCheckpointReached_CheckpointReached_alive_WdgM_SE_Safety_Task_00_10ms
        OpEventGetLocalStatus_GetLocalStatus_localStatus_WdgM_SE_Safety_Task_01_10ms: RteEventRef=OpEventGetLocalStatus_GetLocalStatus_localStatus_WdgM_SE_Safety_Task_01_10ms
        OpEventGetLocalStatus_GetLocalStatus_localStatus_WdgM_SE_Safety_Task_00_10ms: RteEventRef=OpEventGetLocalStatus_GetLocalStatus_localStatus_WdgM_SE_Safety_Task_00_10ms
        OpEventCheckpointReached_CheckpointReached_alive_WdgM_SE_Safety_Com_Task_10ms: RteEventRef=OpEventCheckpointReached_CheckpointReached_alive_WdgM_SE_Safety_Com_Task_10ms
        OpEventGetLocalStatus_GetLocalStatus_localStatus_WdgM_SE_Safety_Com_Task_10ms: RteEventRef=OpEventGetLocalStatus_GetLocalStatus_localStatus_WdgM_SE_Safety_Com_Task_10ms
        OpEventCheckpointReached_CheckpointReached_alive_WdgM_SE_Safety_Task_200ms: RteEventRef=OpEventCheckpointReached_CheckpointReached_alive_WdgM_SE_Safety_Task_200ms
        OpEventGetLocalStatus_GetLocalStatus_localStatus_WdgM_SE_Safety_Task_200ms: RteEventRef=OpEventGetLocalStatus_GetLocalStatus_localStatus_WdgM_SE_Safety_Task_200ms
    Crypto (RteBswModuleInstance): RteBswImplementationRef=Crypto_Impl, RteBswModuleConfigurationRef=Crypto
      Crypto_30_vHsm_MainFunctionTimingEvent0 (RteBswEventToTaskMapping):
        RteBswImmediateRestart = false
        RteBswPositionInTask = 15
        RteBswEventRef = Crypto_30_vHsm_MainFunctionTimingEvent0
        RteBswMappedToTaskRef = QM_ComTask_10ms
        RteBswUsedOsAlarmRef = Rte_Al_TE2_QM_ComTask_10ms_0_10ms
        RteBswUsedOsEventRef = Rte_Ev_Cyclic2_QM_ComTask_10ms_0_10ms
      4 x RteBswExclusiveAreaImpl:
        CRYPTO_30_VHSM_EXCLUSIVE_AREA_0: RteExclusiveAreaImplMechanism=ALL_INTERRUPT_BLOCKING, RteBswExclusiveAreaRef=CRYPTO_30_VHSM_EXCLUSIVE_AREA_0
        CRYPTO_30_VHSM_EXCLUSIVE_AREA_1: RteExclusiveAreaImplMechanism=ALL_INTERRUPT_BLOCKING, RteBswExclusiveAreaRef=CRYPTO_30_VHSM_EXCLUSIVE_AREA_1
        CRYPTO_30_VHSM_EXCLUSIVE_AREA_2: RteExclusiveAreaImplMechanism=NONE, RteBswExclusiveAreaRef=CRYPTO_30_VHSM_EXCLUSIVE_AREA_2
        CRYPTO_30_VHSM_EXCLUSIVE_AREA_3: RteExclusiveAreaImplMechanism=NONE, RteBswExclusiveAreaRef=CRYPTO_30_VHSM_EXCLUSIVE_AREA_3
    4 x RteSwComponentInstance:
      SWC_VCANTx_EcuSwComposition: RteSoftwareComponentInstanceRef=SWC_VCANTx
        SWC_VCANTx_InitEvent (RteEventToTaskMapping): RteImmediateRestart=false, RtePositionInTask=8, RteEventRef=SWC_VCANTx_InitEvent, RteMappedToTaskRef=QM_Task_Init
        TMT_RE_VCANTx_Main (RteEventToTaskMapping):
          RteImmediateRestart = false
          RtePositionInTask = 4
          RteEventRef = TMT_RE_VCANTx_Main
          RteMappedToTaskRef = QM_Task_00_10ms
          RteUsedOsAlarmRef = Rte_Al_TE_QM_Task_00_10ms_0_10ms
      SWC_VCANRx_EcuSwComposition: RteSoftwareComponentInstanceRef=SWC_VCANRx
        SWC_VCANRx_InitEvent (RteEventToTaskMapping): RteImmediateRestart=false, RtePositionInTask=7, RteEventRef=SWC_VCANRx_InitEvent, RteMappedToTaskRef=QM_Task_Init
        TMT_RE_VCANRx_Main (RteEventToTaskMapping):
          RteImmediateRestart = false
          RtePositionInTask = 3
          RteEventRef = TMT_RE_VCANRx_Main
          RteMappedToTaskRef = QM_Task_00_10ms
          RteUsedOsAlarmRef = Rte_Al_TE_QM_Task_00_10ms_0_10ms
      SWC_SafeVCANTx_EcuSwComposition: RteSoftwareComponentInstanceRef=SWC_SafeVCANTx
        SWC_SafeVCANTx_InitEvent (RteEventToTaskMapping): RteImmediateRestart=false, RtePositionInTask=2, RteEventRef=SWC_SafeVCANTx_InitEvent, RteMappedToTaskRef=Safety_Task_Init
        TMT_RE_SafeVCANTx_Main (RteEventToTaskMapping):
          RteImmediateRestart = false
          RtePositionInTask = 2
          RteEventRef = TMT_RE_SafeVCANTx_Main
          RteMappedToTaskRef = Safety_Task_00_10ms
          RteUsedOsAlarmRef = Rte_Al_TE_Safety_Task_00_10ms_0_10ms
      SWC_SafeVCANRx_EcuSwComposition: RteSoftwareComponentInstanceRef=SWC_SafeVCANRx
        SWC_SafeVCANRx_InitEvent (RteEventToTaskMapping): RteImmediateRestart=false, RtePositionInTask=1, RteEventRef=SWC_SafeVCANRx_InitEvent, RteMappedToTaskRef=Safety_Task_Init
        TMT_RE_SafeVCANRx_Main (RteEventToTaskMapping):
          RteImmediateRestart = false
          RtePositionInTask = 1
          RteEventRef = TMT_RE_SafeVCANRx_Main
          RteMappedToTaskRef = Safety_Task_00_10ms
          RteUsedOsAlarmRef = Rte_Al_TE_Safety_Task_00_10ms_0_10ms
    5 x RteSwComponentType:
      SWC_VCANTx: RteComponentTypeRef=SWC_VCANTx, RteImplementationRef=SWC_VCANTx_Implementation
        ComponentTypeCalibration (RteComponentTypeCalibration): RteCalibrationSupportEnabled=false
      SWC_VCANRx: RteComponentTypeRef=SWC_VCANRx, RteImplementationRef=SWC_VCANRx_Implementation
        ComponentTypeCalibration (RteComponentTypeCalibration): RteCalibrationSupportEnabled=false
      SWC_SafeVCANTx: RteComponentTypeRef=SWC_SafeVCANTx, RteImplementationRef=SWC_SafeVCANTx_Implementation
        ComponentTypeCalibration (RteComponentTypeCalibration): RteCalibrationSupportEnabled=false
      SWC_SafeVCANRx: RteComponentTypeRef=SWC_SafeVCANRx, RteImplementationRef=SWC_SafeVCANRx_Implementation
        ComponentTypeCalibration (RteComponentTypeCalibration): RteCalibrationSupportEnabled=false
      SWC_WdgFw: RteComponentTypeRef=SWC_WdgFw, RteImplementationRef=SWC_WdgFw_Implementation
        ComponentTypeCalibration (RteComponentTypeCalibration): RteCalibrationSupportEnabled=false
    SWC_WdgFw_EcuSwComposition (RteSwComponentInstance): RteSoftwareComponentInstanceRef=SWC_WdgFw
      6 x RteEventToTaskMapping, all with RteImmediateRestart=false:
        TMT_Runnable: RtePositionInTask=4, RteEventRef=TMT_Runnable, RteMappedToTaskRef=Safety_WdgTask_10ms, RteUsedOsAlarmRef=Rte_Al_TE_Safety_WdgTask_10ms_0_10ms, RteUsedOsEventRef=Rte_Ev_Cyclic_Safety_WdgTask_10ms_0_10ms
        TMT_WdgFw_Safety_Task_00_10ms_CP_10ms: RtePositionInTask=3, RteEventRef=TMT_WdgFw_Safety_Task_00_10ms_CP_10ms, RteMappedToTaskRef=Safety_Task_00_10ms, RteUsedOsAlarmRef=Rte_Al_TE_Safety_Task_00_10ms_0_10ms
        TMT_WdgFw_Safety_Task_01_10ms_CP_10ms: RtePositionInTask=1, RteEventRef=TMT_WdgFw_Safety_Task_01_10ms_CP_10ms, RteMappedToTaskRef=Safety_Task_01_10ms, RteUsedOsAlarmRef=Rte_Al_TE_Safety_Task_01_10ms_0_10ms
        TMT_WdgM_MainFunction_Call_Cntr_10ms: RtePositionInTask=3, RteEventRef=TMT_WdgM_MainFunction_Call_Cntr_10ms, RteMappedToTaskRef=Safety_WdgTask_10ms, RteUsedOsAlarmRef=Rte_Al_TE_Safety_WdgTask_10ms_0_10ms, RteUsedOsEventRef=Rte_Ev_Cyclic_Safety_WdgTask_10ms_0_10ms
        TMT_WdgFw_Safety_Task_Com_10ms_CP_10ms: RtePositionInTask=1, RteEventRef=TMT_WdgFw_Safety_Task_Com_10ms_CP_10ms, RteMappedToTaskRef=Safety_WdgTask_10ms, RteUsedOsAlarmRef=Rte_Al_TE_Safety_WdgTask_10ms_0_10ms, RteUsedOsEventRef=Rte_Ev_Cyclic_Safety_WdgTask_10ms_0_10ms
        TMT_WdgFw_Safety_Task_200ms_CP_200ms: RtePositionInTask=1, RteEventRef=TMT_WdgFw_Safety_Task_200ms_CP_200ms, RteMappedToTaskRef=Safety_Task_200ms, RteUsedOsEventRef=Rte_Ev_Cyclic_Safety_Task_200ms_0_200ms, RteUsedOsAlarmRef=Rte_Al_TE_Safety_Task_200ms_0_200ms
    CDD_Safety (RteSwComponentType): RteComponentTypeRef=CDD_Safety, RteImplementationRef=CDD_Safety_Implementation
      ComponentTypeCalibration (RteComponentTypeCalibration): RteCalibrationSupportEnabled=false
    CDD_Safety_EcuSwComposition (RteSwComponentInstance): RteSoftwareComponentInstanceRef=CDD_Safety
      TMT_Safety_CDD_MainFunction (RteEventToTaskMapping):
        RteImmediateRestart = false
        RtePositionInTask = 7
        RteEventRef = TMT_Safety_CDD_MainFunction
        RteMappedToTaskRef = Safety_Task_00_10ms
        RteUsedOsAlarmRef = Rte_Al_TE_Safety_Task_00_10ms_0_10ms
      NvmBlock_CDD_Safety_CDD_PMICLastResetReason_BISTStatus (RteNvRamAllocation): RteNvmBlockRef=CDD_SafetyCDD_PMICLastResetReason_BISTStatus, RteSwNvRamMappingRef=CDD_PMICLastResetReason_BISTStatus
    Safety_Gaurd_EcuSwComposition (RteSwComponentInstance): RteSoftwareComponentInstanceRef=Safety_Guard
      TMT_SafetyGuard_Main (RteEventToTaskMapping):
        RteImmediateRestart = false
        RtePositionInTask = 6
        RteEventRef = TMT_SafetyGuard_Main
        RteMappedToTaskRef = Safety_Task_01_10ms
        RteUsedOsAlarmRef = Rte_Al_TE_Safety_Task_01_10ms_0_10ms
      NvmBlock_Safety_Guard_SafeStat2_ResetReason (RteNvRamAllocation): RteNvmBlockRef=Safety_GuardSafeStat2_ResetReason, RteSwNvRamMappingRef=SafeStat2_ResetReason
    Safety_Gaurd (RteSwComponentType): RteComponentTypeRef=Safety_Guard, RteImplementationRef=Safety_Guard_Implementation
      ComponentTypeCalibration (RteComponentTypeCalibration): RteCalibrationSupportEnabled=false
    Cdd_RunTimeStats_B_EcuSwComposition (RteSwComponentInstance): RteSoftwareComponentInstanceRef=Cdd_RunTimeStats_B
      10 x RteEventToTaskMapping, all with RteImmediateRestart=false:
        TMT_Cdd_RunTimeStat_B_Safety_Task_00_10ms_Start: RtePositionInTask=0, RteEventRef=TMT_Cdd_RunTimeStat_B_Safety_Task_00_10ms_Start, RteMappedToTaskRef=Safety_Task_00_10ms, RteUsedOsAlarmRef=Rte_Al_TE_Safety_Task_00_10ms_0_10ms
        TMT_Cdd_RunTimeStat_B_Safety_Task_00_10ms_Stop: RtePositionInTask=8, RteEventRef=TMT_Cdd_RunTimeStat_B_Safety_Task_00_10ms_Stop, RteMappedToTaskRef=Safety_Task_00_10ms, RteUsedOsAlarmRef=Rte_Al_TE_Safety_Task_00_10ms_0_10ms
        TMT_Cdd_RunTimeStat_B_Safety_Task_01_10ms_Start: RtePositionInTask=0, RteEventRef=TMT_Cdd_RunTimeStat_B_Safety_Task_01_10ms_Start, RteMappedToTaskRef=Safety_Task_01_10ms, RteUsedOsAlarmRef=Rte_Al_TE_Safety_Task_01_10ms_0_10ms
        TMT_Cdd_RunTimeStat_B_Safety_Task_01_10ms_Stop: RtePositionInTask=7, RteEventRef=TMT_Cdd_RunTimeStat_B_Safety_Task_01_10ms_Stop, RteMappedToTaskRef=Safety_Task_01_10ms, RteUsedOsAlarmRef=Rte_Al_TE_Safety_Task_01_10ms_0_10ms
        TMT_Cdd_RunTimeStat_B_Safety_Task_01_10ms_Start_1: RtePositionInTask=0, RteEventRef=TMT_Cdd_RunTimeStat_B_Safety_Task_01_10ms_Start_1, RteMappedToTaskRef=Safety_Task_200ms, RteUsedOsEventRef=Rte_Ev_Cyclic_Safety_Task_200ms_0_200ms, RteUsedOsAlarmRef=Rte_Al_TE_Safety_Task_200ms_0_200ms
        TMT_Cdd_RunTimeStat_B_Safety_Task_01_10ms_Start_1_1: RtePositionInTask=3, RteEventRef=TMT_Cdd_RunTimeStat_B_Safety_Task_01_10ms_Start_1_1, RteMappedToTaskRef=Safety_Task_200ms, RteUsedOsEventRef=Rte_Ev_Cyclic_Safety_Task_200ms_0_200ms, RteUsedOsAlarmRef=Rte_Al_TE_Safety_Task_200ms_0_200ms
        TMT_Cdd_RunTimeStat_B_Safety_Task_Init_Start_1: RtePositionInTask=0, RteEventRef=TMT_Cdd_RunTimeStat_B_Safety_Task_Init_Start_1, RteMappedToTaskRef=Safety_WdgTask_10ms, RteUsedOsEventRef=Rte_Ev_Cyclic_Safety_WdgTask_10ms_0_10ms, RteUsedOsAlarmRef=Rte_Al_TE_Safety_WdgTask_10ms_0_10ms
        TMT_Cdd_RunTimeStat_B_Safety_Task_Init_Start_2: RtePositionInTask=6, RteEventRef=TMT_Cdd_RunTimeStat_B_Safety_Task_Init_Start_2, RteMappedToTaskRef=Safety_WdgTask_10ms, RteUsedOsEventRef=Rte_Ev_Cyclic_Safety_WdgTask_10ms_0_10ms, RteUsedOsAlarmRef=Rte_Al_TE_Safety_WdgTask_10ms_0_10ms
        Cdd_RunTimeStats_B_Safety_Task_Init_Start_InitEvent: RtePositionInTask=0, RteEventRef=Cdd_RunTimeStats_B_Safety_Task_Init_Start_InitEvent, RteMappedToTaskRef=Safety_Task_Init
        Cdd_RunTimeStats_B_Safety_Task_Init_Stop_InitEvent: RtePositionInTask=12, RteEventRef=Cdd_RunTimeStats_B_Safety_Task_Init_Stop_InitEvent, RteMappedToTaskRef=Safety_Task_Init
    Cdd_RunTimeStats_QM_EcuSwComposition (RteSwComponentInstance): RteSoftwareComponentInstanceRef=Cdd_RunTimeStats_QM
      18 x RteEventToTaskMapping, all with RteImmediateRestart=false:
        TMT_Cdd_RunTimeStats_QM_ComTask_10ms_Stop: RtePositionInTask=16, RteEventRef=TMT_Cdd_RunTimeStats_QM_ComTask_10ms_Stop, RteMappedToTaskRef=QM_ComTask_10ms, RteUsedOsEventRef=Rte_Ev_Cyclic_QM_ComTask_10ms_0_10ms, RteUsedOsAlarmRef=Rte_Al_TE_QM_ComTask_10ms_0_10ms
        TMT_Cdd_RunTimeStats_QM_ComTask_10ms_Stop_1: RtePositionInTask=0, RteEventRef=TMT_Cdd_RunTimeStats_QM_ComTask_10ms_Stop_1, RteMappedToTaskRef=QM_ComTask_10ms, RteUsedOsEventRef=Rte_Ev_Cyclic_QM_ComTask_10ms_0_10ms, RteUsedOsAlarmRef=Rte_Al_TE_QM_ComTask_10ms_0_10ms
        TMT_Cdd_RunTimeStats_QM_ComTask_10ms_Stop_2: RtePositionInTask=0, RteEventRef=TMT_Cdd_RunTimeStats_QM_ComTask_10ms_Stop_2, RteMappedToTaskRef=QM_ComTask_5ms, RteUsedOsEventRef=Rte_Ev_Cyclic_QM_ComTask_5ms_0_5ms, RteUsedOsAlarmRef=Rte_Al_TE_QM_ComTask_5ms_0_5ms
        TMT_Cdd_RunTimeStats_QM_ComTask_10ms_Stop_4: RtePositionInTask=0, RteEventRef=TMT_Cdd_RunTimeStats_QM_ComTask_10ms_Stop_4, RteMappedToTaskRef=QM_DiagTask_10ms, RteUsedOsEventRef=Rte_Ev_Cyclic_QM_DiagTask_10ms_0_10ms, RteUsedOsAlarmRef=Rte_Al_TE_QM_DiagTask_10ms_0_10ms
        TMT_Cdd_RunTimeStats_QM_ComTask_10ms_Stop_5: RtePositionInTask=4, RteEventRef=TMT_Cdd_RunTimeStats_QM_ComTask_10ms_Stop_5, RteMappedToTaskRef=QM_DiagTask_10ms, RteUsedOsEventRef=Rte_Ev_Cyclic_QM_DiagTask_10ms_0_10ms, RteUsedOsAlarmRef=Rte_Al_TE_QM_DiagTask_10ms_0_10ms
        TMT_Cdd_RunTimeStats_QM_ComTask_10ms_Stop_6: RtePositionInTask=0, RteEventRef=TMT_Cdd_RunTimeStats_QM_ComTask_10ms_Stop_6, RteMappedToTaskRef=QM_MemTask_10ms, RteUsedOsEventRef=Rte_Ev_Cyclic_QM_MemTask_10ms_0_10ms, RteUsedOsAlarmRef=Rte_Al_TE_QM_MemTask_10ms_0_10ms
        TMT_Cdd_RunTimeStats_QM_ComTask_10ms_Stop_7: RtePositionInTask=5, RteEventRef=TMT_Cdd_RunTimeStats_QM_ComTask_10ms_Stop_7, RteMappedToTaskRef=QM_MemTask_10ms, RteUsedOsEventRef=Rte_Ev_Cyclic_QM_MemTask_10ms_0_10ms, RteUsedOsAlarmRef=Rte_Al_TE_QM_MemTask_10ms_0_10ms
        TMT_1_Cdd_RunTimeStats_QM_ComTask_5ms_Stop: RtePositionInTask=4, RteEventRef=TMT_1_Cdd_RunTimeStats_QM_ComTask_5ms_Stop, RteMappedToTaskRef=QM_ComTask_5ms, RteUsedOsEventRef=Rte_Ev_Cyclic_QM_ComTask_5ms_0_5ms, RteUsedOsAlarmRef=Rte_Al_TE_QM_ComTask_5ms_0_5ms
        TMT_Cdd_RunTimeStats_QM_ComTask_10ms_Stop_8: RtePositionInTask=0, RteEventRef=TMT_Cdd_RunTimeStats_QM_ComTask_10ms_Stop_8, RteMappedToTaskRef=QM_Task_00_10ms, RteUsedOsAlarmRef=Rte_Al_TE_QM_Task_00_10ms_0_10ms
        TMT_Cdd_RunTimeStats_QM_ComTask_10ms_Stop_9: RtePositionInTask=14, RteEventRef=TMT_Cdd_RunTimeStats_QM_ComTask_10ms_Stop_9, RteMappedToTaskRef=QM_Task_00_10ms, RteUsedOsAlarmRef=Rte_Al_TE_QM_Task_00_10ms_0_10ms
        TMT_Cdd_RunTimeStats_QM_ComTask_10ms_Stop_10: RtePositionInTask=0, RteEventRef=TMT_Cdd_RunTimeStats_QM_ComTask_10ms_Stop_10, RteMappedToTaskRef=QM_Task_01_10ms, RteUsedOsAlarmRef=Rte_Al_TE_QM_Task_01_10ms_0_10ms
        TMT_Cdd_RunTimeStats_QM_ComTask_10ms_Stop_11: RtePositionInTask=4, RteEventRef=TMT_Cdd_RunTimeStats_QM_ComTask_10ms_Stop_11, RteMappedToTaskRef=QM_Task_01_10ms, RteUsedOsAlarmRef=Rte_Al_TE_QM_Task_01_10ms_0_10ms
        TMT_Cdd_RunTimeStats_QM_ComTask_10ms_Stop_12: RtePositionInTask=0, RteEventRef=TMT_Cdd_RunTimeStats_QM_ComTask_10ms_Stop_12, RteMappedToTaskRef=QM_Task_200ms, RteUsedOsEventRef=Rte_Ev_Cyclic_QM_Task_200ms_0_200ms, RteUsedOsAlarmRef=Rte_Al_TE_QM_Task_200ms_0_200ms
        TMT_Cdd_RunTimeStats_QM_ComTask_10ms_Stop_13: RtePositionInTask=7, RteEventRef=TMT_Cdd_RunTimeStats_QM_ComTask_10ms_Stop_13, RteMappedToTaskRef=QM_Task_200ms, RteUsedOsEventRef=Rte_Ev_Cyclic_QM_Task_200ms_0_200ms, RteUsedOsAlarmRef=Rte_Al_TE_QM_Task_200ms_0_200ms
        Cdd_RunTimeStats_QM_Task_Init_Start_InitEvent: RtePositionInTask=0, RteEventRef=Cdd_RunTimeStats_QM_Task_Init_Start_InitEvent, RteMappedToTaskRef=QM_Task_Init
        Cdd_RunTimeStats_QM_Task_Init_Stop_InitEvent: RtePositionInTask=16, RteEventRef=Cdd_RunTimeStats_QM_Task_Init_Stop_InitEvent, RteMappedToTaskRef=QM_Task_Init
        OIT_RE_PpRunTimeStatCSData_Cdd_RunTimeStatQM_GetData_PpRunTimeStatCSData_Cdd_RunTimeStatQM_GetData: RteEventRef=OIT_RE_PpRunTimeStatCSData_Cdd_RunTimeStatQM_GetData_PpRunTimeStatCSData_Cdd_RunTimeStatQM_GetData
        OIT_PpGetTaskStackUsage_Data_PpGetTaskStackUsage_Data: RteEventRef=OIT_PpGetTaskStackUsage_Data_PpGetTaskStackUsage_Data
    Cdd_RunTimeStats_B (RteSwComponentType): RteComponentTypeRef=Cdd_RunTimeStats_B, RteImplementationRef=Cdd_RunTimeStats_B_Implementation
      ComponentTypeCalibration (RteComponentTypeCalibration): RteCalibrationSupportEnabled=false
    Cdd_RunTimeStats_QM (RteSwComponentType): RteComponentTypeRef=Cdd_RunTimeStats_QM, RteImplementationRef=Cdd_RunTimeStats_QM_Implementation
      ComponentTypeCalibration (RteComponentTypeCalibration): RteCalibrationSupportEnabled=false
