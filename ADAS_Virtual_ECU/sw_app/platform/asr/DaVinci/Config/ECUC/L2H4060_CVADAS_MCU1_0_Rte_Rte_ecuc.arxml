[part 2 of 3: package /ActiveEcuC]
AUTOSAR XML (schema 00048)
package /ActiveEcuC  (continued)
  module config Rte: implementation-config-variant=VARIANT-PRE-COMPILE, module-description=Rte_Impl  (continued)
    4 x RteSwComponentInstance:  (continued)
      DemSatellite_0_EcuSwComposition: RteSoftwareComponentInstanceRef=DemSatellite_0  (continued)
        1486 x RteEventToTaskMapping, all with RteImmediateRestart=false:  (continued)
          OpEventGetEventTested_GetEventTested_EvtInfo_Front_Sensors_PS_VltgeBelowThreshold_B212A16: RteEventRef=OpEventGetEventTested_GetEventTested_EvtInfo_Front_Sensors_PS_VltgeBelowThreshold_B212A16
          OpEventGetEventTested_GetEventTested_Event_Front_Sensors_PS_VltgeBelowThreshold_B212A16: RteEventRef=OpEventGetEventTested_GetEventTested_Event_Front_Sensors_PS_VltgeBelowThreshold_B212A16
          OpEventGetEventTested_GetEventTested_EvtInfo_Left_Camera_Circuit_Voltage_Out_of_Range_B23C61C: RteEventRef=OpEventGetEventTested_GetEventTested_EvtInfo_Left_Camera_Circuit_Voltage_Out_of_Range_B23C61C
          OpEventGetEventTested_GetEventTested_Event_Left_Camera_Circuit_Voltage_Out_of_Range_B23C61C: RteEventRef=OpEventGetEventTested_GetEventTested_Event_Left_Camera_Circuit_Voltage_Out_of_Range_B23C61C
          OpEventGetEventTested_GetEventTested_EvtInfo_Rear_Sensors_PS_VltgeBelowThreshold_B212B16: RteEventRef=OpEventGetEventTested_GetEventTested_EvtInfo_Rear_Sensors_PS_VltgeBelowThreshold_B212B16
          OpEventGetEventTested_GetEventTested_Event_Rear_Sensors_PS_VltgeBelowThreshold_B212B16: RteEventRef=OpEventGetEventTested_GetEventTested_Event_Rear_Sensors_PS_VltgeBelowThreshold_B212B16
          OpEventGetEventTested_GetEventTested_EvtInfo_Rear_Sensors_PS_Bus_Sig_Msg_Failures_B212B08: RteEventRef=OpEventGetEventTested_GetEventTested_EvtInfo_Rear_Sensors_PS_Bus_Sig_Msg_Failures_B212B08
          OpEventGetEventTested_GetEventTested_Event_Rear_Sensors_PS_Bus_Sig_Msg_Failures_B212B08: RteEventRef=OpEventGetEventTested_GetEventTested_Event_Rear_Sensors_PS_Bus_Sig_Msg_Failures_B212B08
          OpEventGetEventTested_GetEventTested_EvtInfo_Rear_Camera_Circuit_Voltage_Out_of_Range_B217A1C: RteEventRef=OpEventGetEventTested_GetEventTested_EvtInfo_Rear_Camera_Circuit_Voltage_Out_of_Range_B217A1C
          OpEventGetEventTested_GetEventTested_Event_Rear_Camera_Circuit_Voltage_Out_of_Range_B217A1C: RteEventRef=OpEventGetEventTested_GetEventTested_Event_Rear_Camera_Circuit_Voltage_Out_of_Range_B217A1C
          OpEventGetEventTested_GetEventTested_EvtInfo_PTS_Sensor_12_Performance_or_Incorrect_Operation_B129992: RteEventRef=OpEventGetEventTested_GetEventTested_EvtInfo_PTS_Sensor_12_Performance_or_Incorrect_Operation_B129992
          OpEventGetEventTested_GetEventTested_Event_PTS_Sensor_12_Performance_or_Incorrect_Operation_B129992: RteEventRef=OpEventGetEventTested_GetEventTested_Event_PTS_Sensor_12_Performance_or_Incorrect_Operation_B129992
          OpEventGetEventTested_GetEventTested_EvtInfo_Battery_Voltage_Over_Voltage_B210C17: RteEventRef=OpEventGetEventTested_GetEventTested_EvtInfo_Battery_Voltage_Over_Voltage_B210C17
          OpEventGetEventTested_GetEventTested_Event_Battery_Voltage_Over_Voltage_B210C17: RteEventRef=OpEventGetEventTested_GetEventTested_Event_Battery_Voltage_Over_Voltage_B210C17
          OpEventGetEventTested_GetEventTested_EvtInfo_Front_Sensors_PS_VltgeAboveThreshold_B212A17: RteEventRef=OpEventGetEventTested_GetEventTested_EvtInfo_Front_Sensors_PS_VltgeAboveThreshold_B212A17
          OpEventGetEventTested_GetEventTested_Event_Front_Sensors_PS_VltgeAboveThreshold_B212A17: RteEventRef=OpEventGetEventTested_GetEventTested_Event_Front_Sensors_PS_VltgeAboveThreshold_B212A17
          OpEventGetEventTested_GetEventTested_EvtInfo_PTS_Sensor_4_Circuit_Open_B129113: RteEventRef=OpEventGetEventTested_GetEventTested_EvtInfo_PTS_Sensor_4_Circuit_Open_B129113
          OpEventGetEventTested_GetEventTested_Event_PTS_Sensor_4_Circuit_Open_B129113: RteEventRef=OpEventGetEventTested_GetEventTested_Event_PTS_Sensor_4_Circuit_Open_B129113
          OpEventGetEventTested_GetEventTested_EvtInfo_PTS_Sensor_12_Circuit_Open_B129913: RteEventRef=OpEventGetEventTested_GetEventTested_EvtInfo_PTS_Sensor_12_Circuit_Open_B129913
          OpEventGetEventTested_GetEventTested_Event_PTS_Sensor_12_Circuit_Open_B129913: RteEventRef=OpEventGetEventTested_GetEventTested_Event_PTS_Sensor_12_Circuit_Open_B129913
          OpEventGetEventTested_GetEventTested_EvtInfo_PTS_Sensor_11_Performance_or_Incorrect_Operation_B129892: RteEventRef=OpEventGetEventTested_GetEventTested_EvtInfo_PTS_Sensor_11_Performance_or_Incorrect_Operation_B129892
          OpEventGetEventTested_GetEventTested_Event_PTS_Sensor_11_Performance_or_Incorrect_Operation_B129892: RteEventRef=OpEventGetEventTested_GetEventTested_Event_PTS_Sensor_11_Performance_or_Incorrect_Operation_B129892
          OpEventGetEventTested_GetEventTested_EvtInfo_Lost_Communication_With_Radio_U018400: RteEventRef=OpEventGetEventTested_GetEventTested_EvtInfo_Lost_Communication_With_Radio_U018400
          OpEventGetEventTested_GetEventTested_Event_Lost_Communication_With_Radio_U018400: RteEventRef=OpEventGetEventTested_GetEventTested_Event_Lost_Communication_With_Radio_U018400
          OpEventGetEventTested_GetEventTested_EvtInfo_Park_Assist_PTS_Switch_Stuck_B12852A: RteEventRef=OpEventGetEventTested_GetEventTested_EvtInfo_Park_Assist_PTS_Switch_Stuck_B12852A
          OpEventGetEventTested_GetEventTested_Event_Park_Assist_PTS_Switch_Stuck_B12852A: RteEventRef=OpEventGetEventTested_GetEventTested_Event_Park_Assist_PTS_Switch_Stuck_B12852A
          OpEventGetEventTested_GetEventTested_EvtInfo_PTS_Sensor_5_Circuit_Open_B129213: RteEventRef=OpEventGetEventTested_GetEventTested_EvtInfo_PTS_Sensor_5_Circuit_Open_B129213
          OpEventGetEventTested_GetEventTested_Event_PTS_Sensor_5_Circuit_Open_B129213: RteEventRef=OpEventGetEventTested_GetEventTested_Event_PTS_Sensor_5_Circuit_Open_B129213
          OpEventGetEventTested_GetEventTested_EvtInfo_PTS_Sensor_5_Performance_or_Incorrect_Operation_B129292: RteEventRef=OpEventGetEventTested_GetEventTested_EvtInfo_PTS_Sensor_5_Performance_or_Incorrect_Operation_B129292
          OpEventGetEventTested_GetEventTested_Event_PTS_Sensor_5_Performance_or_Incorrect_Operation_B129292: RteEventRef=OpEventGetEventTested_GetEventTested_Event_PTS_Sensor_5_Performance_or_Incorrect_Operation_B129292
          OpEventGetEventTested_GetEventTested_EvtInfo_Battery_Voltage_Under_Voltage_B210C16: RteEventRef=OpEventGetEventTested_GetEventTested_EvtInfo_Battery_Voltage_Under_Voltage_B210C16
          OpEventGetEventTested_GetEventTested_Event_Battery_Voltage_Under_Voltage_B210C16: RteEventRef=OpEventGetEventTested_GetEventTested_Event_Battery_Voltage_Under_Voltage_B210C16
          OpEventGetEventTested_GetEventTested_EvtInfo_PTS_Sensor_4_Performance_or_Incorrect_Operation_B129192: RteEventRef=OpEventGetEventTested_GetEventTested_EvtInfo_PTS_Sensor_4_Performance_or_Incorrect_Operation_B129192
          OpEventGetEventTested_GetEventTested_Event_PTS_Sensor_4_Performance_or_Incorrect_Operation_B129192: RteEventRef=OpEventGetEventTested_GetEventTested_Event_PTS_Sensor_4_Performance_or_Incorrect_Operation_B129192
          OpEventGetEventTested_GetEventTested_EvtInfo_HS_FD_CAN2_Comm_Bus_Performance_U104E00: RteEventRef=OpEventGetEventTested_GetEventTested_EvtInfo_HS_FD_CAN2_Comm_Bus_Performance_U104E00
          OpEventGetEventTested_GetEventTested_Event_HS_FD_CAN2_Comm_Bus_Performance_U104E00: RteEventRef=OpEventGetEventTested_GetEventTested_Event_HS_FD_CAN2_Comm_Bus_Performance_U104E00
          OpEventGetEventTested_GetEventTested_EvtInfo_PTS_Sensor_9_Circuit_Open_B129613: RteEventRef=OpEventGetEventTested_GetEventTested_EvtInfo_PTS_Sensor_9_Circuit_Open_B129613
          OpEventGetEventTested_GetEventTested_Event_PTS_Sensor_9_Circuit_Open_B129613: RteEventRef=OpEventGetEventTested_GetEventTested_Event_PTS_Sensor_9_Circuit_Open_B129613
          OpEventGetEventTested_GetEventTested_EvtInfo_Loss_of_Comm_With_Engine_Control_Module_U010000: RteEventRef=OpEventGetEventTested_GetEventTested_EvtInfo_Loss_of_Comm_With_Engine_Control_Module_U010000
          OpEventGetEventTested_GetEventTested_Event_Loss_of_Comm_With_Engine_Control_Module_U010000: RteEventRef=OpEventGetEventTested_GetEventTested_Event_Loss_of_Comm_With_Engine_Control_Module_U010000
          OpEventGetEventTested_GetEventTested_EvtInfo_Lost_Communication_with_Right_Camera_U026700: RteEventRef=OpEventGetEventTested_GetEventTested_EvtInfo_Lost_Communication_with_Right_Camera_U026700
          OpEventGetEventTested_GetEventTested_Event_Lost_Communication_with_Right_Camera_U026700: RteEventRef=OpEventGetEventTested_GetEventTested_Event_Lost_Communication_with_Right_Camera_U026700
          OpEventGetEventTested_GetEventTested_EvtInfo_PTS_Sensor_1_Performance_or_Incorrect_Operation_B128E92: RteEventRef=OpEventGetEventTested_GetEventTested_EvtInfo_PTS_Sensor_1_Performance_or_Incorrect_Operation_B128E92
          OpEventGetEventTested_GetEventTested_Event_PTS_Sensor_1_Performance_or_Incorrect_Operation_B128E92: RteEventRef=OpEventGetEventTested_GetEventTested_Event_PTS_Sensor_1_Performance_or_Incorrect_Operation_B128E92
          OpEventGetEventTested_GetEventTested_EvtInfo_Rear_Camera_Performance_or_Incorrect_Operation_B217A92: RteEventRef=OpEventGetEventTested_GetEventTested_EvtInfo_Rear_Camera_Performance_or_Incorrect_Operation_B217A92
          OpEventGetEventTested_GetEventTested_Event_Rear_Camera_Performance_or_Incorrect_Operation_B217A92: RteEventRef=OpEventGetEventTested_GetEventTested_Event_Rear_Camera_Performance_or_Incorrect_Operation_B217A92
          OpEventGetEventTested_GetEventTested_EvtInfo_PTS_Sensor_2_Performance_or_Incorrect_Operation_B128F92: RteEventRef=OpEventGetEventTested_GetEventTested_EvtInfo_PTS_Sensor_2_Performance_or_Incorrect_Operation_B128F92
          OpEventGetEventTested_GetEventTested_Event_PTS_Sensor_2_Performance_or_Incorrect_Operation_B128F92: RteEventRef=OpEventGetEventTested_GetEventTested_Event_PTS_Sensor_2_Performance_or_Incorrect_Operation_B128F92
          OpEventGetEventTested_GetEventTested_EvtInfo_Right_Camera_Circuit_Voltage_Out_of_Range_B23C71C: RteEventRef=OpEventGetEventTested_GetEventTested_EvtInfo_Right_Camera_Circuit_Voltage_Out_of_Range_B23C71C
          OpEventGetEventTested_GetEventTested_Event_Right_Camera_Circuit_Voltage_Out_of_Range_B23C71C: RteEventRef=OpEventGetEventTested_GetEventTested_Event_Right_Camera_Circuit_Voltage_Out_of_Range_B23C71C
          OpEventGetEventTested_GetEventTested_EvtInfo_PTS_Sensor_8_Circuit_Open_B129513: RteEventRef=OpEventGetEventTested_GetEventTested_EvtInfo_PTS_Sensor_8_Circuit_Open_B129513
          OpEventGetEventTested_GetEventTested_Event_PTS_Sensor_8_Circuit_Open_B129513: RteEventRef=OpEventGetEventTested_GetEventTested_Event_PTS_Sensor_8_Circuit_Open_B129513
          OpEventGetEventTested_GetEventTested_EvtInfo_Implausible_Data_Received_from_Radio_U048500: RteEventRef=OpEventGetEventTested_GetEventTested_EvtInfo_Implausible_Data_Received_from_Radio_U048500
          OpEventGetEventTested_GetEventTested_Event_Implausible_Data_Received_from_Radio_U048500: RteEventRef=OpEventGetEventTested_GetEventTested_Event_Implausible_Data_Received_from_Radio_U048500
          OpEventGetEventTested_GetEventTested_EvtInfo_Implausible_Data_received_from_TRSKM_module_U14A000: RteEventRef=OpEventGetEventTested_GetEventTested_EvtInfo_Implausible_Data_received_from_TRSKM_module_U14A000
          OpEventGetEventTested_GetEventTested_Event_Implausible_Data_received_from_TRSKM_module_U14A000: RteEventRef=OpEventGetEventTested_GetEventTested_Event_Implausible_Data_received_from_TRSKM_module_U14A000
          OpEventGetEventTested_GetEventTested_EvtInfo_Front_Camera_Performance_or_Incorrect_Operation_B23C592: RteEventRef=OpEventGetEventTested_GetEventTested_EvtInfo_Front_Camera_Performance_or_Incorrect_Operation_B23C592
          OpEventGetEventTested_GetEventTested_Event_Front_Camera_Performance_or_Incorrect_Operation_B23C592: RteEventRef=OpEventGetEventTested_GetEventTested_Event_Front_Camera_Performance_or_Incorrect_Operation_B23C592
          OpEventGetEventTested_GetEventTested_EvtInfo_Loss_Communication_with_TRS_Knob_Module_U12B900: RteEventRef=OpEventGetEventTested_GetEventTested_EvtInfo_Loss_Communication_with_TRS_Knob_Module_U12B900
          OpEventGetEventTested_GetEventTested_Event_Loss_Communication_with_TRS_Knob_Module_U12B900: RteEventRef=OpEventGetEventTested_GetEventTested_Event_Loss_Communication_with_TRS_Knob_Module_U12B900
          OpEventGetEventTested_GetEventTested_EvtInfo_PTS_Sensor_7_Circuit_Open_B129413: RteEventRef=OpEventGetEventTested_GetEventTested_EvtInfo_PTS_Sensor_7_Circuit_Open_B129413
          OpEventGetEventTested_GetEventTested_Event_PTS_Sensor_7_Circuit_Open_B129413: RteEventRef=OpEventGetEventTested_GetEventTested_Event_PTS_Sensor_7_Circuit_Open_B129413
          OpEventGetEventTested_GetEventTested_EvtInfo_Front_Sensors_PS_Bus_Sig_Msg_Failures_B212A08: RteEventRef=OpEventGetEventTested_GetEventTested_EvtInfo_Front_Sensors_PS_Bus_Sig_Msg_Failures_B212A08
          OpEventGetEventTested_GetEventTested_Event_Front_Sensors_PS_Bus_Sig_Msg_Failures_B212A08: RteEventRef=OpEventGetEventTested_GetEventTested_Event_Front_Sensors_PS_Bus_Sig_Msg_Failures_B212A08
          OpEventGetEventTested_GetEventTested_EvtInfo_Lost_Communication_With_PSC_Module_A_U013100: RteEventRef=OpEventGetEventTested_GetEventTested_EvtInfo_Lost_Communication_With_PSC_Module_A_U013100
          OpEventGetEventTested_GetEventTested_Event_Lost_Communication_With_PSC_Module_A_U013100: RteEventRef=OpEventGetEventTested_GetEventTested_Event_Lost_Communication_With_PSC_Module_A_U013100
          OpEventGetEventTested_GetEventTested_EvtInfo_Lost_Communication_with_Front_Camera_U026500: RteEventRef=OpEventGetEventTested_GetEventTested_EvtInfo_Lost_Communication_with_Front_Camera_U026500
          OpEventGetEventTested_GetEventTested_Event_Lost_Communication_with_Front_Camera_U026500: RteEventRef=OpEventGetEventTested_GetEventTested_Event_Lost_Communication_with_Front_Camera_U026500
          OpEventGetEventTested_GetEventTested_EvtInfo_PTS_Sensor_3_Performance_or_Incorrect_Operation_B129092: RteEventRef=OpEventGetEventTested_GetEventTested_EvtInfo_PTS_Sensor_3_Performance_or_Incorrect_Operation_B129092
          OpEventGetEventTested_GetEventTested_Event_PTS_Sensor_3_Performance_or_Incorrect_Operation_B129092: RteEventRef=OpEventGetEventTested_GetEventTested_Event_PTS_Sensor_3_Performance_or_Incorrect_Operation_B129092
          OpEventGetEventTested_GetEventTested_EvtInfo_PTS_Sensor_8_Performance_or_Incorrect_Operation_B129592: RteEventRef=OpEventGetEventTested_GetEventTested_EvtInfo_PTS_Sensor_8_Performance_or_Incorrect_Operation_B129592
          OpEventGetEventTested_GetEventTested_Event_PTS_Sensor_8_Performance_or_Incorrect_Operation_B129592: RteEventRef=OpEventGetEventTested_GetEventTested_Event_PTS_Sensor_8_Performance_or_Incorrect_Operation_B129592
          OpEventGetEventTested_GetEventTested_EvtInfo_PPP_Assist_Switch_Stuck_B12B22A: RteEventRef=OpEventGetEventTested_GetEventTested_EvtInfo_PPP_Assist_Switch_Stuck_B12B22A
          OpEventGetEventTested_GetEventTested_Event_PPP_Assist_Switch_Stuck_B12B22A: RteEventRef=OpEventGetEventTested_GetEventTested_Event_PPP_Assist_Switch_Stuck_B12B22A
          OpEventGetEventTested_GetEventTested_EvtInfo_Implausible_data_received_from_ECM_U040100: RteEventRef=OpEventGetEventTested_GetEventTested_EvtInfo_Implausible_data_received_from_ECM_U040100
          OpEventGetEventTested_GetEventTested_Event_Implausible_data_received_from_ECM_U040100: RteEventRef=OpEventGetEventTested_GetEventTested_Event_Implausible_data_received_from_ECM_U040100
          OpEventGetEventTested_GetEventTested_EvtInfo_PTS_Sensor_10_Circuit_Open_B129713: RteEventRef=OpEventGetEventTested_GetEventTested_EvtInfo_PTS_Sensor_10_Circuit_Open_B129713
          OpEventGetEventTested_GetEventTested_Event_PTS_Sensor_10_Circuit_Open_B129713: RteEventRef=OpEventGetEventTested_GetEventTested_Event_PTS_Sensor_10_Circuit_Open_B129713
          OpEventGetEventTested_GetEventTested_EvtInfo_Lost_Communication_With_BSC_module_1_U012900: RteEventRef=OpEventGetEventTested_GetEventTested_EvtInfo_Lost_Communication_With_BSC_module_1_U012900
          OpEventGetEventTested_GetEventTested_Event_Lost_Communication_With_BSC_module_1_U012900: RteEventRef=OpEventGetEventTested_GetEventTested_Event_Lost_Communication_With_BSC_module_1_U012900
          OpEventGetEventTested_GetEventTested_EvtInfo_PTS_Sensor_7_Performance_or_Incorrect_Operation_B129492: RteEventRef=OpEventGetEventTested_GetEventTested_EvtInfo_PTS_Sensor_7_Performance_or_Incorrect_Operation_B129492
          OpEventGetEventTested_GetEventTested_Event_PTS_Sensor_7_Performance_or_Incorrect_Operation_B129492: RteEventRef=OpEventGetEventTested_GetEventTested_Event_PTS_Sensor_7_Performance_or_Incorrect_Operation_B129492
          OpEventGetEventTested_GetEventTested_EvtInfo_Left_Camera_Performance_or_Incorrect_Operation_B23C692: RteEventRef=OpEventGetEventTested_GetEventTested_EvtInfo_Left_Camera_Performance_or_Incorrect_Operation_B23C692
          OpEventGetEventTested_GetEventTested_Event_Left_Camera_Performance_or_Incorrect_Operation_B23C692: RteEventRef=OpEventGetEventTested_GetEventTested_Event_Left_Camera_Performance_or_Incorrect_Operation_B23C692
          OpEventGetEventTested_GetEventTested_EvtInfo_Vehicle_Configuration_Mismatch_B223B00: RteEventRef=OpEventGetEventTested_GetEventTested_EvtInfo_Vehicle_Configuration_Mismatch_B223B00
          OpEventGetEventTested_GetEventTested_Event_Vehicle_Configuration_Mismatch_B223B00: RteEventRef=OpEventGetEventTested_GetEventTested_Event_Vehicle_Configuration_Mismatch_B223B00
          OpEventGetEventTested_GetEventTested_EvtInfo_PTS_Sensor_6_Circuit_Open_B129313: RteEventRef=OpEventGetEventTested_GetEventTested_EvtInfo_PTS_Sensor_6_Circuit_Open_B129313
          OpEventGetEventTested_GetEventTested_Event_PTS_Sensor_6_Circuit_Open_B129313: RteEventRef=OpEventGetEventTested_GetEventTested_Event_PTS_Sensor_6_Circuit_Open_B129313
          OpEventGetEventTested_GetEventTested_EvtInfo_Front_Camera_Circuit_Voltage_Out_of_Range_B23C51C: RteEventRef=OpEventGetEventTested_GetEventTested_EvtInfo_Front_Camera_Circuit_Voltage_Out_of_Range_B23C51C
          OpEventGetEventTested_GetEventTested_Event_Front_Camera_Circuit_Voltage_Out_of_Range_B23C51C: RteEventRef=OpEventGetEventTested_GetEventTested_Event_Front_Camera_Circuit_Voltage_Out_of_Range_B23C51C
          OpEventGetEventTested_GetEventTested_EvtInfo_Implausible_Data_From_BSC_Module_1_U041800: RteEventRef=OpEventGetEventTested_GetEventTested_EvtInfo_Implausible_Data_From_BSC_Module_1_U041800
          OpEventGetEventTested_GetEventTested_Event_Implausible_Data_From_BSC_Module_1_U041800: RteEventRef=OpEventGetEventTested_GetEventTested_Event_Implausible_Data_From_BSC_Module_1_U041800
          OpEventGetEventTested_GetEventTested_EvtInfo_PTS_Sensor_10_Performance_or_Incorrect_Operation_B129792: RteEventRef=OpEventGetEventTested_GetEventTested_EvtInfo_PTS_Sensor_10_Performance_or_Incorrect_Operation_B129792
          OpEventGetEventTested_GetEventTested_Event_PTS_Sensor_10_Performance_or_Incorrect_Operation_B129792: RteEventRef=OpEventGetEventTested_GetEventTested_Event_PTS_Sensor_10_Performance_or_Incorrect_Operation_B129792
          OpEventGetEventTested_GetEventTested_EvtInfo_PTS_Sensor_11_Circuit_Open_B129813: RteEventRef=OpEventGetEventTested_GetEventTested_EvtInfo_PTS_Sensor_11_Circuit_Open_B129813
          OpEventGetEventTested_GetEventTested_Event_PTS_Sensor_11_Circuit_Open_B129813: RteEventRef=OpEventGetEventTested_GetEventTested_Event_PTS_Sensor_11_Circuit_Open_B129813
          OpEventGetEventTested_GetEventTested_EvtInfo_ECU_Internal_Performance_B22A900: RteEventRef=OpEventGetEventTested_GetEventTested_EvtInfo_ECU_Internal_Performance_B22A900
          OpEventGetEventTested_GetEventTested_Event_ECU_Internal_Performance_B22A900: RteEventRef=OpEventGetEventTested_GetEventTested_Event_ECU_Internal_Performance_B22A900
          OpEventGetEventTested_GetEventTested_EvtInfo_PTS_Sensor_9_Performance_or_Incorrect_Operation_B129692: RteEventRef=OpEventGetEventTested_GetEventTested_EvtInfo_PTS_Sensor_9_Performance_or_Incorrect_Operation_B129692
          OpEventGetEventTested_GetEventTested_Event_PTS_Sensor_9_Performance_or_Incorrect_Operation_B129692: RteEventRef=OpEventGetEventTested_GetEventTested_Event_PTS_Sensor_9_Performance_or_Incorrect_Operation_B129692
          OpEventGetEventTested_GetEventTested_EvtInfo_Calibration_Not_Learned_Lost_Calibration_B228600: RteEventRef=OpEventGetEventTested_GetEventTested_EvtInfo_Calibration_Not_Learned_Lost_Calibration_B228600
          OpEventGetEventTested_GetEventTested_Event_Calibration_Not_Learned_Lost_Calibration_B228600: RteEventRef=OpEventGetEventTested_GetEventTested_Event_Calibration_Not_Learned_Lost_Calibration_B228600
          OpEventGetEventTested_GetEventTested_EvtInfo_Lost_Communication_with_ORC_U015100: RteEventRef=OpEventGetEventTested_GetEventTested_EvtInfo_Lost_Communication_with_ORC_U015100
          OpEventGetEventTested_GetEventTested_Event_Lost_Communication_with_ORC_U015100: RteEventRef=OpEventGetEventTested_GetEventTested_Event_Lost_Communication_with_ORC_U015100
          OpEventGetEventTested_GetEventTested_EvtInfo_PTS_Sensor_1_Circuit_Open_B128E13: RteEventRef=OpEventGetEventTested_GetEventTested_EvtInfo_PTS_Sensor_1_Circuit_Open_B128E13
          OpEventGetEventTested_GetEventTested_Event_PTS_Sensor_1_Circuit_Open_B128E13: RteEventRef=OpEventGetEventTested_GetEventTested_Event_PTS_Sensor_1_Circuit_Open_B128E13
          OpEventGetEventTested_GetEventTested_EvtInfo_Lost_Communication_with_Rear_Camera_U026400: RteEventRef=OpEventGetEventTested_GetEventTested_EvtInfo_Lost_Communication_with_Rear_Camera_U026400
          OpEventGetEventTested_GetEventTested_Event_Lost_Communication_with_Rear_Camera_U026400: RteEventRef=OpEventGetEventTested_GetEventTested_Event_Lost_Communication_with_Rear_Camera_U026400
          OpEventGetEventTested_GetEventTested_EvtInfo_HS_FD_CANR_Comm_Bus_Performance_U100B00: RteEventRef=OpEventGetEventTested_GetEventTested_EvtInfo_HS_FD_CANR_Comm_Bus_Performance_U100B00
          OpEventGetEventTested_GetEventTested_Event_HS_FD_CANR_Comm_Bus_Performance_U100B00: RteEventRef=OpEventGetEventTested_GetEventTested_Event_HS_FD_CANR_Comm_Bus_Performance_U100B00
          OpEventGetEventTested_GetEventTested_EvtInfo_Implausible_Data_Received_From_Body_Control_Module_U042200: RteEventRef=OpEventGetEventTested_GetEventTested_EvtInfo_Implausible_Data_Received_From_Body_Control_Module_U042200
          OpEventGetEventTested_GetEventTested_Event_Implausible_Data_Received_From_Body_Control_Module_U042200: RteEventRef=OpEventGetEventTested_GetEventTested_Event_Implausible_Data_Received_From_Body_Control_Module_U042200
          OpEventGetEventTested_GetEventTested_EvtInfo_Lost_Communication_With_BCM_U014000: RteEventRef=OpEventGetEventTested_GetEventTested_EvtInfo_Lost_Communication_With_BCM_U014000
          OpEventGetEventTested_GetEventTested_Event_Lost_Communication_With_BCM_U014000: RteEventRef=OpEventGetEventTested_GetEventTested_Event_Lost_Communication_With_BCM_U014000
          OpEventGetEventTested_GetEventTested_EvtInfo_PTS_Sensor_2_Circuit_Open_B128F13: RteEventRef=OpEventGetEventTested_GetEventTested_EvtInfo_PTS_Sensor_2_Circuit_Open_B128F13
          OpEventGetEventTested_GetEventTested_Event_PTS_Sensor_2_Circuit_Open_B128F13: RteEventRef=OpEventGetEventTested_GetEventTested_Event_PTS_Sensor_2_Circuit_Open_B128F13
          OpEventGetEventTested_GetEventTested_EvtInfo_PTS_Sensor_3_Circuit_Open_B129013: RteEventRef=OpEventGetEventTested_GetEventTested_EvtInfo_PTS_Sensor_3_Circuit_Open_B129013
          OpEventGetEventTested_GetEventTested_Event_PTS_Sensor_3_Circuit_Open_B129013: RteEventRef=OpEventGetEventTested_GetEventTested_Event_PTS_Sensor_3_Circuit_Open_B129013
          OpEventGetEventTested_GetEventTested_EvtInfo_ECU_In_Plant_Mode_C221200: RteEventRef=OpEventGetEventTested_GetEventTested_EvtInfo_ECU_In_Plant_Mode_C221200
          OpEventGetEventTested_GetEventTested_Event_ECU_In_Plant_Mode_C221200: RteEventRef=OpEventGetEventTested_GetEventTested_Event_ECU_In_Plant_Mode_C221200
          OpEventGetEventTested_GetEventTested_EvtInfo_Implausible_Data_from_ORC_module_U045500: RteEventRef=OpEventGetEventTested_GetEventTested_EvtInfo_Implausible_Data_from_ORC_module_U045500
          OpEventGetEventTested_GetEventTested_Event_Implausible_Data_from_ORC_module_U045500: RteEventRef=OpEventGetEventTested_GetEventTested_Event_Implausible_Data_from_ORC_module_U045500
          OpEventGetEventTested_GetEventTested_EvtInfo_Right_Camera_Performance_or_Incorrect_Operation_B23C792: RteEventRef=OpEventGetEventTested_GetEventTested_EvtInfo_Right_Camera_Performance_or_Incorrect_Operation_B23C792
          OpEventGetEventTested_GetEventTested_Event_Right_Camera_Performance_or_Incorrect_Operation_B23C792: RteEventRef=OpEventGetEventTested_GetEventTested_Event_Right_Camera_Performance_or_Incorrect_Operation_B23C792
          OpEventGetEventTested_GetEventTested_EvtInfo_Rear_Sensors_PS_VltgeAboveThreshold_B212B17: RteEventRef=OpEventGetEventTested_GetEventTested_EvtInfo_Rear_Sensors_PS_VltgeAboveThreshold_B212B17
          OpEventGetEventTested_GetEventTested_Event_Rear_Sensors_PS_VltgeAboveThreshold_B212B17: RteEventRef=OpEventGetEventTested_GetEventTested_Event_Rear_Sensors_PS_VltgeAboveThreshold_B212B17
          OpEventGetDTCOfEvent_GetDTCOfEvent_EvtInfo_Invalid_Data_Received_From_Power_Steering_Control_Module_U042000: RteEventRef=OpEventGetDTCOfEvent_GetDTCOfEvent_EvtInfo_Invalid_Data_Received_From_Power_Steering_Control_Module_U042000
          OpEventGetDTCOfEvent_GetDTCOfEvent_Event_Invalid_Data_Received_From_Power_Steering_Control_Module_U042000: RteEventRef=OpEventGetDTCOfEvent_GetDTCOfEvent_Event_Invalid_Data_Received_From_Power_Steering_Control_Module_U042000
          OpEventGetDTCOfEvent_GetDTCOfEvent_EvtInfo_Lost_Communication_with_Left_Camera_U026600: RteEventRef=OpEventGetDTCOfEvent_GetDTCOfEvent_EvtInfo_Lost_Communication_with_Left_Camera_U026600
          OpEventGetDTCOfEvent_GetDTCOfEvent_Event_Lost_Communication_with_Left_Camera_U026600: RteEventRef=OpEventGetDTCOfEvent_GetDTCOfEvent_Event_Lost_Communication_with_Left_Camera_U026600
          OpEventGetDTCOfEvent_GetDTCOfEvent_EvtInfo_Front_Sensors_PS_VltgeBelowThreshold_B212A16: RteEventRef=OpEventGetDTCOfEvent_GetDTCOfEvent_EvtInfo_Front_Sensors_PS_VltgeBelowThreshold_B212A16
          OpEventGetDTCOfEvent_GetDTCOfEvent_Event_Front_Sensors_PS_VltgeBelowThreshold_B212A16: RteEventRef=OpEventGetDTCOfEvent_GetDTCOfEvent_Event_Front_Sensors_PS_VltgeBelowThreshold_B212A16
          OpEventGetDTCOfEvent_GetDTCOfEvent_EvtInfo_Left_Camera_Circuit_Voltage_Out_of_Range_B23C61C: RteEventRef=OpEventGetDTCOfEvent_GetDTCOfEvent_EvtInfo_Left_Camera_Circuit_Voltage_Out_of_Range_B23C61C
          OpEventGetDTCOfEvent_GetDTCOfEvent_Event_Left_Camera_Circuit_Voltage_Out_of_Range_B23C61C: RteEventRef=OpEventGetDTCOfEvent_GetDTCOfEvent_Event_Left_Camera_Circuit_Voltage_Out_of_Range_B23C61C
          OpEventGetDTCOfEvent_GetDTCOfEvent_EvtInfo_Rear_Sensors_PS_VltgeBelowThreshold_B212B16: RteEventRef=OpEventGetDTCOfEvent_GetDTCOfEvent_EvtInfo_Rear_Sensors_PS_VltgeBelowThreshold_B212B16
          OpEventGetDTCOfEvent_GetDTCOfEvent_Event_Rear_Sensors_PS_VltgeBelowThreshold_B212B16: RteEventRef=OpEventGetDTCOfEvent_GetDTCOfEvent_Event_Rear_Sensors_PS_VltgeBelowThreshold_B212B16
          OpEventGetDTCOfEvent_GetDTCOfEvent_EvtInfo_Rear_Sensors_PS_Bus_Sig_Msg_Failures_B212B08: RteEventRef=OpEventGetDTCOfEvent_GetDTCOfEvent_EvtInfo_Rear_Sensors_PS_Bus_Sig_Msg_Failures_B212B08
          OpEventGetDTCOfEvent_GetDTCOfEvent_Event_Rear_Sensors_PS_Bus_Sig_Msg_Failures_B212B08: RteEventRef=OpEventGetDTCOfEvent_GetDTCOfEvent_Event_Rear_Sensors_PS_Bus_Sig_Msg_Failures_B212B08
          OpEventGetDTCOfEvent_GetDTCOfEvent_EvtInfo_Rear_Camera_Circuit_Voltage_Out_of_Range_B217A1C: RteEventRef=OpEventGetDTCOfEvent_GetDTCOfEvent_EvtInfo_Rear_Camera_Circuit_Voltage_Out_of_Range_B217A1C
          OpEventGetDTCOfEvent_GetDTCOfEvent_Event_Rear_Camera_Circuit_Voltage_Out_of_Range_B217A1C: RteEventRef=OpEventGetDTCOfEvent_GetDTCOfEvent_Event_Rear_Camera_Circuit_Voltage_Out_of_Range_B217A1C
          OpEventGetDTCOfEvent_GetDTCOfEvent_EvtInfo_PTS_Sensor_12_Performance_or_Incorrect_Operation_B129992: RteEventRef=OpEventGetDTCOfEvent_GetDTCOfEvent_EvtInfo_PTS_Sensor_12_Performance_or_Incorrect_Operation_B129992
          OpEventGetDTCOfEvent_GetDTCOfEvent_Event_PTS_Sensor_12_Performance_or_Incorrect_Operation_B129992: RteEventRef=OpEventGetDTCOfEvent_GetDTCOfEvent_Event_PTS_Sensor_12_Performance_or_Incorrect_Operation_B129992
          OpEventGetDTCOfEvent_GetDTCOfEvent_EvtInfo_Battery_Voltage_Over_Voltage_B210C17: RteEventRef=OpEventGetDTCOfEvent_GetDTCOfEvent_EvtInfo_Battery_Voltage_Over_Voltage_B210C17
          OpEventGetDTCOfEvent_GetDTCOfEvent_Event_Battery_Voltage_Over_Voltage_B210C17: RteEventRef=OpEventGetDTCOfEvent_GetDTCOfEvent_Event_Battery_Voltage_Over_Voltage_B210C17
          OpEventGetDTCOfEvent_GetDTCOfEvent_EvtInfo_Front_Sensors_PS_VltgeAboveThreshold_B212A17: RteEventRef=OpEventGetDTCOfEvent_GetDTCOfEvent_EvtInfo_Front_Sensors_PS_VltgeAboveThreshold_B212A17
          OpEventGetDTCOfEvent_GetDTCOfEvent_Event_Front_Sensors_PS_VltgeAboveThreshold_B212A17: RteEventRef=OpEventGetDTCOfEvent_GetDTCOfEvent_Event_Front_Sensors_PS_VltgeAboveThreshold_B212A17
          OpEventGetDTCOfEvent_GetDTCOfEvent_EvtInfo_PTS_Sensor_4_Circuit_Open_B129113: RteEventRef=OpEventGetDTCOfEvent_GetDTCOfEvent_EvtInfo_PTS_Sensor_4_Circuit_Open_B129113
          OpEventGetDTCOfEvent_GetDTCOfEvent_Event_PTS_Sensor_4_Circuit_Open_B129113: RteEventRef=OpEventGetDTCOfEvent_GetDTCOfEvent_Event_PTS_Sensor_4_Circuit_Open_B129113
          OpEventGetDTCOfEvent_GetDTCOfEvent_EvtInfo_PTS_Sensor_12_Circuit_Open_B129913: RteEventRef=OpEventGetDTCOfEvent_GetDTCOfEvent_EvtInfo_PTS_Sensor_12_Circuit_Open_B129913
          OpEventGetDTCOfEvent_GetDTCOfEvent_Event_PTS_Sensor_12_Circuit_Open_B129913: RteEventRef=OpEventGetDTCOfEvent_GetDTCOfEvent_Event_PTS_Sensor_12_Circuit_Open_B129913
          OpEventGetDTCOfEvent_GetDTCOfEvent_EvtInfo_PTS_Sensor_11_Performance_or_Incorrect_Operation_B129892: RteEventRef=OpEventGetDTCOfEvent_GetDTCOfEvent_EvtInfo_PTS_Sensor_11_Performance_or_Incorrect_Operation_B129892
          OpEventGetDTCOfEvent_GetDTCOfEvent_Event_PTS_Sensor_11_Performance_or_Incorrect_Operation_B129892: RteEventRef=OpEventGetDTCOfEvent_GetDTCOfEvent_Event_PTS_Sensor_11_Performance_or_Incorrect_Operation_B129892
          OpEventGetDTCOfEvent_GetDTCOfEvent_EvtInfo_Lost_Communication_With_Radio_U018400: RteEventRef=OpEventGetDTCOfEvent_GetDTCOfEvent_EvtInfo_Lost_Communication_With_Radio_U018400
          OpEventGetDTCOfEvent_GetDTCOfEvent_Event_Lost_Communication_With_Radio_U018400: RteEventRef=OpEventGetDTCOfEvent_GetDTCOfEvent_Event_Lost_Communication_With_Radio_U018400
          OpEventGetDTCOfEvent_GetDTCOfEvent_EvtInfo_Park_Assist_PTS_Switch_Stuck_B12852A: RteEventRef=OpEventGetDTCOfEvent_GetDTCOfEvent_EvtInfo_Park_Assist_PTS_Switch_Stuck_B12852A
          OpEventGetDTCOfEvent_GetDTCOfEvent_Event_Park_Assist_PTS_Switch_Stuck_B12852A: RteEventRef=OpEventGetDTCOfEvent_GetDTCOfEvent_Event_Park_Assist_PTS_Switch_Stuck_B12852A
          OpEventGetDTCOfEvent_GetDTCOfEvent_EvtInfo_PTS_Sensor_5_Circuit_Open_B129213: RteEventRef=OpEventGetDTCOfEvent_GetDTCOfEvent_EvtInfo_PTS_Sensor_5_Circuit_Open_B129213
          OpEventGetDTCOfEvent_GetDTCOfEvent_Event_PTS_Sensor_5_Circuit_Open_B129213: RteEventRef=OpEventGetDTCOfEvent_GetDTCOfEvent_Event_PTS_Sensor_5_Circuit_Open_B129213
          OpEventGetDTCOfEvent_GetDTCOfEvent_EvtInfo_PTS_Sensor_5_Performance_or_Incorrect_Operation_B129292: RteEventRef=OpEventGetDTCOfEvent_GetDTCOfEvent_EvtInfo_PTS_Sensor_5_Performance_or_Incorrect_Operation_B129292
          OpEventGetDTCOfEvent_GetDTCOfEvent_Event_PTS_Sensor_5_Performance_or_Incorrect_Operation_B129292: RteEventRef=OpEventGetDTCOfEvent_GetDTCOfEvent_Event_PTS_Sensor_5_Performance_or_Incorrect_Operation_B129292
          OpEventGetDTCOfEvent_GetDTCOfEvent_EvtInfo_Battery_Voltage_Under_Voltage_B210C16: RteEventRef=OpEventGetDTCOfEvent_GetDTCOfEvent_EvtInfo_Battery_Voltage_Under_Voltage_B210C16
          OpEventGetDTCOfEvent_GetDTCOfEvent_Event_Battery_Voltage_Under_Voltage_B210C16: RteEventRef=OpEventGetDTCOfEvent_GetDTCOfEvent_Event_Battery_Voltage_Under_Voltage_B210C16
          OpEventGetDTCOfEvent_GetDTCOfEvent_EvtInfo_PTS_Sensor_4_Performance_or_Incorrect_Operation_B129192: RteEventRef=OpEventGetDTCOfEvent_GetDTCOfEvent_EvtInfo_PTS_Sensor_4_Performance_or_Incorrect_Operation_B129192
          OpEventGetDTCOfEvent_GetDTCOfEvent_Event_PTS_Sensor_4_Performance_or_Incorrect_Operation_B129192: RteEventRef=OpEventGetDTCOfEvent_GetDTCOfEvent_Event_PTS_Sensor_4_Performance_or_Incorrect_Operation_B129192
          OpEventGetDTCOfEvent_GetDTCOfEvent_EvtInfo_HS_FD_CAN2_Comm_Bus_Performance_U104E00: RteEventRef=OpEventGetDTCOfEvent_GetDTCOfEvent_EvtInfo_HS_FD_CAN2_Comm_Bus_Performance_U104E00
          OpEventGetDTCOfEvent_GetDTCOfEvent_Event_HS_FD_CAN2_Comm_Bus_Performance_U104E00: RteEventRef=OpEventGetDTCOfEvent_GetDTCOfEvent_Event_HS_FD_CAN2_Comm_Bus_Performance_U104E00
          OpEventGetDTCOfEvent_GetDTCOfEvent_EvtInfo_PTS_Sensor_9_Circuit_Open_B129613: RteEventRef=OpEventGetDTCOfEvent_GetDTCOfEvent_EvtInfo_PTS_Sensor_9_Circuit_Open_B129613
          OpEventGetDTCOfEvent_GetDTCOfEvent_Event_PTS_Sensor_9_Circuit_Open_B129613: RteEventRef=OpEventGetDTCOfEvent_GetDTCOfEvent_Event_PTS_Sensor_9_Circuit_Open_B129613
          OpEventGetDTCOfEvent_GetDTCOfEvent_EvtInfo_Loss_of_Comm_With_Engine_Control_Module_U010000: RteEventRef=OpEventGetDTCOfEvent_GetDTCOfEvent_EvtInfo_Loss_of_Comm_With_Engine_Control_Module_U010000
          OpEventGetDTCOfEvent_GetDTCOfEvent_Event_Loss_of_Comm_With_Engine_Control_Module_U010000: RteEventRef=OpEventGetDTCOfEvent_GetDTCOfEvent_Event_Loss_of_Comm_With_Engine_Control_Module_U010000
          OpEventGetDTCOfEvent_GetDTCOfEvent_EvtInfo_Lost_Communication_with_Right_Camera_U026700: RteEventRef=OpEventGetDTCOfEvent_GetDTCOfEvent_EvtInfo_Lost_Communication_with_Right_Camera_U026700
          OpEventGetDTCOfEvent_GetDTCOfEvent_Event_Lost_Communication_with_Right_Camera_U026700: RteEventRef=OpEventGetDTCOfEvent_GetDTCOfEvent_Event_Lost_Communication_with_Right_Camera_U026700
          OpEventGetDTCOfEvent_GetDTCOfEvent_EvtInfo_PTS_Sensor_1_Performance_or_Incorrect_Operation_B128E92: RteEventRef=OpEventGetDTCOfEvent_GetDTCOfEvent_EvtInfo_PTS_Sensor_1_Performance_or_Incorrect_Operation_B128E92
          OpEventGetDTCOfEvent_GetDTCOfEvent_Event_PTS_Sensor_1_Performance_or_Incorrect_Operation_B128E92: RteEventRef=OpEventGetDTCOfEvent_GetDTCOfEvent_Event_PTS_Sensor_1_Performance_or_Incorrect_Operation_B128E92
          OpEventGetDTCOfEvent_GetDTCOfEvent_EvtInfo_Rear_Camera_Performance_or_Incorrect_Operation_B217A92: RteEventRef=OpEventGetDTCOfEvent_GetDTCOfEvent_EvtInfo_Rear_Camera_Performance_or_Incorrect_Operation_B217A92
          OpEventGetDTCOfEvent_GetDTCOfEvent_Event_Rear_Camera_Performance_or_Incorrect_Operation_B217A92: RteEventRef=OpEventGetDTCOfEvent_GetDTCOfEvent_Event_Rear_Camera_Performance_or_Incorrect_Operation_B217A92
          OpEventGetDTCOfEvent_GetDTCOfEvent_EvtInfo_PTS_Sensor_2_Performance_or_Incorrect_Operation_B128F92: RteEventRef=OpEventGetDTCOfEvent_GetDTCOfEvent_EvtInfo_PTS_Sensor_2_Performance_or_Incorrect_Operation_B128F92
          OpEventGetDTCOfEvent_GetDTCOfEvent_Event_PTS_Sensor_2_Performance_or_Incorrect_Operation_B128F92: RteEventRef=OpEventGetDTCOfEvent_GetDTCOfEvent_Event_PTS_Sensor_2_Performance_or_Incorrect_Operation_B128F92
          OpEventGetDTCOfEvent_GetDTCOfEvent_EvtInfo_Right_Camera_Circuit_Voltage_Out_of_Range_B23C71C: RteEventRef=OpEventGetDTCOfEvent_GetDTCOfEvent_EvtInfo_Right_Camera_Circuit_Voltage_Out_of_Range_B23C71C
          OpEventGetDTCOfEvent_GetDTCOfEvent_Event_Right_Camera_Circuit_Voltage_Out_of_Range_B23C71C: RteEventRef=OpEventGetDTCOfEvent_GetDTCOfEvent_Event_Right_Camera_Circuit_Voltage_Out_of_Range_B23C71C
          OpEventGetDTCOfEvent_GetDTCOfEvent_EvtInfo_PTS_Sensor_8_Circuit_Open_B129513: RteEventRef=OpEventGetDTCOfEvent_GetDTCOfEvent_EvtInfo_PTS_Sensor_8_Circuit_Open_B129513
          OpEventGetDTCOfEvent_GetDTCOfEvent_Event_PTS_Sensor_8_Circuit_Open_B129513: RteEventRef=OpEventGetDTCOfEvent_GetDTCOfEvent_Event_PTS_Sensor_8_Circuit_Open_B129513
          OpEventGetDTCOfEvent_GetDTCOfEvent_EvtInfo_Implausible_Data_Received_from_Radio_U048500: RteEventRef=OpEventGetDTCOfEvent_GetDTCOfEvent_EvtInfo_Implausible_Data_Received_from_Radio_U048500
          OpEventGetDTCOfEvent_GetDTCOfEvent_Event_Implausible_Data_Received_from_Radio_U048500: RteEventRef=OpEventGetDTCOfEvent_GetDTCOfEvent_Event_Implausible_Data_Received_from_Radio_U048500
          OpEventGetDTCOfEvent_GetDTCOfEvent_EvtInfo_Implausible_Data_received_from_TRSKM_module_U14A000: RteEventRef=OpEventGetDTCOfEvent_GetDTCOfEvent_EvtInfo_Implausible_Data_received_from_TRSKM_module_U14A000
          OpEventGetDTCOfEvent_GetDTCOfEvent_Event_Implausible_Data_received_from_TRSKM_module_U14A000: RteEventRef=OpEventGetDTCOfEvent_GetDTCOfEvent_Event_Implausible_Data_received_from_TRSKM_module_U14A000
          OpEventGetDTCOfEvent_GetDTCOfEvent_EvtInfo_Front_Camera_Performance_or_Incorrect_Operation_B23C592: RteEventRef=OpEventGetDTCOfEvent_GetDTCOfEvent_EvtInfo_Front_Camera_Performance_or_Incorrect_Operation_B23C592
          OpEventGetDTCOfEvent_GetDTCOfEvent_Event_Front_Camera_Performance_or_Incorrect_Operation_B23C592: RteEventRef=OpEventGetDTCOfEvent_GetDTCOfEvent_Event_Front_Camera_Performance_or_Incorrect_Operation_B23C592
          OpEventGetDTCOfEvent_GetDTCOfEvent_EvtInfo_Loss_Communication_with_TRS_Knob_Module_U12B900: RteEventRef=OpEventGetDTCOfEvent_GetDTCOfEvent_EvtInfo_Loss_Communication_with_TRS_Knob_Module_U12B900
          OpEventGetDTCOfEvent_GetDTCOfEvent_Event_Loss_Communication_with_TRS_Knob_Module_U12B900: RteEventRef=OpEventGetDTCOfEvent_GetDTCOfEvent_Event_Loss_Communication_with_TRS_Knob_Module_U12B900
          OpEventGetDTCOfEvent_GetDTCOfEvent_EvtInfo_PTS_Sensor_7_Circuit_Open_B129413: RteEventRef=OpEventGetDTCOfEvent_GetDTCOfEvent_EvtInfo_PTS_Sensor_7_Circuit_Open_B129413
          OpEventGetDTCOfEvent_GetDTCOfEvent_Event_PTS_Sensor_7_Circuit_Open_B129413: RteEventRef=OpEventGetDTCOfEvent_GetDTCOfEvent_Event_PTS_Sensor_7_Circuit_Open_B129413
          OpEventGetDTCOfEvent_GetDTCOfEvent_EvtInfo_Front_Sensors_PS_Bus_Sig_Msg_Failures_B212A08: RteEventRef=OpEventGetDTCOfEvent_GetDTCOfEvent_EvtInfo_Front_Sensors_PS_Bus_Sig_Msg_Failures_B212A08
          OpEventGetDTCOfEvent_GetDTCOfEvent_Event_Front_Sensors_PS_Bus_Sig_Msg_Failures_B212A08: RteEventRef=OpEventGetDTCOfEvent_GetDTCOfEvent_Event_Front_Sensors_PS_Bus_Sig_Msg_Failures_B212A08
          OpEventGetDTCOfEvent_GetDTCOfEvent_EvtInfo_Lost_Communication_With_PSC_Module_A_U013100: RteEventRef=OpEventGetDTCOfEvent_GetDTCOfEvent_EvtInfo_Lost_Communication_With_PSC_Module_A_U013100
          OpEventGetDTCOfEvent_GetDTCOfEvent_Event_Lost_Communication_With_PSC_Module_A_U013100: RteEventRef=OpEventGetDTCOfEvent_GetDTCOfEvent_Event_Lost_Communication_With_PSC_Module_A_U013100
          OpEventGetDTCOfEvent_GetDTCOfEvent_EvtInfo_Lost_Communication_with_Front_Camera_U026500: RteEventRef=OpEventGetDTCOfEvent_GetDTCOfEvent_EvtInfo_Lost_Communication_with_Front_Camera_U026500
          OpEventGetDTCOfEvent_GetDTCOfEvent_Event_Lost_Communication_with_Front_Camera_U026500: RteEventRef=OpEventGetDTCOfEvent_GetDTCOfEvent_Event_Lost_Communication_with_Front_Camera_U026500
          OpEventGetDTCOfEvent_GetDTCOfEvent_EvtInfo_PTS_Sensor_3_Performance_or_Incorrect_Operation_B129092: RteEventRef=OpEventGetDTCOfEvent_GetDTCOfEvent_EvtInfo_PTS_Sensor_3_Performance_or_Incorrect_Operation_B129092
          OpEventGetDTCOfEvent_GetDTCOfEvent_Event_PTS_Sensor_3_Performance_or_Incorrect_Operation_B129092: RteEventRef=OpEventGetDTCOfEvent_GetDTCOfEvent_Event_PTS_Sensor_3_Performance_or_Incorrect_Operation_B129092
          OpEventGetDTCOfEvent_GetDTCOfEvent_EvtInfo_PTS_Sensor_8_Performance_or_Incorrect_Operation_B129592: RteEventRef=OpEventGetDTCOfEvent_GetDTCOfEvent_EvtInfo_PTS_Sensor_8_Performance_or_Incorrect_Operation_B129592
          OpEventGetDTCOfEvent_GetDTCOfEvent_Event_PTS_Sensor_8_Performance_or_Incorrect_Operation_B129592: RteEventRef=OpEventGetDTCOfEvent_GetDTCOfEvent_Event_PTS_Sensor_8_Performance_or_Incorrect_Operation_B129592
          OpEventGetDTCOfEvent_GetDTCOfEvent_EvtInfo_PPP_Assist_Switch_Stuck_B12B22A: RteEventRef=OpEventGetDTCOfEvent_GetDTCOfEvent_EvtInfo_PPP_Assist_Switch_Stuck_B12B22A
          OpEventGetDTCOfEvent_GetDTCOfEvent_Event_PPP_Assist_Switch_Stuck_B12B22A: RteEventRef=OpEventGetDTCOfEvent_GetDTCOfEvent_Event_PPP_Assist_Switch_Stuck_B12B22A
          OpEventGetDTCOfEvent_GetDTCOfEvent_EvtInfo_Implausible_data_received_from_ECM_U040100: RteEventRef=OpEventGetDTCOfEvent_GetDTCOfEvent_EvtInfo_Implausible_data_received_from_ECM_U040100
          OpEventGetDTCOfEvent_GetDTCOfEvent_Event_Implausible_data_received_from_ECM_U040100: RteEventRef=OpEventGetDTCOfEvent_GetDTCOfEvent_Event_Implausible_data_received_from_ECM_U040100
          OpEventGetDTCOfEvent_GetDTCOfEvent_EvtInfo_PTS_Sensor_10_Circuit_Open_B129713: RteEventRef=OpEventGetDTCOfEvent_GetDTCOfEvent_EvtInfo_PTS_Sensor_10_Circuit_Open_B129713
          OpEventGetDTCOfEvent_GetDTCOfEvent_Event_PTS_Sensor_10_Circuit_Open_B129713: RteEventRef=OpEventGetDTCOfEvent_GetDTCOfEvent_Event_PTS_Sensor_10_Circuit_Open_B129713
          OpEventGetDTCOfEvent_GetDTCOfEvent_EvtInfo_Lost_Communication_With_BSC_module_1_U012900: RteEventRef=OpEventGetDTCOfEvent_GetDTCOfEvent_EvtInfo_Lost_Communication_With_BSC_module_1_U012900
          OpEventGetDTCOfEvent_GetDTCOfEvent_Event_Lost_Communication_With_BSC_module_1_U012900: RteEventRef=OpEventGetDTCOfEvent_GetDTCOfEvent_Event_Lost_Communication_With_BSC_module_1_U012900
          OpEventGetDTCOfEvent_GetDTCOfEvent_EvtInfo_PTS_Sensor_7_Performance_or_Incorrect_Operation_B129492: RteEventRef=OpEventGetDTCOfEvent_GetDTCOfEvent_EvtInfo_PTS_Sensor_7_Performance_or_Incorrect_Operation_B129492
          OpEventGetDTCOfEvent_GetDTCOfEvent_Event_PTS_Sensor_7_Performance_or_Incorrect_Operation_B129492: RteEventRef=OpEventGetDTCOfEvent_GetDTCOfEvent_Event_PTS_Sensor_7_Performance_or_Incorrect_Operation_B129492
          OpEventGetDTCOfEvent_GetDTCOfEvent_EvtInfo_Left_Camera_Performance_or_Incorrect_Operation_B23C692: RteEventRef=OpEventGetDTCOfEvent_GetDTCOfEvent_EvtInfo_Left_Camera_Performance_or_Incorrect_Operation_B23C692
          OpEventGetDTCOfEvent_GetDTCOfEvent_Event_Left_Camera_Performance_or_Incorrect_Operation_B23C692: RteEventRef=OpEventGetDTCOfEvent_GetDTCOfEvent_Event_Left_Camera_Performance_or_Incorrect_Operation_B23C692
          OpEventGetDTCOfEvent_GetDTCOfEvent_EvtInfo_Vehicle_Configuration_Mismatch_B223B00: RteEventRef=OpEventGetDTCOfEvent_GetDTCOfEvent_EvtInfo_Vehicle_Configuration_Mismatch_B223B00
          OpEventGetDTCOfEvent_GetDTCOfEvent_Event_Vehicle_Configuration_Mismatch_B223B00: RteEventRef=OpEventGetDTCOfEvent_GetDTCOfEvent_Event_Vehicle_Configuration_Mismatch_B223B00
          OpEventGetDTCOfEvent_GetDTCOfEvent_EvtInfo_PTS_Sensor_6_Circuit_Open_B129313: RteEventRef=OpEventGetDTCOfEvent_GetDTCOfEvent_EvtInfo_PTS_Sensor_6_Circuit_Open_B129313
          OpEventGetDTCOfEvent_GetDTCOfEvent_Event_PTS_Sensor_6_Circuit_Open_B129313: RteEventRef=OpEventGetDTCOfEvent_GetDTCOfEvent_Event_PTS_Sensor_6_Circuit_Open_B129313
          OpEventGetDTCOfEvent_GetDTCOfEvent_EvtInfo_Front_Camera_Circuit_Voltage_Out_of_Range_B23C51C: RteEventRef=OpEventGetDTCOfEvent_GetDTCOfEvent_EvtInfo_Front_Camera_Circuit_Voltage_Out_of_Range_B23C51C
          OpEventGetDTCOfEvent_GetDTCOfEvent_Event_Front_Camera_Circuit_Voltage_Out_of_Range_B23C51C: RteEventRef=OpEventGetDTCOfEvent_GetDTCOfEvent_Event_Front_Camera_Circuit_Voltage_Out_of_Range_B23C51C
          OpEventGetDTCOfEvent_GetDTCOfEvent_EvtInfo_Implausible_Data_From_BSC_Module_1_U041800: RteEventRef=OpEventGetDTCOfEvent_GetDTCOfEvent_EvtInfo_Implausible_Data_From_BSC_Module_1_U041800
          OpEventGetDTCOfEvent_GetDTCOfEvent_Event_Implausible_Data_From_BSC_Module_1_U041800: RteEventRef=OpEventGetDTCOfEvent_GetDTCOfEvent_Event_Implausible_Data_From_BSC_Module_1_U041800
          OpEventGetDTCOfEvent_GetDTCOfEvent_EvtInfo_PTS_Sensor_10_Performance_or_Incorrect_Operation_B129792: RteEventRef=OpEventGetDTCOfEvent_GetDTCOfEvent_EvtInfo_PTS_Sensor_10_Performance_or_Incorrect_Operation_B129792
          OpEventGetDTCOfEvent_GetDTCOfEvent_Event_PTS_Sensor_10_Performance_or_Incorrect_Operation_B129792: RteEventRef=OpEventGetDTCOfEvent_GetDTCOfEvent_Event_PTS_Sensor_10_Performance_or_Incorrect_Operation_B129792
          OpEventGetDTCOfEvent_GetDTCOfEvent_EvtInfo_PTS_Sensor_11_Circuit_Open_B129813: RteEventRef=OpEventGetDTCOfEvent_GetDTCOfEvent_EvtInfo_PTS_Sensor_11_Circuit_Open_B129813
          OpEventGetDTCOfEvent_GetDTCOfEvent_Event_PTS_Sensor_11_Circuit_Open_B129813: RteEventRef=OpEventGetDTCOfEvent_GetDTCOfEvent_Event_PTS_Sensor_11_Circuit_Open_B129813
          OpEventGetDTCOfEvent_GetDTCOfEvent_EvtInfo_ECU_Internal_Performance_B22A900: RteEventRef=OpEventGetDTCOfEvent_GetDTCOfEvent_EvtInfo_ECU_Internal_Performance_B22A900
          OpEventGetDTCOfEvent_GetDTCOfEvent_Event_ECU_Internal_Performance_B22A900: RteEventRef=OpEventGetDTCOfEvent_GetDTCOfEvent_Event_ECU_Internal_Performance_B22A900
          OpEventGetDTCOfEvent_GetDTCOfEvent_EvtInfo_PTS_Sensor_9_Performance_or_Incorrect_Operation_B129692: RteEventRef=OpEventGetDTCOfEvent_GetDTCOfEvent_EvtInfo_PTS_Sensor_9_Performance_or_Incorrect_Operation_B129692
          OpEventGetDTCOfEvent_GetDTCOfEvent_Event_PTS_Sensor_9_Performance_or_Incorrect_Operation_B129692: RteEventRef=OpEventGetDTCOfEvent_GetDTCOfEvent_Event_PTS_Sensor_9_Performance_or_Incorrect_Operation_B129692
          OpEventGetDTCOfEvent_GetDTCOfEvent_EvtInfo_Calibration_Not_Learned_Lost_Calibration_B228600: RteEventRef=OpEventGetDTCOfEvent_GetDTCOfEvent_EvtInfo_Calibration_Not_Learned_Lost_Calibration_B228600
          OpEventGetDTCOfEvent_GetDTCOfEvent_Event_Calibration_Not_Learned_Lost_Calibration_B228600: RteEventRef=OpEventGetDTCOfEvent_GetDTCOfEvent_Event_Calibration_Not_Learned_Lost_Calibration_B228600
          OpEventGetDTCOfEvent_GetDTCOfEvent_EvtInfo_Lost_Communication_with_ORC_U015100: RteEventRef=OpEventGetDTCOfEvent_GetDTCOfEvent_EvtInfo_Lost_Communication_with_ORC_U015100
          OpEventGetDTCOfEvent_GetDTCOfEvent_Event_Lost_Communication_with_ORC_U015100: RteEventRef=OpEventGetDTCOfEvent_GetDTCOfEvent_Event_Lost_Communication_with_ORC_U015100
          OpEventGetDTCOfEvent_GetDTCOfEvent_EvtInfo_PTS_Sensor_1_Circuit_Open_B128E13: RteEventRef=OpEventGetDTCOfEvent_GetDTCOfEvent_EvtInfo_PTS_Sensor_1_Circuit_Open_B128E13
          OpEventGetDTCOfEvent_GetDTCOfEvent_Event_PTS_Sensor_1_Circuit_Open_B128E13: RteEventRef=OpEventGetDTCOfEvent_GetDTCOfEvent_Event_PTS_Sensor_1_Circuit_Open_B128E13
          OpEventGetDTCOfEvent_GetDTCOfEvent_EvtInfo_Lost_Communication_with_Rear_Camera_U026400: RteEventRef=OpEventGetDTCOfEvent_GetDTCOfEvent_EvtInfo_Lost_Communication_with_Rear_Camera_U026400
          OpEventGetDTCOfEvent_GetDTCOfEvent_Event_Lost_Communication_with_Rear_Camera_U026400: RteEventRef=OpEventGetDTCOfEvent_GetDTCOfEvent_Event_Lost_Communication_with_Rear_Camera_U026400
          OpEventGetDTCOfEvent_GetDTCOfEvent_EvtInfo_HS_FD_CANR_Comm_Bus_Performance_U100B00: RteEventRef=OpEventGetDTCOfEvent_GetDTCOfEvent_EvtInfo_HS_FD_CANR_Comm_Bus_Performance_U100B00
          OpEventGetDTCOfEvent_GetDTCOfEvent_Event_HS_FD_CANR_Comm_Bus_Performance_U100B00: RteEventRef=OpEventGetDTCOfEvent_GetDTCOfEvent_Event_HS_FD_CANR_Comm_Bus_Performance_U100B00
          OpEventGetDTCOfEvent_GetDTCOfEvent_EvtInfo_Implausible_Data_Received_From_Body_Control_Module_U042200: RteEventRef=OpEventGetDTCOfEvent_GetDTCOfEvent_EvtInfo_Implausible_Data_Received_From_Body_Control_Module_U042200
          OpEventGetDTCOfEvent_GetDTCOfEvent_Event_Implausible_Data_Received_From_Body_Control_Module_U042200: RteEventRef=OpEventGetDTCOfEvent_GetDTCOfEvent_Event_Implausible_Data_Received_From_Body_Control_Module_U042200
          OpEventGetDTCOfEvent_GetDTCOfEvent_EvtInfo_Lost_Communication_With_BCM_U014000: RteEventRef=OpEventGetDTCOfEvent_GetDTCOfEvent_EvtInfo_Lost_Communication_With_BCM_U014000
          OpEventGetDTCOfEvent_GetDTCOfEvent_Event_Lost_Communication_With_BCM_U014000: RteEventRef=OpEventGetDTCOfEvent_GetDTCOfEvent_Event_Lost_Communication_With_BCM_U014000
          OpEventGetDTCOfEvent_GetDTCOfEvent_EvtInfo_PTS_Sensor_2_Circuit_Open_B128F13: RteEventRef=OpEventGetDTCOfEvent_GetDTCOfEvent_EvtInfo_PTS_Sensor_2_Circuit_Open_B128F13
          OpEventGetDTCOfEvent_GetDTCOfEvent_Event_PTS_Sensor_2_Circuit_Open_B128F13: RteEventRef=OpEventGetDTCOfEvent_GetDTCOfEvent_Event_PTS_Sensor_2_Circuit_Open_B128F13
          OpEventGetDTCOfEvent_GetDTCOfEvent_EvtInfo_PTS_Sensor_3_Circuit_Open_B129013: RteEventRef=OpEventGetDTCOfEvent_GetDTCOfEvent_EvtInfo_PTS_Sensor_3_Circuit_Open_B129013
          OpEventGetDTCOfEvent_GetDTCOfEvent_Event_PTS_Sensor_3_Circuit_Open_B129013: RteEventRef=OpEventGetDTCOfEvent_GetDTCOfEvent_Event_PTS_Sensor_3_Circuit_Open_B129013
          OpEventGetDTCOfEvent_GetDTCOfEvent_EvtInfo_ECU_In_Plant_Mode_C221200: RteEventRef=OpEventGetDTCOfEvent_GetDTCOfEvent_EvtInfo_ECU_In_Plant_Mode_C221200
          OpEventGetDTCOfEvent_GetDTCOfEvent_Event_ECU_In_Plant_Mode_C221200: RteEventRef=OpEventGetDTCOfEvent_GetDTCOfEvent_Event_ECU_In_Plant_Mode_C221200
          OpEventGetDTCOfEvent_GetDTCOfEvent_EvtInfo_Implausible_Data_from_ORC_module_U045500: RteEventRef=OpEventGetDTCOfEvent_GetDTCOfEvent_EvtInfo_Implausible_Data_from_ORC_module_U045500
          OpEventGetDTCOfEvent_GetDTCOfEvent_Event_Implausible_Data_from_ORC_module_U045500: RteEventRef=OpEventGetDTCOfEvent_GetDTCOfEvent_Event_Implausible_Data_from_ORC_module_U045500
          OpEventGetDTCOfEvent_GetDTCOfEvent_EvtInfo_Right_Camera_Performance_or_Incorrect_Operation_B23C792: RteEventRef=OpEventGetDTCOfEvent_GetDTCOfEvent_EvtInfo_Right_Camera_Performance_or_Incorrect_Operation_B23C792
          OpEventGetDTCOfEvent_GetDTCOfEvent_Event_Right_Camera_Performance_or_Incorrect_Operation_B23C792: RteEventRef=OpEventGetDTCOfEvent_GetDTCOfEvent_Event_Right_Camera_Performance_or_Incorrect_Operation_B23C792
          OpEventGetDTCOfEvent_GetDTCOfEvent_EvtInfo_Rear_Sensors_PS_VltgeAboveThreshold_B212B17: RteEventRef=OpEventGetDTCOfEvent_GetDTCOfEvent_EvtInfo_Rear_Sensors_PS_VltgeAboveThreshold_B212B17
          OpEventGetDTCOfEvent_GetDTCOfEvent_Event_Rear_Sensors_PS_VltgeAboveThreshold_B212B17: RteEventRef=OpEventGetDTCOfEvent_GetDTCOfEvent_Event_Rear_Sensors_PS_VltgeAboveThreshold_B212B17
          OpEventGetFaultDetectionCounter_GetFaultDetectionCounter_EvtInfo_Invalid_Data_Received_From_Power_Steering_Control_Modu_281ede3f: RteEventRef=OpEventGetFaultDetectionCounter_GetFaultDetectionCounter_EvtInfo_Invalid_Data_Received_From_Power_Steering_Control_Modu_281ede3f
          OpEventGetFaultDetectionCounter_GetFaultDetectionCounter_Event_Invalid_Data_Received_From_Power_Steering_Control_Module_U042000: RteEventRef=OpEventGetFaultDetectionCounter_GetFaultDetectionCounter_Event_Invalid_Data_Received_From_Power_Steering_Control_Module_U042000
          OpEventGetFaultDetectionCounter_GetFaultDetectionCounter_EvtInfo_Lost_Communication_with_Left_Camera_U026600: RteEventRef=OpEventGetFaultDetectionCounter_GetFaultDetectionCounter_EvtInfo_Lost_Communication_with_Left_Camera_U026600
          OpEventGetFaultDetectionCounter_GetFaultDetectionCounter_Event_Lost_Communication_with_Left_Camera_U026600: RteEventRef=OpEventGetFaultDetectionCounter_GetFaultDetectionCounter_Event_Lost_Communication_with_Left_Camera_U026600
          OpEventGetFaultDetectionCounter_GetFaultDetectionCounter_EvtInfo_Front_Sensors_PS_VltgeBelowThreshold_B212A16: RteEventRef=OpEventGetFaultDetectionCounter_GetFaultDetectionCounter_EvtInfo_Front_Sensors_PS_VltgeBelowThreshold_B212A16
          OpEventGetFaultDetectionCounter_GetFaultDetectionCounter_Event_Front_Sensors_PS_VltgeBelowThreshold_B212A16: RteEventRef=OpEventGetFaultDetectionCounter_GetFaultDetectionCounter_Event_Front_Sensors_PS_VltgeBelowThreshold_B212A16
          OpEventGetFaultDetectionCounter_GetFaultDetectionCounter_EvtInfo_Left_Camera_Circuit_Voltage_Out_of_Range_B23C61C: RteEventRef=OpEventGetFaultDetectionCounter_GetFaultDetectionCounter_EvtInfo_Left_Camera_Circuit_Voltage_Out_of_Range_B23C61C
          OpEventGetFaultDetectionCounter_GetFaultDetectionCounter_Event_Left_Camera_Circuit_Voltage_Out_of_Range_B23C61C: RteEventRef=OpEventGetFaultDetectionCounter_GetFaultDetectionCounter_Event_Left_Camera_Circuit_Voltage_Out_of_Range_B23C61C
          OpEventGetFaultDetectionCounter_GetFaultDetectionCounter_EvtInfo_Rear_Sensors_PS_VltgeBelowThreshold_B212B16: RteEventRef=OpEventGetFaultDetectionCounter_GetFaultDetectionCounter_EvtInfo_Rear_Sensors_PS_VltgeBelowThreshold_B212B16
          OpEventGetFaultDetectionCounter_GetFaultDetectionCounter_Event_Rear_Sensors_PS_VltgeBelowThreshold_B212B16: RteEventRef=OpEventGetFaultDetectionCounter_GetFaultDetectionCounter_Event_Rear_Sensors_PS_VltgeBelowThreshold_B212B16
          OpEventGetFaultDetectionCounter_GetFaultDetectionCounter_EvtInfo_Rear_Sensors_PS_Bus_Sig_Msg_Failures_B212B08: RteEventRef=OpEventGetFaultDetectionCounter_GetFaultDetectionCounter_EvtInfo_Rear_Sensors_PS_Bus_Sig_Msg_Failures_B212B08
          OpEventGetFaultDetectionCounter_GetFaultDetectionCounter_Event_Rear_Sensors_PS_Bus_Sig_Msg_Failures_B212B08: RteEventRef=OpEventGetFaultDetectionCounter_GetFaultDetectionCounter_Event_Rear_Sensors_PS_Bus_Sig_Msg_Failures_B212B08
          OpEventGetFaultDetectionCounter_GetFaultDetectionCounter_EvtInfo_Rear_Camera_Circuit_Voltage_Out_of_Range_B217A1C: RteEventRef=OpEventGetFaultDetectionCounter_GetFaultDetectionCounter_EvtInfo_Rear_Camera_Circuit_Voltage_Out_of_Range_B217A1C
          OpEventGetFaultDetectionCounter_GetFaultDetectionCounter_Event_Rear_Camera_Circuit_Voltage_Out_of_Range_B217A1C: RteEventRef=OpEventGetFaultDetectionCounter_GetFaultDetectionCounter_Event_Rear_Camera_Circuit_Voltage_Out_of_Range_B217A1C
          OpEventGetFaultDetectionCounter_GetFaultDetectionCounter_EvtInfo_PTS_Sensor_12_Performance_or_Incorrect_Operation_B129992: RteEventRef=OpEventGetFaultDetectionCounter_GetFaultDetectionCounter_EvtInfo_PTS_Sensor_12_Performance_or_Incorrect_Operation_B129992
          OpEventGetFaultDetectionCounter_GetFaultDetectionCounter_Event_PTS_Sensor_12_Performance_or_Incorrect_Operation_B129992: RteEventRef=OpEventGetFaultDetectionCounter_GetFaultDetectionCounter_Event_PTS_Sensor_12_Performance_or_Incorrect_Operation_B129992
          OpEventGetFaultDetectionCounter_GetFaultDetectionCounter_EvtInfo_Battery_Voltage_Over_Voltage_B210C17: RteEventRef=OpEventGetFaultDetectionCounter_GetFaultDetectionCounter_EvtInfo_Battery_Voltage_Over_Voltage_B210C17
          OpEventGetFaultDetectionCounter_GetFaultDetectionCounter_Event_Battery_Voltage_Over_Voltage_B210C17: RteEventRef=OpEventGetFaultDetectionCounter_GetFaultDetectionCounter_Event_Battery_Voltage_Over_Voltage_B210C17
          OpEventGetFaultDetectionCounter_GetFaultDetectionCounter_EvtInfo_Front_Sensors_PS_VltgeAboveThreshold_B212A17: RteEventRef=OpEventGetFaultDetectionCounter_GetFaultDetectionCounter_EvtInfo_Front_Sensors_PS_VltgeAboveThreshold_B212A17
          OpEventGetFaultDetectionCounter_GetFaultDetectionCounter_Event_Front_Sensors_PS_VltgeAboveThreshold_B212A17: RteEventRef=OpEventGetFaultDetectionCounter_GetFaultDetectionCounter_Event_Front_Sensors_PS_VltgeAboveThreshold_B212A17
          OpEventGetFaultDetectionCounter_GetFaultDetectionCounter_EvtInfo_PTS_Sensor_4_Circuit_Open_B129113: RteEventRef=OpEventGetFaultDetectionCounter_GetFaultDetectionCounter_EvtInfo_PTS_Sensor_4_Circuit_Open_B129113
          OpEventGetFaultDetectionCounter_GetFaultDetectionCounter_Event_PTS_Sensor_4_Circuit_Open_B129113: RteEventRef=OpEventGetFaultDetectionCounter_GetFaultDetectionCounter_Event_PTS_Sensor_4_Circuit_Open_B129113
          OpEventGetFaultDetectionCounter_GetFaultDetectionCounter_EvtInfo_PTS_Sensor_12_Circuit_Open_B129913: RteEventRef=OpEventGetFaultDetectionCounter_GetFaultDetectionCounter_EvtInfo_PTS_Sensor_12_Circuit_Open_B129913
          OpEventGetFaultDetectionCounter_GetFaultDetectionCounter_Event_PTS_Sensor_12_Circuit_Open_B129913: RteEventRef=OpEventGetFaultDetectionCounter_GetFaultDetectionCounter_Event_PTS_Sensor_12_Circuit_Open_B129913
          OpEventGetFaultDetectionCounter_GetFaultDetectionCounter_EvtInfo_PTS_Sensor_11_Performance_or_Incorrect_Operation_B129892: RteEventRef=OpEventGetFaultDetectionCounter_GetFaultDetectionCounter_EvtInfo_PTS_Sensor_11_Performance_or_Incorrect_Operation_B129892
          OpEventGetFaultDetectionCounter_GetFaultDetectionCounter_Event_PTS_Sensor_11_Performance_or_Incorrect_Operation_B129892: RteEventRef=OpEventGetFaultDetectionCounter_GetFaultDetectionCounter_Event_PTS_Sensor_11_Performance_or_Incorrect_Operation_B129892
          OpEventGetFaultDetectionCounter_GetFaultDetectionCounter_EvtInfo_Lost_Communication_With_Radio_U018400: RteEventRef=OpEventGetFaultDetectionCounter_GetFaultDetectionCounter_EvtInfo_Lost_Communication_With_Radio_U018400
          OpEventGetFaultDetectionCounter_GetFaultDetectionCounter_Event_Lost_Communication_With_Radio_U018400: RteEventRef=OpEventGetFaultDetectionCounter_GetFaultDetectionCounter_Event_Lost_Communication_With_Radio_U018400
          OpEventGetFaultDetectionCounter_GetFaultDetectionCounter_EvtInfo_Park_Assist_PTS_Switch_Stuck_B12852A: RteEventRef=OpEventGetFaultDetectionCounter_GetFaultDetectionCounter_EvtInfo_Park_Assist_PTS_Switch_Stuck_B12852A
          OpEventGetFaultDetectionCounter_GetFaultDetectionCounter_Event_Park_Assist_PTS_Switch_Stuck_B12852A: RteEventRef=OpEventGetFaultDetectionCounter_GetFaultDetectionCounter_Event_Park_Assist_PTS_Switch_Stuck_B12852A
          OpEventGetFaultDetectionCounter_GetFaultDetectionCounter_EvtInfo_PTS_Sensor_5_Circuit_Open_B129213: RteEventRef=OpEventGetFaultDetectionCounter_GetFaultDetectionCounter_EvtInfo_PTS_Sensor_5_Circuit_Open_B129213
          OpEventGetFaultDetectionCounter_GetFaultDetectionCounter_Event_PTS_Sensor_5_Circuit_Open_B129213: RteEventRef=OpEventGetFaultDetectionCounter_GetFaultDetectionCounter_Event_PTS_Sensor_5_Circuit_Open_B129213
          OpEventGetFaultDetectionCounter_GetFaultDetectionCounter_EvtInfo_PTS_Sensor_5_Performance_or_Incorrect_Operation_B129292: RteEventRef=OpEventGetFaultDetectionCounter_GetFaultDetectionCounter_EvtInfo_PTS_Sensor_5_Performance_or_Incorrect_Operation_B129292
          OpEventGetFaultDetectionCounter_GetFaultDetectionCounter_Event_PTS_Sensor_5_Performance_or_Incorrect_Operation_B129292: RteEventRef=OpEventGetFaultDetectionCounter_GetFaultDetectionCounter_Event_PTS_Sensor_5_Performance_or_Incorrect_Operation_B129292
          OpEventGetFaultDetectionCounter_GetFaultDetectionCounter_EvtInfo_Battery_Voltage_Under_Voltage_B210C16: RteEventRef=OpEventGetFaultDetectionCounter_GetFaultDetectionCounter_EvtInfo_Battery_Voltage_Under_Voltage_B210C16
          OpEventGetFaultDetectionCounter_GetFaultDetectionCounter_Event_Battery_Voltage_Under_Voltage_B210C16: RteEventRef=OpEventGetFaultDetectionCounter_GetFaultDetectionCounter_Event_Battery_Voltage_Under_Voltage_B210C16
          OpEventGetFaultDetectionCounter_GetFaultDetectionCounter_EvtInfo_PTS_Sensor_4_Performance_or_Incorrect_Operation_B129192: RteEventRef=OpEventGetFaultDetectionCounter_GetFaultDetectionCounter_EvtInfo_PTS_Sensor_4_Performance_or_Incorrect_Operation_B129192
          OpEventGetFaultDetectionCounter_GetFaultDetectionCounter_Event_PTS_Sensor_4_Performance_or_Incorrect_Operation_B129192: RteEventRef=OpEventGetFaultDetectionCounter_GetFaultDetectionCounter_Event_PTS_Sensor_4_Performance_or_Incorrect_Operation_B129192
          OpEventGetFaultDetectionCounter_GetFaultDetectionCounter_EvtInfo_HS_FD_CAN2_Comm_Bus_Performance_U104E00: RteEventRef=OpEventGetFaultDetectionCounter_GetFaultDetectionCounter_EvtInfo_HS_FD_CAN2_Comm_Bus_Performance_U104E00
          OpEventGetFaultDetectionCounter_GetFaultDetectionCounter_Event_HS_FD_CAN2_Comm_Bus_Performance_U104E00: RteEventRef=OpEventGetFaultDetectionCounter_GetFaultDetectionCounter_Event_HS_FD_CAN2_Comm_Bus_Performance_U104E00
          OpEventGetFaultDetectionCounter_GetFaultDetectionCounter_EvtInfo_PTS_Sensor_9_Circuit_Open_B129613: RteEventRef=OpEventGetFaultDetectionCounter_GetFaultDetectionCounter_EvtInfo_PTS_Sensor_9_Circuit_Open_B129613
          OpEventGetFaultDetectionCounter_GetFaultDetectionCounter_Event_PTS_Sensor_9_Circuit_Open_B129613: RteEventRef=OpEventGetFaultDetectionCounter_GetFaultDetectionCounter_Event_PTS_Sensor_9_Circuit_Open_B129613
          OpEventGetFaultDetectionCounter_GetFaultDetectionCounter_EvtInfo_Loss_of_Comm_With_Engine_Control_Module_U010000: RteEventRef=OpEventGetFaultDetectionCounter_GetFaultDetectionCounter_EvtInfo_Loss_of_Comm_With_Engine_Control_Module_U010000
          OpEventGetFaultDetectionCounter_GetFaultDetectionCounter_Event_Loss_of_Comm_With_Engine_Control_Module_U010000: RteEventRef=OpEventGetFaultDetectionCounter_GetFaultDetectionCounter_Event_Loss_of_Comm_With_Engine_Control_Module_U010000
          OpEventGetFaultDetectionCounter_GetFaultDetectionCounter_EvtInfo_Lost_Communication_with_Right_Camera_U026700: RteEventRef=OpEventGetFaultDetectionCounter_GetFaultDetectionCounter_EvtInfo_Lost_Communication_with_Right_Camera_U026700
          OpEventGetFaultDetectionCounter_GetFaultDetectionCounter_Event_Lost_Communication_with_Right_Camera_U026700: RteEventRef=OpEventGetFaultDetectionCounter_GetFaultDetectionCounter_Event_Lost_Communication_with_Right_Camera_U026700
          OpEventGetFaultDetectionCounter_GetFaultDetectionCounter_EvtInfo_PTS_Sensor_1_Performance_or_Incorrect_Operation_B128E92: RteEventRef=OpEventGetFaultDetectionCounter_GetFaultDetectionCounter_EvtInfo_PTS_Sensor_1_Performance_or_Incorrect_Operation_B128E92
          OpEventGetFaultDetectionCounter_GetFaultDetectionCounter_Event_PTS_Sensor_1_Performance_or_Incorrect_Operation_B128E92: RteEventRef=OpEventGetFaultDetectionCounter_GetFaultDetectionCounter_Event_PTS_Sensor_1_Performance_or_Incorrect_Operation_B128E92
          OpEventGetFaultDetectionCounter_GetFaultDetectionCounter_EvtInfo_Rear_Camera_Performance_or_Incorrect_Operation_B217A92: RteEventRef=OpEventGetFaultDetectionCounter_GetFaultDetectionCounter_EvtInfo_Rear_Camera_Performance_or_Incorrect_Operation_B217A92
          OpEventGetFaultDetectionCounter_GetFaultDetectionCounter_Event_Rear_Camera_Performance_or_Incorrect_Operation_B217A92: RteEventRef=OpEventGetFaultDetectionCounter_GetFaultDetectionCounter_Event_Rear_Camera_Performance_or_Incorrect_Operation_B217A92
          OpEventGetFaultDetectionCounter_GetFaultDetectionCounter_EvtInfo_PTS_Sensor_2_Performance_or_Incorrect_Operation_B128F92: RteEventRef=OpEventGetFaultDetectionCounter_GetFaultDetectionCounter_EvtInfo_PTS_Sensor_2_Performance_or_Incorrect_Operation_B128F92
          OpEventGetFaultDetectionCounter_GetFaultDetectionCounter_Event_PTS_Sensor_2_Performance_or_Incorrect_Operation_B128F92: RteEventRef=OpEventGetFaultDetectionCounter_GetFaultDetectionCounter_Event_PTS_Sensor_2_Performance_or_Incorrect_Operation_B128F92
          OpEventGetFaultDetectionCounter_GetFaultDetectionCounter_EvtInfo_Right_Camera_Circuit_Voltage_Out_of_Range_B23C71C: RteEventRef=OpEventGetFaultDetectionCounter_GetFaultDetectionCounter_EvtInfo_Right_Camera_Circuit_Voltage_Out_of_Range_B23C71C
          OpEventGetFaultDetectionCounter_GetFaultDetectionCounter_Event_Right_Camera_Circuit_Voltage_Out_of_Range_B23C71C: RteEventRef=OpEventGetFaultDetectionCounter_GetFaultDetectionCounter_Event_Right_Camera_Circuit_Voltage_Out_of_Range_B23C71C
          OpEventGetFaultDetectionCounter_GetFaultDetectionCounter_EvtInfo_PTS_Sensor_8_Circuit_Open_B129513: RteEventRef=OpEventGetFaultDetectionCounter_GetFaultDetectionCounter_EvtInfo_PTS_Sensor_8_Circuit_Open_B129513
          OpEventGetFaultDetectionCounter_GetFaultDetectionCounter_Event_PTS_Sensor_8_Circuit_Open_B129513: RteEventRef=OpEventGetFaultDetectionCounter_GetFaultDetectionCounter_Event_PTS_Sensor_8_Circuit_Open_B129513
          OpEventGetFaultDetectionCounter_GetFaultDetectionCounter_EvtInfo_Implausible_Data_Received_from_Radio_U048500: RteEventRef=OpEventGetFaultDetectionCounter_GetFaultDetectionCounter_EvtInfo_Implausible_Data_Received_from_Radio_U048500
          OpEventGetFaultDetectionCounter_GetFaultDetectionCounter_Event_Implausible_Data_Received_from_Radio_U048500: RteEventRef=OpEventGetFaultDetectionCounter_GetFaultDetectionCounter_Event_Implausible_Data_Received_from_Radio_U048500
          OpEventGetFaultDetectionCounter_GetFaultDetectionCounter_EvtInfo_Implausible_Data_received_from_TRSKM_module_U14A000: RteEventRef=OpEventGetFaultDetectionCounter_GetFaultDetectionCounter_EvtInfo_Implausible_Data_received_from_TRSKM_module_U14A000
          OpEventGetFaultDetectionCounter_GetFaultDetectionCounter_Event_Implausible_Data_received_from_TRSKM_module_U14A000: RteEventRef=OpEventGetFaultDetectionCounter_GetFaultDetectionCounter_Event_Implausible_Data_received_from_TRSKM_module_U14A000
          OpEventGetFaultDetectionCounter_GetFaultDetectionCounter_EvtInfo_Front_Camera_Performance_or_Incorrect_Operation_B23C592: RteEventRef=OpEventGetFaultDetectionCounter_GetFaultDetectionCounter_EvtInfo_Front_Camera_Performance_or_Incorrect_Operation_B23C592
          OpEventGetFaultDetectionCounter_GetFaultDetectionCounter_Event_Front_Camera_Performance_or_Incorrect_Operation_B23C592: RteEventRef=OpEventGetFaultDetectionCounter_GetFaultDetectionCounter_Event_Front_Camera_Performance_or_Incorrect_Operation_B23C592
          OpEventGetFaultDetectionCounter_GetFaultDetectionCounter_EvtInfo_Loss_Communication_with_TRS_Knob_Module_U12B900: RteEventRef=OpEventGetFaultDetectionCounter_GetFaultDetectionCounter_EvtInfo_Loss_Communication_with_TRS_Knob_Module_U12B900
          OpEventGetFaultDetectionCounter_GetFaultDetectionCounter_Event_Loss_Communication_with_TRS_Knob_Module_U12B900: RteEventRef=OpEventGetFaultDetectionCounter_GetFaultDetectionCounter_Event_Loss_Communication_with_TRS_Knob_Module_U12B900
          OpEventGetFaultDetectionCounter_GetFaultDetectionCounter_EvtInfo_PTS_Sensor_7_Circuit_Open_B129413: RteEventRef=OpEventGetFaultDetectionCounter_GetFaultDetectionCounter_EvtInfo_PTS_Sensor_7_Circuit_Open_B129413
          OpEventGetFaultDetectionCounter_GetFaultDetectionCounter_Event_PTS_Sensor_7_Circuit_Open_B129413: RteEventRef=OpEventGetFaultDetectionCounter_GetFaultDetectionCounter_Event_PTS_Sensor_7_Circuit_Open_B129413
          OpEventGetFaultDetectionCounter_GetFaultDetectionCounter_EvtInfo_Front_Sensors_PS_Bus_Sig_Msg_Failures_B212A08: RteEventRef=OpEventGetFaultDetectionCounter_GetFaultDetectionCounter_EvtInfo_Front_Sensors_PS_Bus_Sig_Msg_Failures_B212A08
          OpEventGetFaultDetectionCounter_GetFaultDetectionCounter_Event_Front_Sensors_PS_Bus_Sig_Msg_Failures_B212A08: RteEventRef=OpEventGetFaultDetectionCounter_GetFaultDetectionCounter_Event_Front_Sensors_PS_Bus_Sig_Msg_Failures_B212A08
          OpEventGetFaultDetectionCounter_GetFaultDetectionCounter_EvtInfo_Lost_Communication_With_PSC_Module_A_U013100: RteEventRef=OpEventGetFaultDetectionCounter_GetFaultDetectionCounter_EvtInfo_Lost_Communication_With_PSC_Module_A_U013100
          OpEventGetFaultDetectionCounter_GetFaultDetectionCounter_Event_Lost_Communication_With_PSC_Module_A_U013100: RteEventRef=OpEventGetFaultDetectionCounter_GetFaultDetectionCounter_Event_Lost_Communication_With_PSC_Module_A_U013100
          OpEventGetFaultDetectionCounter_GetFaultDetectionCounter_EvtInfo_Lost_Communication_with_Front_Camera_U026500: RteEventRef=OpEventGetFaultDetectionCounter_GetFaultDetectionCounter_EvtInfo_Lost_Communication_with_Front_Camera_U026500
          OpEventGetFaultDetectionCounter_GetFaultDetectionCounter_Event_Lost_Communication_with_Front_Camera_U026500: RteEventRef=OpEventGetFaultDetectionCounter_GetFaultDetectionCounter_Event_Lost_Communication_with_Front_Camera_U026500
          OpEventGetFaultDetectionCounter_GetFaultDetectionCounter_EvtInfo_PTS_Sensor_3_Performance_or_Incorrect_Operation_B129092: RteEventRef=OpEventGetFaultDetectionCounter_GetFaultDetectionCounter_EvtInfo_PTS_Sensor_3_Performance_or_Incorrect_Operation_B129092
          OpEventGetFaultDetectionCounter_GetFaultDetectionCounter_Event_PTS_Sensor_3_Performance_or_Incorrect_Operation_B129092: RteEventRef=OpEventGetFaultDetectionCounter_GetFaultDetectionCounter_Event_PTS_Sensor_3_Performance_or_Incorrect_Operation_B129092
          OpEventGetFaultDetectionCounter_GetFaultDetectionCounter_EvtInfo_PTS_Sensor_8_Performance_or_Incorrect_Operation_B129592: RteEventRef=OpEventGetFaultDetectionCounter_GetFaultDetectionCounter_EvtInfo_PTS_Sensor_8_Performance_or_Incorrect_Operation_B129592
          OpEventGetFaultDetectionCounter_GetFaultDetectionCounter_Event_PTS_Sensor_8_Performance_or_Incorrect_Operation_B129592: RteEventRef=OpEventGetFaultDetectionCounter_GetFaultDetectionCounter_Event_PTS_Sensor_8_Performance_or_Incorrect_Operation_B129592
          OpEventGetFaultDetectionCounter_GetFaultDetectionCounter_EvtInfo_PPP_Assist_Switch_Stuck_B12B22A: RteEventRef=OpEventGetFaultDetectionCounter_GetFaultDetectionCounter_EvtInfo_PPP_Assist_Switch_Stuck_B12B22A
          OpEventGetFaultDetectionCounter_GetFaultDetectionCounter_Event_PPP_Assist_Switch_Stuck_B12B22A: RteEventRef=OpEventGetFaultDetectionCounter_GetFaultDetectionCounter_Event_PPP_Assist_Switch_Stuck_B12B22A
          OpEventGetFaultDetectionCounter_GetFaultDetectionCounter_EvtInfo_Implausible_data_received_from_ECM_U040100: RteEventRef=OpEventGetFaultDetectionCounter_GetFaultDetectionCounter_EvtInfo_Implausible_data_received_from_ECM_U040100
          OpEventGetFaultDetectionCounter_GetFaultDetectionCounter_Event_Implausible_data_received_from_ECM_U040100: RteEventRef=OpEventGetFaultDetectionCounter_GetFaultDetectionCounter_Event_Implausible_data_received_from_ECM_U040100
          OpEventGetFaultDetectionCounter_GetFaultDetectionCounter_EvtInfo_PTS_Sensor_10_Circuit_Open_B129713: RteEventRef=OpEventGetFaultDetectionCounter_GetFaultDetectionCounter_EvtInfo_PTS_Sensor_10_Circuit_Open_B129713
          OpEventGetFaultDetectionCounter_GetFaultDetectionCounter_Event_PTS_Sensor_10_Circuit_Open_B129713: RteEventRef=OpEventGetFaultDetectionCounter_GetFaultDetectionCounter_Event_PTS_Sensor_10_Circuit_Open_B129713
          OpEventGetFaultDetectionCounter_GetFaultDetectionCounter_EvtInfo_Lost_Communication_With_BSC_module_1_U012900: RteEventRef=OpEventGetFaultDetectionCounter_GetFaultDetectionCounter_EvtInfo_Lost_Communication_With_BSC_module_1_U012900
          OpEventGetFaultDetectionCounter_GetFaultDetectionCounter_Event_Lost_Communication_With_BSC_module_1_U012900: RteEventRef=OpEventGetFaultDetectionCounter_GetFaultDetectionCounter_Event_Lost_Communication_With_BSC_module_1_U012900
          OpEventGetFaultDetectionCounter_GetFaultDetectionCounter_EvtInfo_PTS_Sensor_7_Performance_or_Incorrect_Operation_B129492: RteEventRef=OpEventGetFaultDetectionCounter_GetFaultDetectionCounter_EvtInfo_PTS_Sensor_7_Performance_or_Incorrect_Operation_B129492
          OpEventGetFaultDetectionCounter_GetFaultDetectionCounter_Event_PTS_Sensor_7_Performance_or_Incorrect_Operation_B129492: RteEventRef=OpEventGetFaultDetectionCounter_GetFaultDetectionCounter_Event_PTS_Sensor_7_Performance_or_Incorrect_Operation_B129492
          OpEventGetFaultDetectionCounter_GetFaultDetectionCounter_EvtInfo_Left_Camera_Performance_or_Incorrect_Operation_B23C692: RteEventRef=OpEventGetFaultDetectionCounter_GetFaultDetectionCounter_EvtInfo_Left_Camera_Performance_or_Incorrect_Operation_B23C692
          OpEventGetFaultDetectionCounter_GetFaultDetectionCounter_Event_Left_Camera_Performance_or_Incorrect_Operation_B23C692: RteEventRef=OpEventGetFaultDetectionCounter_GetFaultDetectionCounter_Event_Left_Camera_Performance_or_Incorrect_Operation_B23C692
          OpEventGetFaultDetectionCounter_GetFaultDetectionCounter_EvtInfo_Vehicle_Configuration_Mismatch_B223B00: RteEventRef=OpEventGetFaultDetectionCounter_GetFaultDetectionCounter_EvtInfo_Vehicle_Configuration_Mismatch_B223B00
          OpEventGetFaultDetectionCounter_GetFaultDetectionCounter_Event_Vehicle_Configuration_Mismatch_B223B00: RteEventRef=OpEventGetFaultDetectionCounter_GetFaultDetectionCounter_Event_Vehicle_Configuration_Mismatch_B223B00
          OpEventGetFaultDetectionCounter_GetFaultDetectionCounter_EvtInfo_PTS_Sensor_6_Circuit_Open_B129313: RteEventRef=OpEventGetFaultDetectionCounter_GetFaultDetectionCounter_EvtInfo_PTS_Sensor_6_Circuit_Open_B129313
          OpEventGetFaultDetectionCounter_GetFaultDetectionCounter_Event_PTS_Sensor_6_Circuit_Open_B129313: RteEventRef=OpEventGetFaultDetectionCounter_GetFaultDetectionCounter_Event_PTS_Sensor_6_Circuit_Open_B129313
          OpEventGetFaultDetectionCounter_GetFaultDetectionCounter_EvtInfo_Front_Camera_Circuit_Voltage_Out_of_Range_B23C51C: RteEventRef=OpEventGetFaultDetectionCounter_GetFaultDetectionCounter_EvtInfo_Front_Camera_Circuit_Voltage_Out_of_Range_B23C51C
          OpEventGetFaultDetectionCounter_GetFaultDetectionCounter_Event_Front_Camera_Circuit_Voltage_Out_of_Range_B23C51C: RteEventRef=OpEventGetFaultDetectionCounter_GetFaultDetectionCounter_Event_Front_Camera_Circuit_Voltage_Out_of_Range_B23C51C
          OpEventGetFaultDetectionCounter_GetFaultDetectionCounter_EvtInfo_Implausible_Data_From_BSC_Module_1_U041800: RteEventRef=OpEventGetFaultDetectionCounter_GetFaultDetectionCounter_EvtInfo_Implausible_Data_From_BSC_Module_1_U041800
          OpEventGetFaultDetectionCounter_GetFaultDetectionCounter_Event_Implausible_Data_From_BSC_Module_1_U041800: RteEventRef=OpEventGetFaultDetectionCounter_GetFaultDetectionCounter_Event_Implausible_Data_From_BSC_Module_1_U041800
          OpEventGetFaultDetectionCounter_GetFaultDetectionCounter_EvtInfo_PTS_Sensor_10_Performance_or_Incorrect_Operation_B129792: RteEventRef=OpEventGetFaultDetectionCounter_GetFaultDetectionCounter_EvtInfo_PTS_Sensor_10_Performance_or_Incorrect_Operation_B129792
          OpEventGetFaultDetectionCounter_GetFaultDetectionCounter_Event_PTS_Sensor_10_Performance_or_Incorrect_Operation_B129792: RteEventRef=OpEventGetFaultDetectionCounter_GetFaultDetectionCounter_Event_PTS_Sensor_10_Performance_or_Incorrect_Operation_B129792
          OpEventGetFaultDetectionCounter_GetFaultDetectionCounter_EvtInfo_PTS_Sensor_11_Circuit_Open_B129813: RteEventRef=OpEventGetFaultDetectionCounter_GetFaultDetectionCounter_EvtInfo_PTS_Sensor_11_Circuit_Open_B129813
          OpEventGetFaultDetectionCounter_GetFaultDetectionCounter_Event_PTS_Sensor_11_Circuit_Open_B129813: RteEventRef=OpEventGetFaultDetectionCounter_GetFaultDetectionCounter_Event_PTS_Sensor_11_Circuit_Open_B129813
          OpEventGetFaultDetectionCounter_GetFaultDetectionCounter_EvtInfo_ECU_Internal_Performance_B22A900: RteEventRef=OpEventGetFaultDetectionCounter_GetFaultDetectionCounter_EvtInfo_ECU_Internal_Performance_B22A900
          OpEventGetFaultDetectionCounter_GetFaultDetectionCounter_Event_ECU_Internal_Performance_B22A900: RteEventRef=OpEventGetFaultDetectionCounter_GetFaultDetectionCounter_Event_ECU_Internal_Performance_B22A900
          OpEventGetFaultDetectionCounter_GetFaultDetectionCounter_EvtInfo_PTS_Sensor_9_Performance_or_Incorrect_Operation_B129692: RteEventRef=OpEventGetFaultDetectionCounter_GetFaultDetectionCounter_EvtInfo_PTS_Sensor_9_Performance_or_Incorrect_Operation_B129692
          OpEventGetFaultDetectionCounter_GetFaultDetectionCounter_Event_PTS_Sensor_9_Performance_or_Incorrect_Operation_B129692: RteEventRef=OpEventGetFaultDetectionCounter_GetFaultDetectionCounter_Event_PTS_Sensor_9_Performance_or_Incorrect_Operation_B129692
          OpEventGetFaultDetectionCounter_GetFaultDetectionCounter_EvtInfo_Calibration_Not_Learned_Lost_Calibration_B228600: RteEventRef=OpEventGetFaultDetectionCounter_GetFaultDetectionCounter_EvtInfo_Calibration_Not_Learned_Lost_Calibration_B228600
          OpEventGetFaultDetectionCounter_GetFaultDetectionCounter_Event_Calibration_Not_Learned_Lost_Calibration_B228600: RteEventRef=OpEventGetFaultDetectionCounter_GetFaultDetectionCounter_Event_Calibration_Not_Learned_Lost_Calibration_B228600
          OpEventGetFaultDetectionCounter_GetFaultDetectionCounter_EvtInfo_Lost_Communication_with_ORC_U015100: RteEventRef=OpEventGetFaultDetectionCounter_GetFaultDetectionCounter_EvtInfo_Lost_Communication_with_ORC_U015100
          OpEventGetFaultDetectionCounter_GetFaultDetectionCounter_Event_Lost_Communication_with_ORC_U015100: RteEventRef=OpEventGetFaultDetectionCounter_GetFaultDetectionCounter_Event_Lost_Communication_with_ORC_U015100
          OpEventGetFaultDetectionCounter_GetFaultDetectionCounter_EvtInfo_PTS_Sensor_1_Circuit_Open_B128E13: RteEventRef=OpEventGetFaultDetectionCounter_GetFaultDetectionCounter_EvtInfo_PTS_Sensor_1_Circuit_Open_B128E13
          OpEventGetFaultDetectionCounter_GetFaultDetectionCounter_Event_PTS_Sensor_1_Circuit_Open_B128E13: RteEventRef=OpEventGetFaultDetectionCounter_GetFaultDetectionCounter_Event_PTS_Sensor_1_Circuit_Open_B128E13
          OpEventGetFaultDetectionCounter_GetFaultDetectionCounter_EvtInfo_Lost_Communication_with_Rear_Camera_U026400: RteEventRef=OpEventGetFaultDetectionCounter_GetFaultDetectionCounter_EvtInfo_Lost_Communication_with_Rear_Camera_U026400
          OpEventGetFaultDetectionCounter_GetFaultDetectionCounter_Event_Lost_Communication_with_Rear_Camera_U026400: RteEventRef=OpEventGetFaultDetectionCounter_GetFaultDetectionCounter_Event_Lost_Communication_with_Rear_Camera_U026400
          OpEventGetFaultDetectionCounter_GetFaultDetectionCounter_EvtInfo_HS_FD_CANR_Comm_Bus_Performance_U100B00: RteEventRef=OpEventGetFaultDetectionCounter_GetFaultDetectionCounter_EvtInfo_HS_FD_CANR_Comm_Bus_Performance_U100B00
          OpEventGetFaultDetectionCounter_GetFaultDetectionCounter_Event_HS_FD_CANR_Comm_Bus_Performance_U100B00: RteEventRef=OpEventGetFaultDetectionCounter_GetFaultDetectionCounter_Event_HS_FD_CANR_Comm_Bus_Performance_U100B00
          OpEventGetFaultDetectionCounter_GetFaultDetectionCounter_EvtInfo_Implausible_Data_Received_From_Body_Control_Module_U042200: RteEventRef=OpEventGetFaultDetectionCounter_GetFaultDetectionCounter_EvtInfo_Implausible_Data_Received_From_Body_Control_Module_U042200
          OpEventGetFaultDetectionCounter_GetFaultDetectionCounter_Event_Implausible_Data_Received_From_Body_Control_Module_U042200: RteEventRef=OpEventGetFaultDetectionCounter_GetFaultDetectionCounter_Event_Implausible_Data_Received_From_Body_Control_Module_U042200
          OpEventGetFaultDetectionCounter_GetFaultDetectionCounter_EvtInfo_Lost_Communication_With_BCM_U014000: RteEventRef=OpEventGetFaultDetectionCounter_GetFaultDetectionCounter_EvtInfo_Lost_Communication_With_BCM_U014000
          OpEventGetFaultDetectionCounter_GetFaultDetectionCounter_Event_Lost_Communication_With_BCM_U014000: RteEventRef=OpEventGetFaultDetectionCounter_GetFaultDetectionCounter_Event_Lost_Communication_With_BCM_U014000
          OpEventGetFaultDetectionCounter_GetFaultDetectionCounter_EvtInfo_PTS_Sensor_2_Circuit_Open_B128F13: RteEventRef=OpEventGetFaultDetectionCounter_GetFaultDetectionCounter_EvtInfo_PTS_Sensor_2_Circuit_Open_B128F13
          OpEventGetFaultDetectionCounter_GetFaultDetectionCounter_Event_PTS_Sensor_2_Circuit_Open_B128F13: RteEventRef=OpEventGetFaultDetectionCounter_GetFaultDetectionCounter_Event_PTS_Sensor_2_Circuit_Open_B128F13
          OpEventGetFaultDetectionCounter_GetFaultDetectionCounter_EvtInfo_PTS_Sensor_3_Circuit_Open_B129013: RteEventRef=OpEventGetFaultDetectionCounter_GetFaultDetectionCounter_EvtInfo_PTS_Sensor_3_Circuit_Open_B129013
          OpEventGetFaultDetectionCounter_GetFaultDetectionCounter_Event_PTS_Sensor_3_Circuit_Open_B129013: RteEventRef=OpEventGetFaultDetectionCounter_GetFaultDetectionCounter_Event_PTS_Sensor_3_Circuit_Open_B129013
          OpEventGetFaultDetectionCounter_GetFaultDetectionCounter_EvtInfo_ECU_In_Plant_Mode_C221200: RteEventRef=OpEventGetFaultDetectionCounter_GetFaultDetectionCounter_EvtInfo_ECU_In_Plant_Mode_C221200
          OpEventGetFaultDetectionCounter_GetFaultDetectionCounter_Event_ECU_In_Plant_Mode_C221200: RteEventRef=OpEventGetFaultDetectionCounter_GetFaultDetectionCounter_Event_ECU_In_Plant_Mode_C221200
          OpEventGetFaultDetectionCounter_GetFaultDetectionCounter_EvtInfo_Implausible_Data_from_ORC_module_U045500: RteEventRef=OpEventGetFaultDetectionCounter_GetFaultDetectionCounter_EvtInfo_Implausible_Data_from_ORC_module_U045500
          OpEventGetFaultDetectionCounter_GetFaultDetectionCounter_Event_Implausible_Data_from_ORC_module_U045500: RteEventRef=OpEventGetFaultDetectionCounter_GetFaultDetectionCounter_Event_Implausible_Data_from_ORC_module_U045500
          OpEventGetFaultDetectionCounter_GetFaultDetectionCounter_EvtInfo_Right_Camera_Performance_or_Incorrect_Operation_B23C792: RteEventRef=OpEventGetFaultDetectionCounter_GetFaultDetectionCounter_EvtInfo_Right_Camera_Performance_or_Incorrect_Operation_B23C792
          OpEventGetFaultDetectionCounter_GetFaultDetectionCounter_Event_Right_Camera_Performance_or_Incorrect_Operation_B23C792: RteEventRef=OpEventGetFaultDetectionCounter_GetFaultDetectionCounter_Event_Right_Camera_Performance_or_Incorrect_Operation_B23C792
          OpEventGetFaultDetectionCounter_GetFaultDetectionCounter_EvtInfo_Rear_Sensors_PS_VltgeAboveThreshold_B212B17: RteEventRef=OpEventGetFaultDetectionCounter_GetFaultDetectionCounter_EvtInfo_Rear_Sensors_PS_VltgeAboveThreshold_B212B17
          OpEventGetFaultDetectionCounter_GetFaultDetectionCounter_Event_Rear_Sensors_PS_VltgeAboveThreshold_B212B17: RteEventRef=OpEventGetFaultDetectionCounter_GetFaultDetectionCounter_Event_Rear_Sensors_PS_VltgeAboveThreshold_B212B17
          OpEventGetEventFreezeFrameDataEx_GetEventFreezeFrameDataEx_EvtInfo_Invalid_Data_Received_From_Power_Steering_Control_Mo_805c40b7: RteEventRef=OpEventGetEventFreezeFrameDataEx_GetEventFreezeFrameDataEx_EvtInfo_Invalid_Data_Received_From_Power_Steering_Control_Mo_805c40b7
          OpEventGetEventFreezeFrameDataEx_GetEventFreezeFrameDataEx_Event_Invalid_Data_Received_From_Power_Steering_Control_Modu_5020bf09: RteEventRef=OpEventGetEventFreezeFrameDataEx_GetEventFreezeFrameDataEx_Event_Invalid_Data_Received_From_Power_Steering_Control_Modu_5020bf09
          OpEventGetEventFreezeFrameDataEx_GetEventFreezeFrameDataEx_EvtInfo_Lost_Communication_with_Left_Camera_U026600: RteEventRef=OpEventGetEventFreezeFrameDataEx_GetEventFreezeFrameDataEx_EvtInfo_Lost_Communication_with_Left_Camera_U026600
          OpEventGetEventFreezeFrameDataEx_GetEventFreezeFrameDataEx_Event_Lost_Communication_with_Left_Camera_U026600: RteEventRef=OpEventGetEventFreezeFrameDataEx_GetEventFreezeFrameDataEx_Event_Lost_Communication_with_Left_Camera_U026600
          OpEventGetEventFreezeFrameDataEx_GetEventFreezeFrameDataEx_EvtInfo_Front_Sensors_PS_VltgeBelowThreshold_B212A16: RteEventRef=OpEventGetEventFreezeFrameDataEx_GetEventFreezeFrameDataEx_EvtInfo_Front_Sensors_PS_VltgeBelowThreshold_B212A16
          OpEventGetEventFreezeFrameDataEx_GetEventFreezeFrameDataEx_Event_Front_Sensors_PS_VltgeBelowThreshold_B212A16: RteEventRef=OpEventGetEventFreezeFrameDataEx_GetEventFreezeFrameDataEx_Event_Front_Sensors_PS_VltgeBelowThreshold_B212A16
          OpEventGetEventFreezeFrameDataEx_GetEventFreezeFrameDataEx_EvtInfo_Left_Camera_Circuit_Voltage_Out_of_Range_B23C61C: RteEventRef=OpEventGetEventFreezeFrameDataEx_GetEventFreezeFrameDataEx_EvtInfo_Left_Camera_Circuit_Voltage_Out_of_Range_B23C61C
          OpEventGetEventFreezeFrameDataEx_GetEventFreezeFrameDataEx_Event_Left_Camera_Circuit_Voltage_Out_of_Range_B23C61C: RteEventRef=OpEventGetEventFreezeFrameDataEx_GetEventFreezeFrameDataEx_Event_Left_Camera_Circuit_Voltage_Out_of_Range_B23C61C
          OpEventGetEventFreezeFrameDataEx_GetEventFreezeFrameDataEx_EvtInfo_Rear_Sensors_PS_VltgeBelowThreshold_B212B16: RteEventRef=OpEventGetEventFreezeFrameDataEx_GetEventFreezeFrameDataEx_EvtInfo_Rear_Sensors_PS_VltgeBelowThreshold_B212B16
          OpEventGetEventFreezeFrameDataEx_GetEventFreezeFrameDataEx_Event_Rear_Sensors_PS_VltgeBelowThreshold_B212B16: RteEventRef=OpEventGetEventFreezeFrameDataEx_GetEventFreezeFrameDataEx_Event_Rear_Sensors_PS_VltgeBelowThreshold_B212B16
          OpEventGetEventFreezeFrameDataEx_GetEventFreezeFrameDataEx_EvtInfo_Rear_Sensors_PS_Bus_Sig_Msg_Failures_B212B08: RteEventRef=OpEventGetEventFreezeFrameDataEx_GetEventFreezeFrameDataEx_EvtInfo_Rear_Sensors_PS_Bus_Sig_Msg_Failures_B212B08
          OpEventGetEventFreezeFrameDataEx_GetEventFreezeFrameDataEx_Event_Rear_Sensors_PS_Bus_Sig_Msg_Failures_B212B08: RteEventRef=OpEventGetEventFreezeFrameDataEx_GetEventFreezeFrameDataEx_Event_Rear_Sensors_PS_Bus_Sig_Msg_Failures_B212B08
          OpEventGetEventFreezeFrameDataEx_GetEventFreezeFrameDataEx_EvtInfo_Rear_Camera_Circuit_Voltage_Out_of_Range_B217A1C: RteEventRef=OpEventGetEventFreezeFrameDataEx_GetEventFreezeFrameDataEx_EvtInfo_Rear_Camera_Circuit_Voltage_Out_of_Range_B217A1C
          OpEventGetEventFreezeFrameDataEx_GetEventFreezeFrameDataEx_Event_Rear_Camera_Circuit_Voltage_Out_of_Range_B217A1C: RteEventRef=OpEventGetEventFreezeFrameDataEx_GetEventFreezeFrameDataEx_Event_Rear_Camera_Circuit_Voltage_Out_of_Range_B217A1C
          OpEventGetEventFreezeFrameDataEx_GetEventFreezeFrameDataEx_EvtInfo_PTS_Sensor_12_Performance_or_Incorrect_Operation_B129992: RteEventRef=OpEventGetEventFreezeFrameDataEx_GetEventFreezeFrameDataEx_EvtInfo_PTS_Sensor_12_Performance_or_Incorrect_Operation_B129992
          OpEventGetEventFreezeFrameDataEx_GetEventFreezeFrameDataEx_Event_PTS_Sensor_12_Performance_or_Incorrect_Operation_B129992: RteEventRef=OpEventGetEventFreezeFrameDataEx_GetEventFreezeFrameDataEx_Event_PTS_Sensor_12_Performance_or_Incorrect_Operation_B129992
          OpEventGetEventFreezeFrameDataEx_GetEventFreezeFrameDataEx_EvtInfo_Battery_Voltage_Over_Voltage_B210C17: RteEventRef=OpEventGetEventFreezeFrameDataEx_GetEventFreezeFrameDataEx_EvtInfo_Battery_Voltage_Over_Voltage_B210C17
          OpEventGetEventFreezeFrameDataEx_GetEventFreezeFrameDataEx_Event_Battery_Voltage_Over_Voltage_B210C17: RteEventRef=OpEventGetEventFreezeFrameDataEx_GetEventFreezeFrameDataEx_Event_Battery_Voltage_Over_Voltage_B210C17
          OpEventGetEventFreezeFrameDataEx_GetEventFreezeFrameDataEx_EvtInfo_Front_Sensors_PS_VltgeAboveThreshold_B212A17: RteEventRef=OpEventGetEventFreezeFrameDataEx_GetEventFreezeFrameDataEx_EvtInfo_Front_Sensors_PS_VltgeAboveThreshold_B212A17
          OpEventGetEventFreezeFrameDataEx_GetEventFreezeFrameDataEx_Event_Front_Sensors_PS_VltgeAboveThreshold_B212A17: RteEventRef=OpEventGetEventFreezeFrameDataEx_GetEventFreezeFrameDataEx_Event_Front_Sensors_PS_VltgeAboveThreshold_B212A17
          OpEventGetEventFreezeFrameDataEx_GetEventFreezeFrameDataEx_EvtInfo_PTS_Sensor_4_Circuit_Open_B129113: RteEventRef=OpEventGetEventFreezeFrameDataEx_GetEventFreezeFrameDataEx_EvtInfo_PTS_Sensor_4_Circuit_Open_B129113
          OpEventGetEventFreezeFrameDataEx_GetEventFreezeFrameDataEx_Event_PTS_Sensor_4_Circuit_Open_B129113: RteEventRef=OpEventGetEventFreezeFrameDataEx_GetEventFreezeFrameDataEx_Event_PTS_Sensor_4_Circuit_Open_B129113
          OpEventGetEventFreezeFrameDataEx_GetEventFreezeFrameDataEx_EvtInfo_PTS_Sensor_12_Circuit_Open_B129913: RteEventRef=OpEventGetEventFreezeFrameDataEx_GetEventFreezeFrameDataEx_EvtInfo_PTS_Sensor_12_Circuit_Open_B129913
          OpEventGetEventFreezeFrameDataEx_GetEventFreezeFrameDataEx_Event_PTS_Sensor_12_Circuit_Open_B129913: RteEventRef=OpEventGetEventFreezeFrameDataEx_GetEventFreezeFrameDataEx_Event_PTS_Sensor_12_Circuit_Open_B129913
          OpEventGetEventFreezeFrameDataEx_GetEventFreezeFrameDataEx_EvtInfo_PTS_Sensor_11_Performance_or_Incorrect_Operation_B129892: RteEventRef=OpEventGetEventFreezeFrameDataEx_GetEventFreezeFrameDataEx_EvtInfo_PTS_Sensor_11_Performance_or_Incorrect_Operation_B129892
          OpEventGetEventFreezeFrameDataEx_GetEventFreezeFrameDataEx_Event_PTS_Sensor_11_Performance_or_Incorrect_Operation_B129892: RteEventRef=OpEventGetEventFreezeFrameDataEx_GetEventFreezeFrameDataEx_Event_PTS_Sensor_11_Performance_or_Incorrect_Operation_B129892
          OpEventGetEventFreezeFrameDataEx_GetEventFreezeFrameDataEx_EvtInfo_Lost_Communication_With_Radio_U018400: RteEventRef=OpEventGetEventFreezeFrameDataEx_GetEventFreezeFrameDataEx_EvtInfo_Lost_Communication_With_Radio_U018400
          OpEventGetEventFreezeFrameDataEx_GetEventFreezeFrameDataEx_Event_Lost_Communication_With_Radio_U018400: RteEventRef=OpEventGetEventFreezeFrameDataEx_GetEventFreezeFrameDataEx_Event_Lost_Communication_With_Radio_U018400
          OpEventGetEventFreezeFrameDataEx_GetEventFreezeFrameDataEx_EvtInfo_Park_Assist_PTS_Switch_Stuck_B12852A: RteEventRef=OpEventGetEventFreezeFrameDataEx_GetEventFreezeFrameDataEx_EvtInfo_Park_Assist_PTS_Switch_Stuck_B12852A
          OpEventGetEventFreezeFrameDataEx_GetEventFreezeFrameDataEx_Event_Park_Assist_PTS_Switch_Stuck_B12852A: RteEventRef=OpEventGetEventFreezeFrameDataEx_GetEventFreezeFrameDataEx_Event_Park_Assist_PTS_Switch_Stuck_B12852A
          OpEventGetEventFreezeFrameDataEx_GetEventFreezeFrameDataEx_EvtInfo_PTS_Sensor_5_Circuit_Open_B129213: RteEventRef=OpEventGetEventFreezeFrameDataEx_GetEventFreezeFrameDataEx_EvtInfo_PTS_Sensor_5_Circuit_Open_B129213
          OpEventGetEventFreezeFrameDataEx_GetEventFreezeFrameDataEx_Event_PTS_Sensor_5_Circuit_Open_B129213: RteEventRef=OpEventGetEventFreezeFrameDataEx_GetEventFreezeFrameDataEx_Event_PTS_Sensor_5_Circuit_Open_B129213
          OpEventGetEventFreezeFrameDataEx_GetEventFreezeFrameDataEx_EvtInfo_PTS_Sensor_5_Performance_or_Incorrect_Operation_B129292: RteEventRef=OpEventGetEventFreezeFrameDataEx_GetEventFreezeFrameDataEx_EvtInfo_PTS_Sensor_5_Performance_or_Incorrect_Operation_B129292
          OpEventGetEventFreezeFrameDataEx_GetEventFreezeFrameDataEx_Event_PTS_Sensor_5_Performance_or_Incorrect_Operation_B129292: RteEventRef=OpEventGetEventFreezeFrameDataEx_GetEventFreezeFrameDataEx_Event_PTS_Sensor_5_Performance_or_Incorrect_Operation_B129292
          OpEventGetEventFreezeFrameDataEx_GetEventFreezeFrameDataEx_EvtInfo_Battery_Voltage_Under_Voltage_B210C16: RteEventRef=OpEventGetEventFreezeFrameDataEx_GetEventFreezeFrameDataEx_EvtInfo_Battery_Voltage_Under_Voltage_B210C16
          OpEventGetEventFreezeFrameDataEx_GetEventFreezeFrameDataEx_Event_Battery_Voltage_Under_Voltage_B210C16: RteEventRef=OpEventGetEventFreezeFrameDataEx_GetEventFreezeFrameDataEx_Event_Battery_Voltage_Under_Voltage_B210C16
          OpEventGetEventFreezeFrameDataEx_GetEventFreezeFrameDataEx_EvtInfo_PTS_Sensor_4_Performance_or_Incorrect_Operation_B129192: RteEventRef=OpEventGetEventFreezeFrameDataEx_GetEventFreezeFrameDataEx_EvtInfo_PTS_Sensor_4_Performance_or_Incorrect_Operation_B129192
          OpEventGetEventFreezeFrameDataEx_GetEventFreezeFrameDataEx_Event_PTS_Sensor_4_Performance_or_Incorrect_Operation_B129192: RteEventRef=OpEventGetEventFreezeFrameDataEx_GetEventFreezeFrameDataEx_Event_PTS_Sensor_4_Performance_or_Incorrect_Operation_B129192
          OpEventGetEventFreezeFrameDataEx_GetEventFreezeFrameDataEx_EvtInfo_HS_FD_CAN2_Comm_Bus_Performance_U104E00: RteEventRef=OpEventGetEventFreezeFrameDataEx_GetEventFreezeFrameDataEx_EvtInfo_HS_FD_CAN2_Comm_Bus_Performance_U104E00
          OpEventGetEventFreezeFrameDataEx_GetEventFreezeFrameDataEx_Event_HS_FD_CAN2_Comm_Bus_Performance_U104E00: RteEventRef=OpEventGetEventFreezeFrameDataEx_GetEventFreezeFrameDataEx_Event_HS_FD_CAN2_Comm_Bus_Performance_U104E00
          OpEventGetEventFreezeFrameDataEx_GetEventFreezeFrameDataEx_EvtInfo_PTS_Sensor_9_Circuit_Open_B129613: RteEventRef=OpEventGetEventFreezeFrameDataEx_GetEventFreezeFrameDataEx_EvtInfo_PTS_Sensor_9_Circuit_Open_B129613
          OpEventGetEventFreezeFrameDataEx_GetEventFreezeFrameDataEx_Event_PTS_Sensor_9_Circuit_Open_B129613: RteEventRef=OpEventGetEventFreezeFrameDataEx_GetEventFreezeFrameDataEx_Event_PTS_Sensor_9_Circuit_Open_B129613
          OpEventGetEventFreezeFrameDataEx_GetEventFreezeFrameDataEx_EvtInfo_Loss_of_Comm_With_Engine_Control_Module_U010000: RteEventRef=OpEventGetEventFreezeFrameDataEx_GetEventFreezeFrameDataEx_EvtInfo_Loss_of_Comm_With_Engine_Control_Module_U010000
          OpEventGetEventFreezeFrameDataEx_GetEventFreezeFrameDataEx_Event_Loss_of_Comm_With_Engine_Control_Module_U010000: RteEventRef=OpEventGetEventFreezeFrameDataEx_GetEventFreezeFrameDataEx_Event_Loss_of_Comm_With_Engine_Control_Module_U010000
          OpEventGetEventFreezeFrameDataEx_GetEventFreezeFrameDataEx_EvtInfo_Lost_Communication_with_Right_Camera_U026700: RteEventRef=OpEventGetEventFreezeFrameDataEx_GetEventFreezeFrameDataEx_EvtInfo_Lost_Communication_with_Right_Camera_U026700
          OpEventGetEventFreezeFrameDataEx_GetEventFreezeFrameDataEx_Event_Lost_Communication_with_Right_Camera_U026700: RteEventRef=OpEventGetEventFreezeFrameDataEx_GetEventFreezeFrameDataEx_Event_Lost_Communication_with_Right_Camera_U026700
          OpEventGetEventFreezeFrameDataEx_GetEventFreezeFrameDataEx_EvtInfo_PTS_Sensor_1_Performance_or_Incorrect_Operation_B128E92: RteEventRef=OpEventGetEventFreezeFrameDataEx_GetEventFreezeFrameDataEx_EvtInfo_PTS_Sensor_1_Performance_or_Incorrect_Operation_B128E92
          OpEventGetEventFreezeFrameDataEx_GetEventFreezeFrameDataEx_Event_PTS_Sensor_1_Performance_or_Incorrect_Operation_B128E92: RteEventRef=OpEventGetEventFreezeFrameDataEx_GetEventFreezeFrameDataEx_Event_PTS_Sensor_1_Performance_or_Incorrect_Operation_B128E92
          OpEventGetEventFreezeFrameDataEx_GetEventFreezeFrameDataEx_EvtInfo_Rear_Camera_Performance_or_Incorrect_Operation_B217A92: RteEventRef=OpEventGetEventFreezeFrameDataEx_GetEventFreezeFrameDataEx_EvtInfo_Rear_Camera_Performance_or_Incorrect_Operation_B217A92
          OpEventGetEventFreezeFrameDataEx_GetEventFreezeFrameDataEx_Event_Rear_Camera_Performance_or_Incorrect_Operation_B217A92: RteEventRef=OpEventGetEventFreezeFrameDataEx_GetEventFreezeFrameDataEx_Event_Rear_Camera_Performance_or_Incorrect_Operation_B217A92
          OpEventGetEventFreezeFrameDataEx_GetEventFreezeFrameDataEx_EvtInfo_PTS_Sensor_2_Performance_or_Incorrect_Operation_B128F92: RteEventRef=OpEventGetEventFreezeFrameDataEx_GetEventFreezeFrameDataEx_EvtInfo_PTS_Sensor_2_Performance_or_Incorrect_Operation_B128F92
          OpEventGetEventFreezeFrameDataEx_GetEventFreezeFrameDataEx_Event_PTS_Sensor_2_Performance_or_Incorrect_Operation_B128F92: RteEventRef=OpEventGetEventFreezeFrameDataEx_GetEventFreezeFrameDataEx_Event_PTS_Sensor_2_Performance_or_Incorrect_Operation_B128F92
          OpEventGetEventFreezeFrameDataEx_GetEventFreezeFrameDataEx_EvtInfo_Right_Camera_Circuit_Voltage_Out_of_Range_B23C71C: RteEventRef=OpEventGetEventFreezeFrameDataEx_GetEventFreezeFrameDataEx_EvtInfo_Right_Camera_Circuit_Voltage_Out_of_Range_B23C71C
          OpEventGetEventFreezeFrameDataEx_GetEventFreezeFrameDataEx_Event_Right_Camera_Circuit_Voltage_Out_of_Range_B23C71C: RteEventRef=OpEventGetEventFreezeFrameDataEx_GetEventFreezeFrameDataEx_Event_Right_Camera_Circuit_Voltage_Out_of_Range_B23C71C
          OpEventGetEventFreezeFrameDataEx_GetEventFreezeFrameDataEx_EvtInfo_PTS_Sensor_8_Circuit_Open_B129513: RteEventRef=OpEventGetEventFreezeFrameDataEx_GetEventFreezeFrameDataEx_EvtInfo_PTS_Sensor_8_Circuit_Open_B129513
          OpEventGetEventFreezeFrameDataEx_GetEventFreezeFrameDataEx_Event_PTS_Sensor_8_Circuit_Open_B129513: RteEventRef=OpEventGetEventFreezeFrameDataEx_GetEventFreezeFrameDataEx_Event_PTS_Sensor_8_Circuit_Open_B129513
          OpEventGetEventFreezeFrameDataEx_GetEventFreezeFrameDataEx_EvtInfo_Implausible_Data_Received_from_Radio_U048500: RteEventRef=OpEventGetEventFreezeFrameDataEx_GetEventFreezeFrameDataEx_EvtInfo_Implausible_Data_Received_from_Radio_U048500
          OpEventGetEventFreezeFrameDataEx_GetEventFreezeFrameDataEx_Event_Implausible_Data_Received_from_Radio_U048500: RteEventRef=OpEventGetEventFreezeFrameDataEx_GetEventFreezeFrameDataEx_Event_Implausible_Data_Received_from_Radio_U048500
          OpEventGetEventFreezeFrameDataEx_GetEventFreezeFrameDataEx_EvtInfo_Implausible_Data_received_from_TRSKM_module_U14A000: RteEventRef=OpEventGetEventFreezeFrameDataEx_GetEventFreezeFrameDataEx_EvtInfo_Implausible_Data_received_from_TRSKM_module_U14A000
          OpEventGetEventFreezeFrameDataEx_GetEventFreezeFrameDataEx_Event_Implausible_Data_received_from_TRSKM_module_U14A000: RteEventRef=OpEventGetEventFreezeFrameDataEx_GetEventFreezeFrameDataEx_Event_Implausible_Data_received_from_TRSKM_module_U14A000
          OpEventGetEventFreezeFrameDataEx_GetEventFreezeFrameDataEx_EvtInfo_Front_Camera_Performance_or_Incorrect_Operation_B23C592: RteEventRef=OpEventGetEventFreezeFrameDataEx_GetEventFreezeFrameDataEx_EvtInfo_Front_Camera_Performance_or_Incorrect_Operation_B23C592
          OpEventGetEventFreezeFrameDataEx_GetEventFreezeFrameDataEx_Event_Front_Camera_Performance_or_Incorrect_Operation_B23C592: RteEventRef=OpEventGetEventFreezeFrameDataEx_GetEventFreezeFrameDataEx_Event_Front_Camera_Performance_or_Incorrect_Operation_B23C592
          OpEventGetEventFreezeFrameDataEx_GetEventFreezeFrameDataEx_EvtInfo_Loss_Communication_with_TRS_Knob_Module_U12B900: RteEventRef=OpEventGetEventFreezeFrameDataEx_GetEventFreezeFrameDataEx_EvtInfo_Loss_Communication_with_TRS_Knob_Module_U12B900
          OpEventGetEventFreezeFrameDataEx_GetEventFreezeFrameDataEx_Event_Loss_Communication_with_TRS_Knob_Module_U12B900: RteEventRef=OpEventGetEventFreezeFrameDataEx_GetEventFreezeFrameDataEx_Event_Loss_Communication_with_TRS_Knob_Module_U12B900
          OpEventGetEventFreezeFrameDataEx_GetEventFreezeFrameDataEx_EvtInfo_PTS_Sensor_7_Circuit_Open_B129413: RteEventRef=OpEventGetEventFreezeFrameDataEx_GetEventFreezeFrameDataEx_EvtInfo_PTS_Sensor_7_Circuit_Open_B129413
          OpEventGetEventFreezeFrameDataEx_GetEventFreezeFrameDataEx_Event_PTS_Sensor_7_Circuit_Open_B129413: RteEventRef=OpEventGetEventFreezeFrameDataEx_GetEventFreezeFrameDataEx_Event_PTS_Sensor_7_Circuit_Open_B129413
          OpEventGetEventFreezeFrameDataEx_GetEventFreezeFrameDataEx_EvtInfo_Front_Sensors_PS_Bus_Sig_Msg_Failures_B212A08: RteEventRef=OpEventGetEventFreezeFrameDataEx_GetEventFreezeFrameDataEx_EvtInfo_Front_Sensors_PS_Bus_Sig_Msg_Failures_B212A08
          OpEventGetEventFreezeFrameDataEx_GetEventFreezeFrameDataEx_Event_Front_Sensors_PS_Bus_Sig_Msg_Failures_B212A08: RteEventRef=OpEventGetEventFreezeFrameDataEx_GetEventFreezeFrameDataEx_Event_Front_Sensors_PS_Bus_Sig_Msg_Failures_B212A08
          OpEventGetEventFreezeFrameDataEx_GetEventFreezeFrameDataEx_EvtInfo_Lost_Communication_With_PSC_Module_A_U013100: RteEventRef=OpEventGetEventFreezeFrameDataEx_GetEventFreezeFrameDataEx_EvtInfo_Lost_Communication_With_PSC_Module_A_U013100
          OpEventGetEventFreezeFrameDataEx_GetEventFreezeFrameDataEx_Event_Lost_Communication_With_PSC_Module_A_U013100: RteEventRef=OpEventGetEventFreezeFrameDataEx_GetEventFreezeFrameDataEx_Event_Lost_Communication_With_PSC_Module_A_U013100
          OpEventGetEventFreezeFrameDataEx_GetEventFreezeFrameDataEx_EvtInfo_Lost_Communication_with_Front_Camera_U026500: RteEventRef=OpEventGetEventFreezeFrameDataEx_GetEventFreezeFrameDataEx_EvtInfo_Lost_Communication_with_Front_Camera_U026500
          OpEventGetEventFreezeFrameDataEx_GetEventFreezeFrameDataEx_Event_Lost_Communication_with_Front_Camera_U026500: RteEventRef=OpEventGetEventFreezeFrameDataEx_GetEventFreezeFrameDataEx_Event_Lost_Communication_with_Front_Camera_U026500
          OpEventGetEventFreezeFrameDataEx_GetEventFreezeFrameDataEx_EvtInfo_PTS_Sensor_3_Performance_or_Incorrect_Operation_B129092: RteEventRef=OpEventGetEventFreezeFrameDataEx_GetEventFreezeFrameDataEx_EvtInfo_PTS_Sensor_3_Performance_or_Incorrect_Operation_B129092
          OpEventGetEventFreezeFrameDataEx_GetEventFreezeFrameDataEx_Event_PTS_Sensor_3_Performance_or_Incorrect_Operation_B129092: RteEventRef=OpEventGetEventFreezeFrameDataEx_GetEventFreezeFrameDataEx_Event_PTS_Sensor_3_Performance_or_Incorrect_Operation_B129092
          OpEventGetEventFreezeFrameDataEx_GetEventFreezeFrameDataEx_EvtInfo_PTS_Sensor_8_Performance_or_Incorrect_Operation_B129592: RteEventRef=OpEventGetEventFreezeFrameDataEx_GetEventFreezeFrameDataEx_EvtInfo_PTS_Sensor_8_Performance_or_Incorrect_Operation_B129592
          OpEventGetEventFreezeFrameDataEx_GetEventFreezeFrameDataEx_Event_PTS_Sensor_8_Performance_or_Incorrect_Operation_B129592: RteEventRef=OpEventGetEventFreezeFrameDataEx_GetEventFreezeFrameDataEx_Event_PTS_Sensor_8_Performance_or_Incorrect_Operation_B129592
          OpEventGetEventFreezeFrameDataEx_GetEventFreezeFrameDataEx_EvtInfo_PPP_Assist_Switch_Stuck_B12B22A: RteEventRef=OpEventGetEventFreezeFrameDataEx_GetEventFreezeFrameDataEx_EvtInfo_PPP_Assist_Switch_Stuck_B12B22A
          OpEventGetEventFreezeFrameDataEx_GetEventFreezeFrameDataEx_Event_PPP_Assist_Switch_Stuck_B12B22A: RteEventRef=OpEventGetEventFreezeFrameDataEx_GetEventFreezeFrameDataEx_Event_PPP_Assist_Switch_Stuck_B12B22A
          OpEventGetEventFreezeFrameDataEx_GetEventFreezeFrameDataEx_EvtInfo_Implausible_data_received_from_ECM_U040100: RteEventRef=OpEventGetEventFreezeFrameDataEx_GetEventFreezeFrameDataEx_EvtInfo_Implausible_data_received_from_ECM_U040100
          OpEventGetEventFreezeFrameDataEx_GetEventFreezeFrameDataEx_Event_Implausible_data_received_from_ECM_U040100: RteEventRef=OpEventGetEventFreezeFrameDataEx_GetEventFreezeFrameDataEx_Event_Implausible_data_received_from_ECM_U040100
          OpEventGetEventFreezeFrameDataEx_GetEventFreezeFrameDataEx_EvtInfo_PTS_Sensor_10_Circuit_Open_B129713: RteEventRef=OpEventGetEventFreezeFrameDataEx_GetEventFreezeFrameDataEx_EvtInfo_PTS_Sensor_10_Circuit_Open_B129713
          OpEventGetEventFreezeFrameDataEx_GetEventFreezeFrameDataEx_Event_PTS_Sensor_10_Circuit_Open_B129713: RteEventRef=OpEventGetEventFreezeFrameDataEx_GetEventFreezeFrameDataEx_Event_PTS_Sensor_10_Circuit_Open_B129713
          OpEventGetEventFreezeFrameDataEx_GetEventFreezeFrameDataEx_EvtInfo_Lost_Communication_With_BSC_module_1_U012900: RteEventRef=OpEventGetEventFreezeFrameDataEx_GetEventFreezeFrameDataEx_EvtInfo_Lost_Communication_With_BSC_module_1_U012900
          OpEventGetEventFreezeFrameDataEx_GetEventFreezeFrameDataEx_Event_Lost_Communication_With_BSC_module_1_U012900: RteEventRef=OpEventGetEventFreezeFrameDataEx_GetEventFreezeFrameDataEx_Event_Lost_Communication_With_BSC_module_1_U012900
          OpEventGetEventFreezeFrameDataEx_GetEventFreezeFrameDataEx_EvtInfo_PTS_Sensor_7_Performance_or_Incorrect_Operation_B129492: RteEventRef=OpEventGetEventFreezeFrameDataEx_GetEventFreezeFrameDataEx_EvtInfo_PTS_Sensor_7_Performance_or_Incorrect_Operation_B129492
          OpEventGetEventFreezeFrameDataEx_GetEventFreezeFrameDataEx_Event_PTS_Sensor_7_Performance_or_Incorrect_Operation_B129492: RteEventRef=OpEventGetEventFreezeFrameDataEx_GetEventFreezeFrameDataEx_Event_PTS_Sensor_7_Performance_or_Incorrect_Operation_B129492
          OpEventGetEventFreezeFrameDataEx_GetEventFreezeFrameDataEx_EvtInfo_Left_Camera_Performance_or_Incorrect_Operation_B23C692: RteEventRef=OpEventGetEventFreezeFrameDataEx_GetEventFreezeFrameDataEx_EvtInfo_Left_Camera_Performance_or_Incorrect_Operation_B23C692
          OpEventGetEventFreezeFrameDataEx_GetEventFreezeFrameDataEx_Event_Left_Camera_Performance_or_Incorrect_Operation_B23C692: RteEventRef=OpEventGetEventFreezeFrameDataEx_GetEventFreezeFrameDataEx_Event_Left_Camera_Performance_or_Incorrect_Operation_B23C692
          OpEventGetEventFreezeFrameDataEx_GetEventFreezeFrameDataEx_EvtInfo_Vehicle_Configuration_Mismatch_B223B00: RteEventRef=OpEventGetEventFreezeFrameDataEx_GetEventFreezeFrameDataEx_EvtInfo_Vehicle_Configuration_Mismatch_B223B00
          OpEventGetEventFreezeFrameDataEx_GetEventFreezeFrameDataEx_Event_Vehicle_Configuration_Mismatch_B223B00: RteEventRef=OpEventGetEventFreezeFrameDataEx_GetEventFreezeFrameDataEx_Event_Vehicle_Configuration_Mismatch_B223B00
          OpEventGetEventFreezeFrameDataEx_GetEventFreezeFrameDataEx_EvtInfo_PTS_Sensor_6_Circuit_Open_B129313: RteEventRef=OpEventGetEventFreezeFrameDataEx_GetEventFreezeFrameDataEx_EvtInfo_PTS_Sensor_6_Circuit_Open_B129313
          OpEventGetEventFreezeFrameDataEx_GetEventFreezeFrameDataEx_Event_PTS_Sensor_6_Circuit_Open_B129313: RteEventRef=OpEventGetEventFreezeFrameDataEx_GetEventFreezeFrameDataEx_Event_PTS_Sensor_6_Circuit_Open_B129313
          OpEventGetEventFreezeFrameDataEx_GetEventFreezeFrameDataEx_EvtInfo_Front_Camera_Circuit_Voltage_Out_of_Range_B23C51C: RteEventRef=OpEventGetEventFreezeFrameDataEx_GetEventFreezeFrameDataEx_EvtInfo_Front_Camera_Circuit_Voltage_Out_of_Range_B23C51C
          OpEventGetEventFreezeFrameDataEx_GetEventFreezeFrameDataEx_Event_Front_Camera_Circuit_Voltage_Out_of_Range_B23C51C: RteEventRef=OpEventGetEventFreezeFrameDataEx_GetEventFreezeFrameDataEx_Event_Front_Camera_Circuit_Voltage_Out_of_Range_B23C51C
          OpEventGetEventFreezeFrameDataEx_GetEventFreezeFrameDataEx_EvtInfo_Implausible_Data_From_BSC_Module_1_U041800: RteEventRef=OpEventGetEventFreezeFrameDataEx_GetEventFreezeFrameDataEx_EvtInfo_Implausible_Data_From_BSC_Module_1_U041800
          OpEventGetEventFreezeFrameDataEx_GetEventFreezeFrameDataEx_Event_Implausible_Data_From_BSC_Module_1_U041800: RteEventRef=OpEventGetEventFreezeFrameDataEx_GetEventFreezeFrameDataEx_Event_Implausible_Data_From_BSC_Module_1_U041800
          OpEventGetEventFreezeFrameDataEx_GetEventFreezeFrameDataEx_EvtInfo_PTS_Sensor_10_Performance_or_Incorrect_Operation_B129792: RteEventRef=OpEventGetEventFreezeFrameDataEx_GetEventFreezeFrameDataEx_EvtInfo_PTS_Sensor_10_Performance_or_Incorrect_Operation_B129792
          OpEventGetEventFreezeFrameDataEx_GetEventFreezeFrameDataEx_Event_PTS_Sensor_10_Performance_or_Incorrect_Operation_B129792: RteEventRef=OpEventGetEventFreezeFrameDataEx_GetEventFreezeFrameDataEx_Event_PTS_Sensor_10_Performance_or_Incorrect_Operation_B129792
          OpEventGetEventFreezeFrameDataEx_GetEventFreezeFrameDataEx_EvtInfo_PTS_Sensor_11_Circuit_Open_B129813: RteEventRef=OpEventGetEventFreezeFrameDataEx_GetEventFreezeFrameDataEx_EvtInfo_PTS_Sensor_11_Circuit_Open_B129813
          OpEventGetEventFreezeFrameDataEx_GetEventFreezeFrameDataEx_Event_PTS_Sensor_11_Circuit_Open_B129813: RteEventRef=OpEventGetEventFreezeFrameDataEx_GetEventFreezeFrameDataEx_Event_PTS_Sensor_11_Circuit_Open_B129813
          OpEventGetEventFreezeFrameDataEx_GetEventFreezeFrameDataEx_EvtInfo_ECU_Internal_Performance_B22A900: RteEventRef=OpEventGetEventFreezeFrameDataEx_GetEventFreezeFrameDataEx_EvtInfo_ECU_Internal_Performance_B22A900
          OpEventGetEventFreezeFrameDataEx_GetEventFreezeFrameDataEx_Event_ECU_Internal_Performance_B22A900: RteEventRef=OpEventGetEventFreezeFrameDataEx_GetEventFreezeFrameDataEx_Event_ECU_Internal_Performance_B22A900
          OpEventGetEventFreezeFrameDataEx_GetEventFreezeFrameDataEx_EvtInfo_PTS_Sensor_9_Performance_or_Incorrect_Operation_B129692: RteEventRef=OpEventGetEventFreezeFrameDataEx_GetEventFreezeFrameDataEx_EvtInfo_PTS_Sensor_9_Performance_or_Incorrect_Operation_B129692
          OpEventGetEventFreezeFrameDataEx_GetEventFreezeFrameDataEx_Event_PTS_Sensor_9_Performance_or_Incorrect_Operation_B129692: RteEventRef=OpEventGetEventFreezeFrameDataEx_GetEventFreezeFrameDataEx_Event_PTS_Sensor_9_Performance_or_Incorrect_Operation_B129692
          OpEventGetEventFreezeFrameDataEx_GetEventFreezeFrameDataEx_EvtInfo_Calibration_Not_Learned_Lost_Calibration_B228600: RteEventRef=OpEventGetEventFreezeFrameDataEx_GetEventFreezeFrameDataEx_EvtInfo_Calibration_Not_Learned_Lost_Calibration_B228600
          OpEventGetEventFreezeFrameDataEx_GetEventFreezeFrameDataEx_Event_Calibration_Not_Learned_Lost_Calibration_B228600: RteEventRef=OpEventGetEventFreezeFrameDataEx_GetEventFreezeFrameDataEx_Event_Calibration_Not_Learned_Lost_Calibration_B228600
          OpEventGetEventFreezeFrameDataEx_GetEventFreezeFrameDataEx_EvtInfo_Lost_Communication_with_ORC_U015100: RteEventRef=OpEventGetEventFreezeFrameDataEx_GetEventFreezeFrameDataEx_EvtInfo_Lost_Communication_with_ORC_U015100
          OpEventGetEventFreezeFrameDataEx_GetEventFreezeFrameDataEx_Event_Lost_Communication_with_ORC_U015100: RteEventRef=OpEventGetEventFreezeFrameDataEx_GetEventFreezeFrameDataEx_Event_Lost_Communication_with_ORC_U015100
          OpEventGetEventFreezeFrameDataEx_GetEventFreezeFrameDataEx_EvtInfo_PTS_Sensor_1_Circuit_Open_B128E13: RteEventRef=OpEventGetEventFreezeFrameDataEx_GetEventFreezeFrameDataEx_EvtInfo_PTS_Sensor_1_Circuit_Open_B128E13
          OpEventGetEventFreezeFrameDataEx_GetEventFreezeFrameDataEx_Event_PTS_Sensor_1_Circuit_Open_B128E13: RteEventRef=OpEventGetEventFreezeFrameDataEx_GetEventFreezeFrameDataEx_Event_PTS_Sensor_1_Circuit_Open_B128E13
          OpEventGetEventFreezeFrameDataEx_GetEventFreezeFrameDataEx_EvtInfo_Lost_Communication_with_Rear_Camera_U026400: RteEventRef=OpEventGetEventFreezeFrameDataEx_GetEventFreezeFrameDataEx_EvtInfo_Lost_Communication_with_Rear_Camera_U026400
          OpEventGetEventFreezeFrameDataEx_GetEventFreezeFrameDataEx_Event_Lost_Communication_with_Rear_Camera_U026400: RteEventRef=OpEventGetEventFreezeFrameDataEx_GetEventFreezeFrameDataEx_Event_Lost_Communication_with_Rear_Camera_U026400
          OpEventGetEventFreezeFrameDataEx_GetEventFreezeFrameDataEx_EvtInfo_HS_FD_CANR_Comm_Bus_Performance_U100B00: RteEventRef=OpEventGetEventFreezeFrameDataEx_GetEventFreezeFrameDataEx_EvtInfo_HS_FD_CANR_Comm_Bus_Performance_U100B00
          OpEventGetEventFreezeFrameDataEx_GetEventFreezeFrameDataEx_Event_HS_FD_CANR_Comm_Bus_Performance_U100B00: RteEventRef=OpEventGetEventFreezeFrameDataEx_GetEventFreezeFrameDataEx_Event_HS_FD_CANR_Comm_Bus_Performance_U100B00
          OpEventGetEventFreezeFrameDataEx_GetEventFreezeFrameDataEx_EvtInfo_Implausible_Data_Received_From_Body_Control_Module_U042200: RteEventRef=OpEventGetEventFreezeFrameDataEx_GetEventFreezeFrameDataEx_EvtInfo_Implausible_Data_Received_From_Body_Control_Module_U042200
          OpEventGetEventFreezeFrameDataEx_GetEventFreezeFrameDataEx_Event_Implausible_Data_Received_From_Body_Control_Module_U042200: RteEventRef=OpEventGetEventFreezeFrameDataEx_GetEventFreezeFrameDataEx_Event_Implausible_Data_Received_From_Body_Control_Module_U042200
          OpEventGetEventFreezeFrameDataEx_GetEventFreezeFrameDataEx_EvtInfo_Lost_Communication_With_BCM_U014000: RteEventRef=OpEventGetEventFreezeFrameDataEx_GetEventFreezeFrameDataEx_EvtInfo_Lost_Communication_With_BCM_U014000
          OpEventGetEventFreezeFrameDataEx_GetEventFreezeFrameDataEx_Event_Lost_Communication_With_BCM_U014000: RteEventRef=OpEventGetEventFreezeFrameDataEx_GetEventFreezeFrameDataEx_Event_Lost_Communication_With_BCM_U014000
          OpEventGetEventFreezeFrameDataEx_GetEventFreezeFrameDataEx_EvtInfo_PTS_Sensor_2_Circuit_Open_B128F13: RteEventRef=OpEventGetEventFreezeFrameDataEx_GetEventFreezeFrameDataEx_EvtInfo_PTS_Sensor_2_Circuit_Open_B128F13
          OpEventGetEventFreezeFrameDataEx_GetEventFreezeFrameDataEx_Event_PTS_Sensor_2_Circuit_Open_B128F13: RteEventRef=OpEventGetEventFreezeFrameDataEx_GetEventFreezeFrameDataEx_Event_PTS_Sensor_2_Circuit_Open_B128F13
          OpEventGetEventFreezeFrameDataEx_GetEventFreezeFrameDataEx_EvtInfo_PTS_Sensor_3_Circuit_Open_B129013: RteEventRef=OpEventGetEventFreezeFrameDataEx_GetEventFreezeFrameDataEx_EvtInfo_PTS_Sensor_3_Circuit_Open_B129013
          OpEventGetEventFreezeFrameDataEx_GetEventFreezeFrameDataEx_Event_PTS_Sensor_3_Circuit_Open_B129013: RteEventRef=OpEventGetEventFreezeFrameDataEx_GetEventFreezeFrameDataEx_Event_PTS_Sensor_3_Circuit_Open_B129013
          OpEventGetEventFreezeFrameDataEx_GetEventFreezeFrameDataEx_EvtInfo_ECU_In_Plant_Mode_C221200: RteEventRef=OpEventGetEventFreezeFrameDataEx_GetEventFreezeFrameDataEx_EvtInfo_ECU_In_Plant_Mode_C221200
          OpEventGetEventFreezeFrameDataEx_GetEventFreezeFrameDataEx_Event_ECU_In_Plant_Mode_C221200: RteEventRef=OpEventGetEventFreezeFrameDataEx_GetEventFreezeFrameDataEx_Event_ECU_In_Plant_Mode_C221200
          OpEventGetEventFreezeFrameDataEx_GetEventFreezeFrameDataEx_EvtInfo_Implausible_Data_from_ORC_module_U045500: RteEventRef=OpEventGetEventFreezeFrameDataEx_GetEventFreezeFrameDataEx_EvtInfo_Implausible_Data_from_ORC_module_U045500
          OpEventGetEventFreezeFrameDataEx_GetEventFreezeFrameDataEx_Event_Implausible_Data_from_ORC_module_U045500: RteEventRef=OpEventGetEventFreezeFrameDataEx_GetEventFreezeFrameDataEx_Event_Implausible_Data_from_ORC_module_U045500
          OpEventGetEventFreezeFrameDataEx_GetEventFreezeFrameDataEx_EvtInfo_Right_Camera_Performance_or_Incorrect_Operation_B23C792: RteEventRef=OpEventGetEventFreezeFrameDataEx_GetEventFreezeFrameDataEx_EvtInfo_Right_Camera_Performance_or_Incorrect_Operation_B23C792
          OpEventGetEventFreezeFrameDataEx_GetEventFreezeFrameDataEx_Event_Right_Camera_Performance_or_Incorrect_Operation_B23C792: RteEventRef=OpEventGetEventFreezeFrameDataEx_GetEventFreezeFrameDataEx_Event_Right_Camera_Performance_or_Incorrect_Operation_B23C792
          OpEventGetEventFreezeFrameDataEx_GetEventFreezeFrameDataEx_EvtInfo_Rear_Sensors_PS_VltgeAboveThreshold_B212B17: RteEventRef=OpEventGetEventFreezeFrameDataEx_GetEventFreezeFrameDataEx_EvtInfo_Rear_Sensors_PS_VltgeAboveThreshold_B212B17
          OpEventGetEventFreezeFrameDataEx_GetEventFreezeFrameDataEx_Event_Rear_Sensors_PS_VltgeAboveThreshold_B212B17: RteEventRef=OpEventGetEventFreezeFrameDataEx_GetEventFreezeFrameDataEx_Event_Rear_Sensors_PS_VltgeAboveThreshold_B212B17
          OpEventGetEventExtendedDataRecordEx_GetEventExtendedDataRecordEx_EvtInfo_Invalid_Data_Received_From_Power_Steering_Cont_c119dc8e: RteEventRef=OpEventGetEventExtendedDataRecordEx_GetEventExtendedDataRecordEx_EvtInfo_Invalid_Data_Received_From_Power_Steering_Cont_c119dc8e
          OpEventGetEventExtendedDataRecordEx_GetEventExtendedDataRecordEx_Event_Invalid_Data_Received_From_Power_Steering_Contro_b20374a2: RteEventRef=OpEventGetEventExtendedDataRecordEx_GetEventExtendedDataRecordEx_Event_Invalid_Data_Received_From_Power_Steering_Contro_b20374a2
          OpEventGetEventExtendedDataRecordEx_GetEventExtendedDataRecordEx_EvtInfo_Lost_Communication_with_Left_Camera_U026600: RteEventRef=OpEventGetEventExtendedDataRecordEx_GetEventExtendedDataRecordEx_EvtInfo_Lost_Communication_with_Left_Camera_U026600
          OpEventGetEventExtendedDataRecordEx_GetEventExtendedDataRecordEx_Event_Lost_Communication_with_Left_Camera_U026600: RteEventRef=OpEventGetEventExtendedDataRecordEx_GetEventExtendedDataRecordEx_Event_Lost_Communication_with_Left_Camera_U026600
          OpEventGetEventExtendedDataRecordEx_GetEventExtendedDataRecordEx_EvtInfo_Front_Sensors_PS_VltgeBelowThreshold_B212A16: RteEventRef=OpEventGetEventExtendedDataRecordEx_GetEventExtendedDataRecordEx_EvtInfo_Front_Sensors_PS_VltgeBelowThreshold_B212A16
          OpEventGetEventExtendedDataRecordEx_GetEventExtendedDataRecordEx_Event_Front_Sensors_PS_VltgeBelowThreshold_B212A16: RteEventRef=OpEventGetEventExtendedDataRecordEx_GetEventExtendedDataRecordEx_Event_Front_Sensors_PS_VltgeBelowThreshold_B212A16
          OpEventGetEventExtendedDataRecordEx_GetEventExtendedDataRecordEx_EvtInfo_Left_Camera_Circuit_Voltage_Out_of_Range_B23C61C: RteEventRef=OpEventGetEventExtendedDataRecordEx_GetEventExtendedDataRecordEx_EvtInfo_Left_Camera_Circuit_Voltage_Out_of_Range_B23C61C
          OpEventGetEventExtendedDataRecordEx_GetEventExtendedDataRecordEx_Event_Left_Camera_Circuit_Voltage_Out_of_Range_B23C61C: RteEventRef=OpEventGetEventExtendedDataRecordEx_GetEventExtendedDataRecordEx_Event_Left_Camera_Circuit_Voltage_Out_of_Range_B23C61C
          OpEventGetEventExtendedDataRecordEx_GetEventExtendedDataRecordEx_EvtInfo_Rear_Sensors_PS_VltgeBelowThreshold_B212B16: RteEventRef=OpEventGetEventExtendedDataRecordEx_GetEventExtendedDataRecordEx_EvtInfo_Rear_Sensors_PS_VltgeBelowThreshold_B212B16
          OpEventGetEventExtendedDataRecordEx_GetEventExtendedDataRecordEx_Event_Rear_Sensors_PS_VltgeBelowThreshold_B212B16: RteEventRef=OpEventGetEventExtendedDataRecordEx_GetEventExtendedDataRecordEx_Event_Rear_Sensors_PS_VltgeBelowThreshold_B212B16
          OpEventGetEventExtendedDataRecordEx_GetEventExtendedDataRecordEx_EvtInfo_Rear_Sensors_PS_Bus_Sig_Msg_Failures_B212B08: RteEventRef=OpEventGetEventExtendedDataRecordEx_GetEventExtendedDataRecordEx_EvtInfo_Rear_Sensors_PS_Bus_Sig_Msg_Failures_B212B08
          OpEventGetEventExtendedDataRecordEx_GetEventExtendedDataRecordEx_Event_Rear_Sensors_PS_Bus_Sig_Msg_Failures_B212B08: RteEventRef=OpEventGetEventExtendedDataRecordEx_GetEventExtendedDataRecordEx_Event_Rear_Sensors_PS_Bus_Sig_Msg_Failures_B212B08
          OpEventGetEventExtendedDataRecordEx_GetEventExtendedDataRecordEx_EvtInfo_Rear_Camera_Circuit_Voltage_Out_of_Range_B217A1C: RteEventRef=OpEventGetEventExtendedDataRecordEx_GetEventExtendedDataRecordEx_EvtInfo_Rear_Camera_Circuit_Voltage_Out_of_Range_B217A1C
          OpEventGetEventExtendedDataRecordEx_GetEventExtendedDataRecordEx_Event_Rear_Camera_Circuit_Voltage_Out_of_Range_B217A1C: RteEventRef=OpEventGetEventExtendedDataRecordEx_GetEventExtendedDataRecordEx_Event_Rear_Camera_Circuit_Voltage_Out_of_Range_B217A1C
          OpEventGetEventExtendedDataRecordEx_GetEventExtendedDataRecordEx_EvtInfo_PTS_Sensor_12_Performance_or_Incorrect_Operati_346a3681: RteEventRef=OpEventGetEventExtendedDataRecordEx_GetEventExtendedDataRecordEx_EvtInfo_PTS_Sensor_12_Performance_or_Incorrect_Operati_346a3681
          OpEventGetEventExtendedDataRecordEx_GetEventExtendedDataRecordEx_Event_PTS_Sensor_12_Performance_or_Incorrect_Operation_B129992: RteEventRef=OpEventGetEventExtendedDataRecordEx_GetEventExtendedDataRecordEx_Event_PTS_Sensor_12_Performance_or_Incorrect_Operation_B129992
          OpEventGetEventExtendedDataRecordEx_GetEventExtendedDataRecordEx_EvtInfo_Battery_Voltage_Over_Voltage_B210C17: RteEventRef=OpEventGetEventExtendedDataRecordEx_GetEventExtendedDataRecordEx_EvtInfo_Battery_Voltage_Over_Voltage_B210C17
          OpEventGetEventExtendedDataRecordEx_GetEventExtendedDataRecordEx_Event_Battery_Voltage_Over_Voltage_B210C17: RteEventRef=OpEventGetEventExtendedDataRecordEx_GetEventExtendedDataRecordEx_Event_Battery_Voltage_Over_Voltage_B210C17
          OpEventGetEventExtendedDataRecordEx_GetEventExtendedDataRecordEx_EvtInfo_Front_Sensors_PS_VltgeAboveThreshold_B212A17: RteEventRef=OpEventGetEventExtendedDataRecordEx_GetEventExtendedDataRecordEx_EvtInfo_Front_Sensors_PS_VltgeAboveThreshold_B212A17
          OpEventGetEventExtendedDataRecordEx_GetEventExtendedDataRecordEx_Event_Front_Sensors_PS_VltgeAboveThreshold_B212A17: RteEventRef=OpEventGetEventExtendedDataRecordEx_GetEventExtendedDataRecordEx_Event_Front_Sensors_PS_VltgeAboveThreshold_B212A17
          OpEventGetEventExtendedDataRecordEx_GetEventExtendedDataRecordEx_EvtInfo_PTS_Sensor_4_Circuit_Open_B129113: RteEventRef=OpEventGetEventExtendedDataRecordEx_GetEventExtendedDataRecordEx_EvtInfo_PTS_Sensor_4_Circuit_Open_B129113
          OpEventGetEventExtendedDataRecordEx_GetEventExtendedDataRecordEx_Event_PTS_Sensor_4_Circuit_Open_B129113: RteEventRef=OpEventGetEventExtendedDataRecordEx_GetEventExtendedDataRecordEx_Event_PTS_Sensor_4_Circuit_Open_B129113
          OpEventGetEventExtendedDataRecordEx_GetEventExtendedDataRecordEx_EvtInfo_PTS_Sensor_12_Circuit_Open_B129913: RteEventRef=OpEventGetEventExtendedDataRecordEx_GetEventExtendedDataRecordEx_EvtInfo_PTS_Sensor_12_Circuit_Open_B129913
          OpEventGetEventExtendedDataRecordEx_GetEventExtendedDataRecordEx_Event_PTS_Sensor_12_Circuit_Open_B129913: RteEventRef=OpEventGetEventExtendedDataRecordEx_GetEventExtendedDataRecordEx_Event_PTS_Sensor_12_Circuit_Open_B129913
          OpEventGetEventExtendedDataRecordEx_GetEventExtendedDataRecordEx_EvtInfo_PTS_Sensor_11_Performance_or_Incorrect_Operati_4bd01410: RteEventRef=OpEventGetEventExtendedDataRecordEx_GetEventExtendedDataRecordEx_EvtInfo_PTS_Sensor_11_Performance_or_Incorrect_Operati_4bd01410
          OpEventGetEventExtendedDataRecordEx_GetEventExtendedDataRecordEx_Event_PTS_Sensor_11_Performance_or_Incorrect_Operation_B129892: RteEventRef=OpEventGetEventExtendedDataRecordEx_GetEventExtendedDataRecordEx_Event_PTS_Sensor_11_Performance_or_Incorrect_Operation_B129892
          OpEventGetEventExtendedDataRecordEx_GetEventExtendedDataRecordEx_EvtInfo_Lost_Communication_With_Radio_U018400: RteEventRef=OpEventGetEventExtendedDataRecordEx_GetEventExtendedDataRecordEx_EvtInfo_Lost_Communication_With_Radio_U018400
          OpEventGetEventExtendedDataRecordEx_GetEventExtendedDataRecordEx_Event_Lost_Communication_With_Radio_U018400: RteEventRef=OpEventGetEventExtendedDataRecordEx_GetEventExtendedDataRecordEx_Event_Lost_Communication_With_Radio_U018400
          OpEventGetEventExtendedDataRecordEx_GetEventExtendedDataRecordEx_EvtInfo_Park_Assist_PTS_Switch_Stuck_B12852A: RteEventRef=OpEventGetEventExtendedDataRecordEx_GetEventExtendedDataRecordEx_EvtInfo_Park_Assist_PTS_Switch_Stuck_B12852A
          OpEventGetEventExtendedDataRecordEx_GetEventExtendedDataRecordEx_Event_Park_Assist_PTS_Switch_Stuck_B12852A: RteEventRef=OpEventGetEventExtendedDataRecordEx_GetEventExtendedDataRecordEx_Event_Park_Assist_PTS_Switch_Stuck_B12852A
          OpEventGetEventExtendedDataRecordEx_GetEventExtendedDataRecordEx_EvtInfo_PTS_Sensor_5_Circuit_Open_B129213: RteEventRef=OpEventGetEventExtendedDataRecordEx_GetEventExtendedDataRecordEx_EvtInfo_PTS_Sensor_5_Circuit_Open_B129213
          OpEventGetEventExtendedDataRecordEx_GetEventExtendedDataRecordEx_Event_PTS_Sensor_5_Circuit_Open_B129213: RteEventRef=OpEventGetEventExtendedDataRecordEx_GetEventExtendedDataRecordEx_Event_PTS_Sensor_5_Circuit_Open_B129213
          OpEventGetEventExtendedDataRecordEx_GetEventExtendedDataRecordEx_EvtInfo_PTS_Sensor_5_Performance_or_Incorrect_Operation_B129292: RteEventRef=OpEventGetEventExtendedDataRecordEx_GetEventExtendedDataRecordEx_EvtInfo_PTS_Sensor_5_Performance_or_Incorrect_Operation_B129292
          OpEventGetEventExtendedDataRecordEx_GetEventExtendedDataRecordEx_Event_PTS_Sensor_5_Performance_or_Incorrect_Operation_B129292: RteEventRef=OpEventGetEventExtendedDataRecordEx_GetEventExtendedDataRecordEx_Event_PTS_Sensor_5_Performance_or_Incorrect_Operation_B129292
          OpEventGetEventExtendedDataRecordEx_GetEventExtendedDataRecordEx_EvtInfo_Battery_Voltage_Under_Voltage_B210C16: RteEventRef=OpEventGetEventExtendedDataRecordEx_GetEventExtendedDataRecordEx_EvtInfo_Battery_Voltage_Under_Voltage_B210C16
          OpEventGetEventExtendedDataRecordEx_GetEventExtendedDataRecordEx_Event_Battery_Voltage_Under_Voltage_B210C16: RteEventRef=OpEventGetEventExtendedDataRecordEx_GetEventExtendedDataRecordEx_Event_Battery_Voltage_Under_Voltage_B210C16
          OpEventGetEventExtendedDataRecordEx_GetEventExtendedDataRecordEx_EvtInfo_PTS_Sensor_4_Performance_or_Incorrect_Operation_B129192: RteEventRef=OpEventGetEventExtendedDataRecordEx_GetEventExtendedDataRecordEx_EvtInfo_PTS_Sensor_4_Performance_or_Incorrect_Operation_B129192
          OpEventGetEventExtendedDataRecordEx_GetEventExtendedDataRecordEx_Event_PTS_Sensor_4_Performance_or_Incorrect_Operation_B129192: RteEventRef=OpEventGetEventExtendedDataRecordEx_GetEventExtendedDataRecordEx_Event_PTS_Sensor_4_Performance_or_Incorrect_Operation_B129192
          OpEventGetEventExtendedDataRecordEx_GetEventExtendedDataRecordEx_EvtInfo_HS_FD_CAN2_Comm_Bus_Performance_U104E00: RteEventRef=OpEventGetEventExtendedDataRecordEx_GetEventExtendedDataRecordEx_EvtInfo_HS_FD_CAN2_Comm_Bus_Performance_U104E00
          OpEventGetEventExtendedDataRecordEx_GetEventExtendedDataRecordEx_Event_HS_FD_CAN2_Comm_Bus_Performance_U104E00: RteEventRef=OpEventGetEventExtendedDataRecordEx_GetEventExtendedDataRecordEx_Event_HS_FD_CAN2_Comm_Bus_Performance_U104E00
          OpEventGetEventExtendedDataRecordEx_GetEventExtendedDataRecordEx_EvtInfo_PTS_Sensor_9_Circuit_Open_B129613: RteEventRef=OpEventGetEventExtendedDataRecordEx_GetEventExtendedDataRecordEx_EvtInfo_PTS_Sensor_9_Circuit_Open_B129613
          OpEventGetEventExtendedDataRecordEx_GetEventExtendedDataRecordEx_Event_PTS_Sensor_9_Circuit_Open_B129613: RteEventRef=OpEventGetEventExtendedDataRecordEx_GetEventExtendedDataRecordEx_Event_PTS_Sensor_9_Circuit_Open_B129613
          OpEventGetEventExtendedDataRecordEx_GetEventExtendedDataRecordEx_EvtInfo_Loss_of_Comm_With_Engine_Control_Module_U010000: RteEventRef=OpEventGetEventExtendedDataRecordEx_GetEventExtendedDataRecordEx_EvtInfo_Loss_of_Comm_With_Engine_Control_Module_U010000
          OpEventGetEventExtendedDataRecordEx_GetEventExtendedDataRecordEx_Event_Loss_of_Comm_With_Engine_Control_Module_U010000: RteEventRef=OpEventGetEventExtendedDataRecordEx_GetEventExtendedDataRecordEx_Event_Loss_of_Comm_With_Engine_Control_Module_U010000
          OpEventGetEventExtendedDataRecordEx_GetEventExtendedDataRecordEx_EvtInfo_Lost_Communication_with_Right_Camera_U026700: RteEventRef=OpEventGetEventExtendedDataRecordEx_GetEventExtendedDataRecordEx_EvtInfo_Lost_Communication_with_Right_Camera_U026700
          OpEventGetEventExtendedDataRecordEx_GetEventExtendedDataRecordEx_Event_Lost_Communication_with_Right_Camera_U026700: RteEventRef=OpEventGetEventExtendedDataRecordEx_GetEventExtendedDataRecordEx_Event_Lost_Communication_with_Right_Camera_U026700
          OpEventGetEventExtendedDataRecordEx_GetEventExtendedDataRecordEx_EvtInfo_PTS_Sensor_1_Performance_or_Incorrect_Operation_B128E92: RteEventRef=OpEventGetEventExtendedDataRecordEx_GetEventExtendedDataRecordEx_EvtInfo_PTS_Sensor_1_Performance_or_Incorrect_Operation_B128E92
          OpEventGetEventExtendedDataRecordEx_GetEventExtendedDataRecordEx_Event_PTS_Sensor_1_Performance_or_Incorrect_Operation_B128E92: RteEventRef=OpEventGetEventExtendedDataRecordEx_GetEventExtendedDataRecordEx_Event_PTS_Sensor_1_Performance_or_Incorrect_Operation_B128E92
          OpEventGetEventExtendedDataRecordEx_GetEventExtendedDataRecordEx_EvtInfo_Rear_Camera_Performance_or_Incorrect_Operation_B217A92: RteEventRef=OpEventGetEventExtendedDataRecordEx_GetEventExtendedDataRecordEx_EvtInfo_Rear_Camera_Performance_or_Incorrect_Operation_B217A92
          OpEventGetEventExtendedDataRecordEx_GetEventExtendedDataRecordEx_Event_Rear_Camera_Performance_or_Incorrect_Operation_B217A92: RteEventRef=OpEventGetEventExtendedDataRecordEx_GetEventExtendedDataRecordEx_Event_Rear_Camera_Performance_or_Incorrect_Operation_B217A92
          OpEventGetEventExtendedDataRecordEx_GetEventExtendedDataRecordEx_EvtInfo_PTS_Sensor_2_Performance_or_Incorrect_Operation_B128F92: RteEventRef=OpEventGetEventExtendedDataRecordEx_GetEventExtendedDataRecordEx_EvtInfo_PTS_Sensor_2_Performance_or_Incorrect_Operation_B128F92
          OpEventGetEventExtendedDataRecordEx_GetEventExtendedDataRecordEx_Event_PTS_Sensor_2_Performance_or_Incorrect_Operation_B128F92: RteEventRef=OpEventGetEventExtendedDataRecordEx_GetEventExtendedDataRecordEx_Event_PTS_Sensor_2_Performance_or_Incorrect_Operation_B128F92
          OpEventGetEventExtendedDataRecordEx_GetEventExtendedDataRecordEx_EvtInfo_Right_Camera_Circuit_Voltage_Out_of_Range_B23C71C: RteEventRef=OpEventGetEventExtendedDataRecordEx_GetEventExtendedDataRecordEx_EvtInfo_Right_Camera_Circuit_Voltage_Out_of_Range_B23C71C
          OpEventGetEventExtendedDataRecordEx_GetEventExtendedDataRecordEx_Event_Right_Camera_Circuit_Voltage_Out_of_Range_B23C71C: RteEventRef=OpEventGetEventExtendedDataRecordEx_GetEventExtendedDataRecordEx_Event_Right_Camera_Circuit_Voltage_Out_of_Range_B23C71C
          OpEventGetEventExtendedDataRecordEx_GetEventExtendedDataRecordEx_EvtInfo_PTS_Sensor_8_Circuit_Open_B129513: RteEventRef=OpEventGetEventExtendedDataRecordEx_GetEventExtendedDataRecordEx_EvtInfo_PTS_Sensor_8_Circuit_Open_B129513
          OpEventGetEventExtendedDataRecordEx_GetEventExtendedDataRecordEx_Event_PTS_Sensor_8_Circuit_Open_B129513: RteEventRef=OpEventGetEventExtendedDataRecordEx_GetEventExtendedDataRecordEx_Event_PTS_Sensor_8_Circuit_Open_B129513
          OpEventGetEventExtendedDataRecordEx_GetEventExtendedDataRecordEx_EvtInfo_Implausible_Data_Received_from_Radio_U048500: RteEventRef=OpEventGetEventExtendedDataRecordEx_GetEventExtendedDataRecordEx_EvtInfo_Implausible_Data_Received_from_Radio_U048500
          OpEventGetEventExtendedDataRecordEx_GetEventExtendedDataRecordEx_Event_Implausible_Data_Received_from_Radio_U048500: RteEventRef=OpEventGetEventExtendedDataRecordEx_GetEventExtendedDataRecordEx_Event_Implausible_Data_Received_from_Radio_U048500
          OpEventGetEventExtendedDataRecordEx_GetEventExtendedDataRecordEx_EvtInfo_Implausible_Data_received_from_TRSKM_module_U14A000: RteEventRef=OpEventGetEventExtendedDataRecordEx_GetEventExtendedDataRecordEx_EvtInfo_Implausible_Data_received_from_TRSKM_module_U14A000
          OpEventGetEventExtendedDataRecordEx_GetEventExtendedDataRecordEx_Event_Implausible_Data_received_from_TRSKM_module_U14A000: RteEventRef=OpEventGetEventExtendedDataRecordEx_GetEventExtendedDataRecordEx_Event_Implausible_Data_received_from_TRSKM_module_U14A000
          OpEventGetEventExtendedDataRecordEx_GetEventExtendedDataRecordEx_EvtInfo_Front_Camera_Performance_or_Incorrect_Operation_B23C592: RteEventRef=OpEventGetEventExtendedDataRecordEx_GetEventExtendedDataRecordEx_EvtInfo_Front_Camera_Performance_or_Incorrect_Operation_B23C592
          OpEventGetEventExtendedDataRecordEx_GetEventExtendedDataRecordEx_Event_Front_Camera_Performance_or_Incorrect_Operation_B23C592: RteEventRef=OpEventGetEventExtendedDataRecordEx_GetEventExtendedDataRecordEx_Event_Front_Camera_Performance_or_Incorrect_Operation_B23C592
          OpEventGetEventExtendedDataRecordEx_GetEventExtendedDataRecordEx_EvtInfo_Loss_Communication_with_TRS_Knob_Module_U12B900: RteEventRef=OpEventGetEventExtendedDataRecordEx_GetEventExtendedDataRecordEx_EvtInfo_Loss_Communication_with_TRS_Knob_Module_U12B900
          OpEventGetEventExtendedDataRecordEx_GetEventExtendedDataRecordEx_Event_Loss_Communication_with_TRS_Knob_Module_U12B900: RteEventRef=OpEventGetEventExtendedDataRecordEx_GetEventExtendedDataRecordEx_Event_Loss_Communication_with_TRS_Knob_Module_U12B900
          OpEventGetEventExtendedDataRecordEx_GetEventExtendedDataRecordEx_EvtInfo_PTS_Sensor_7_Circuit_Open_B129413: RteEventRef=OpEventGetEventExtendedDataRecordEx_GetEventExtendedDataRecordEx_EvtInfo_PTS_Sensor_7_Circuit_Open_B129413
          OpEventGetEventExtendedDataRecordEx_GetEventExtendedDataRecordEx_Event_PTS_Sensor_7_Circuit_Open_B129413: RteEventRef=OpEventGetEventExtendedDataRecordEx_GetEventExtendedDataRecordEx_Event_PTS_Sensor_7_Circuit_Open_B129413
          OpEventGetEventExtendedDataRecordEx_GetEventExtendedDataRecordEx_EvtInfo_Front_Sensors_PS_Bus_Sig_Msg_Failures_B212A08: RteEventRef=OpEventGetEventExtendedDataRecordEx_GetEventExtendedDataRecordEx_EvtInfo_Front_Sensors_PS_Bus_Sig_Msg_Failures_B212A08
          OpEventGetEventExtendedDataRecordEx_GetEventExtendedDataRecordEx_Event_Front_Sensors_PS_Bus_Sig_Msg_Failures_B212A08: RteEventRef=OpEventGetEventExtendedDataRecordEx_GetEventExtendedDataRecordEx_Event_Front_Sensors_PS_Bus_Sig_Msg_Failures_B212A08
          OpEventGetEventExtendedDataRecordEx_GetEventExtendedDataRecordEx_EvtInfo_Lost_Communication_With_PSC_Module_A_U013100: RteEventRef=OpEventGetEventExtendedDataRecordEx_GetEventExtendedDataRecordEx_EvtInfo_Lost_Communication_With_PSC_Module_A_U013100
          OpEventGetEventExtendedDataRecordEx_GetEventExtendedDataRecordEx_Event_Lost_Communication_With_PSC_Module_A_U013100: RteEventRef=OpEventGetEventExtendedDataRecordEx_GetEventExtendedDataRecordEx_Event_Lost_Communication_With_PSC_Module_A_U013100
          OpEventGetEventExtendedDataRecordEx_GetEventExtendedDataRecordEx_EvtInfo_Lost_Communication_with_Front_Camera_U026500: RteEventRef=OpEventGetEventExtendedDataRecordEx_GetEventExtendedDataRecordEx_EvtInfo_Lost_Communication_with_Front_Camera_U026500
          OpEventGetEventExtendedDataRecordEx_GetEventExtendedDataRecordEx_Event_Lost_Communication_with_Front_Camera_U026500: RteEventRef=OpEventGetEventExtendedDataRecordEx_GetEventExtendedDataRecordEx_Event_Lost_Communication_with_Front_Camera_U026500
          OpEventGetEventExtendedDataRecordEx_GetEventExtendedDataRecordEx_EvtInfo_PTS_Sensor_3_Performance_or_Incorrect_Operation_B129092: RteEventRef=OpEventGetEventExtendedDataRecordEx_GetEventExtendedDataRecordEx_EvtInfo_PTS_Sensor_3_Performance_or_Incorrect_Operation_B129092
          OpEventGetEventExtendedDataRecordEx_GetEventExtendedDataRecordEx_Event_PTS_Sensor_3_Performance_or_Incorrect_Operation_B129092: RteEventRef=OpEventGetEventExtendedDataRecordEx_GetEventExtendedDataRecordEx_Event_PTS_Sensor_3_Performance_or_Incorrect_Operation_B129092
          OpEventGetEventExtendedDataRecordEx_GetEventExtendedDataRecordEx_EvtInfo_PTS_Sensor_8_Performance_or_Incorrect_Operation_B129592: RteEventRef=OpEventGetEventExtendedDataRecordEx_GetEventExtendedDataRecordEx_EvtInfo_PTS_Sensor_8_Performance_or_Incorrect_Operation_B129592
          OpEventGetEventExtendedDataRecordEx_GetEventExtendedDataRecordEx_Event_PTS_Sensor_8_Performance_or_Incorrect_Operation_B129592: RteEventRef=OpEventGetEventExtendedDataRecordEx_GetEventExtendedDataRecordEx_Event_PTS_Sensor_8_Performance_or_Incorrect_Operation_B129592
          OpEventGetEventExtendedDataRecordEx_GetEventExtendedDataRecordEx_EvtInfo_PPP_Assist_Switch_Stuck_B12B22A: RteEventRef=OpEventGetEventExtendedDataRecordEx_GetEventExtendedDataRecordEx_EvtInfo_PPP_Assist_Switch_Stuck_B12B22A
          OpEventGetEventExtendedDataRecordEx_GetEventExtendedDataRecordEx_Event_PPP_Assist_Switch_Stuck_B12B22A: RteEventRef=OpEventGetEventExtendedDataRecordEx_GetEventExtendedDataRecordEx_Event_PPP_Assist_Switch_Stuck_B12B22A
          OpEventGetEventExtendedDataRecordEx_GetEventExtendedDataRecordEx_EvtInfo_Implausible_data_received_from_ECM_U040100: RteEventRef=OpEventGetEventExtendedDataRecordEx_GetEventExtendedDataRecordEx_EvtInfo_Implausible_data_received_from_ECM_U040100
          OpEventGetEventExtendedDataRecordEx_GetEventExtendedDataRecordEx_Event_Implausible_data_received_from_ECM_U040100: RteEventRef=OpEventGetEventExtendedDataRecordEx_GetEventExtendedDataRecordEx_Event_Implausible_data_received_from_ECM_U040100
          OpEventGetEventExtendedDataRecordEx_GetEventExtendedDataRecordEx_EvtInfo_PTS_Sensor_10_Circuit_Open_B129713: RteEventRef=OpEventGetEventExtendedDataRecordEx_GetEventExtendedDataRecordEx_EvtInfo_PTS_Sensor_10_Circuit_Open_B129713
          OpEventGetEventExtendedDataRecordEx_GetEventExtendedDataRecordEx_Event_PTS_Sensor_10_Circuit_Open_B129713: RteEventRef=OpEventGetEventExtendedDataRecordEx_GetEventExtendedDataRecordEx_Event_PTS_Sensor_10_Circuit_Open_B129713
          OpEventGetEventExtendedDataRecordEx_GetEventExtendedDataRecordEx_EvtInfo_Lost_Communication_With_BSC_module_1_U012900: RteEventRef=OpEventGetEventExtendedDataRecordEx_GetEventExtendedDataRecordEx_EvtInfo_Lost_Communication_With_BSC_module_1_U012900
          OpEventGetEventExtendedDataRecordEx_GetEventExtendedDataRecordEx_Event_Lost_Communication_With_BSC_module_1_U012900: RteEventRef=OpEventGetEventExtendedDataRecordEx_GetEventExtendedDataRecordEx_Event_Lost_Communication_With_BSC_module_1_U012900
          OpEventGetEventExtendedDataRecordEx_GetEventExtendedDataRecordEx_EvtInfo_PTS_Sensor_7_Performance_or_Incorrect_Operation_B129492: RteEventRef=OpEventGetEventExtendedDataRecordEx_GetEventExtendedDataRecordEx_EvtInfo_PTS_Sensor_7_Performance_or_Incorrect_Operation_B129492
          OpEventGetEventExtendedDataRecordEx_GetEventExtendedDataRecordEx_Event_PTS_Sensor_7_Performance_or_Incorrect_Operation_B129492: RteEventRef=OpEventGetEventExtendedDataRecordEx_GetEventExtendedDataRecordEx_Event_PTS_Sensor_7_Performance_or_Incorrect_Operation_B129492
          OpEventGetEventExtendedDataRecordEx_GetEventExtendedDataRecordEx_EvtInfo_Left_Camera_Performance_or_Incorrect_Operation_B23C692: RteEventRef=OpEventGetEventExtendedDataRecordEx_GetEventExtendedDataRecordEx_EvtInfo_Left_Camera_Performance_or_Incorrect_Operation_B23C692
          OpEventGetEventExtendedDataRecordEx_GetEventExtendedDataRecordEx_Event_Left_Camera_Performance_or_Incorrect_Operation_B23C692: RteEventRef=OpEventGetEventExtendedDataRecordEx_GetEventExtendedDataRecordEx_Event_Left_Camera_Performance_or_Incorrect_Operation_B23C692
          OpEventGetEventExtendedDataRecordEx_GetEventExtendedDataRecordEx_EvtInfo_Vehicle_Configuration_Mismatch_B223B00: RteEventRef=OpEventGetEventExtendedDataRecordEx_GetEventExtendedDataRecordEx_EvtInfo_Vehicle_Configuration_Mismatch_B223B00
          OpEventGetEventExtendedDataRecordEx_GetEventExtendedDataRecordEx_Event_Vehicle_Configuration_Mismatch_B223B00: RteEventRef=OpEventGetEventExtendedDataRecordEx_GetEventExtendedDataRecordEx_Event_Vehicle_Configuration_Mismatch_B223B00
          OpEventGetEventExtendedDataRecordEx_GetEventExtendedDataRecordEx_EvtInfo_PTS_Sensor_6_Circuit_Open_B129313: RteEventRef=OpEventGetEventExtendedDataRecordEx_GetEventExtendedDataRecordEx_EvtInfo_PTS_Sensor_6_Circuit_Open_B129313
          OpEventGetEventExtendedDataRecordEx_GetEventExtendedDataRecordEx_Event_PTS_Sensor_6_Circuit_Open_B129313: RteEventRef=OpEventGetEventExtendedDataRecordEx_GetEventExtendedDataRecordEx_Event_PTS_Sensor_6_Circuit_Open_B129313
          OpEventGetEventExtendedDataRecordEx_GetEventExtendedDataRecordEx_EvtInfo_Front_Camera_Circuit_Voltage_Out_of_Range_B23C51C: RteEventRef=OpEventGetEventExtendedDataRecordEx_GetEventExtendedDataRecordEx_EvtInfo_Front_Camera_Circuit_Voltage_Out_of_Range_B23C51C
          OpEventGetEventExtendedDataRecordEx_GetEventExtendedDataRecordEx_Event_Front_Camera_Circuit_Voltage_Out_of_Range_B23C51C: RteEventRef=OpEventGetEventExtendedDataRecordEx_GetEventExtendedDataRecordEx_Event_Front_Camera_Circuit_Voltage_Out_of_Range_B23C51C
          OpEventGetEventExtendedDataRecordEx_GetEventExtendedDataRecordEx_EvtInfo_Implausible_Data_From_BSC_Module_1_U041800: RteEventRef=OpEventGetEventExtendedDataRecordEx_GetEventExtendedDataRecordEx_EvtInfo_Implausible_Data_From_BSC_Module_1_U041800
          OpEventGetEventExtendedDataRecordEx_GetEventExtendedDataRecordEx_Event_Implausible_Data_From_BSC_Module_1_U041800: RteEventRef=OpEventGetEventExtendedDataRecordEx_GetEventExtendedDataRecordEx_Event_Implausible_Data_From_BSC_Module_1_U041800
          OpEventGetEventExtendedDataRecordEx_GetEventExtendedDataRecordEx_EvtInfo_PTS_Sensor_10_Performance_or_Incorrect_Operati_6aa46b4f: RteEventRef=OpEventGetEventExtendedDataRecordEx_GetEventExtendedDataRecordEx_EvtInfo_PTS_Sensor_10_Performance_or_Incorrect_Operati_6aa46b4f
          OpEventGetEventExtendedDataRecordEx_GetEventExtendedDataRecordEx_Event_PTS_Sensor_10_Performance_or_Incorrect_Operation_B129792: RteEventRef=OpEventGetEventExtendedDataRecordEx_GetEventExtendedDataRecordEx_Event_PTS_Sensor_10_Performance_or_Incorrect_Operation_B129792
          OpEventGetEventExtendedDataRecordEx_GetEventExtendedDataRecordEx_EvtInfo_PTS_Sensor_11_Circuit_Open_B129813: RteEventRef=OpEventGetEventExtendedDataRecordEx_GetEventExtendedDataRecordEx_EvtInfo_PTS_Sensor_11_Circuit_Open_B129813
          OpEventGetEventExtendedDataRecordEx_GetEventExtendedDataRecordEx_Event_PTS_Sensor_11_Circuit_Open_B129813: RteEventRef=OpEventGetEventExtendedDataRecordEx_GetEventExtendedDataRecordEx_Event_PTS_Sensor_11_Circuit_Open_B129813
          OpEventGetEventExtendedDataRecordEx_GetEventExtendedDataRecordEx_EvtInfo_ECU_Internal_Performance_B22A900: RteEventRef=OpEventGetEventExtendedDataRecordEx_GetEventExtendedDataRecordEx_EvtInfo_ECU_Internal_Performance_B22A900
          OpEventGetEventExtendedDataRecordEx_GetEventExtendedDataRecordEx_Event_ECU_Internal_Performance_B22A900: RteEventRef=OpEventGetEventExtendedDataRecordEx_GetEventExtendedDataRecordEx_Event_ECU_Internal_Performance_B22A900
          OpEventGetEventExtendedDataRecordEx_GetEventExtendedDataRecordEx_EvtInfo_PTS_Sensor_9_Performance_or_Incorrect_Operation_B129692: RteEventRef=OpEventGetEventExtendedDataRecordEx_GetEventExtendedDataRecordEx_EvtInfo_PTS_Sensor_9_Performance_or_Incorrect_Operation_B129692
          OpEventGetEventExtendedDataRecordEx_GetEventExtendedDataRecordEx_Event_PTS_Sensor_9_Performance_or_Incorrect_Operation_B129692: RteEventRef=OpEventGetEventExtendedDataRecordEx_GetEventExtendedDataRecordEx_Event_PTS_Sensor_9_Performance_or_Incorrect_Operation_B129692
          OpEventGetEventExtendedDataRecordEx_GetEventExtendedDataRecordEx_EvtInfo_Calibration_Not_Learned_Lost_Calibration_B228600: RteEventRef=OpEventGetEventExtendedDataRecordEx_GetEventExtendedDataRecordEx_EvtInfo_Calibration_Not_Learned_Lost_Calibration_B228600
          OpEventGetEventExtendedDataRecordEx_GetEventExtendedDataRecordEx_Event_Calibration_Not_Learned_Lost_Calibration_B228600: RteEventRef=OpEventGetEventExtendedDataRecordEx_GetEventExtendedDataRecordEx_Event_Calibration_Not_Learned_Lost_Calibration_B228600
          OpEventGetEventExtendedDataRecordEx_GetEventExtendedDataRecordEx_EvtInfo_Lost_Communication_with_ORC_U015100: RteEventRef=OpEventGetEventExtendedDataRecordEx_GetEventExtendedDataRecordEx_EvtInfo_Lost_Communication_with_ORC_U015100
          OpEventGetEventExtendedDataRecordEx_GetEventExtendedDataRecordEx_Event_Lost_Communication_with_ORC_U015100: RteEventRef=OpEventGetEventExtendedDataRecordEx_GetEventExtendedDataRecordEx_Event_Lost_Communication_with_ORC_U015100
          OpEventGetEventExtendedDataRecordEx_GetEventExtendedDataRecordEx_EvtInfo_PTS_Sensor_1_Circuit_Open_B128E13: RteEventRef=OpEventGetEventExtendedDataRecordEx_GetEventExtendedDataRecordEx_EvtInfo_PTS_Sensor_1_Circuit_Open_B128E13
          OpEventGetEventExtendedDataRecordEx_GetEventExtendedDataRecordEx_Event_PTS_Sensor_1_Circuit_Open_B128E13: RteEventRef=OpEventGetEventExtendedDataRecordEx_GetEventExtendedDataRecordEx_Event_PTS_Sensor_1_Circuit_Open_B128E13
          OpEventGetEventExtendedDataRecordEx_GetEventExtendedDataRecordEx_EvtInfo_Lost_Communication_with_Rear_Camera_U026400: RteEventRef=OpEventGetEventExtendedDataRecordEx_GetEventExtendedDataRecordEx_EvtInfo_Lost_Communication_with_Rear_Camera_U026400
          OpEventGetEventExtendedDataRecordEx_GetEventExtendedDataRecordEx_Event_Lost_Communication_with_Rear_Camera_U026400: RteEventRef=OpEventGetEventExtendedDataRecordEx_GetEventExtendedDataRecordEx_Event_Lost_Communication_with_Rear_Camera_U026400
          OpEventGetEventExtendedDataRecordEx_GetEventExtendedDataRecordEx_EvtInfo_HS_FD_CANR_Comm_Bus_Performance_U100B00: RteEventRef=OpEventGetEventExtendedDataRecordEx_GetEventExtendedDataRecordEx_EvtInfo_HS_FD_CANR_Comm_Bus_Performance_U100B00
          OpEventGetEventExtendedDataRecordEx_GetEventExtendedDataRecordEx_Event_HS_FD_CANR_Comm_Bus_Performance_U100B00: RteEventRef=OpEventGetEventExtendedDataRecordEx_GetEventExtendedDataRecordEx_Event_HS_FD_CANR_Comm_Bus_Performance_U100B00
          OpEventGetEventExtendedDataRecordEx_GetEventExtendedDataRecordEx_EvtInfo_Implausible_Data_Received_From_Body_Control_Mo_0fb85e14: RteEventRef=OpEventGetEventExtendedDataRecordEx_GetEventExtendedDataRecordEx_EvtInfo_Implausible_Data_Received_From_Body_Control_Mo_0fb85e14
          OpEventGetEventExtendedDataRecordEx_GetEventExtendedDataRecordEx_Event_Implausible_Data_Received_From_Body_Control_Modu_63c40a72: RteEventRef=OpEventGetEventExtendedDataRecordEx_GetEventExtendedDataRecordEx_Event_Implausible_Data_Received_From_Body_Control_Modu_63c40a72
          OpEventGetEventExtendedDataRecordEx_GetEventExtendedDataRecordEx_EvtInfo_Lost_Communication_With_BCM_U014000: RteEventRef=OpEventGetEventExtendedDataRecordEx_GetEventExtendedDataRecordEx_EvtInfo_Lost_Communication_With_BCM_U014000
          OpEventGetEventExtendedDataRecordEx_GetEventExtendedDataRecordEx_Event_Lost_Communication_With_BCM_U014000: RteEventRef=OpEventGetEventExtendedDataRecordEx_GetEventExtendedDataRecordEx_Event_Lost_Communication_With_BCM_U014000
          OpEventGetEventExtendedDataRecordEx_GetEventExtendedDataRecordEx_EvtInfo_PTS_Sensor_2_Circuit_Open_B128F13: RteEventRef=OpEventGetEventExtendedDataRecordEx_GetEventExtendedDataRecordEx_EvtInfo_PTS_Sensor_2_Circuit_Open_B128F13
          OpEventGetEventExtendedDataRecordEx_GetEventExtendedDataRecordEx_Event_PTS_Sensor_2_Circuit_Open_B128F13: RteEventRef=OpEventGetEventExtendedDataRecordEx_GetEventExtendedDataRecordEx_Event_PTS_Sensor_2_Circuit_Open_B128F13
          OpEventGetEventExtendedDataRecordEx_GetEventExtendedDataRecordEx_EvtInfo_PTS_Sensor_3_Circuit_Open_B129013: RteEventRef=OpEventGetEventExtendedDataRecordEx_GetEventExtendedDataRecordEx_EvtInfo_PTS_Sensor_3_Circuit_Open_B129013
          OpEventGetEventExtendedDataRecordEx_GetEventExtendedDataRecordEx_Event_PTS_Sensor_3_Circuit_Open_B129013: RteEventRef=OpEventGetEventExtendedDataRecordEx_GetEventExtendedDataRecordEx_Event_PTS_Sensor_3_Circuit_Open_B129013
          OpEventGetEventExtendedDataRecordEx_GetEventExtendedDataRecordEx_EvtInfo_ECU_In_Plant_Mode_C221200: RteEventRef=OpEventGetEventExtendedDataRecordEx_GetEventExtendedDataRecordEx_EvtInfo_ECU_In_Plant_Mode_C221200
          OpEventGetEventExtendedDataRecordEx_GetEventExtendedDataRecordEx_Event_ECU_In_Plant_Mode_C221200: RteEventRef=OpEventGetEventExtendedDataRecordEx_GetEventExtendedDataRecordEx_Event_ECU_In_Plant_Mode_C221200
          OpEventGetEventExtendedDataRecordEx_GetEventExtendedDataRecordEx_EvtInfo_Implausible_Data_from_ORC_module_U045500: RteEventRef=OpEventGetEventExtendedDataRecordEx_GetEventExtendedDataRecordEx_EvtInfo_Implausible_Data_from_ORC_module_U045500
          OpEventGetEventExtendedDataRecordEx_GetEventExtendedDataRecordEx_Event_Implausible_Data_from_ORC_module_U045500: RteEventRef=OpEventGetEventExtendedDataRecordEx_GetEventExtendedDataRecordEx_Event_Implausible_Data_from_ORC_module_U045500
          OpEventGetEventExtendedDataRecordEx_GetEventExtendedDataRecordEx_EvtInfo_Right_Camera_Performance_or_Incorrect_Operation_B23C792: RteEventRef=OpEventGetEventExtendedDataRecordEx_GetEventExtendedDataRecordEx_EvtInfo_Right_Camera_Performance_or_Incorrect_Operation_B23C792
          OpEventGetEventExtendedDataRecordEx_GetEventExtendedDataRecordEx_Event_Right_Camera_Performance_or_Incorrect_Operation_B23C792: RteEventRef=OpEventGetEventExtendedDataRecordEx_GetEventExtendedDataRecordEx_Event_Right_Camera_Performance_or_Incorrect_Operation_B23C792
          OpEventGetEventExtendedDataRecordEx_GetEventExtendedDataRecordEx_EvtInfo_Rear_Sensors_PS_VltgeAboveThreshold_B212B17: RteEventRef=OpEventGetEventExtendedDataRecordEx_GetEventExtendedDataRecordEx_EvtInfo_Rear_Sensors_PS_VltgeAboveThreshold_B212B17
          OpEventGetEventExtendedDataRecordEx_GetEventExtendedDataRecordEx_Event_Rear_Sensors_PS_VltgeAboveThreshold_B212B17: RteEventRef=OpEventGetEventExtendedDataRecordEx_GetEventExtendedDataRecordEx_Event_Rear_Sensors_PS_VltgeAboveThreshold_B212B17
          OpEventGetEventEnableCondition_GetEventEnableCondition_EvtInfo_Invalid_Data_Received_From_Power_Steering_Control_Module_U042000: RteEventRef=OpEventGetEventEnableCondition_GetEventEnableCondition_EvtInfo_Invalid_Data_Received_From_Power_Steering_Control_Module_U042000
          OpEventGetEventEnableCondition_GetEventEnableCondition_EvtInfo_Lost_Communication_with_Left_Camera_U026600: RteEventRef=OpEventGetEventEnableCondition_GetEventEnableCondition_EvtInfo_Lost_Communication_with_Left_Camera_U026600
          OpEventGetEventEnableCondition_GetEventEnableCondition_EvtInfo_Front_Sensors_PS_VltgeBelowThreshold_B212A16: RteEventRef=OpEventGetEventEnableCondition_GetEventEnableCondition_EvtInfo_Front_Sensors_PS_VltgeBelowThreshold_B212A16
          OpEventGetEventEnableCondition_GetEventEnableCondition_EvtInfo_Left_Camera_Circuit_Voltage_Out_of_Range_B23C61C: RteEventRef=OpEventGetEventEnableCondition_GetEventEnableCondition_EvtInfo_Left_Camera_Circuit_Voltage_Out_of_Range_B23C61C
          OpEventGetEventEnableCondition_GetEventEnableCondition_EvtInfo_Rear_Sensors_PS_VltgeBelowThreshold_B212B16: RteEventRef=OpEventGetEventEnableCondition_GetEventEnableCondition_EvtInfo_Rear_Sensors_PS_VltgeBelowThreshold_B212B16
          OpEventGetEventEnableCondition_GetEventEnableCondition_EvtInfo_Rear_Sensors_PS_Bus_Sig_Msg_Failures_B212B08: RteEventRef=OpEventGetEventEnableCondition_GetEventEnableCondition_EvtInfo_Rear_Sensors_PS_Bus_Sig_Msg_Failures_B212B08
          OpEventGetEventEnableCondition_GetEventEnableCondition_EvtInfo_Rear_Camera_Circuit_Voltage_Out_of_Range_B217A1C: RteEventRef=OpEventGetEventEnableCondition_GetEventEnableCondition_EvtInfo_Rear_Camera_Circuit_Voltage_Out_of_Range_B217A1C
          OpEventGetEventEnableCondition_GetEventEnableCondition_EvtInfo_PTS_Sensor_12_Performance_or_Incorrect_Operation_B129992: RteEventRef=OpEventGetEventEnableCondition_GetEventEnableCondition_EvtInfo_PTS_Sensor_12_Performance_or_Incorrect_Operation_B129992
          OpEventGetEventEnableCondition_GetEventEnableCondition_EvtInfo_Battery_Voltage_Over_Voltage_B210C17: RteEventRef=OpEventGetEventEnableCondition_GetEventEnableCondition_EvtInfo_Battery_Voltage_Over_Voltage_B210C17
          OpEventGetEventEnableCondition_GetEventEnableCondition_EvtInfo_Front_Sensors_PS_VltgeAboveThreshold_B212A17: RteEventRef=OpEventGetEventEnableCondition_GetEventEnableCondition_EvtInfo_Front_Sensors_PS_VltgeAboveThreshold_B212A17
          OpEventGetEventEnableCondition_GetEventEnableCondition_EvtInfo_PTS_Sensor_4_Circuit_Open_B129113: RteEventRef=OpEventGetEventEnableCondition_GetEventEnableCondition_EvtInfo_PTS_Sensor_4_Circuit_Open_B129113
          OpEventGetEventEnableCondition_GetEventEnableCondition_EvtInfo_PTS_Sensor_12_Circuit_Open_B129913: RteEventRef=OpEventGetEventEnableCondition_GetEventEnableCondition_EvtInfo_PTS_Sensor_12_Circuit_Open_B129913
          OpEventGetEventEnableCondition_GetEventEnableCondition_EvtInfo_PTS_Sensor_11_Performance_or_Incorrect_Operation_B129892: RteEventRef=OpEventGetEventEnableCondition_GetEventEnableCondition_EvtInfo_PTS_Sensor_11_Performance_or_Incorrect_Operation_B129892
          OpEventGetEventEnableCondition_GetEventEnableCondition_EvtInfo_Lost_Communication_With_Radio_U018400: RteEventRef=OpEventGetEventEnableCondition_GetEventEnableCondition_EvtInfo_Lost_Communication_With_Radio_U018400
          OpEventGetEventEnableCondition_GetEventEnableCondition_EvtInfo_Park_Assist_PTS_Switch_Stuck_B12852A: RteEventRef=OpEventGetEventEnableCondition_GetEventEnableCondition_EvtInfo_Park_Assist_PTS_Switch_Stuck_B12852A
          OpEventGetEventEnableCondition_GetEventEnableCondition_EvtInfo_PTS_Sensor_5_Circuit_Open_B129213: RteEventRef=OpEventGetEventEnableCondition_GetEventEnableCondition_EvtInfo_PTS_Sensor_5_Circuit_Open_B129213
          OpEventGetEventEnableCondition_GetEventEnableCondition_EvtInfo_PTS_Sensor_5_Performance_or_Incorrect_Operation_B129292: RteEventRef=OpEventGetEventEnableCondition_GetEventEnableCondition_EvtInfo_PTS_Sensor_5_Performance_or_Incorrect_Operation_B129292
          OpEventGetEventEnableCondition_GetEventEnableCondition_EvtInfo_Battery_Voltage_Under_Voltage_B210C16: RteEventRef=OpEventGetEventEnableCondition_GetEventEnableCondition_EvtInfo_Battery_Voltage_Under_Voltage_B210C16
          OpEventGetEventEnableCondition_GetEventEnableCondition_EvtInfo_PTS_Sensor_4_Performance_or_Incorrect_Operation_B129192: RteEventRef=OpEventGetEventEnableCondition_GetEventEnableCondition_EvtInfo_PTS_Sensor_4_Performance_or_Incorrect_Operation_B129192
          OpEventGetEventEnableCondition_GetEventEnableCondition_EvtInfo_HS_FD_CAN2_Comm_Bus_Performance_U104E00: RteEventRef=OpEventGetEventEnableCondition_GetEventEnableCondition_EvtInfo_HS_FD_CAN2_Comm_Bus_Performance_U104E00
          OpEventGetEventEnableCondition_GetEventEnableCondition_EvtInfo_PTS_Sensor_9_Circuit_Open_B129613: RteEventRef=OpEventGetEventEnableCondition_GetEventEnableCondition_EvtInfo_PTS_Sensor_9_Circuit_Open_B129613
          OpEventGetEventEnableCondition_GetEventEnableCondition_EvtInfo_Loss_of_Comm_With_Engine_Control_Module_U010000: RteEventRef=OpEventGetEventEnableCondition_GetEventEnableCondition_EvtInfo_Loss_of_Comm_With_Engine_Control_Module_U010000
          OpEventGetEventEnableCondition_GetEventEnableCondition_EvtInfo_Lost_Communication_with_Right_Camera_U026700: RteEventRef=OpEventGetEventEnableCondition_GetEventEnableCondition_EvtInfo_Lost_Communication_with_Right_Camera_U026700
          OpEventGetEventEnableCondition_GetEventEnableCondition_EvtInfo_PTS_Sensor_1_Performance_or_Incorrect_Operation_B128E92: RteEventRef=OpEventGetEventEnableCondition_GetEventEnableCondition_EvtInfo_PTS_Sensor_1_Performance_or_Incorrect_Operation_B128E92
          OpEventGetEventEnableCondition_GetEventEnableCondition_EvtInfo_Rear_Camera_Performance_or_Incorrect_Operation_B217A92: RteEventRef=OpEventGetEventEnableCondition_GetEventEnableCondition_EvtInfo_Rear_Camera_Performance_or_Incorrect_Operation_B217A92
          OpEventGetEventEnableCondition_GetEventEnableCondition_EvtInfo_PTS_Sensor_2_Performance_or_Incorrect_Operation_B128F92: RteEventRef=OpEventGetEventEnableCondition_GetEventEnableCondition_EvtInfo_PTS_Sensor_2_Performance_or_Incorrect_Operation_B128F92
          OpEventGetEventEnableCondition_GetEventEnableCondition_EvtInfo_Right_Camera_Circuit_Voltage_Out_of_Range_B23C71C: RteEventRef=OpEventGetEventEnableCondition_GetEventEnableCondition_EvtInfo_Right_Camera_Circuit_Voltage_Out_of_Range_B23C71C
          OpEventGetEventEnableCondition_GetEventEnableCondition_EvtInfo_PTS_Sensor_8_Circuit_Open_B129513: RteEventRef=OpEventGetEventEnableCondition_GetEventEnableCondition_EvtInfo_PTS_Sensor_8_Circuit_Open_B129513
          OpEventGetEventEnableCondition_GetEventEnableCondition_EvtInfo_Implausible_Data_Received_from_Radio_U048500: RteEventRef=OpEventGetEventEnableCondition_GetEventEnableCondition_EvtInfo_Implausible_Data_Received_from_Radio_U048500
          OpEventGetEventEnableCondition_GetEventEnableCondition_EvtInfo_Implausible_Data_received_from_TRSKM_module_U14A000: RteEventRef=OpEventGetEventEnableCondition_GetEventEnableCondition_EvtInfo_Implausible_Data_received_from_TRSKM_module_U14A000
          OpEventGetEventEnableCondition_GetEventEnableCondition_EvtInfo_Front_Camera_Performance_or_Incorrect_Operation_B23C592: RteEventRef=OpEventGetEventEnableCondition_GetEventEnableCondition_EvtInfo_Front_Camera_Performance_or_Incorrect_Operation_B23C592
          OpEventGetEventEnableCondition_GetEventEnableCondition_EvtInfo_Loss_Communication_with_TRS_Knob_Module_U12B900: RteEventRef=OpEventGetEventEnableCondition_GetEventEnableCondition_EvtInfo_Loss_Communication_with_TRS_Knob_Module_U12B900
          OpEventGetEventEnableCondition_GetEventEnableCondition_EvtInfo_PTS_Sensor_7_Circuit_Open_B129413: RteEventRef=OpEventGetEventEnableCondition_GetEventEnableCondition_EvtInfo_PTS_Sensor_7_Circuit_Open_B129413
          OpEventGetEventEnableCondition_GetEventEnableCondition_EvtInfo_Front_Sensors_PS_Bus_Sig_Msg_Failures_B212A08: RteEventRef=OpEventGetEventEnableCondition_GetEventEnableCondition_EvtInfo_Front_Sensors_PS_Bus_Sig_Msg_Failures_B212A08
          OpEventGetEventEnableCondition_GetEventEnableCondition_EvtInfo_Lost_Communication_With_PSC_Module_A_U013100: RteEventRef=OpEventGetEventEnableCondition_GetEventEnableCondition_EvtInfo_Lost_Communication_With_PSC_Module_A_U013100
          OpEventGetEventEnableCondition_GetEventEnableCondition_EvtInfo_Lost_Communication_with_Front_Camera_U026500: RteEventRef=OpEventGetEventEnableCondition_GetEventEnableCondition_EvtInfo_Lost_Communication_with_Front_Camera_U026500
          OpEventGetEventEnableCondition_GetEventEnableCondition_EvtInfo_PTS_Sensor_3_Performance_or_Incorrect_Operation_B129092: RteEventRef=OpEventGetEventEnableCondition_GetEventEnableCondition_EvtInfo_PTS_Sensor_3_Performance_or_Incorrect_Operation_B129092
          OpEventGetEventEnableCondition_GetEventEnableCondition_EvtInfo_PTS_Sensor_8_Performance_or_Incorrect_Operation_B129592: RteEventRef=OpEventGetEventEnableCondition_GetEventEnableCondition_EvtInfo_PTS_Sensor_8_Performance_or_Incorrect_Operation_B129592
          OpEventGetEventEnableCondition_GetEventEnableCondition_EvtInfo_PPP_Assist_Switch_Stuck_B12B22A: RteEventRef=OpEventGetEventEnableCondition_GetEventEnableCondition_EvtInfo_PPP_Assist_Switch_Stuck_B12B22A
          OpEventGetEventEnableCondition_GetEventEnableCondition_EvtInfo_Implausible_data_received_from_ECM_U040100: RteEventRef=OpEventGetEventEnableCondition_GetEventEnableCondition_EvtInfo_Implausible_data_received_from_ECM_U040100
          OpEventGetEventEnableCondition_GetEventEnableCondition_EvtInfo_PTS_Sensor_10_Circuit_Open_B129713: RteEventRef=OpEventGetEventEnableCondition_GetEventEnableCondition_EvtInfo_PTS_Sensor_10_Circuit_Open_B129713
          OpEventGetEventEnableCondition_GetEventEnableCondition_EvtInfo_Lost_Communication_With_BSC_module_1_U012900: RteEventRef=OpEventGetEventEnableCondition_GetEventEnableCondition_EvtInfo_Lost_Communication_With_BSC_module_1_U012900
          OpEventGetEventEnableCondition_GetEventEnableCondition_EvtInfo_PTS_Sensor_7_Performance_or_Incorrect_Operation_B129492: RteEventRef=OpEventGetEventEnableCondition_GetEventEnableCondition_EvtInfo_PTS_Sensor_7_Performance_or_Incorrect_Operation_B129492
          OpEventGetEventEnableCondition_GetEventEnableCondition_EvtInfo_Left_Camera_Performance_or_Incorrect_Operation_B23C692: RteEventRef=OpEventGetEventEnableCondition_GetEventEnableCondition_EvtInfo_Left_Camera_Performance_or_Incorrect_Operation_B23C692
          OpEventGetEventEnableCondition_GetEventEnableCondition_EvtInfo_Vehicle_Configuration_Mismatch_B223B00: RteEventRef=OpEventGetEventEnableCondition_GetEventEnableCondition_EvtInfo_Vehicle_Configuration_Mismatch_B223B00
          OpEventGetEventEnableCondition_GetEventEnableCondition_EvtInfo_PTS_Sensor_6_Circuit_Open_B129313: RteEventRef=OpEventGetEventEnableCondition_GetEventEnableCondition_EvtInfo_PTS_Sensor_6_Circuit_Open_B129313
          OpEventGetEventEnableCondition_GetEventEnableCondition_EvtInfo_Front_Camera_Circuit_Voltage_Out_of_Range_B23C51C: RteEventRef=OpEventGetEventEnableCondition_GetEventEnableCondition_EvtInfo_Front_Camera_Circuit_Voltage_Out_of_Range_B23C51C
          OpEventGetEventEnableCondition_GetEventEnableCondition_EvtInfo_Implausible_Data_From_BSC_Module_1_U041800: RteEventRef=OpEventGetEventEnableCondition_GetEventEnableCondition_EvtInfo_Implausible_Data_From_BSC_Module_1_U041800
          OpEventGetEventEnableCondition_GetEventEnableCondition_EvtInfo_PTS_Sensor_10_Performance_or_Incorrect_Operation_B129792: RteEventRef=OpEventGetEventEnableCondition_GetEventEnableCondition_EvtInfo_PTS_Sensor_10_Performance_or_Incorrect_Operation_B129792
          OpEventGetEventEnableCondition_GetEventEnableCondition_EvtInfo_PTS_Sensor_11_Circuit_Open_B129813: RteEventRef=OpEventGetEventEnableCondition_GetEventEnableCondition_EvtInfo_PTS_Sensor_11_Circuit_Open_B129813
          OpEventGetEventEnableCondition_GetEventEnableCondition_EvtInfo_ECU_Internal_Performance_B22A900: RteEventRef=OpEventGetEventEnableCondition_GetEventEnableCondition_EvtInfo_ECU_Internal_Performance_B22A900
          OpEventGetEventEnableCondition_GetEventEnableCondition_EvtInfo_PTS_Sensor_9_Performance_or_Incorrect_Operation_B129692: RteEventRef=OpEventGetEventEnableCondition_GetEventEnableCondition_EvtInfo_PTS_Sensor_9_Performance_or_Incorrect_Operation_B129692
          OpEventGetEventEnableCondition_GetEventEnableCondition_EvtInfo_Calibration_Not_Learned_Lost_Calibration_B228600: RteEventRef=OpEventGetEventEnableCondition_GetEventEnableCondition_EvtInfo_Calibration_Not_Learned_Lost_Calibration_B228600
          OpEventGetEventEnableCondition_GetEventEnableCondition_EvtInfo_Lost_Communication_with_ORC_U015100: RteEventRef=OpEventGetEventEnableCondition_GetEventEnableCondition_EvtInfo_Lost_Communication_with_ORC_U015100
          OpEventGetEventEnableCondition_GetEventEnableCondition_EvtInfo_PTS_Sensor_1_Circuit_Open_B128E13: RteEventRef=OpEventGetEventEnableCondition_GetEventEnableCondition_EvtInfo_PTS_Sensor_1_Circuit_Open_B128E13
          OpEventGetEventEnableCondition_GetEventEnableCondition_EvtInfo_Lost_Communication_with_Rear_Camera_U026400: RteEventRef=OpEventGetEventEnableCondition_GetEventEnableCondition_EvtInfo_Lost_Communication_with_Rear_Camera_U026400
          OpEventGetEventEnableCondition_GetEventEnableCondition_EvtInfo_HS_FD_CANR_Comm_Bus_Performance_U100B00: RteEventRef=OpEventGetEventEnableCondition_GetEventEnableCondition_EvtInfo_HS_FD_CANR_Comm_Bus_Performance_U100B00
          OpEventGetEventEnableCondition_GetEventEnableCondition_EvtInfo_Implausible_Data_Received_From_Body_Control_Module_U042200: RteEventRef=OpEventGetEventEnableCondition_GetEventEnableCondition_EvtInfo_Implausible_Data_Received_From_Body_Control_Module_U042200
          OpEventGetEventEnableCondition_GetEventEnableCondition_EvtInfo_Lost_Communication_With_BCM_U014000: RteEventRef=OpEventGetEventEnableCondition_GetEventEnableCondition_EvtInfo_Lost_Communication_With_BCM_U014000
          OpEventGetEventEnableCondition_GetEventEnableCondition_EvtInfo_PTS_Sensor_2_Circuit_Open_B128F13: RteEventRef=OpEventGetEventEnableCondition_GetEventEnableCondition_EvtInfo_PTS_Sensor_2_Circuit_Open_B128F13
          OpEventGetEventEnableCondition_GetEventEnableCondition_EvtInfo_PTS_Sensor_3_Circuit_Open_B129013: RteEventRef=OpEventGetEventEnableCondition_GetEventEnableCondition_EvtInfo_PTS_Sensor_3_Circuit_Open_B129013
          OpEventGetEventEnableCondition_GetEventEnableCondition_EvtInfo_ECU_In_Plant_Mode_C221200: RteEventRef=OpEventGetEventEnableCondition_GetEventEnableCondition_EvtInfo_ECU_In_Plant_Mode_C221200
          OpEventGetEventEnableCondition_GetEventEnableCondition_EvtInfo_Implausible_Data_from_ORC_module_U045500: RteEventRef=OpEventGetEventEnableCondition_GetEventEnableCondition_EvtInfo_Implausible_Data_from_ORC_module_U045500
          OpEventGetEventEnableCondition_GetEventEnableCondition_EvtInfo_Right_Camera_Performance_or_Incorrect_Operation_B23C792: RteEventRef=OpEventGetEventEnableCondition_GetEventEnableCondition_EvtInfo_Right_Camera_Performance_or_Incorrect_Operation_B23C792
          OpEventGetEventEnableCondition_GetEventEnableCondition_EvtInfo_Rear_Sensors_PS_VltgeAboveThreshold_B212B17: RteEventRef=OpEventGetEventEnableCondition_GetEventEnableCondition_EvtInfo_Rear_Sensors_PS_VltgeAboveThreshold_B212B17
          OpEventGetDebouncingOfEvent_GetDebouncingOfEvent_EvtInfo_Invalid_Data_Received_From_Power_Steering_Control_Module_U042000: RteEventRef=OpEventGetDebouncingOfEvent_GetDebouncingOfEvent_EvtInfo_Invalid_Data_Received_From_Power_Steering_Control_Module_U042000
          OpEventGetDebouncingOfEvent_GetDebouncingOfEvent_EvtInfo_Lost_Communication_with_Left_Camera_U026600: RteEventRef=OpEventGetDebouncingOfEvent_GetDebouncingOfEvent_EvtInfo_Lost_Communication_with_Left_Camera_U026600
          OpEventGetDebouncingOfEvent_GetDebouncingOfEvent_EvtInfo_Front_Sensors_PS_VltgeBelowThreshold_B212A16: RteEventRef=OpEventGetDebouncingOfEvent_GetDebouncingOfEvent_EvtInfo_Front_Sensors_PS_VltgeBelowThreshold_B212A16
          OpEventGetDebouncingOfEvent_GetDebouncingOfEvent_EvtInfo_Left_Camera_Circuit_Voltage_Out_of_Range_B23C61C: RteEventRef=OpEventGetDebouncingOfEvent_GetDebouncingOfEvent_EvtInfo_Left_Camera_Circuit_Voltage_Out_of_Range_B23C61C
          OpEventGetDebouncingOfEvent_GetDebouncingOfEvent_EvtInfo_Rear_Sensors_PS_VltgeBelowThreshold_B212B16: RteEventRef=OpEventGetDebouncingOfEvent_GetDebouncingOfEvent_EvtInfo_Rear_Sensors_PS_VltgeBelowThreshold_B212B16
          OpEventGetDebouncingOfEvent_GetDebouncingOfEvent_EvtInfo_Rear_Sensors_PS_Bus_Sig_Msg_Failures_B212B08: RteEventRef=OpEventGetDebouncingOfEvent_GetDebouncingOfEvent_EvtInfo_Rear_Sensors_PS_Bus_Sig_Msg_Failures_B212B08
          OpEventGetDebouncingOfEvent_GetDebouncingOfEvent_EvtInfo_Rear_Camera_Circuit_Voltage_Out_of_Range_B217A1C: RteEventRef=OpEventGetDebouncingOfEvent_GetDebouncingOfEvent_EvtInfo_Rear_Camera_Circuit_Voltage_Out_of_Range_B217A1C
          OpEventGetDebouncingOfEvent_GetDebouncingOfEvent_EvtInfo_PTS_Sensor_12_Performance_or_Incorrect_Operation_B129992: RteEventRef=OpEventGetDebouncingOfEvent_GetDebouncingOfEvent_EvtInfo_PTS_Sensor_12_Performance_or_Incorrect_Operation_B129992
          OpEventGetDebouncingOfEvent_GetDebouncingOfEvent_EvtInfo_Battery_Voltage_Over_Voltage_B210C17: RteEventRef=OpEventGetDebouncingOfEvent_GetDebouncingOfEvent_EvtInfo_Battery_Voltage_Over_Voltage_B210C17
          OpEventGetDebouncingOfEvent_GetDebouncingOfEvent_EvtInfo_Front_Sensors_PS_VltgeAboveThreshold_B212A17: RteEventRef=OpEventGetDebouncingOfEvent_GetDebouncingOfEvent_EvtInfo_Front_Sensors_PS_VltgeAboveThreshold_B212A17
          OpEventGetDebouncingOfEvent_GetDebouncingOfEvent_EvtInfo_PTS_Sensor_4_Circuit_Open_B129113: RteEventRef=OpEventGetDebouncingOfEvent_GetDebouncingOfEvent_EvtInfo_PTS_Sensor_4_Circuit_Open_B129113
          OpEventGetDebouncingOfEvent_GetDebouncingOfEvent_EvtInfo_PTS_Sensor_12_Circuit_Open_B129913: RteEventRef=OpEventGetDebouncingOfEvent_GetDebouncingOfEvent_EvtInfo_PTS_Sensor_12_Circuit_Open_B129913
          OpEventGetDebouncingOfEvent_GetDebouncingOfEvent_EvtInfo_PTS_Sensor_11_Performance_or_Incorrect_Operation_B129892: RteEventRef=OpEventGetDebouncingOfEvent_GetDebouncingOfEvent_EvtInfo_PTS_Sensor_11_Performance_or_Incorrect_Operation_B129892
          OpEventGetDebouncingOfEvent_GetDebouncingOfEvent_EvtInfo_Lost_Communication_With_Radio_U018400: RteEventRef=OpEventGetDebouncingOfEvent_GetDebouncingOfEvent_EvtInfo_Lost_Communication_With_Radio_U018400
          OpEventGetDebouncingOfEvent_GetDebouncingOfEvent_EvtInfo_Park_Assist_PTS_Switch_Stuck_B12852A: RteEventRef=OpEventGetDebouncingOfEvent_GetDebouncingOfEvent_EvtInfo_Park_Assist_PTS_Switch_Stuck_B12852A
          OpEventGetDebouncingOfEvent_GetDebouncingOfEvent_EvtInfo_PTS_Sensor_5_Circuit_Open_B129213: RteEventRef=OpEventGetDebouncingOfEvent_GetDebouncingOfEvent_EvtInfo_PTS_Sensor_5_Circuit_Open_B129213
          OpEventGetDebouncingOfEvent_GetDebouncingOfEvent_EvtInfo_PTS_Sensor_5_Performance_or_Incorrect_Operation_B129292: RteEventRef=OpEventGetDebouncingOfEvent_GetDebouncingOfEvent_EvtInfo_PTS_Sensor_5_Performance_or_Incorrect_Operation_B129292
          OpEventGetDebouncingOfEvent_GetDebouncingOfEvent_EvtInfo_Battery_Voltage_Under_Voltage_B210C16: RteEventRef=OpEventGetDebouncingOfEvent_GetDebouncingOfEvent_EvtInfo_Battery_Voltage_Under_Voltage_B210C16
          OpEventGetDebouncingOfEvent_GetDebouncingOfEvent_EvtInfo_PTS_Sensor_4_Performance_or_Incorrect_Operation_B129192: RteEventRef=OpEventGetDebouncingOfEvent_GetDebouncingOfEvent_EvtInfo_PTS_Sensor_4_Performance_or_Incorrect_Operation_B129192
          OpEventGetDebouncingOfEvent_GetDebouncingOfEvent_EvtInfo_HS_FD_CAN2_Comm_Bus_Performance_U104E00: RteEventRef=OpEventGetDebouncingOfEvent_GetDebouncingOfEvent_EvtInfo_HS_FD_CAN2_Comm_Bus_Performance_U104E00
          OpEventGetDebouncingOfEvent_GetDebouncingOfEvent_EvtInfo_PTS_Sensor_9_Circuit_Open_B129613: RteEventRef=OpEventGetDebouncingOfEvent_GetDebouncingOfEvent_EvtInfo_PTS_Sensor_9_Circuit_Open_B129613
          OpEventGetDebouncingOfEvent_GetDebouncingOfEvent_EvtInfo_Loss_of_Comm_With_Engine_Control_Module_U010000: RteEventRef=OpEventGetDebouncingOfEvent_GetDebouncingOfEvent_EvtInfo_Loss_of_Comm_With_Engine_Control_Module_U010000
          OpEventGetDebouncingOfEvent_GetDebouncingOfEvent_EvtInfo_Lost_Communication_with_Right_Camera_U026700: RteEventRef=OpEventGetDebouncingOfEvent_GetDebouncingOfEvent_EvtInfo_Lost_Communication_with_Right_Camera_U026700
          OpEventGetDebouncingOfEvent_GetDebouncingOfEvent_EvtInfo_PTS_Sensor_1_Performance_or_Incorrect_Operation_B128E92: RteEventRef=OpEventGetDebouncingOfEvent_GetDebouncingOfEvent_EvtInfo_PTS_Sensor_1_Performance_or_Incorrect_Operation_B128E92
          OpEventGetDebouncingOfEvent_GetDebouncingOfEvent_EvtInfo_Rear_Camera_Performance_or_Incorrect_Operation_B217A92: RteEventRef=OpEventGetDebouncingOfEvent_GetDebouncingOfEvent_EvtInfo_Rear_Camera_Performance_or_Incorrect_Operation_B217A92
          OpEventGetDebouncingOfEvent_GetDebouncingOfEvent_EvtInfo_PTS_Sensor_2_Performance_or_Incorrect_Operation_B128F92: RteEventRef=OpEventGetDebouncingOfEvent_GetDebouncingOfEvent_EvtInfo_PTS_Sensor_2_Performance_or_Incorrect_Operation_B128F92
          OpEventGetDebouncingOfEvent_GetDebouncingOfEvent_EvtInfo_Right_Camera_Circuit_Voltage_Out_of_Range_B23C71C: RteEventRef=OpEventGetDebouncingOfEvent_GetDebouncingOfEvent_EvtInfo_Right_Camera_Circuit_Voltage_Out_of_Range_B23C71C
          OpEventGetDebouncingOfEvent_GetDebouncingOfEvent_EvtInfo_PTS_Sensor_8_Circuit_Open_B129513: RteEventRef=OpEventGetDebouncingOfEvent_GetDebouncingOfEvent_EvtInfo_PTS_Sensor_8_Circuit_Open_B129513
          OpEventGetDebouncingOfEvent_GetDebouncingOfEvent_EvtInfo_Implausible_Data_Received_from_Radio_U048500: RteEventRef=OpEventGetDebouncingOfEvent_GetDebouncingOfEvent_EvtInfo_Implausible_Data_Received_from_Radio_U048500
          OpEventGetDebouncingOfEvent_GetDebouncingOfEvent_EvtInfo_Implausible_Data_received_from_TRSKM_module_U14A000: RteEventRef=OpEventGetDebouncingOfEvent_GetDebouncingOfEvent_EvtInfo_Implausible_Data_received_from_TRSKM_module_U14A000
          OpEventGetDebouncingOfEvent_GetDebouncingOfEvent_EvtInfo_Front_Camera_Performance_or_Incorrect_Operation_B23C592: RteEventRef=OpEventGetDebouncingOfEvent_GetDebouncingOfEvent_EvtInfo_Front_Camera_Performance_or_Incorrect_Operation_B23C592
          OpEventGetDebouncingOfEvent_GetDebouncingOfEvent_EvtInfo_Loss_Communication_with_TRS_Knob_Module_U12B900: RteEventRef=OpEventGetDebouncingOfEvent_GetDebouncingOfEvent_EvtInfo_Loss_Communication_with_TRS_Knob_Module_U12B900
          OpEventGetDebouncingOfEvent_GetDebouncingOfEvent_EvtInfo_PTS_Sensor_7_Circuit_Open_B129413: RteEventRef=OpEventGetDebouncingOfEvent_GetDebouncingOfEvent_EvtInfo_PTS_Sensor_7_Circuit_Open_B129413
          OpEventGetDebouncingOfEvent_GetDebouncingOfEvent_EvtInfo_Front_Sensors_PS_Bus_Sig_Msg_Failures_B212A08: RteEventRef=OpEventGetDebouncingOfEvent_GetDebouncingOfEvent_EvtInfo_Front_Sensors_PS_Bus_Sig_Msg_Failures_B212A08
          OpEventGetDebouncingOfEvent_GetDebouncingOfEvent_EvtInfo_Lost_Communication_With_PSC_Module_A_U013100: RteEventRef=OpEventGetDebouncingOfEvent_GetDebouncingOfEvent_EvtInfo_Lost_Communication_With_PSC_Module_A_U013100
          OpEventGetDebouncingOfEvent_GetDebouncingOfEvent_EvtInfo_Lost_Communication_with_Front_Camera_U026500: RteEventRef=OpEventGetDebouncingOfEvent_GetDebouncingOfEvent_EvtInfo_Lost_Communication_with_Front_Camera_U026500
          OpEventGetDebouncingOfEvent_GetDebouncingOfEvent_EvtInfo_PTS_Sensor_3_Performance_or_Incorrect_Operation_B129092: RteEventRef=OpEventGetDebouncingOfEvent_GetDebouncingOfEvent_EvtInfo_PTS_Sensor_3_Performance_or_Incorrect_Operation_B129092
          OpEventGetDebouncingOfEvent_GetDebouncingOfEvent_EvtInfo_PTS_Sensor_8_Performance_or_Incorrect_Operation_B129592: RteEventRef=OpEventGetDebouncingOfEvent_GetDebouncingOfEvent_EvtInfo_PTS_Sensor_8_Performance_or_Incorrect_Operation_B129592
          OpEventGetDebouncingOfEvent_GetDebouncingOfEvent_EvtInfo_PPP_Assist_Switch_Stuck_B12B22A: RteEventRef=OpEventGetDebouncingOfEvent_GetDebouncingOfEvent_EvtInfo_PPP_Assist_Switch_Stuck_B12B22A
          OpEventGetDebouncingOfEvent_GetDebouncingOfEvent_EvtInfo_Implausible_data_received_from_ECM_U040100: RteEventRef=OpEventGetDebouncingOfEvent_GetDebouncingOfEvent_EvtInfo_Implausible_data_received_from_ECM_U040100
          OpEventGetDebouncingOfEvent_GetDebouncingOfEvent_EvtInfo_PTS_Sensor_10_Circuit_Open_B129713: RteEventRef=OpEventGetDebouncingOfEvent_GetDebouncingOfEvent_EvtInfo_PTS_Sensor_10_Circuit_Open_B129713
          OpEventGetDebouncingOfEvent_GetDebouncingOfEvent_EvtInfo_Lost_Communication_With_BSC_module_1_U012900: RteEventRef=OpEventGetDebouncingOfEvent_GetDebouncingOfEvent_EvtInfo_Lost_Communication_With_BSC_module_1_U012900
          OpEventGetDebouncingOfEvent_GetDebouncingOfEvent_EvtInfo_PTS_Sensor_7_Performance_or_Incorrect_Operation_B129492: RteEventRef=OpEventGetDebouncingOfEvent_GetDebouncingOfEvent_EvtInfo_PTS_Sensor_7_Performance_or_Incorrect_Operation_B129492
          OpEventGetDebouncingOfEvent_GetDebouncingOfEvent_EvtInfo_Left_Camera_Performance_or_Incorrect_Operation_B23C692: RteEventRef=OpEventGetDebouncingOfEvent_GetDebouncingOfEvent_EvtInfo_Left_Camera_Performance_or_Incorrect_Operation_B23C692
          OpEventGetDebouncingOfEvent_GetDebouncingOfEvent_EvtInfo_Vehicle_Configuration_Mismatch_B223B00: RteEventRef=OpEventGetDebouncingOfEvent_GetDebouncingOfEvent_EvtInfo_Vehicle_Configuration_Mismatch_B223B00
          OpEventGetDebouncingOfEvent_GetDebouncingOfEvent_EvtInfo_PTS_Sensor_6_Circuit_Open_B129313: RteEventRef=OpEventGetDebouncingOfEvent_GetDebouncingOfEvent_EvtInfo_PTS_Sensor_6_Circuit_Open_B129313
          OpEventGetDebouncingOfEvent_GetDebouncingOfEvent_EvtInfo_Front_Camera_Circuit_Voltage_Out_of_Range_B23C51C: RteEventRef=OpEventGetDebouncingOfEvent_GetDebouncingOfEvent_EvtInfo_Front_Camera_Circuit_Voltage_Out_of_Range_B23C51C
          OpEventGetDebouncingOfEvent_GetDebouncingOfEvent_EvtInfo_Implausible_Data_From_BSC_Module_1_U041800: RteEventRef=OpEventGetDebouncingOfEvent_GetDebouncingOfEvent_EvtInfo_Implausible_Data_From_BSC_Module_1_U041800
          OpEventGetDebouncingOfEvent_GetDebouncingOfEvent_EvtInfo_PTS_Sensor_10_Performance_or_Incorrect_Operation_B129792: RteEventRef=OpEventGetDebouncingOfEvent_GetDebouncingOfEvent_EvtInfo_PTS_Sensor_10_Performance_or_Incorrect_Operation_B129792
          OpEventGetDebouncingOfEvent_GetDebouncingOfEvent_EvtInfo_PTS_Sensor_11_Circuit_Open_B129813: RteEventRef=OpEventGetDebouncingOfEvent_GetDebouncingOfEvent_EvtInfo_PTS_Sensor_11_Circuit_Open_B129813
          OpEventGetDebouncingOfEvent_GetDebouncingOfEvent_EvtInfo_ECU_Internal_Performance_B22A900: RteEventRef=OpEventGetDebouncingOfEvent_GetDebouncingOfEvent_EvtInfo_ECU_Internal_Performance_B22A900
          OpEventGetDebouncingOfEvent_GetDebouncingOfEvent_EvtInfo_PTS_Sensor_9_Performance_or_Incorrect_Operation_B129692: RteEventRef=OpEventGetDebouncingOfEvent_GetDebouncingOfEvent_EvtInfo_PTS_Sensor_9_Performance_or_Incorrect_Operation_B129692
          OpEventGetDebouncingOfEvent_GetDebouncingOfEvent_EvtInfo_Calibration_Not_Learned_Lost_Calibration_B228600: RteEventRef=OpEventGetDebouncingOfEvent_GetDebouncingOfEvent_EvtInfo_Calibration_Not_Learned_Lost_Calibration_B228600
          OpEventGetDebouncingOfEvent_GetDebouncingOfEvent_EvtInfo_Lost_Communication_with_ORC_U015100: RteEventRef=OpEventGetDebouncingOfEvent_GetDebouncingOfEvent_EvtInfo_Lost_Communication_with_ORC_U015100
          OpEventGetDebouncingOfEvent_GetDebouncingOfEvent_EvtInfo_PTS_Sensor_1_Circuit_Open_B128E13: RteEventRef=OpEventGetDebouncingOfEvent_GetDebouncingOfEvent_EvtInfo_PTS_Sensor_1_Circuit_Open_B128E13
          OpEventGetDebouncingOfEvent_GetDebouncingOfEvent_EvtInfo_Lost_Communication_with_Rear_Camera_U026400: RteEventRef=OpEventGetDebouncingOfEvent_GetDebouncingOfEvent_EvtInfo_Lost_Communication_with_Rear_Camera_U026400
          OpEventGetDebouncingOfEvent_GetDebouncingOfEvent_EvtInfo_HS_FD_CANR_Comm_Bus_Performance_U100B00: RteEventRef=OpEventGetDebouncingOfEvent_GetDebouncingOfEvent_EvtInfo_HS_FD_CANR_Comm_Bus_Performance_U100B00
          OpEventGetDebouncingOfEvent_GetDebouncingOfEvent_EvtInfo_Implausible_Data_Received_From_Body_Control_Module_U042200: RteEventRef=OpEventGetDebouncingOfEvent_GetDebouncingOfEvent_EvtInfo_Implausible_Data_Received_From_Body_Control_Module_U042200
          OpEventGetDebouncingOfEvent_GetDebouncingOfEvent_EvtInfo_Lost_Communication_With_BCM_U014000: RteEventRef=OpEventGetDebouncingOfEvent_GetDebouncingOfEvent_EvtInfo_Lost_Communication_With_BCM_U014000
          OpEventGetDebouncingOfEvent_GetDebouncingOfEvent_EvtInfo_PTS_Sensor_2_Circuit_Open_B128F13: RteEventRef=OpEventGetDebouncingOfEvent_GetDebouncingOfEvent_EvtInfo_PTS_Sensor_2_Circuit_Open_B128F13
          OpEventGetDebouncingOfEvent_GetDebouncingOfEvent_EvtInfo_PTS_Sensor_3_Circuit_Open_B129013: RteEventRef=OpEventGetDebouncingOfEvent_GetDebouncingOfEvent_EvtInfo_PTS_Sensor_3_Circuit_Open_B129013
          OpEventGetDebouncingOfEvent_GetDebouncingOfEvent_EvtInfo_ECU_In_Plant_Mode_C221200: RteEventRef=OpEventGetDebouncingOfEvent_GetDebouncingOfEvent_EvtInfo_ECU_In_Plant_Mode_C221200
          OpEventGetDebouncingOfEvent_GetDebouncingOfEvent_EvtInfo_Implausible_Data_from_ORC_module_U045500: RteEventRef=OpEventGetDebouncingOfEvent_GetDebouncingOfEvent_EvtInfo_Implausible_Data_from_ORC_module_U045500
          OpEventGetDebouncingOfEvent_GetDebouncingOfEvent_EvtInfo_Right_Camera_Performance_or_Incorrect_Operation_B23C792: RteEventRef=OpEventGetDebouncingOfEvent_GetDebouncingOfEvent_EvtInfo_Right_Camera_Performance_or_Incorrect_Operation_B23C792
          OpEventGetDebouncingOfEvent_GetDebouncingOfEvent_EvtInfo_Rear_Sensors_PS_VltgeAboveThreshold_B212B17: RteEventRef=OpEventGetDebouncingOfEvent_GetDebouncingOfEvent_EvtInfo_Rear_Sensors_PS_VltgeAboveThreshold_B212B17
          OpEventGetMonitorStatus_GetMonitorStatus_EvtInfo_Invalid_Data_Received_From_Power_Steering_Control_Module_U042000: RteEventRef=OpEventGetMonitorStatus_GetMonitorStatus_EvtInfo_Invalid_Data_Received_From_Power_Steering_Control_Module_U042000
          OpEventGetMonitorStatus_GetMonitorStatus_EvtInfo_Lost_Communication_with_Left_Camera_U026600: RteEventRef=OpEventGetMonitorStatus_GetMonitorStatus_EvtInfo_Lost_Communication_with_Left_Camera_U026600
          OpEventGetMonitorStatus_GetMonitorStatus_EvtInfo_Front_Sensors_PS_VltgeBelowThreshold_B212A16: RteEventRef=OpEventGetMonitorStatus_GetMonitorStatus_EvtInfo_Front_Sensors_PS_VltgeBelowThreshold_B212A16
          OpEventGetMonitorStatus_GetMonitorStatus_EvtInfo_Left_Camera_Circuit_Voltage_Out_of_Range_B23C61C: RteEventRef=OpEventGetMonitorStatus_GetMonitorStatus_EvtInfo_Left_Camera_Circuit_Voltage_Out_of_Range_B23C61C
          OpEventGetMonitorStatus_GetMonitorStatus_EvtInfo_Rear_Sensors_PS_VltgeBelowThreshold_B212B16: RteEventRef=OpEventGetMonitorStatus_GetMonitorStatus_EvtInfo_Rear_Sensors_PS_VltgeBelowThreshold_B212B16
          OpEventGetMonitorStatus_GetMonitorStatus_EvtInfo_Rear_Sensors_PS_Bus_Sig_Msg_Failures_B212B08: RteEventRef=OpEventGetMonitorStatus_GetMonitorStatus_EvtInfo_Rear_Sensors_PS_Bus_Sig_Msg_Failures_B212B08
          OpEventGetMonitorStatus_GetMonitorStatus_EvtInfo_Rear_Camera_Circuit_Voltage_Out_of_Range_B217A1C: RteEventRef=OpEventGetMonitorStatus_GetMonitorStatus_EvtInfo_Rear_Camera_Circuit_Voltage_Out_of_Range_B217A1C
          OpEventGetMonitorStatus_GetMonitorStatus_EvtInfo_PTS_Sensor_12_Performance_or_Incorrect_Operation_B129992: RteEventRef=OpEventGetMonitorStatus_GetMonitorStatus_EvtInfo_PTS_Sensor_12_Performance_or_Incorrect_Operation_B129992
          OpEventGetMonitorStatus_GetMonitorStatus_EvtInfo_Battery_Voltage_Over_Voltage_B210C17: RteEventRef=OpEventGetMonitorStatus_GetMonitorStatus_EvtInfo_Battery_Voltage_Over_Voltage_B210C17
          OpEventGetMonitorStatus_GetMonitorStatus_EvtInfo_Front_Sensors_PS_VltgeAboveThreshold_B212A17: RteEventRef=OpEventGetMonitorStatus_GetMonitorStatus_EvtInfo_Front_Sensors_PS_VltgeAboveThreshold_B212A17
          OpEventGetMonitorStatus_GetMonitorStatus_EvtInfo_PTS_Sensor_4_Circuit_Open_B129113: RteEventRef=OpEventGetMonitorStatus_GetMonitorStatus_EvtInfo_PTS_Sensor_4_Circuit_Open_B129113
          OpEventGetMonitorStatus_GetMonitorStatus_EvtInfo_PTS_Sensor_12_Circuit_Open_B129913: RteEventRef=OpEventGetMonitorStatus_GetMonitorStatus_EvtInfo_PTS_Sensor_12_Circuit_Open_B129913
          OpEventGetMonitorStatus_GetMonitorStatus_EvtInfo_PTS_Sensor_11_Performance_or_Incorrect_Operation_B129892: RteEventRef=OpEventGetMonitorStatus_GetMonitorStatus_EvtInfo_PTS_Sensor_11_Performance_or_Incorrect_Operation_B129892
          OpEventGetMonitorStatus_GetMonitorStatus_EvtInfo_Lost_Communication_With_Radio_U018400: RteEventRef=OpEventGetMonitorStatus_GetMonitorStatus_EvtInfo_Lost_Communication_With_Radio_U018400
          OpEventGetMonitorStatus_GetMonitorStatus_EvtInfo_Park_Assist_PTS_Switch_Stuck_B12852A: RteEventRef=OpEventGetMonitorStatus_GetMonitorStatus_EvtInfo_Park_Assist_PTS_Switch_Stuck_B12852A
          OpEventGetMonitorStatus_GetMonitorStatus_EvtInfo_PTS_Sensor_5_Circuit_Open_B129213: RteEventRef=OpEventGetMonitorStatus_GetMonitorStatus_EvtInfo_PTS_Sensor_5_Circuit_Open_B129213
          OpEventGetMonitorStatus_GetMonitorStatus_EvtInfo_PTS_Sensor_5_Performance_or_Incorrect_Operation_B129292: RteEventRef=OpEventGetMonitorStatus_GetMonitorStatus_EvtInfo_PTS_Sensor_5_Performance_or_Incorrect_Operation_B129292
          OpEventGetMonitorStatus_GetMonitorStatus_EvtInfo_Battery_Voltage_Under_Voltage_B210C16: RteEventRef=OpEventGetMonitorStatus_GetMonitorStatus_EvtInfo_Battery_Voltage_Under_Voltage_B210C16
          OpEventGetMonitorStatus_GetMonitorStatus_EvtInfo_PTS_Sensor_4_Performance_or_Incorrect_Operation_B129192: RteEventRef=OpEventGetMonitorStatus_GetMonitorStatus_EvtInfo_PTS_Sensor_4_Performance_or_Incorrect_Operation_B129192
          OpEventGetMonitorStatus_GetMonitorStatus_EvtInfo_HS_FD_CAN2_Comm_Bus_Performance_U104E00: RteEventRef=OpEventGetMonitorStatus_GetMonitorStatus_EvtInfo_HS_FD_CAN2_Comm_Bus_Performance_U104E00
          OpEventGetMonitorStatus_GetMonitorStatus_EvtInfo_PTS_Sensor_9_Circuit_Open_B129613: RteEventRef=OpEventGetMonitorStatus_GetMonitorStatus_EvtInfo_PTS_Sensor_9_Circuit_Open_B129613
          OpEventGetMonitorStatus_GetMonitorStatus_EvtInfo_Loss_of_Comm_With_Engine_Control_Module_U010000: RteEventRef=OpEventGetMonitorStatus_GetMonitorStatus_EvtInfo_Loss_of_Comm_With_Engine_Control_Module_U010000
          OpEventGetMonitorStatus_GetMonitorStatus_EvtInfo_Lost_Communication_with_Right_Camera_U026700: RteEventRef=OpEventGetMonitorStatus_GetMonitorStatus_EvtInfo_Lost_Communication_with_Right_Camera_U026700
          OpEventGetMonitorStatus_GetMonitorStatus_EvtInfo_PTS_Sensor_1_Performance_or_Incorrect_Operation_B128E92: RteEventRef=OpEventGetMonitorStatus_GetMonitorStatus_EvtInfo_PTS_Sensor_1_Performance_or_Incorrect_Operation_B128E92
          OpEventGetMonitorStatus_GetMonitorStatus_EvtInfo_Rear_Camera_Performance_or_Incorrect_Operation_B217A92: RteEventRef=OpEventGetMonitorStatus_GetMonitorStatus_EvtInfo_Rear_Camera_Performance_or_Incorrect_Operation_B217A92
          OpEventGetMonitorStatus_GetMonitorStatus_EvtInfo_PTS_Sensor_2_Performance_or_Incorrect_Operation_B128F92: RteEventRef=OpEventGetMonitorStatus_GetMonitorStatus_EvtInfo_PTS_Sensor_2_Performance_or_Incorrect_Operation_B128F92
          OpEventGetMonitorStatus_GetMonitorStatus_EvtInfo_Right_Camera_Circuit_Voltage_Out_of_Range_B23C71C: RteEventRef=OpEventGetMonitorStatus_GetMonitorStatus_EvtInfo_Right_Camera_Circuit_Voltage_Out_of_Range_B23C71C
          OpEventGetMonitorStatus_GetMonitorStatus_EvtInfo_PTS_Sensor_8_Circuit_Open_B129513: RteEventRef=OpEventGetMonitorStatus_GetMonitorStatus_EvtInfo_PTS_Sensor_8_Circuit_Open_B129513
          OpEventGetMonitorStatus_GetMonitorStatus_EvtInfo_Implausible_Data_Received_from_Radio_U048500: RteEventRef=OpEventGetMonitorStatus_GetMonitorStatus_EvtInfo_Implausible_Data_Received_from_Radio_U048500
          OpEventGetMonitorStatus_GetMonitorStatus_EvtInfo_Implausible_Data_received_from_TRSKM_module_U14A000: RteEventRef=OpEventGetMonitorStatus_GetMonitorStatus_EvtInfo_Implausible_Data_received_from_TRSKM_module_U14A000
          OpEventGetMonitorStatus_GetMonitorStatus_EvtInfo_Front_Camera_Performance_or_Incorrect_Operation_B23C592: RteEventRef=OpEventGetMonitorStatus_GetMonitorStatus_EvtInfo_Front_Camera_Performance_or_Incorrect_Operation_B23C592
          OpEventGetMonitorStatus_GetMonitorStatus_EvtInfo_Loss_Communication_with_TRS_Knob_Module_U12B900: RteEventRef=OpEventGetMonitorStatus_GetMonitorStatus_EvtInfo_Loss_Communication_with_TRS_Knob_Module_U12B900
          OpEventGetMonitorStatus_GetMonitorStatus_EvtInfo_PTS_Sensor_7_Circuit_Open_B129413: RteEventRef=OpEventGetMonitorStatus_GetMonitorStatus_EvtInfo_PTS_Sensor_7_Circuit_Open_B129413
          OpEventGetMonitorStatus_GetMonitorStatus_EvtInfo_Front_Sensors_PS_Bus_Sig_Msg_Failures_B212A08: RteEventRef=OpEventGetMonitorStatus_GetMonitorStatus_EvtInfo_Front_Sensors_PS_Bus_Sig_Msg_Failures_B212A08
          OpEventGetMonitorStatus_GetMonitorStatus_EvtInfo_Lost_Communication_With_PSC_Module_A_U013100: RteEventRef=OpEventGetMonitorStatus_GetMonitorStatus_EvtInfo_Lost_Communication_With_PSC_Module_A_U013100
          OpEventGetMonitorStatus_GetMonitorStatus_EvtInfo_Lost_Communication_with_Front_Camera_U026500: RteEventRef=OpEventGetMonitorStatus_GetMonitorStatus_EvtInfo_Lost_Communication_with_Front_Camera_U026500
          OpEventGetMonitorStatus_GetMonitorStatus_EvtInfo_PTS_Sensor_3_Performance_or_Incorrect_Operation_B129092: RteEventRef=OpEventGetMonitorStatus_GetMonitorStatus_EvtInfo_PTS_Sensor_3_Performance_or_Incorrect_Operation_B129092
          OpEventGetMonitorStatus_GetMonitorStatus_EvtInfo_PTS_Sensor_8_Performance_or_Incorrect_Operation_B129592: RteEventRef=OpEventGetMonitorStatus_GetMonitorStatus_EvtInfo_PTS_Sensor_8_Performance_or_Incorrect_Operation_B129592
          OpEventGetMonitorStatus_GetMonitorStatus_EvtInfo_PPP_Assist_Switch_Stuck_B12B22A: RteEventRef=OpEventGetMonitorStatus_GetMonitorStatus_EvtInfo_PPP_Assist_Switch_Stuck_B12B22A
          OpEventGetMonitorStatus_GetMonitorStatus_EvtInfo_Implausible_data_received_from_ECM_U040100: RteEventRef=OpEventGetMonitorStatus_GetMonitorStatus_EvtInfo_Implausible_data_received_from_ECM_U040100
          OpEventGetMonitorStatus_GetMonitorStatus_EvtInfo_PTS_Sensor_10_Circuit_Open_B129713: RteEventRef=OpEventGetMonitorStatus_GetMonitorStatus_EvtInfo_PTS_Sensor_10_Circuit_Open_B129713
          OpEventGetMonitorStatus_GetMonitorStatus_EvtInfo_Lost_Communication_With_BSC_module_1_U012900: RteEventRef=OpEventGetMonitorStatus_GetMonitorStatus_EvtInfo_Lost_Communication_With_BSC_module_1_U012900
          OpEventGetMonitorStatus_GetMonitorStatus_EvtInfo_PTS_Sensor_7_Performance_or_Incorrect_Operation_B129492: RteEventRef=OpEventGetMonitorStatus_GetMonitorStatus_EvtInfo_PTS_Sensor_7_Performance_or_Incorrect_Operation_B129492
          OpEventGetMonitorStatus_GetMonitorStatus_EvtInfo_Left_Camera_Performance_or_Incorrect_Operation_B23C692: RteEventRef=OpEventGetMonitorStatus_GetMonitorStatus_EvtInfo_Left_Camera_Performance_or_Incorrect_Operation_B23C692
          OpEventGetMonitorStatus_GetMonitorStatus_EvtInfo_Vehicle_Configuration_Mismatch_B223B00: RteEventRef=OpEventGetMonitorStatus_GetMonitorStatus_EvtInfo_Vehicle_Configuration_Mismatch_B223B00
          OpEventGetMonitorStatus_GetMonitorStatus_EvtInfo_PTS_Sensor_6_Circuit_Open_B129313: RteEventRef=OpEventGetMonitorStatus_GetMonitorStatus_EvtInfo_PTS_Sensor_6_Circuit_Open_B129313
          OpEventGetMonitorStatus_GetMonitorStatus_EvtInfo_Front_Camera_Circuit_Voltage_Out_of_Range_B23C51C: RteEventRef=OpEventGetMonitorStatus_GetMonitorStatus_EvtInfo_Front_Camera_Circuit_Voltage_Out_of_Range_B23C51C
          OpEventGetMonitorStatus_GetMonitorStatus_EvtInfo_Implausible_Data_From_BSC_Module_1_U041800: RteEventRef=OpEventGetMonitorStatus_GetMonitorStatus_EvtInfo_Implausible_Data_From_BSC_Module_1_U041800
          OpEventGetMonitorStatus_GetMonitorStatus_EvtInfo_PTS_Sensor_10_Performance_or_Incorrect_Operation_B129792: RteEventRef=OpEventGetMonitorStatus_GetMonitorStatus_EvtInfo_PTS_Sensor_10_Performance_or_Incorrect_Operation_B129792
          OpEventGetMonitorStatus_GetMonitorStatus_EvtInfo_PTS_Sensor_11_Circuit_Open_B129813: RteEventRef=OpEventGetMonitorStatus_GetMonitorStatus_EvtInfo_PTS_Sensor_11_Circuit_Open_B129813
          OpEventGetMonitorStatus_GetMonitorStatus_EvtInfo_ECU_Internal_Performance_B22A900: RteEventRef=OpEventGetMonitorStatus_GetMonitorStatus_EvtInfo_ECU_Internal_Performance_B22A900
          OpEventGetMonitorStatus_GetMonitorStatus_EvtInfo_PTS_Sensor_9_Performance_or_Incorrect_Operation_B129692: RteEventRef=OpEventGetMonitorStatus_GetMonitorStatus_EvtInfo_PTS_Sensor_9_Performance_or_Incorrect_Operation_B129692
          OpEventGetMonitorStatus_GetMonitorStatus_EvtInfo_Calibration_Not_Learned_Lost_Calibration_B228600: RteEventRef=OpEventGetMonitorStatus_GetMonitorStatus_EvtInfo_Calibration_Not_Learned_Lost_Calibration_B228600
          OpEventGetMonitorStatus_GetMonitorStatus_EvtInfo_Lost_Communication_with_ORC_U015100: RteEventRef=OpEventGetMonitorStatus_GetMonitorStatus_EvtInfo_Lost_Communication_with_ORC_U015100
