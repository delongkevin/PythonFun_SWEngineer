AUTOSAR XML (schema 00048)
package /ActiveEcuC
  module config Xcp: implementation-config-variant=VARIANT-PRE-COMPILE, module-description=Xcp_Impl
    XcpConfig
      XcpTransportLayer
        XcpOnCan:
          XcpOnCanMaxCto = 8
          XcpOnCanMaxDto = 8
          XcpOnCanConfirmationTimeout = 10
          XcpOnCanMultiConnectionProtection = false
          XcpOnCanVariableDlc = false
          XcpPduMode = false
      XcpCoreDefinition: XcpSendQueueSize=256
      XcpEventChannel_10ms (XcpEventChannel):
        XcpEventChannelMaxDaqList = 1
        XcpEventChannelNumber = 0
        XcpEventChannelTimeCycle = 10
        XcpEventChannelTimeUnit = TIMESTAMP_UNIT_1MS
        XcpEventChannelType = DAQ
        XcpEventChannelCoreRef = XcpCoreDefinition
      XcpPdu_rx (XcpPdu)
        XcpRxPdu: XcpRxPduId=0, XcpRxPduRef=XCP_Rx_oFDCAN2_6c5435ab_Rx, XcpTxPduContRef=XcpTxPdu
      XcpPdu_tx (XcpPdu)
        XcpTxPdu: XcpTxPduId=0, XcpTxPduRef=XCP_Tx_oFDCAN2_538ae81a_Tx
    XcpCmdConfig: XcpOpenCommandInterface=false
      XcpStandard:
        XcpBlockUpload = false
        XcpCommunicationModeInfo = true
        XcpGetIdGeneric = true
        XcpMemoryReadProtection = false
        XcpSeedKey = false
        XcpUserDefinedCommand = false
      XcpAsynchMessage: XcpEventCodes=false, XcpServiceRequestMessage=false
      XcpCalibration: XcpBlockDownload=false, XcpMIN_STForBlockDownload=0, XcpModifyBits=true, XcpShortDownload=false
      XcpDaqAndStim:
        XcpFixedTimestamp = false
        XcpGetDAQEventInfo = true
        XcpMaxNumberOfOdtDaq = 123
        XcpMaxNumberOfOdtEntries = 124
        XcpMaxNumberOfOdtStim = 1
        XcpOverrunIndication = true
        XcpResolutionInfo = true
        XcpResumeMode = false
        XcpSynchronousDataStimulation = false
        XcpWriteDAQMultiple = false
        XcpDAQMessageHeader = ODT
        XcpComplementaryDAQ = false
    XcpGeneral:
      XcpDevErrorDetect = true
      XcpMainFunctionPeriod = 0.01
      XcpMaxEventChannel = 255
      XcpOnCanEnabled = true
      XcpOnCddEnabled = false
      XcpOnEthernetEnabled = false
      XcpOnFlexRayEnabled = false
      XcpPrescalerSupported = false
      XcpVersionInfoApi = true
      XcpBootloaderDownload = false
      XcpControl = true
      XcpMultiClientSupport = false
      XcpRuntimeMeasurementSupport = false
      XcpSafeBswChecks = false
      XcpSessionStatusAPI = false
      XcpTypeSafeCopy = false
      XcpDAQMemAccessByApplication = false
      XcpA2L: XcpTimeoutT1=2000, XcpTimeoutT2=10000, XcpTimeoutT3=2000, XcpTimeoutT4=2000, XcpTimeoutT5=2000, XcpTimeoutT6=2000, XcpTimeoutT7=0
