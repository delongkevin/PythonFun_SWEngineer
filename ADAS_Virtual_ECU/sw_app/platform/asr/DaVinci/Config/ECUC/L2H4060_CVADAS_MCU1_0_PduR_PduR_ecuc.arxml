AUTOSAR XML (schema 00048)
package /ActiveEcuC
  module config PduR: implementation-config-variant=VARIANT-PRE-COMPILE, module-description=PduR_Impl
    PduRGeneral:
      PduRDevErrorDetect = true
      PduRVersionInfoApi = false
      PduRMetaDataSupport = false
      PduRPduCallback = false
      PduRSwitching = false
      PduRSafeBswChecks = false
      PduREnableDeferredTransmission = false
      PduREnableDeferredReception = false
      PduRSupportMulticore = false
      PduRRoutingTypeGateway = false
      PduRSpinlockRetryCounter = 4294967295
      PduRExtendedErrorChecks = false
      PduRGeneration:
        PduROutOfBoundsWriteProtectionStrategy = NONE
        PduROutOfBoundsWriteSanitizer = false
        PduROutOfBoundsReadSanitizer = false
        PduRNumericalDataTypeMinimizationStrategy = WITH_CAST
        PduRReduceConstantData2Define = false
        PduRBoolDataInArrayOfStructStrategy = BITMASKING
        PduRDeduplicateIndirectedData = true
        PduRDataDeduplicationStrategy = WITH_CAST
        PduRReduceBoolDataByNegationThreshold = 2
        PduRReduceBoolDataByNumericalComparisonThreshold = 2
        PduRReduceBoolDataByNumericalRelationThreshold = 2
        PduRReduceBoolDataByNumericalOperandStrategy = WITH_ANY_VALUE
        PduRReduceNumericalDataByOffsetThreshold = 2
        PduRReduceNumericalDataByArraySubtractionThreshold = 2
        PduRReduceDataByStreaming = false
        PduRShortSymbols = false
        PduRInterfacesForDeactivatedData = false
        PduRReferringKeysInComments = false
    PduRRoutingTables: PduRConfigurationId=0
      PduRRoutingTable
        186 x PduRRoutingPath, all with PduRMulticoreRoutingPath=false, PduRLockRef=PduRLock_PduRExclusiveArea:
          BCM_FD_3_oFDCAN2_95fa4902_Rx: PduRRoutingPathCommunicationType=COMMUNICATION_INTERFACE
            PduRSrcPdu_bf2e5cd2 (PduRSrcPdu): PduRSourcePduHandleId=6, PduRSrcPduDirection=RECEIVE, PduRSrcPduRef=BCM_FD_3_oFDCAN2_95fa4902_Rx, PduRSrcPduPduRBswModulesRef=CanIf
            BCM_FD_3_oFDCAN2_95fa4902_Rx_bf2e5cd2_Rx (PduRDestPdu):
              PduRDestPduHandleId = 6
              PduRDestPduDirection = RECEIVE
              PduRDestPduRoutingType = API_FORWARDING
              PduRDestPduDataProcessing = IMMEDIATE
              PduRPduLengthHandlingStrategy = IGNORE
              PduRDestPduCrossPartitionDestination = false
              PduRTransmissionConfirmation = false
              PduRDestPduRef = BCM_FD_3_oFDCAN2_e4a1de59_Rx
              PduRDestPduPduRBswModulesRef = Com
          BRAKE_FD_4_oFDCAN2_86ae4855_Rx: PduRRoutingPathCommunicationType=COMMUNICATION_INTERFACE
            BRAKE_FD_4_oFDCAN2_86ae4855_Rx_8bfd03c9_Rx (PduRDestPdu):
              PduRDestPduHandleId = 21
              PduRDestPduDirection = RECEIVE
              PduRDestPduRoutingType = API_FORWARDING
              PduRDestPduDataProcessing = IMMEDIATE
              PduRPduLengthHandlingStrategy = IGNORE
              PduRDestPduCrossPartitionDestination = false
              PduRTransmissionConfirmation = false
              PduRDestPduRef = BRAKE_FD_4_oFDCAN2_1f938324_Rx
              PduRDestPduPduRBswModulesRef = Com
            PduRSrcPdu_8bfd03c9 (PduRSrcPdu): PduRSourcePduHandleId=21, PduRSrcPduDirection=RECEIVE, PduRSrcPduRef=BRAKE_FD_4_oFDCAN2_86ae4855_Rx, PduRSrcPduPduRBswModulesRef=CanIf
          DRIVETRAIN_FD_3_oFDCAN2_a178c37e_Rx: PduRRoutingPathCommunicationType=COMMUNICATION_INTERFACE
            PduRSrcPdu_ded4397c (PduRSrcPdu): PduRSourcePduHandleId=28, PduRSrcPduDirection=RECEIVE, PduRSrcPduRef=DRIVETRAIN_FD_3_oFDCAN2_a178c37e_Rx, PduRSrcPduPduRBswModulesRef=CanIf
            DRIVETRAIN_FD_3_oFDCAN2_a178c37e_Rx_ded4397c_Rx (PduRDestPdu):
              PduRDestPduHandleId = 28
              PduRDestPduDirection = RECEIVE
              PduRDestPduRoutingType = API_FORWARDING
              PduRDestPduDataProcessing = IMMEDIATE
              PduRPduLengthHandlingStrategy = IGNORE
              PduRDestPduCrossPartitionDestination = false
              PduRTransmissionConfirmation = false
              PduRDestPduRef = DRIVETRAIN_FD_3_oFDCAN2_8dcee934_Rx
              PduRDestPduPduRBswModulesRef = Com
          EPS_FD_1_oFDCAN2_8187a19a_Rx: PduRRoutingPathCommunicationType=COMMUNICATION_INTERFACE
            PduRSrcPdu_da0c1a40 (PduRSrcPdu): PduRSourcePduHandleId=35, PduRSrcPduDirection=RECEIVE, PduRSrcPduRef=EPS_FD_1_oFDCAN2_8187a19a_Rx, PduRSrcPduPduRBswModulesRef=CanIf
            EPS_FD_1_oFDCAN2_8187a19a_Rx_da0c1a40_Rx (PduRDestPdu):
              PduRDestPduHandleId = 35
              PduRDestPduDirection = RECEIVE
              PduRDestPduRoutingType = API_FORWARDING
              PduRDestPduDataProcessing = IMMEDIATE
              PduRPduLengthHandlingStrategy = IGNORE
              PduRDestPduCrossPartitionDestination = false
              PduRTransmissionConfirmation = false
              PduRDestPduRef = EPS_FD_1_oFDCAN2_cf989270_Rx
              PduRDestPduPduRBswModulesRef = Com
          BRAKE_FD_3_oFDCAN2_48feb4fd_Rx: PduRRoutingPathCommunicationType=COMMUNICATION_INTERFACE
            BRAKE_FD_3_oFDCAN2_48feb4fd_Rx_a96d8b06_Rx (PduRDestPdu):
              PduRDestPduHandleId = 19
              PduRDestPduDirection = RECEIVE
              PduRDestPduRoutingType = API_FORWARDING
              PduRDestPduDataProcessing = IMMEDIATE
              PduRPduLengthHandlingStrategy = IGNORE
              PduRDestPduCrossPartitionDestination = false
              PduRTransmissionConfirmation = false
              PduRDestPduRef = BRAKE_FD_3_oFDCAN2_7bf2eeed_Rx
              PduRDestPduPduRBswModulesRef = Com
            PduRSrcPdu_a96d8b06 (PduRSrcPdu): PduRSourcePduHandleId=19, PduRSrcPduDirection=RECEIVE, PduRSrcPduRef=BRAKE_FD_3_oFDCAN2_48feb4fd_Rx, PduRSrcPduPduRBswModulesRef=CanIf
          PDC_INFO_FD_TRLR_REV_oFDCAN2_e488d728_Rx: PduRRoutingPathCommunicationType=COMMUNICATION_INTERFACE
            PduRSrcPdu_62f2c61a (PduRSrcPdu): PduRSourcePduHandleId=50, PduRSrcPduDirection=RECEIVE, PduRSrcPduRef=PDC_INFO_FD_TRLR_REV_oFDCAN2_e488d728_Rx, PduRSrcPduPduRBswModulesRef=CanIf
            PDC_INFO_FD_TRLR_REV_oFDCAN2_e488d728_Rx_62f2c61a_Rx (PduRDestPdu):
              PduRDestPduHandleId = 50
              PduRDestPduDirection = RECEIVE
              PduRDestPduRoutingType = API_FORWARDING
              PduRDestPduDataProcessing = IMMEDIATE
              PduRPduLengthHandlingStrategy = IGNORE
              PduRDestPduCrossPartitionDestination = false
              PduRTransmissionConfirmation = false
              PduRDestPduRef = PDC_INFO_FD_TRLR_REV_oFDCAN2_2234319b_Rx
              PduRDestPduPduRBswModulesRef = Com
          BCM_FD_7_oFDCAN2_6e4703f9_Rx: PduRRoutingPathCommunicationType=COMMUNICATION_INTERFACE
            BCM_FD_7_oFDCAN2_6e4703f9_Rx_7d500349_Rx (PduRDestPdu):
              PduRDestPduHandleId = 7
              PduRDestPduDirection = RECEIVE
              PduRDestPduRoutingType = API_FORWARDING
              PduRDestPduDataProcessing = IMMEDIATE
              PduRPduLengthHandlingStrategy = IGNORE
              PduRDestPduCrossPartitionDestination = false
              PduRTransmissionConfirmation = false
              PduRDestPduRef = BCM_FD_7_oFDCAN2_b94d8f55_Rx
              PduRDestPduPduRBswModulesRef = Com
            PduRSrcPdu_7d500349 (PduRSrcPdu): PduRSourcePduHandleId=7, PduRSrcPduDirection=RECEIVE, PduRSrcPduRef=BCM_FD_7_oFDCAN2_6e4703f9_Rx, PduRSrcPduPduRBswModulesRef=CanIf
          BCM_FD_12_oFDCAN2_41ba01f0_Rx: PduRRoutingPathCommunicationType=COMMUNICATION_INTERFACE
            BCM_FD_12_oFDCAN2_41ba01f0_Rx_9203d069_Rx (PduRDestPdu):
              PduRDestPduHandleId = 10
              PduRDestPduDirection = RECEIVE
              PduRDestPduRoutingType = API_FORWARDING
              PduRDestPduDataProcessing = IMMEDIATE
              PduRPduLengthHandlingStrategy = IGNORE
              PduRDestPduCrossPartitionDestination = false
              PduRTransmissionConfirmation = false
              PduRDestPduRef = BCM_FD_12_oFDCAN2_a380ab28_Rx
              PduRDestPduPduRBswModulesRef = Com
            PduRSrcPdu_9203d069 (PduRSrcPdu): PduRSourcePduHandleId=10, PduRSrcPduDirection=RECEIVE, PduRSrcPduRef=BCM_FD_12_oFDCAN2_41ba01f0_Rx, PduRSrcPduPduRBswModulesRef=CanIf
          DIAGNOSTIC_REQUEST_FD_FUNCTIONAL_oFDCAN2_20_73727a47_Rx: PduRRoutingPathCommunicationType=TRANSPORT_PROTOCOL
            PduRSrcPdu_d1f51245 (PduRSrcPdu):
              PduRSourcePduHandleId = 0
              PduRSrcPduDirection = RECEIVE
              PduRSrcPduRef = DIAGNOSTIC_REQUEST_FD_FUNCTIONAL_oFDCAN2_20_73727a47_Rx
              PduRSrcPduPduRBswModulesRef = CanTp
            DIAGNOSTIC_REQUEST_FD_FUNCTIONAL_oFDCAN2_20_73727a47_Rx_d1f51245_Rx (PduRDestPdu):
              PduRDestPduHandleId = 0
              PduRDestPduDirection = RECEIVE
              PduRDestPduRoutingType = API_FORWARDING
              PduRDestPduDataProcessing = IMMEDIATE
              PduRPduLengthHandlingStrategy = UNUSED
              PduRDestPduCrossPartitionDestination = false
              PduRDestPduRef = DIAGNOSTIC_REQUEST_FD_FUNCTIONAL_oFDCAN2_20_4dd8a3fb_Rx
              PduRDestPduPduRBswModulesRef = Dcm
          TELEMATIC_FD_5_oFDCAN2_39a02182_Rx: PduRRoutingPathCommunicationType=COMMUNICATION_INTERFACE
            PduRSrcPdu_9ce57069 (PduRSrcPdu): PduRSourcePduHandleId=54, PduRSrcPduDirection=RECEIVE, PduRSrcPduRef=TELEMATIC_FD_5_oFDCAN2_39a02182_Rx, PduRSrcPduPduRBswModulesRef=CanIf
            TELEMATIC_FD_5_oFDCAN2_39a02182_Rx_9ce57069_Rx (PduRDestPdu):
              PduRDestPduHandleId = 54
              PduRDestPduDirection = RECEIVE
              PduRDestPduRoutingType = API_FORWARDING
              PduRDestPduDataProcessing = IMMEDIATE
              PduRPduLengthHandlingStrategy = IGNORE
              PduRDestPduCrossPartitionDestination = false
              PduRTransmissionConfirmation = false
              PduRDestPduRef = TELEMATIC_FD_5_oFDCAN2_e0161ca6_Rx
              PduRDestPduPduRBswModulesRef = Com
          DIAGNOSTIC_REQUEST_FD_PAM_oFDCAN2_aee787f0_Rx: PduRRoutingPathCommunicationType=TRANSPORT_PROTOCOL
            DIAGNOSTIC_REQUEST_FD_PAM_oFDCAN2_aee787f0_Rx_e393916e_Rx (PduRDestPdu):
              PduRDestPduHandleId = 3
              PduRDestPduDirection = RECEIVE
              PduRDestPduRoutingType = API_FORWARDING
              PduRDestPduDataProcessing = IMMEDIATE
              PduRPduLengthHandlingStrategy = UNUSED
              PduRDestPduCrossPartitionDestination = false
              PduRDestPduRef = DIAGNOSTIC_REQUEST_FD_PAM_oFDCAN2_df0385a5_Rx
              PduRDestPduPduRBswModulesRef = Dcm
            PduRSrcPdu_e393916e (PduRSrcPdu):
              PduRSourcePduHandleId = 3
              PduRSrcPduDirection = RECEIVE
              PduRSrcPduRef = DIAGNOSTIC_REQUEST_FD_PAM_oFDCAN2_aee787f0_Rx
              PduRSrcPduPduRBswModulesRef = CanTp
          BRAKE_FD_1_oFDCAN2_d89892a0_Rx: PduRRoutingPathCommunicationType=COMMUNICATION_INTERFACE
            PduRSrcPdu_571b255a (PduRSrcPdu): PduRSourcePduHandleId=15, PduRSrcPduDirection=RECEIVE, PduRSrcPduRef=BRAKE_FD_1_oFDCAN2_d89892a0_Rx, PduRSrcPduPduRBswModulesRef=CanIf
            BRAKE_FD_1_oFDCAN2_d89892a0_Rx_571b255a_Rx (PduRDestPdu):
              PduRDestPduHandleId = 15
              PduRDestPduDirection = RECEIVE
              PduRDestPduRoutingType = API_FORWARDING
              PduRDestPduDataProcessing = IMMEDIATE
              PduRPduLengthHandlingStrategy = IGNORE
              PduRDestPduCrossPartitionDestination = false
              PduRTransmissionConfirmation = false
              PduRDestPduRef = BRAKE_FD_1_oFDCAN2_5504c66b_Rx
              PduRDestPduPduRBswModulesRef = Com
          TRANSM_FD_4_oFDCAN2_8222be40_Rx: PduRRoutingPathCommunicationType=COMMUNICATION_INTERFACE
            TRANSM_FD_4_oFDCAN2_8222be40_Rx_3f93ac02_Rx (PduRDestPdu):
              PduRDestPduHandleId = 59
              PduRDestPduDirection = RECEIVE
              PduRDestPduRoutingType = API_FORWARDING
              PduRDestPduDataProcessing = IMMEDIATE
              PduRPduLengthHandlingStrategy = IGNORE
              PduRDestPduCrossPartitionDestination = false
              PduRTransmissionConfirmation = false
              PduRDestPduRef = TRANSM_FD_4_oFDCAN2_94daed95_Rx
              PduRDestPduPduRBswModulesRef = Com
            PduRSrcPdu_3f93ac02 (PduRSrcPdu): PduRSourcePduHandleId=59, PduRSrcPduDirection=RECEIVE, PduRSrcPduRef=TRANSM_FD_4_oFDCAN2_8222be40_Rx, PduRSrcPduPduRBswModulesRef=CanIf
          VIN_oFDCAN2_664087b5_Rx: PduRRoutingPathCommunicationType=COMMUNICATION_INTERFACE
            PduRSrcPdu_b7bdbd30 (PduRSrcPdu): PduRSourcePduHandleId=61, PduRSrcPduDirection=RECEIVE, PduRSrcPduRef=VIN_oFDCAN2_664087b5_Rx, PduRSrcPduPduRBswModulesRef=CanIf
            VIN_oFDCAN2_664087b5_Rx_b7bdbd30_Rx (PduRDestPdu):
              PduRDestPduHandleId = 61
              PduRDestPduDirection = RECEIVE
              PduRDestPduRoutingType = API_FORWARDING
              PduRDestPduDataProcessing = IMMEDIATE
              PduRPduLengthHandlingStrategy = IGNORE
              PduRDestPduCrossPartitionDestination = false
              PduRTransmissionConfirmation = false
              PduRDestPduRef = VIN_oFDCAN2_e2480108_Rx
              PduRDestPduPduRBswModulesRef = Com
          ENGINE_FD_2_oFDCAN2_bbb4bd5c_Rx: PduRRoutingPathCommunicationType=COMMUNICATION_INTERFACE
            ENGINE_FD_2_oFDCAN2_bbb4bd5c_Rx_7be870cb_Rx (PduRDestPdu):
              PduRDestPduHandleId = 29
              PduRDestPduDirection = RECEIVE
              PduRDestPduRoutingType = API_FORWARDING
              PduRDestPduDataProcessing = IMMEDIATE
              PduRPduLengthHandlingStrategy = IGNORE
              PduRDestPduCrossPartitionDestination = false
              PduRTransmissionConfirmation = false
              PduRDestPduRef = ENGINE_FD_2_oFDCAN2_c0c2b657_Rx
              PduRDestPduPduRBswModulesRef = Com
            PduRSrcPdu_7be870cb (PduRSrcPdu): PduRSourcePduHandleId=29, PduRSrcPduDirection=RECEIVE, PduRSrcPduRef=ENGINE_FD_2_oFDCAN2_bbb4bd5c_Rx, PduRSrcPduPduRBswModulesRef=CanIf
          PDC_INFO_FD_ADCM_oFDCAN2_b5d3e253_Rx: PduRRoutingPathCommunicationType=COMMUNICATION_INTERFACE
            PDC_INFO_FD_ADCM_oFDCAN2_b5d3e253_Rx_8a512cba_Rx (PduRDestPdu):
              PduRDestPduHandleId = 43
              PduRDestPduDirection = RECEIVE
              PduRDestPduRoutingType = API_FORWARDING
              PduRDestPduDataProcessing = IMMEDIATE
              PduRPduLengthHandlingStrategy = IGNORE
              PduRDestPduCrossPartitionDestination = false
              PduRTransmissionConfirmation = false
              PduRDestPduRef = PDC_INFO_FD_ADCM_oFDCAN2_36bf9aab_Rx
              PduRDestPduPduRBswModulesRef = Com
            PduRSrcPdu_8a512cba (PduRSrcPdu): PduRSourcePduHandleId=43, PduRSrcPduDirection=RECEIVE, PduRSrcPduRef=PDC_INFO_FD_ADCM_oFDCAN2_b5d3e253_Rx, PduRSrcPduPduRBswModulesRef=CanIf
          PDC_INFO_FD_BCM_oFDCAN2_d0394486_Rx: PduRRoutingPathCommunicationType=COMMUNICATION_INTERFACE
            PduRSrcPdu_7ea80a52 (PduRSrcPdu): PduRSourcePduHandleId=44, PduRSrcPduDirection=RECEIVE, PduRSrcPduRef=PDC_INFO_FD_BCM_oFDCAN2_d0394486_Rx, PduRSrcPduPduRBswModulesRef=CanIf
            PDC_INFO_FD_BCM_oFDCAN2_d0394486_Rx_7ea80a52_Rx (PduRDestPdu):
              PduRDestPduHandleId = 44
              PduRDestPduDirection = RECEIVE
              PduRDestPduRoutingType = API_FORWARDING
              PduRDestPduDataProcessing = IMMEDIATE
              PduRPduLengthHandlingStrategy = IGNORE
              PduRDestPduCrossPartitionDestination = false
              PduRTransmissionConfirmation = false
              PduRDestPduRef = PDC_INFO_FD_BCM_oFDCAN2_8ca0d2c1_Rx
              PduRDestPduPduRBswModulesRef = Com
          ASCM_FD_2_oFDCAN2_18540c4a_Rx: PduRRoutingPathCommunicationType=COMMUNICATION_INTERFACE
            ASCM_FD_2_oFDCAN2_18540c4a_Rx_ede52381_Rx (PduRDestPdu):
              PduRDestPduHandleId = 4
              PduRDestPduDirection = RECEIVE
              PduRDestPduRoutingType = API_FORWARDING
              PduRDestPduDataProcessing = IMMEDIATE
              PduRPduLengthHandlingStrategy = IGNORE
              PduRDestPduCrossPartitionDestination = false
              PduRTransmissionConfirmation = false
              PduRDestPduRef = ASCM_FD_2_oFDCAN2_e1c26b67_Rx
              PduRDestPduPduRBswModulesRef = Com
            PduRSrcPdu_ede52381 (PduRSrcPdu): PduRSourcePduHandleId=4, PduRSrcPduDirection=RECEIVE, PduRSrcPduRef=ASCM_FD_2_oFDCAN2_18540c4a_Rx, PduRSrcPduPduRBswModulesRef=CanIf
          DIAGNOSTIC_RESPONSE_FD_PAM_oFDCAN2_20_4032c583_Tx: PduRRoutingPathCommunicationType=TRANSPORT_PROTOCOL
            DIAGNOSTIC_RESPONSE_FD_PAM_oFDCAN2_20_25761d2e_Tx (PduRDestPdu):
              PduRDestPduHandleId = 0
              PduRDestPduDirection = TRANSMIT
              PduRDestPduRoutingType = API_FORWARDING
              PduRDestPduDataProcessing = IMMEDIATE
              PduRPduLengthHandlingStrategy = UNUSED
              PduRDestPduCrossPartitionDestination = false
              PduRDestPduRef = DIAGNOSTIC_RESPONSE_FD_PAM_oFDCAN2_20_25761d2e_Tx
              PduRDestPduPduRBswModulesRef = CanTp
            PduRSrcPdu_042e3f8c (PduRSrcPdu):
              PduRSourcePduHandleId = 10
              PduRSrcPduDirection = TRANSMIT
              PduRSrcPduRef = DIAGNOSTIC_RESPONSE_FD_PAM_oFDCAN2_20_4032c583_Tx
              PduRSrcPduPduRBswModulesRef = Dcm
          BRAKE2_FD_1_oFDCAN2_13e6bf8d_Rx: PduRRoutingPathCommunicationType=COMMUNICATION_INTERFACE
            PduRSrcPdu_f29b81fe (PduRSrcPdu): PduRSourcePduHandleId=13, PduRSrcPduDirection=RECEIVE, PduRSrcPduRef=BRAKE2_FD_1_oFDCAN2_13e6bf8d_Rx, PduRSrcPduPduRBswModulesRef=CanIf
            BRAKE2_FD_1_oFDCAN2_13e6bf8d_Rx_f29b81fe_Rx (PduRDestPdu):
              PduRDestPduHandleId = 13
              PduRDestPduDirection = RECEIVE
              PduRDestPduRoutingType = API_FORWARDING
              PduRDestPduDataProcessing = IMMEDIATE
              PduRPduLengthHandlingStrategy = IGNORE
              PduRDestPduCrossPartitionDestination = false
              PduRTransmissionConfirmation = false
              PduRDestPduRef = BRAKE2_FD_1_oFDCAN2_f0e909db_Rx
              PduRDestPduPduRBswModulesRef = Com
          BCM_FD_10_oFDCAN2_d1dc27ad_Rx: PduRRoutingPathCommunicationType=COMMUNICATION_INTERFACE
            BCM_FD_10_oFDCAN2_d1dc27ad_Rx_88cfc416_Rx (PduRDestPdu):
              PduRDestPduHandleId = 9
              PduRDestPduDirection = RECEIVE
              PduRDestPduRoutingType = API_FORWARDING
              PduRDestPduDataProcessing = IMMEDIATE
              PduRPduLengthHandlingStrategy = IGNORE
              PduRDestPduCrossPartitionDestination = false
              PduRTransmissionConfirmation = false
              PduRDestPduRef = BCM_FD_10_oFDCAN2_8d7683ae_Rx
              PduRDestPduPduRBswModulesRef = Com
            PduRSrcPdu_88cfc416 (PduRSrcPdu): PduRSourcePduHandleId=9, PduRSrcPduDirection=RECEIVE, PduRSrcPduRef=BCM_FD_10_oFDCAN2_d1dc27ad_Rx, PduRSrcPduPduRBswModulesRef=CanIf
          BRAKE_FD_5_oFDCAN2_2325d85b_Rx: PduRRoutingPathCommunicationType=COMMUNICATION_INTERFACE
            PduRSrcPdu_7b57434e (PduRSrcPdu): PduRSourcePduHandleId=23, PduRSrcPduDirection=RECEIVE, PduRSrcPduRef=BRAKE_FD_5_oFDCAN2_2325d85b_Rx, PduRSrcPduPduRBswModulesRef=CanIf
            BRAKE_FD_5_oFDCAN2_2325d85b_Rx_7b57434e_Rx (PduRDestPdu):
              PduRDestPduHandleId = 23
              PduRDestPduDirection = RECEIVE
              PduRDestPduRoutingType = API_FORWARDING
              PduRDestPduDataProcessing = IMMEDIATE
              PduRPduLengthHandlingStrategy = IGNORE
              PduRDestPduCrossPartitionDestination = false
              PduRTransmissionConfirmation = false
              PduRDestPduRef = BRAKE_FD_5_oFDCAN2_08e89767_Rx
              PduRDestPduPduRBswModulesRef = Com
          ENGINE_FD_5_oFDCAN2_75e441f4_Rx: PduRRoutingPathCommunicationType=COMMUNICATION_INTERFACE
            ENGINE_FD_5_oFDCAN2_75e441f4_Rx_1160b0c4_Rx (PduRDestPdu):
              PduRDestPduHandleId = 31
              PduRDestPduDirection = RECEIVE
              PduRDestPduRoutingType = API_FORWARDING
              PduRDestPduDataProcessing = IMMEDIATE
              PduRPduLengthHandlingStrategy = IGNORE
              PduRDestPduCrossPartitionDestination = false
              PduRTransmissionConfirmation = false
              PduRDestPduRef = ENGINE_FD_5_oFDCAN2_a4a3db9e_Rx
              PduRDestPduPduRBswModulesRef = Com
            PduRSrcPdu_1160b0c4 (PduRSrcPdu): PduRSourcePduHandleId=31, PduRSrcPduDirection=RECEIVE, PduRSrcPduRef=ENGINE_FD_5_oFDCAN2_75e441f4_Rx, PduRSrcPduPduRBswModulesRef=CanIf
          DIAGNOSTIC_REQUEST_FD_FUNCTIONAL_oFDCAN2_56e1939c_Rx: PduRRoutingPathCommunicationType=TRANSPORT_PROTOCOL
            PduRSrcPdu_74e62a6c (PduRSrcPdu):
              PduRSourcePduHandleId = 1
              PduRSrcPduDirection = RECEIVE
              PduRSrcPduRef = DIAGNOSTIC_REQUEST_FD_FUNCTIONAL_oFDCAN2_56e1939c_Rx
              PduRSrcPduPduRBswModulesRef = CanTp
            DIAGNOSTIC_REQUEST_FD_FUNCTIONAL_oFDCAN2_56e1939c_Rx_74e62a6c_Rx (PduRDestPdu):
              PduRDestPduHandleId = 1
              PduRDestPduDirection = RECEIVE
              PduRDestPduRoutingType = API_FORWARDING
              PduRDestPduDataProcessing = IMMEDIATE
              PduRPduLengthHandlingStrategy = UNUSED
              PduRDestPduCrossPartitionDestination = false
              PduRDestPduRef = DIAGNOSTIC_REQUEST_FD_FUNCTIONAL_oFDCAN2_d8147fe7_Rx
              PduRDestPduPduRBswModulesRef = Dcm
          PDC_INFO_FD_CADM2_oFDCAN2_5b04fff1_Rx: PduRRoutingPathCommunicationType=COMMUNICATION_INTERFACE
            PDC_INFO_FD_CADM2_oFDCAN2_5b04fff1_Rx_29906768_Rx (PduRDestPdu):
              PduRDestPduHandleId = 46
              PduRDestPduDirection = RECEIVE
              PduRDestPduRoutingType = API_FORWARDING
              PduRDestPduDataProcessing = IMMEDIATE
              PduRPduLengthHandlingStrategy = IGNORE
              PduRDestPduCrossPartitionDestination = false
              PduRTransmissionConfirmation = false
              PduRDestPduRef = PDC_INFO_FD_CADM2_oFDCAN2_25d021b9_Rx
              PduRDestPduPduRBswModulesRef = Com
            PduRSrcPdu_29906768 (PduRSrcPdu): PduRSourcePduHandleId=46, PduRSrcPduDirection=RECEIVE, PduRSrcPduRef=PDC_INFO_FD_CADM2_oFDCAN2_5b04fff1_Rx, PduRSrcPduPduRBswModulesRef=CanIf
          PDC_INFO_FD_PAM_oFDCAN2_7ecf7ff6_Tx: PduRRoutingPathCommunicationType=COMMUNICATION_INTERFACE
            PduRSrcPdu_5dfea50f (PduRSrcPdu): PduRSourcePduHandleId=98, PduRSrcPduDirection=TRANSMIT, PduRSrcPduRef=PDC_INFO_FD_PAM_oFDCAN2_7ecf7ff6_Tx, PduRSrcPduPduRBswModulesRef=Com
            PDC_INFO_FD_PAM_oFDCAN2_461f923e_Tx (PduRDestPdu):
              PduRDestPduHandleId = 95
              PduRDestPduDirection = TRANSMIT
              PduRDestPduRoutingType = API_FORWARDING
              PduRDestPduDataProcessing = IMMEDIATE
              PduRPduLengthHandlingStrategy = IGNORE
              PduRDestPduCrossPartitionDestination = false
              PduRDestPduDataProvision = PDUR_DIRECT
              PduRTransmissionConfirmation = true
              PduRDestPduRef = PDC_INFO_FD_PAM_oFDCAN2_461f923e_Tx
              PduRDestPduPduRBswModulesRef = CanIf
          TRANSM_FD_1_oFDCAN2_dc1464b5_Rx: PduRRoutingPathCommunicationType=COMMUNICATION_INTERFACE
            PduRSrcPdu_f9e5605f (PduRSrcPdu): PduRSourcePduHandleId=57, PduRSrcPduDirection=RECEIVE, PduRSrcPduRef=TRANSM_FD_1_oFDCAN2_dc1464b5_Rx, PduRSrcPduPduRBswModulesRef=CanIf
            TRANSM_FD_1_oFDCAN2_dc1464b5_Rx_f9e5605f_Rx (PduRDestPdu):
              PduRDestPduHandleId = 57
              PduRDestPduDirection = RECEIVE
              PduRDestPduRoutingType = API_FORWARDING
              PduRDestPduDataProcessing = IMMEDIATE
              PduRPduLengthHandlingStrategy = IGNORE
              PduRDestPduCrossPartitionDestination = false
              PduRTransmissionConfirmation = false
              PduRDestPduRef = TRANSM_FD_1_oFDCAN2_de4da8da_Rx
              PduRDestPduPduRBswModulesRef = Com
          DIAGNOSTIC_RESPONSE_PAM_oFDCAN2_5ac3c1c1_Tx: PduRRoutingPathCommunicationType=TRANSPORT_PROTOCOL
            DIAGNOSTIC_RESPONSE_PAM_oFDCAN2_7c9fd6f9_Tx (PduRDestPdu):
              PduRDestPduHandleId = 2
              PduRDestPduDirection = TRANSMIT
              PduRDestPduRoutingType = API_FORWARDING
              PduRDestPduDataProcessing = IMMEDIATE
              PduRPduLengthHandlingStrategy = UNUSED
              PduRDestPduCrossPartitionDestination = false
              PduRDestPduRef = DIAGNOSTIC_RESPONSE_PAM_oFDCAN2_7c9fd6f9_Tx
              PduRDestPduPduRBswModulesRef = CanTp
            PduRSrcPdu_8b616172 (PduRSrcPdu): PduRSourcePduHandleId=12, PduRSrcPduDirection=TRANSMIT, PduRSrcPduRef=DIAGNOSTIC_RESPONSE_PAM_oFDCAN2_5ac3c1c1_Tx, PduRSrcPduPduRBswModulesRef=Dcm
          CVPAM_FD_Info_oFDCAN2_a36629be_Tx: PduRRoutingPathCommunicationType=COMMUNICATION_INTERFACE
            PduRSrcPdu_9da562d1 (PduRSrcPdu): PduRSourcePduHandleId=8, PduRSrcPduDirection=TRANSMIT, PduRSrcPduRef=CVPAM_FD_Info_oFDCAN2_a36629be_Tx, PduRSrcPduPduRBswModulesRef=Com
            CVPAM_FD_Info_oFDCAN2_b99cd129_Tx (PduRDestPdu):
              PduRDestPduHandleId = 8
              PduRDestPduDirection = TRANSMIT
              PduRDestPduRoutingType = API_FORWARDING
              PduRDestPduDataProcessing = IMMEDIATE
              PduRPduLengthHandlingStrategy = IGNORE
              PduRDestPduCrossPartitionDestination = false
              PduRDestPduDataProvision = PDUR_DIRECT
              PduRTransmissionConfirmation = false
              PduRDestPduRef = CVPAM_FD_Info_oFDCAN2_b99cd129_Tx
              PduRDestPduPduRBswModulesRef = CanIf
          TRSCM_FD_1_oFDCAN2_e88cefba_Tx: PduRRoutingPathCommunicationType=COMMUNICATION_INTERFACE
            PduRSrcPdu_eeb2db14 (PduRSrcPdu): PduRSourcePduHandleId=107, PduRSrcPduDirection=TRANSMIT, PduRSrcPduRef=TRSCM_FD_1_oFDCAN2_e88cefba_Tx, PduRSrcPduPduRBswModulesRef=Com
            TRSCM_FD_1_oFDCAN2_4cf656c2_Tx (PduRDestPdu):
              PduRDestPduHandleId = 104
              PduRDestPduDirection = TRANSMIT
              PduRDestPduRoutingType = API_FORWARDING
              PduRDestPduDataProcessing = IMMEDIATE
              PduRPduLengthHandlingStrategy = IGNORE
              PduRDestPduCrossPartitionDestination = false
              PduRDestPduDataProvision = PDUR_DIRECT
              PduRTransmissionConfirmation = true
              PduRDestPduRef = TRSCM_FD_1_oFDCAN2_4cf656c2_Tx
              PduRDestPduPduRBswModulesRef = CanIf
          BRAKE_FD_2_oFDCAN2_ed7524f3_Rx: PduRRoutingPathCommunicationType=COMMUNICATION_INTERFACE
            BRAKE_FD_2_oFDCAN2_ed7524f3_Rx_69af14e5_Rx (PduRDestPdu):
              PduRDestPduHandleId = 17
              PduRDestPduDirection = RECEIVE
              PduRDestPduRoutingType = API_FORWARDING
              PduRDestPduDataProcessing = IMMEDIATE
              PduRPduLengthHandlingStrategy = IGNORE
              PduRDestPduCrossPartitionDestination = false
              PduRTransmissionConfirmation = false
              PduRDestPduRef = BRAKE_FD_2_oFDCAN2_6c89faae_Rx
              PduRDestPduPduRBswModulesRef = Com
            PduRSrcPdu_69af14e5 (PduRSrcPdu): PduRSourcePduHandleId=17, PduRSrcPduDirection=RECEIVE, PduRSrcPduRef=BRAKE_FD_2_oFDCAN2_ed7524f3_Rx, PduRSrcPduPduRBswModulesRef=CanIf
          EPS_FD_2_oFDCAN2_b46a17c9_Rx: PduRRoutingPathCommunicationType=COMMUNICATION_INTERFACE
            PduRSrcPdu_0f370d19 (PduRSrcPdu): PduRSourcePduHandleId=37, PduRSrcPduDirection=RECEIVE, PduRSrcPduRef=EPS_FD_2_oFDCAN2_b46a17c9_Rx, PduRSrcPduPduRBswModulesRef=CanIf
            EPS_FD_2_oFDCAN2_b46a17c9_Rx_0f370d19_Rx (PduRDestPdu):
              PduRDestPduHandleId = 37
              PduRDestPduDirection = RECEIVE
              PduRDestPduRoutingType = API_FORWARDING
              PduRDestPduDataProcessing = IMMEDIATE
              PduRPduLengthHandlingStrategy = IGNORE
              PduRDestPduCrossPartitionDestination = false
              PduRTransmissionConfirmation = false
              PduRDestPduRef = EPS_FD_2_oFDCAN2_f615aeb5_Rx
              PduRDestPduPduRBswModulesRef = Com
          DIAGNOSTIC_ROE_PAM_oFDCAN2_f10c61f5_Tx: PduRRoutingPathCommunicationType=COMMUNICATION_INTERFACE
            DIAGNOSTIC_ROE_PAM_oFDCAN2_ff776c1c_Tx (PduRDestPdu):
              PduRDestPduHandleId = 11
              PduRDestPduDirection = TRANSMIT
              PduRDestPduRoutingType = API_FORWARDING
              PduRDestPduDataProcessing = IMMEDIATE
              PduRPduLengthHandlingStrategy = IGNORE
              PduRDestPduCrossPartitionDestination = false
              PduRDestPduDataProvision = PDUR_DIRECT
              PduRTransmissionConfirmation = false
              PduRDestPduRef = DIAGNOSTIC_ROE_PAM_oFDCAN2_ff776c1c_Tx
              PduRDestPduPduRBswModulesRef = CanIf
            PduRSrcPdu_135671e0 (PduRSrcPdu): PduRSourcePduHandleId=14, PduRSrcPduDirection=TRANSMIT, PduRSrcPduRef=DIAGNOSTIC_ROE_PAM_oFDCAN2_f10c61f5_Tx, PduRSrcPduPduRBswModulesRef=Com
          IPC_FD_1_oFDCAN2_63f5b3e6_Rx: PduRRoutingPathCommunicationType=COMMUNICATION_INTERFACE
            IPC_FD_1_oFDCAN2_63f5b3e6_Rx_02099541_Rx (PduRDestPdu):
              PduRDestPduHandleId = 40
              PduRDestPduDirection = RECEIVE
              PduRDestPduRoutingType = API_FORWARDING
              PduRDestPduDataProcessing = IMMEDIATE
              PduRPduLengthHandlingStrategy = IGNORE
              PduRDestPduCrossPartitionDestination = false
              PduRTransmissionConfirmation = false
              PduRDestPduRef = IPC_FD_1_oFDCAN2_0e087dd4_Rx
              PduRDestPduPduRBswModulesRef = Com
            PduRSrcPdu_02099541 (PduRSrcPdu): PduRSourcePduHandleId=40, PduRSrcPduDirection=RECEIVE, PduRSrcPduRef=IPC_FD_1_oFDCAN2_63f5b3e6_Rx, PduRSrcPduPduRBswModulesRef=CanIf
          ORC_FD_1_oFDCAN2_3775757b_Rx: PduRRoutingPathCommunicationType=COMMUNICATION_INTERFACE
            ORC_FD_1_oFDCAN2_3775757b_Rx_6630d5d3_Rx (PduRDestPdu):
              PduRDestPduHandleId = 42
              PduRDestPduDirection = RECEIVE
              PduRDestPduRoutingType = API_FORWARDING
              PduRDestPduDataProcessing = IMMEDIATE
              PduRPduLengthHandlingStrategy = IGNORE
              PduRDestPduCrossPartitionDestination = false
              PduRTransmissionConfirmation = false
              PduRDestPduRef = ORC_FD_1_oFDCAN2_f51fa5a1_Rx
              PduRDestPduPduRBswModulesRef = Com
            PduRSrcPdu_6630d5d3 (PduRSrcPdu): PduRSourcePduHandleId=42, PduRSrcPduDirection=RECEIVE, PduRSrcPduRef=ORC_FD_1_oFDCAN2_3775757b_Rx, PduRSrcPduPduRBswModulesRef=CanIf
          PDC_INFO_FD_BSM2_oFDCAN2_e01465fe_Rx: PduRRoutingPathCommunicationType=COMMUNICATION_INTERFACE
            PduRSrcPdu_6911e70b (PduRSrcPdu): PduRSourcePduHandleId=45, PduRSrcPduDirection=RECEIVE, PduRSrcPduRef=PDC_INFO_FD_BSM2_oFDCAN2_e01465fe_Rx, PduRSrcPduPduRBswModulesRef=CanIf
            PDC_INFO_FD_BSM2_oFDCAN2_e01465fe_Rx_6911e70b_Rx (PduRDestPdu):
              PduRDestPduHandleId = 45
              PduRDestPduDirection = RECEIVE
              PduRDestPduRoutingType = API_FORWARDING
              PduRDestPduDataProcessing = IMMEDIATE
              PduRPduLengthHandlingStrategy = IGNORE
              PduRDestPduCrossPartitionDestination = false
              PduRTransmissionConfirmation = false
              PduRDestPduRef = PDC_INFO_FD_BSM2_oFDCAN2_f73fa5a4_Rx
              PduRDestPduPduRBswModulesRef = Com
          TELEMATIC_FD_11_oFDCAN2_a69db35a_Rx: PduRRoutingPathCommunicationType=COMMUNICATION_INTERFACE
            TELEMATIC_FD_11_oFDCAN2_a69db35a_Rx_1f2567dc_Rx (PduRDestPdu):
              PduRDestPduHandleId = 55
              PduRDestPduDirection = RECEIVE
              PduRDestPduRoutingType = API_FORWARDING
              PduRDestPduDataProcessing = IMMEDIATE
              PduRPduLengthHandlingStrategy = IGNORE
              PduRDestPduCrossPartitionDestination = false
              PduRTransmissionConfirmation = false
              PduRDestPduRef = TELEMATIC_FD_11_oFDCAN2_ba15bfe5_Rx
              PduRDestPduPduRBswModulesRef = Com
            PduRSrcPdu_1f2567dc (PduRSrcPdu): PduRSourcePduHandleId=55, PduRSrcPduDirection=RECEIVE, PduRSrcPduRef=TELEMATIC_FD_11_oFDCAN2_a69db35a_Rx, PduRSrcPduPduRBswModulesRef=CanIf
          TRANSM_FD_2_oFDCAN2_e9f9d2e6_Rx: PduRRoutingPathCommunicationType=COMMUNICATION_INTERFACE
            TRANSM_FD_2_oFDCAN2_e9f9d2e6_Rx_a2f37aee_Rx (PduRDestPdu):
              PduRDestPduHandleId = 58
              PduRDestPduDirection = RECEIVE
              PduRDestPduRoutingType = API_FORWARDING
              PduRDestPduDataProcessing = IMMEDIATE
              PduRPduLengthHandlingStrategy = IGNORE
              PduRDestPduCrossPartitionDestination = false
              PduRTransmissionConfirmation = false
              PduRDestPduRef = TRANSM_FD_2_oFDCAN2_e7c0941f_Rx
              PduRDestPduPduRBswModulesRef = Com
            PduRSrcPdu_a2f37aee (PduRSrcPdu): PduRSourcePduHandleId=58, PduRSrcPduDirection=RECEIVE, PduRSrcPduRef=TRANSM_FD_2_oFDCAN2_e9f9d2e6_Rx, PduRSrcPduPduRBswModulesRef=CanIf
          ENGINE_FD_7_oFDCAN2_e58267a9_Rx: PduRRoutingPathCommunicationType=COMMUNICATION_INTERFACE
            PduRSrcPdu_91888c03 (PduRSrcPdu): PduRSourcePduHandleId=33, PduRSrcPduDirection=RECEIVE, PduRSrcPduRef=ENGINE_FD_7_oFDCAN2_e58267a9_Rx, PduRSrcPduPduRBswModulesRef=CanIf
            ENGINE_FD_7_oFDCAN2_e58267a9_Rx_91888c03_Rx (PduRDestPdu):
              PduRDestPduHandleId = 33
              PduRDestPduDirection = RECEIVE
              PduRDestPduRoutingType = API_FORWARDING
              PduRDestPduDataProcessing = IMMEDIATE
              PduRPduLengthHandlingStrategy = IGNORE
              PduRDestPduCrossPartitionDestination = false
              PduRTransmissionConfirmation = false
              PduRDestPduRef = ENGINE_FD_7_oFDCAN2_8a55f318_Rx
              PduRDestPduPduRBswModulesRef = Com
          DIAGNOSTIC_ROE_FD_PAM_oFDCAN2_60d4d54e_Tx: PduRRoutingPathCommunicationType=COMMUNICATION_INTERFACE
            DIAGNOSTIC_ROE_FD_PAM_oFDCAN2_5ecfbbbe_Tx (PduRDestPdu):
              PduRDestPduHandleId = 10
              PduRDestPduDirection = TRANSMIT
              PduRDestPduRoutingType = API_FORWARDING
              PduRDestPduDataProcessing = IMMEDIATE
              PduRPduLengthHandlingStrategy = IGNORE
              PduRDestPduCrossPartitionDestination = false
              PduRDestPduDataProvision = PDUR_DIRECT
              PduRTransmissionConfirmation = false
              PduRDestPduRef = DIAGNOSTIC_ROE_FD_PAM_oFDCAN2_5ecfbbbe_Tx
              PduRDestPduPduRBswModulesRef = CanIf
            PduRSrcPdu_3925f43f (PduRSrcPdu): PduRSourcePduHandleId=13, PduRSrcPduDirection=TRANSMIT, PduRSrcPduRef=DIAGNOSTIC_ROE_FD_PAM_oFDCAN2_60d4d54e_Tx, PduRSrcPduPduRBswModulesRef=Com
          BCM_FD_29_oFDCAN2_aa0bc9ec_Rx: PduRRoutingPathCommunicationType=COMMUNICATION_INTERFACE
            BCM_FD_29_oFDCAN2_aa0bc9ec_Rx_f737c45a_Rx (PduRDestPdu):
              PduRDestPduHandleId = 12
              PduRDestPduDirection = RECEIVE
              PduRDestPduRoutingType = API_FORWARDING
              PduRDestPduDataProcessing = IMMEDIATE
              PduRPduLengthHandlingStrategy = IGNORE
              PduRDestPduCrossPartitionDestination = false
              PduRTransmissionConfirmation = false
              PduRDestPduRef = BCM_FD_29_oFDCAN2_cae28ef6_Rx
              PduRDestPduPduRBswModulesRef = Com
            PduRSrcPdu_f737c45a (PduRSrcPdu): PduRSourcePduHandleId=12, PduRSrcPduDirection=RECEIVE, PduRSrcPduRef=BCM_FD_29_oFDCAN2_aa0bc9ec_Rx, PduRSrcPduPduRBswModulesRef=CanIf
          CFG_DATA_CODE_RSP_PAM_oFDCAN2_56f16977_Tx: PduRRoutingPathCommunicationType=COMMUNICATION_INTERFACE
            CFG_DATA_CODE_RSP_PAM_oFDCAN2_5b222c4a_Tx (PduRDestPdu):
              PduRDestPduHandleId = 5
              PduRDestPduDirection = TRANSMIT
              PduRDestPduRoutingType = API_FORWARDING
              PduRDestPduDataProcessing = IMMEDIATE
              PduRPduLengthHandlingStrategy = IGNORE
              PduRDestPduCrossPartitionDestination = false
              PduRDestPduDataProvision = PDUR_DIRECT
              PduRTransmissionConfirmation = false
              PduRDestPduRef = CFG_DATA_CODE_RSP_PAM_oFDCAN2_5b222c4a_Tx
              PduRDestPduPduRBswModulesRef = CanIf
            PduRSrcPdu_06add09a (PduRSrcPdu): PduRSourcePduHandleId=5, PduRSrcPduDirection=TRANSMIT, PduRSrcPduRef=CFG_DATA_CODE_RSP_PAM_oFDCAN2_56f16977_Tx, PduRSrcPduPduRBswModulesRef=Com
          PDC_INFO_FD_SGW_oFDCAN2_2e2ff0c8_Rx: PduRRoutingPathCommunicationType=COMMUNICATION_INTERFACE
            PduRSrcPdu_e656730e (PduRSrcPdu): PduRSourcePduHandleId=49, PduRSrcPduDirection=RECEIVE, PduRSrcPduRef=PDC_INFO_FD_SGW_oFDCAN2_2e2ff0c8_Rx, PduRSrcPduPduRBswModulesRef=CanIf
            PDC_INFO_FD_SGW_oFDCAN2_2e2ff0c8_Rx_e656730e_Rx (PduRDestPdu):
              PduRDestPduHandleId = 49
              PduRDestPduDirection = RECEIVE
              PduRDestPduRoutingType = API_FORWARDING
              PduRDestPduDataProcessing = IMMEDIATE
              PduRPduLengthHandlingStrategy = IGNORE
              PduRDestPduCrossPartitionDestination = false
              PduRTransmissionConfirmation = false
              PduRDestPduRef = PDC_INFO_FD_SGW_oFDCAN2_d3dda15f_Rx
              PduRDestPduPduRBswModulesRef = Com
          GLOB_NAV_FD_C2_oFDCAN2_93cc1f91_Rx: PduRRoutingPathCommunicationType=COMMUNICATION_INTERFACE
            PduRSrcPdu_e918f131 (PduRSrcPdu): PduRSourcePduHandleId=39, PduRSrcPduDirection=RECEIVE, PduRSrcPduRef=GLOB_NAV_FD_C2_oFDCAN2_93cc1f91_Rx, PduRSrcPduPduRBswModulesRef=CanIf
            GLOB_NAV_FD_C2_oFDCAN2_93cc1f91_Rx_e918f131_Rx (PduRDestPdu):
              PduRDestPduHandleId = 39
              PduRDestPduDirection = RECEIVE
              PduRDestPduRoutingType = API_FORWARDING
              PduRDestPduDataProcessing = IMMEDIATE
              PduRPduLengthHandlingStrategy = IGNORE
              PduRDestPduCrossPartitionDestination = false
              PduRTransmissionConfirmation = false
              PduRDestPduRef = GLOB_NAV_FD_C2_oFDCAN2_098ddc16_Rx
              PduRDestPduPduRBswModulesRef = Com
          TRSKM_FD_1_oFDCAN2_3bc9104a_Rx: PduRRoutingPathCommunicationType=COMMUNICATION_INTERFACE
            PduRSrcPdu_caa8877e (PduRSrcPdu): PduRSourcePduHandleId=60, PduRSrcPduDirection=RECEIVE, PduRSrcPduRef=TRSKM_FD_1_oFDCAN2_3bc9104a_Rx, PduRSrcPduPduRBswModulesRef=CanIf
            TRSKM_FD_1_oFDCAN2_3bc9104a_Rx_caa8877e_Rx (PduRDestPdu):
              PduRDestPduHandleId = 60
              PduRDestPduDirection = RECEIVE
              PduRDestPduRoutingType = API_FORWARDING
              PduRDestPduDataProcessing = IMMEDIATE
              PduRPduLengthHandlingStrategy = IGNORE
              PduRDestPduCrossPartitionDestination = false
              PduRTransmissionConfirmation = false
              PduRDestPduRef = TRSKM_FD_1_oFDCAN2_2705233d_Rx
              PduRDestPduPduRBswModulesRef = Com
          DIAGNOSTIC_REQUEST_FUNCTIONAL_oFDCAN2_fa8f9425_Rx: PduRRoutingPathCommunicationType=TRANSPORT_PROTOCOL
            DIAGNOSTIC_REQUEST_FUNCTIONAL_oFDCAN2_fa8f9425_Rx_ec401e20_Rx (PduRDestPdu):
              PduRDestPduHandleId = 4
              PduRDestPduDirection = RECEIVE
              PduRDestPduRoutingType = API_FORWARDING
              PduRDestPduDataProcessing = IMMEDIATE
              PduRPduLengthHandlingStrategy = UNUSED
              PduRDestPduCrossPartitionDestination = false
              PduRDestPduRef = DIAGNOSTIC_REQUEST_FUNCTIONAL_oFDCAN2_4ccc9554_Rx
              PduRDestPduPduRBswModulesRef = Dcm
            PduRSrcPdu_ec401e20 (PduRSrcPdu):
              PduRSourcePduHandleId = 4
              PduRSrcPduDirection = RECEIVE
              PduRSrcPduRef = DIAGNOSTIC_REQUEST_FUNCTIONAL_oFDCAN2_fa8f9425_Rx
              PduRSrcPduPduRBswModulesRef = CanTp
          DIAGNOSTIC_REQUEST_PAM_oFDCAN2_d3c55b76_Rx: PduRRoutingPathCommunicationType=TRANSPORT_PROTOCOL
            PduRSrcPdu_274afd95 (PduRSrcPdu): PduRSourcePduHandleId=5, PduRSrcPduDirection=RECEIVE, PduRSrcPduRef=DIAGNOSTIC_REQUEST_PAM_oFDCAN2_d3c55b76_Rx, PduRSrcPduPduRBswModulesRef=CanTp
            DIAGNOSTIC_REQUEST_PAM_oFDCAN2_d3c55b76_Rx_274afd95_Rx (PduRDestPdu):
              PduRDestPduHandleId = 5
              PduRDestPduDirection = RECEIVE
              PduRDestPduRoutingType = API_FORWARDING
              PduRDestPduDataProcessing = IMMEDIATE
              PduRPduLengthHandlingStrategy = UNUSED
              PduRDestPduCrossPartitionDestination = false
              PduRDestPduRef = DIAGNOSTIC_REQUEST_PAM_oFDCAN2_7b4c614e_Rx
              PduRDestPduPduRBswModulesRef = Dcm
          BCM_FD_27_oFDCAN2_eddb36fd_Rx: PduRRoutingPathCommunicationType=COMMUNICATION_INTERFACE
            BCM_FD_27_oFDCAN2_eddb36fd_Rx_5542795d_Rx (PduRDestPdu):
              PduRDestPduHandleId = 11
              PduRDestPduDirection = RECEIVE
              PduRDestPduRoutingType = API_FORWARDING
              PduRDestPduDataProcessing = IMMEDIATE
              PduRPduLengthHandlingStrategy = IGNORE
              PduRDestPduCrossPartitionDestination = false
              PduRTransmissionConfirmation = false
              PduRDestPduRef = BCM_FD_27_oFDCAN2_02205564_Rx
              PduRDestPduPduRBswModulesRef = Com
            PduRSrcPdu_5542795d (PduRSrcPdu): PduRSourcePduHandleId=11, PduRSrcPduDirection=RECEIVE, PduRSrcPduRef=BCM_FD_27_oFDCAN2_eddb36fd_Rx, PduRSrcPduPduRBswModulesRef=CanIf
          CFG_DATA_CODE_REQUEST_oFDCAN2_f0797e1f_Rx: PduRRoutingPathCommunicationType=COMMUNICATION_INTERFACE
            PduRSrcPdu_fcb49c19 (PduRSrcPdu): PduRSourcePduHandleId=27, PduRSrcPduDirection=RECEIVE, PduRSrcPduRef=CFG_DATA_CODE_REQUEST_oFDCAN2_f0797e1f_Rx, PduRSrcPduPduRBswModulesRef=CanIf
            CFG_DATA_CODE_REQUEST_oFDCAN2_f0797e1f_Rx_fcb49c19_Rx (PduRDestPdu):
              PduRDestPduHandleId = 27
              PduRDestPduDirection = RECEIVE
              PduRDestPduRoutingType = API_FORWARDING
              PduRDestPduDataProcessing = IMMEDIATE
              PduRPduLengthHandlingStrategy = IGNORE
              PduRDestPduCrossPartitionDestination = false
              PduRTransmissionConfirmation = false
              PduRDestPduRef = CFG_DATA_CODE_REQUEST_oFDCAN2_03b9e23f_Rx
              PduRDestPduPduRBswModulesRef = Com
          PDC_INFO_FD_EPS_oFDCAN2_452e6cff_Rx: PduRRoutingPathCommunicationType=COMMUNICATION_INTERFACE
            PDC_INFO_FD_EPS_oFDCAN2_452e6cff_Rx_41ead865_Rx (PduRDestPdu):
              PduRDestPduHandleId = 47
              PduRDestPduDirection = RECEIVE
              PduRDestPduRoutingType = API_FORWARDING
              PduRDestPduDataProcessing = IMMEDIATE
              PduRPduLengthHandlingStrategy = IGNORE
              PduRDestPduCrossPartitionDestination = false
              PduRTransmissionConfirmation = false
              PduRDestPduRef = PDC_INFO_FD_EPS_oFDCAN2_0d00644a_Rx
              PduRDestPduPduRBswModulesRef = Com
            PduRSrcPdu_41ead865 (PduRSrcPdu): PduRSourcePduHandleId=47, PduRSrcPduDirection=RECEIVE, PduRSrcPduRef=PDC_INFO_FD_EPS_oFDCAN2_452e6cff_Rx, PduRSrcPduPduRBswModulesRef=CanIf
          TELEMATIC_FD_14_oFDCAN2_f8ab69af_Rx: PduRRoutingPathCommunicationType=COMMUNICATION_INTERFACE
            TELEMATIC_FD_14_oFDCAN2_f8ab69af_Rx_8c549050_Rx (PduRDestPdu):
              PduRDestPduHandleId = 56
              PduRDestPduDirection = RECEIVE
              PduRDestPduRoutingType = API_FORWARDING
              PduRDestPduDataProcessing = IMMEDIATE
              PduRPduLengthHandlingStrategy = IGNORE
              PduRDestPduCrossPartitionDestination = false
              PduRTransmissionConfirmation = false
              PduRDestPduRef = TELEMATIC_FD_14_oFDCAN2_f082faaa_Rx
              PduRDestPduPduRBswModulesRef = Com
            PduRSrcPdu_8c549050 (PduRSrcPdu): PduRSourcePduHandleId=56, PduRSrcPduDirection=RECEIVE, PduRSrcPduRef=TELEMATIC_FD_14_oFDCAN2_f8ab69af_Rx, PduRSrcPduPduRBswModulesRef=CanIf
          DIAGNOSTIC_RESPONSE_FD_PAM_oFDCAN2_e66afb61_Tx: PduRRoutingPathCommunicationType=TRANSPORT_PROTOCOL
            DIAGNOSTIC_RESPONSE_FD_PAM_oFDCAN2_411d850e_Tx (PduRDestPdu):
              PduRDestPduHandleId = 1
              PduRDestPduDirection = TRANSMIT
              PduRDestPduRoutingType = API_FORWARDING
              PduRDestPduDataProcessing = IMMEDIATE
              PduRPduLengthHandlingStrategy = UNUSED
              PduRDestPduCrossPartitionDestination = false
              PduRDestPduRef = DIAGNOSTIC_RESPONSE_FD_PAM_oFDCAN2_411d850e_Tx
              PduRDestPduPduRBswModulesRef = CanTp
            PduRSrcPdu_a27f7930 (PduRSrcPdu):
              PduRSourcePduHandleId = 11
              PduRSrcPduDirection = TRANSMIT
              PduRSrcPduRef = DIAGNOSTIC_RESPONSE_FD_PAM_oFDCAN2_e66afb61_Tx
              PduRSrcPduPduRBswModulesRef = Dcm
          CVPAM_FD_Control_oFDCAN2_2dc7d8b6_Tx: PduRRoutingPathCommunicationType=COMMUNICATION_INTERFACE
            PduRSrcPdu_7fd1469a (PduRSrcPdu): PduRSourcePduHandleId=6, PduRSrcPduDirection=TRANSMIT, PduRSrcPduRef=CVPAM_FD_Control_oFDCAN2_2dc7d8b6_Tx, PduRSrcPduPduRBswModulesRef=Com
            CVPAM_FD_Control_oFDCAN2_b23be072_Tx (PduRDestPdu):
              PduRDestPduHandleId = 6
              PduRDestPduDirection = TRANSMIT
              PduRDestPduRoutingType = API_FORWARDING
              PduRDestPduDataProcessing = IMMEDIATE
              PduRPduLengthHandlingStrategy = IGNORE
              PduRDestPduCrossPartitionDestination = false
              PduRDestPduDataProvision = PDUR_DIRECT
              PduRTransmissionConfirmation = false
              PduRDestPduRef = CVPAM_FD_Control_oFDCAN2_b23be072_Tx
              PduRDestPduPduRBswModulesRef = CanIf
          BCM_FD_2_oFDCAN2_3071d90c_Rx: PduRRoutingPathCommunicationType=COMMUNICATION_INTERFACE
            BCM_FD_2_oFDCAN2_3071d90c_Rx_44196b0f_Rx (PduRDestPdu):
              PduRDestPduHandleId = 5
              PduRDestPduDirection = RECEIVE
              PduRDestPduRoutingType = API_FORWARDING
              PduRDestPduDataProcessing = IMMEDIATE
              PduRPduLengthHandlingStrategy = IGNORE
              PduRDestPduCrossPartitionDestination = false
              PduRTransmissionConfirmation = false
              PduRDestPduRef = BCM_FD_2_oFDCAN2_f3daca1a_Rx
              PduRDestPduPduRBswModulesRef = Com
            PduRSrcPdu_44196b0f (PduRSrcPdu): PduRSourcePduHandleId=5, PduRSrcPduDirection=RECEIVE, PduRSrcPduRef=BCM_FD_2_oFDCAN2_3071d90c_Rx, PduRSrcPduPduRBswModulesRef=CanIf
          AGSM_FD_2_oFDCAN2_9af9f599_Rx: PduRRoutingPathCommunicationType=COMMUNICATION_INTERFACE
            AGSM_FD_2_oFDCAN2_9af9f599_Rx_edfa5d4e_Rx (PduRDestPdu):
              PduRDestPduHandleId = 2
              PduRDestPduDirection = RECEIVE
              PduRDestPduRoutingType = API_FORWARDING
              PduRDestPduDataProcessing = IMMEDIATE
              PduRPduLengthHandlingStrategy = IGNORE
              PduRDestPduCrossPartitionDestination = false
              PduRTransmissionConfirmation = false
              PduRDestPduRef = AGSM_FD_2_oFDCAN2_97b68631_Rx
              PduRDestPduPduRBswModulesRef = Com
            PduRSrcPdu_edfa5d4e (PduRSrcPdu): PduRSourcePduHandleId=2, PduRSrcPduDirection=RECEIVE, PduRSrcPduRef=AGSM_FD_2_oFDCAN2_9af9f599_Rx, PduRSrcPduPduRBswModulesRef=CanIf
          DIAGNOSTIC_REQUEST_FD_PAM_oFDCAN2_20_f5723a9b_Rx: PduRRoutingPathCommunicationType=TRANSPORT_PROTOCOL
            PduRSrcPdu_ff4aa4e5 (PduRSrcPdu):
              PduRSourcePduHandleId = 2
              PduRSrcPduDirection = RECEIVE
              PduRSrcPduRef = DIAGNOSTIC_REQUEST_FD_PAM_oFDCAN2_20_f5723a9b_Rx
              PduRSrcPduPduRBswModulesRef = CanTp
            DIAGNOSTIC_REQUEST_FD_PAM_oFDCAN2_20_f5723a9b_Rx_ff4aa4e5_Rx (PduRDestPdu):
              PduRDestPduHandleId = 2
              PduRDestPduDirection = RECEIVE
              PduRDestPduRoutingType = API_FORWARDING
              PduRDestPduDataProcessing = IMMEDIATE
              PduRPduLengthHandlingStrategy = UNUSED
              PduRDestPduCrossPartitionDestination = false
              PduRDestPduRef = DIAGNOSTIC_REQUEST_FD_PAM_oFDCAN2_20_534676a2_Rx
              PduRDestPduPduRBswModulesRef = Dcm
          ASCM_FD_1_oFDCAN2_2db9ba19_Rx: PduRRoutingPathCommunicationType=COMMUNICATION_INTERFACE
            ASCM_FD_1_oFDCAN2_2db9ba19_Rx_1edc6963_Rx (PduRDestPdu):
              PduRDestPduHandleId = 3
              PduRDestPduDirection = RECEIVE
              PduRDestPduRoutingType = API_FORWARDING
              PduRDestPduDataProcessing = IMMEDIATE
              PduRPduLengthHandlingStrategy = IGNORE
              PduRDestPduCrossPartitionDestination = false
              PduRTransmissionConfirmation = false
              PduRDestPduRef = ASCM_FD_1_oFDCAN2_d84f57a2_Rx
              PduRDestPduPduRBswModulesRef = Com
            PduRSrcPdu_1edc6963 (PduRSrcPdu): PduRSourcePduHandleId=3, PduRSrcPduDirection=RECEIVE, PduRSrcPduRef=ASCM_FD_1_oFDCAN2_2db9ba19_Rx, PduRSrcPduPduRBswModulesRef=CanIf
          PDC_INFO_FD_ORC_oFDCAN2_17e9e0f6_Rx: PduRRoutingPathCommunicationType=COMMUNICATION_INTERFACE
            PduRSrcPdu_fb43a35e (PduRSrcPdu): PduRSourcePduHandleId=48, PduRSrcPduDirection=RECEIVE, PduRSrcPduRef=PDC_INFO_FD_ORC_oFDCAN2_17e9e0f6_Rx, PduRSrcPduPduRBswModulesRef=CanIf
            PDC_INFO_FD_ORC_oFDCAN2_17e9e0f6_Rx_fb43a35e_Rx (PduRDestPdu):
              PduRDestPduHandleId = 48
              PduRDestPduDirection = RECEIVE
              PduRDestPduRoutingType = API_FORWARDING
              PduRDestPduDataProcessing = IMMEDIATE
              PduRPduLengthHandlingStrategy = IGNORE
              PduRDestPduCrossPartitionDestination = false
              PduRTransmissionConfirmation = false
              PduRDestPduRef = PDC_INFO_FD_ORC_oFDCAN2_479aae82_Rx
              PduRDestPduPduRBswModulesRef = Com
          IPC_VEHICLE_SETUP_oFDCAN2_a22ca3c4_Rx: PduRRoutingPathCommunicationType=COMMUNICATION_INTERFACE
            PduRSrcPdu_d78ab2ca (PduRSrcPdu): PduRSourcePduHandleId=41, PduRSrcPduDirection=RECEIVE, PduRSrcPduRef=IPC_VEHICLE_SETUP_oFDCAN2_a22ca3c4_Rx, PduRSrcPduPduRBswModulesRef=CanIf
            IPC_VEHICLE_SETUP_oFDCAN2_a22ca3c4_Rx_d78ab2ca_Rx (PduRDestPdu):
              PduRDestPduHandleId = 41
              PduRDestPduDirection = RECEIVE
              PduRDestPduRoutingType = API_FORWARDING
              PduRDestPduDataProcessing = IMMEDIATE
              PduRPduLengthHandlingStrategy = IGNORE
              PduRDestPduCrossPartitionDestination = false
              PduRTransmissionConfirmation = false
              PduRDestPduRef = IPC_VEHICLE_SETUP_oFDCAN2_ddb2e91d_Rx
              PduRDestPduPduRBswModulesRef = Com
          ADAS_FD_INFO_C2_oFDCAN2_3ce9cdd9_Rx: PduRRoutingPathCommunicationType=COMMUNICATION_INTERFACE
            ADAS_FD_INFO_C2_oFDCAN2_3ce9cdd9_Rx_c7180dec_Rx (PduRDestPdu):
              PduRDestPduHandleId = 0
              PduRDestPduDirection = RECEIVE
              PduRDestPduRoutingType = API_FORWARDING
              PduRDestPduDataProcessing = IMMEDIATE
              PduRPduLengthHandlingStrategy = IGNORE
              PduRDestPduCrossPartitionDestination = false
              PduRTransmissionConfirmation = false
              PduRDestPduRef = ADAS_FD_INFO_C2_oFDCAN2_f97a3a77_Rx
              PduRDestPduPduRBswModulesRef = Com
            PduRSrcPdu_c7180dec (PduRSrcPdu): PduRSourcePduHandleId=0, PduRSrcPduDirection=RECEIVE, PduRSrcPduRef=ADAS_FD_INFO_C2_oFDCAN2_3ce9cdd9_Rx, PduRSrcPduPduRBswModulesRef=CanIf
          BCM_FD_9_oFDCAN2_2997fce8_Rx: PduRRoutingPathCommunicationType=COMMUNICATION_INTERFACE
            PduRSrcPdu_ffb63425 (PduRSrcPdu): PduRSourcePduHandleId=8, PduRSrcPduDirection=RECEIVE, PduRSrcPduRef=BCM_FD_9_oFDCAN2_2997fce8_Rx, PduRSrcPduPduRBswModulesRef=CanIf
            BCM_FD_9_oFDCAN2_2997fce8_Rx_ffb63425_Rx (PduRDestPdu):
              PduRDestPduHandleId = 8
              PduRDestPduDirection = RECEIVE
              PduRDestPduRoutingType = API_FORWARDING
              PduRDestPduDataProcessing = IMMEDIATE
              PduRPduLengthHandlingStrategy = IGNORE
              PduRDestPduCrossPartitionDestination = false
              PduRTransmissionConfirmation = false
              PduRDestPduRef = BCM_FD_9_oFDCAN2_718f54c7_Rx
              PduRDestPduPduRBswModulesRef = Com
          CVPAM_FD_Info_oFDCAN14_f4e1b059_Tx: PduRRoutingPathCommunicationType=COMMUNICATION_INTERFACE
            CVPAM_FD_Info_oFDCAN14_838aefa3_Tx (PduRDestPdu):
              PduRDestPduHandleId = 9
              PduRDestPduDirection = TRANSMIT
              PduRDestPduRoutingType = API_FORWARDING
              PduRDestPduDataProcessing = IMMEDIATE
              PduRPduLengthHandlingStrategy = IGNORE
              PduRDestPduCrossPartitionDestination = false
              PduRDestPduDataProvision = PDUR_DIRECT
              PduRTransmissionConfirmation = false
              PduRDestPduRef = CVPAM_FD_Info_oFDCAN14_838aefa3_Tx
              PduRDestPduPduRBswModulesRef = CanIf
            PduRSrcPdu_ae34d87e (PduRSrcPdu): PduRSourcePduHandleId=9, PduRSrcPduDirection=TRANSMIT, PduRSrcPduRef=CVPAM_FD_Info_oFDCAN14_f4e1b059_Tx, PduRSrcPduPduRBswModulesRef=Com
          EPS_FD_2_oFDCAN14_aff3763c_Rx: PduRRoutingPathCommunicationType=COMMUNICATION_INTERFACE
            EPS_FD_2_oFDCAN14_aff3763c_Rx_aa61fa9f_Rx (PduRDestPdu):
              PduRDestPduHandleId = 38
              PduRDestPduDirection = RECEIVE
              PduRDestPduRoutingType = API_FORWARDING
              PduRDestPduDataProcessing = IMMEDIATE
              PduRPduLengthHandlingStrategy = IGNORE
              PduRDestPduCrossPartitionDestination = false
              PduRTransmissionConfirmation = false
              PduRDestPduRef = EPS_FD_2_oFDCAN14_63661a56_Rx
              PduRDestPduPduRBswModulesRef = Com
            PduRSrcPdu_aa61fa9f (PduRSrcPdu): PduRSourcePduHandleId=38, PduRSrcPduDirection=RECEIVE, PduRSrcPduRef=EPS_FD_2_oFDCAN14_aff3763c_Rx, PduRSrcPduPduRBswModulesRef=CanIf
          ENGINE_FD_7_oFDCAN14_9a0b3d4f_Rx: PduRRoutingPathCommunicationType=COMMUNICATION_INTERFACE
            PduRSrcPdu_78022248 (PduRSrcPdu): PduRSourcePduHandleId=34, PduRSrcPduDirection=RECEIVE, PduRSrcPduRef=ENGINE_FD_7_oFDCAN14_9a0b3d4f_Rx, PduRSrcPduPduRBswModulesRef=CanIf
            ENGINE_FD_7_oFDCAN14_9a0b3d4f_Rx_78022248_Rx (PduRDestPdu):
              PduRDestPduHandleId = 34
              PduRDestPduDirection = RECEIVE
              PduRDestPduRoutingType = API_FORWARDING
              PduRDestPduDataProcessing = IMMEDIATE
              PduRPduLengthHandlingStrategy = IGNORE
              PduRDestPduCrossPartitionDestination = false
              PduRTransmissionConfirmation = false
              PduRDestPduRef = ENGINE_FD_7_oFDCAN14_cb7d855e_Rx
              PduRDestPduPduRBswModulesRef = Com
          BRAKE_FD_7_oFDCAN14_3a47e048_Rx: PduRRoutingPathCommunicationType=COMMUNICATION_INTERFACE
            PduRSrcPdu_ea1aa754 (PduRSrcPdu): PduRSourcePduHandleId=26, PduRSrcPduDirection=RECEIVE, PduRSrcPduRef=BRAKE_FD_7_oFDCAN14_3a47e048_Rx, PduRSrcPduPduRBswModulesRef=CanIf
            BRAKE_FD_7_oFDCAN14_3a47e048_Rx_ea1aa754_Rx (PduRDestPdu):
              PduRDestPduHandleId = 26
              PduRDestPduDirection = RECEIVE
              PduRDestPduRoutingType = API_FORWARDING
              PduRDestPduDataProcessing = IMMEDIATE
              PduRPduLengthHandlingStrategy = IGNORE
              PduRDestPduCrossPartitionDestination = false
              PduRTransmissionConfirmation = false
              PduRDestPduRef = BRAKE_FD_7_oFDCAN14_0fb084aa_Rx
              PduRDestPduPduRBswModulesRef = Com
          BRAKE_FD_6_oFDCAN14_54cbfb09_Rx: PduRRoutingPathCommunicationType=COMMUNICATION_INTERFACE
            PduRSrcPdu_7cdde702 (PduRSrcPdu): PduRSourcePduHandleId=25, PduRSrcPduDirection=RECEIVE, PduRSrcPduRef=BRAKE_FD_6_oFDCAN14_54cbfb09_Rx, PduRSrcPduPduRBswModulesRef=CanIf
            BRAKE_FD_6_oFDCAN14_54cbfb09_Rx_7cdde702_Rx (PduRDestPdu):
              PduRDestPduHandleId = 25
              PduRDestPduDirection = RECEIVE
              PduRDestPduRoutingType = API_FORWARDING
              PduRDestPduDataProcessing = IMMEDIATE
              PduRPduLengthHandlingStrategy = IGNORE
              PduRDestPduCrossPartitionDestination = false
              PduRTransmissionConfirmation = false
              PduRDestPduRef = BRAKE_FD_6_oFDCAN14_e072ef94_Rx
              PduRDestPduPduRBswModulesRef = Com
          BRAKE_FD_3_oFDCAN14_5b068b0d_Rx: PduRRoutingPathCommunicationType=COMMUNICATION_INTERFACE
            BRAKE_FD_3_oFDCAN14_5b068b0d_Rx_536023d7_Rx (PduRDestPdu):
              PduRDestPduHandleId = 20
              PduRDestPduDirection = RECEIVE
              PduRDestPduRoutingType = API_FORWARDING
              PduRDestPduDataProcessing = IMMEDIATE
              PduRPduLengthHandlingStrategy = IGNORE
              PduRDestPduCrossPartitionDestination = false
              PduRTransmissionConfirmation = false
              PduRDestPduRef = BRAKE_FD_3_oFDCAN14_065b24d0_Rx
              PduRDestPduPduRBswModulesRef = Com
            PduRSrcPdu_536023d7 (PduRSrcPdu): PduRSourcePduHandleId=20, PduRSrcPduDirection=RECEIVE, PduRSrcPduRef=BRAKE_FD_3_oFDCAN14_5b068b0d_Rx, PduRSrcPduPduRBswModulesRef=CanIf
          BRAKE_FD_1_oFDCAN14_861ebd8f_Rx: PduRRoutingPathCommunicationType=COMMUNICATION_INTERFACE
            BRAKE_FD_1_oFDCAN14_861ebd8f_Rx_010cb7aa_Rx (PduRDestPdu):
              PduRDestPduHandleId = 16
              PduRDestPduDirection = RECEIVE
              PduRDestPduRoutingType = API_FORWARDING
              PduRDestPduDataProcessing = IMMEDIATE
              PduRPduLengthHandlingStrategy = IGNORE
              PduRDestPduCrossPartitionDestination = false
              PduRTransmissionConfirmation = false
              PduRDestPduRef = BRAKE_FD_1_oFDCAN14_02aef4ed_Rx
              PduRDestPduPduRBswModulesRef = Com
            PduRSrcPdu_010cb7aa (PduRSrcPdu): PduRSourcePduHandleId=16, PduRSrcPduDirection=RECEIVE, PduRSrcPduRef=BRAKE_FD_1_oFDCAN14_861ebd8f_Rx, PduRSrcPduPduRBswModulesRef=CanIf
          ENGINE_FD_5_oFDCAN14_47130bcd_Rx: PduRRoutingPathCommunicationType=COMMUNICATION_INTERFACE
            ENGINE_FD_5_oFDCAN14_47130bcd_Rx_60b0950b_Rx (PduRDestPdu):
              PduRDestPduHandleId = 32
              PduRDestPduDirection = RECEIVE
              PduRDestPduRoutingType = API_FORWARDING
              PduRDestPduDataProcessing = IMMEDIATE
              PduRPduLengthHandlingStrategy = IGNORE
              PduRDestPduCrossPartitionDestination = false
              PduRTransmissionConfirmation = false
              PduRDestPduRef = ENGINE_FD_5_oFDCAN14_cf885563_Rx
              PduRDestPduPduRBswModulesRef = Com
            PduRSrcPdu_60b0950b (PduRSrcPdu): PduRSourcePduHandleId=32, PduRSrcPduDirection=RECEIVE, PduRSrcPduRef=ENGINE_FD_5_oFDCAN14_47130bcd_Rx, PduRSrcPduPduRBswModulesRef=CanIf
          BRAKE_FD_5_oFDCAN14_e75fd6ca_Rx: PduRRoutingPathCommunicationType=COMMUNICATION_INTERFACE
            PduRSrcPdu_22a4d3fd (PduRSrcPdu): PduRSourcePduHandleId=24, PduRSrcPduDirection=RECEIVE, PduRSrcPduRef=BRAKE_FD_5_oFDCAN14_e75fd6ca_Rx, PduRSrcPduPduRBswModulesRef=CanIf
            BRAKE_FD_5_oFDCAN14_e75fd6ca_Rx_22a4d3fd_Rx (PduRDestPdu):
              PduRDestPduHandleId = 24
              PduRDestPduDirection = RECEIVE
              PduRDestPduRoutingType = API_FORWARDING
              PduRDestPduDataProcessing = IMMEDIATE
              PduRPduLengthHandlingStrategy = IGNORE
              PduRDestPduCrossPartitionDestination = false
              PduRTransmissionConfirmation = false
              PduRDestPduRef = BRAKE_FD_5_oFDCAN14_0b455497_Rx
              PduRDestPduPduRBswModulesRef = Com
          ENGINE_FD_2_oFDCAN14_95c64d4b_Rx: PduRRoutingPathCommunicationType=COMMUNICATION_INTERFACE
            PduRSrcPdu_5302daec (PduRSrcPdu): PduRSourcePduHandleId=30, PduRSrcPduDirection=RECEIVE, PduRSrcPduRef=ENGINE_FD_2_oFDCAN14_95c64d4b_Rx, PduRSrcPduPduRBswModulesRef=CanIf
            ENGINE_FD_2_oFDCAN14_95c64d4b_Rx_5302daec_Rx (PduRDestPdu):
              PduRDestPduHandleId = 30
              PduRDestPduDirection = RECEIVE
              PduRDestPduRoutingType = API_FORWARDING
              PduRDestPduDataProcessing = IMMEDIATE
              PduRPduLengthHandlingStrategy = IGNORE
              PduRDestPduCrossPartitionDestination = false
              PduRTransmissionConfirmation = false
              PduRDestPduRef = ENGINE_FD_2_oFDCAN14_2d544e1a_Rx
              PduRDestPduPduRBswModulesRef = Com
          ADAS_FD_INFO_oFDCAN14_a55fd54d_Rx: PduRRoutingPathCommunicationType=COMMUNICATION_INTERFACE
            ADAS_FD_INFO_oFDCAN14_a55fd54d_Rx_a7c45d7d_Rx (PduRDestPdu):
              PduRDestPduHandleId = 1
              PduRDestPduDirection = RECEIVE
              PduRDestPduRoutingType = API_FORWARDING
              PduRDestPduDataProcessing = IMMEDIATE
              PduRPduLengthHandlingStrategy = IGNORE
              PduRDestPduCrossPartitionDestination = false
              PduRTransmissionConfirmation = false
              PduRDestPduRef = ADAS_FD_INFO_oFDCAN14_fa8dfd08_Rx
              PduRDestPduPduRBswModulesRef = Com
            PduRSrcPdu_a7c45d7d (PduRSrcPdu): PduRSourcePduHandleId=1, PduRSrcPduDirection=RECEIVE, PduRSrcPduRef=ADAS_FD_INFO_oFDCAN14_a55fd54d_Rx, PduRSrcPduPduRBswModulesRef=CanIf
          TRSCM_FD_1_oFDCAN14_f3c79e86_Tx: PduRRoutingPathCommunicationType=COMMUNICATION_INTERFACE
            TRSCM_FD_1_oFDCAN14_4ddc266d_Tx (PduRDestPdu):
              PduRDestPduHandleId = 105
              PduRDestPduDirection = TRANSMIT
              PduRDestPduRoutingType = API_FORWARDING
              PduRDestPduDataProcessing = IMMEDIATE
              PduRPduLengthHandlingStrategy = IGNORE
              PduRDestPduCrossPartitionDestination = false
              PduRDestPduDataProvision = PDUR_DIRECT
              PduRTransmissionConfirmation = true
              PduRDestPduRef = TRSCM_FD_1_oFDCAN14_4ddc266d_Tx
              PduRDestPduPduRBswModulesRef = CanIf
            PduRSrcPdu_b6572f92 (PduRSrcPdu): PduRSourcePduHandleId=108, PduRSrcPduDirection=TRANSMIT, PduRSrcPduRef=TRSCM_FD_1_oFDCAN14_f3c79e86_Tx, PduRSrcPduPduRBswModulesRef=Com
          BRAKE_FD_4_oFDCAN14_89d3cd8b_Rx: PduRRoutingPathCommunicationType=COMMUNICATION_INTERFACE
            BRAKE_FD_4_oFDCAN14_89d3cd8b_Rx_3917797c_Rx (PduRDestPdu):
              PduRDestPduHandleId = 22
              PduRDestPduDirection = RECEIVE
              PduRDestPduRoutingType = API_FORWARDING
              PduRDestPduDataProcessing = IMMEDIATE
              PduRPduLengthHandlingStrategy = IGNORE
              PduRDestPduCrossPartitionDestination = false
              PduRTransmissionConfirmation = false
              PduRDestPduRef = BRAKE_FD_4_oFDCAN14_e4873fa9_Rx
              PduRDestPduPduRBswModulesRef = Com
            PduRSrcPdu_3917797c (PduRSrcPdu): PduRSourcePduHandleId=22, PduRSrcPduDirection=RECEIVE, PduRSrcPduRef=BRAKE_FD_4_oFDCAN14_89d3cd8b_Rx, PduRSrcPduPduRBswModulesRef=CanIf
          BRAKE_FD_2_oFDCAN14_358a904c_Rx: PduRRoutingPathCommunicationType=COMMUNICATION_INTERFACE
            PduRSrcPdu_9c687493 (PduRSrcPdu): PduRSourcePduHandleId=18, PduRSrcPduDirection=RECEIVE, PduRSrcPduRef=BRAKE_FD_2_oFDCAN14_358a904c_Rx, PduRSrcPduPduRBswModulesRef=CanIf
            BRAKE_FD_2_oFDCAN14_358a904c_Rx_9c687493_Rx (PduRDestPdu):
              PduRDestPduHandleId = 18
              PduRDestPduDirection = RECEIVE
              PduRDestPduRoutingType = API_FORWARDING
              PduRDestPduDataProcessing = IMMEDIATE
              PduRPduLengthHandlingStrategy = IGNORE
              PduRDestPduCrossPartitionDestination = false
              PduRTransmissionConfirmation = false
              PduRDestPduRef = BRAKE_FD_2_oFDCAN14_e9994fee_Rx
              PduRDestPduPduRBswModulesRef = Com
          PT_TORQUE_FD_1_oFDCAN14_0134da63_Rx: PduRRoutingPathCommunicationType=COMMUNICATION_INTERFACE
            PT_TORQUE_FD_1_oFDCAN14_0134da63_Rx_8efc5a15_Rx (PduRDestPdu):
              PduRDestPduHandleId = 51
              PduRDestPduDirection = RECEIVE
              PduRDestPduRoutingType = API_FORWARDING
              PduRDestPduDataProcessing = IMMEDIATE
              PduRPduLengthHandlingStrategy = IGNORE
              PduRDestPduCrossPartitionDestination = false
              PduRTransmissionConfirmation = false
              PduRDestPduRef = PT_TORQUE_FD_1_oFDCAN14_c23d259d_Rx
              PduRDestPduPduRBswModulesRef = Com
            PduRSrcPdu_8efc5a15 (PduRSrcPdu): PduRSourcePduHandleId=51, PduRSrcPduDirection=RECEIVE, PduRSrcPduRef=PT_TORQUE_FD_1_oFDCAN14_0134da63_Rx, PduRSrcPduPduRBswModulesRef=CanIf
          CVPAM_FD_Control_oFDCAN14_fab4999a_Tx: PduRRoutingPathCommunicationType=COMMUNICATION_INTERFACE
            CVPAM_FD_Control_oFDCAN14_8b1b60a1_Tx (PduRDestPdu):
              PduRDestPduHandleId = 7
              PduRDestPduDirection = TRANSMIT
              PduRDestPduRoutingType = API_FORWARDING
              PduRDestPduDataProcessing = IMMEDIATE
              PduRPduLengthHandlingStrategy = IGNORE
              PduRDestPduCrossPartitionDestination = false
              PduRDestPduDataProvision = PDUR_DIRECT
              PduRTransmissionConfirmation = false
              PduRDestPduRef = CVPAM_FD_Control_oFDCAN14_8b1b60a1_Tx
              PduRDestPduPduRBswModulesRef = CanIf
            PduRSrcPdu_e95b61d0 (PduRSrcPdu): PduRSourcePduHandleId=7, PduRSrcPduDirection=TRANSMIT, PduRSrcPduRef=CVPAM_FD_Control_oFDCAN14_fab4999a_Tx, PduRSrcPduPduRBswModulesRef=Com
          EPS_FD_1_oFDCAN14_1c675bff_Rx: PduRRoutingPathCommunicationType=COMMUNICATION_INTERFACE
            PduRSrcPdu_3c3be572 (PduRSrcPdu): PduRSourcePduHandleId=36, PduRSrcPduDirection=RECEIVE, PduRSrcPduRef=EPS_FD_1_oFDCAN14_1c675bff_Rx, PduRSrcPduPduRBswModulesRef=CanIf
            EPS_FD_1_oFDCAN14_1c675bff_Rx_3c3be572_Rx (PduRDestPdu):
              PduRDestPduHandleId = 36
              PduRDestPduDirection = RECEIVE
              PduRDestPduRoutingType = API_FORWARDING
              PduRDestPduDataProcessing = IMMEDIATE
              PduRPduLengthHandlingStrategy = IGNORE
              PduRDestPduCrossPartitionDestination = false
              PduRTransmissionConfirmation = false
              PduRDestPduRef = EPS_FD_1_oFDCAN14_8851a155_Rx
              PduRDestPduPduRBswModulesRef = Com
          ADAS_FD_LANES_1_oFDCAN2_2258c462_Tx: PduRRoutingPathCommunicationType=COMMUNICATION_INTERFACE
            PduRSrcPdu_b34a10e6 (PduRSrcPdu): PduRSourcePduHandleId=0, PduRSrcPduDirection=TRANSMIT, PduRSrcPduRef=ADAS_FD_LANES_1_oFDCAN2_2258c462_Tx, PduRSrcPduPduRBswModulesRef=Com
            ADAS_FD_LANES_1_oFDCAN2_671c0d83_Tx (PduRDestPdu):
              PduRDestPduHandleId = 0
              PduRDestPduDirection = TRANSMIT
              PduRDestPduRoutingType = API_FORWARDING
              PduRDestPduDataProcessing = IMMEDIATE
              PduRPduLengthHandlingStrategy = IGNORE
              PduRDestPduCrossPartitionDestination = false
              PduRDestPduDataProvision = PDUR_DIRECT
              PduRTransmissionConfirmation = false
              PduRDestPduRef = ADAS_FD_LANES_1_oFDCAN2_671c0d83_Tx
              PduRDestPduPduRBswModulesRef = CanIf
          ADAS_FD_LANES_1_oFDCAN14_7b05104b_Tx: PduRRoutingPathCommunicationType=COMMUNICATION_INTERFACE
            PduRSrcPdu_d8aac21d (PduRSrcPdu): PduRSourcePduHandleId=1, PduRSrcPduDirection=TRANSMIT, PduRSrcPduRef=ADAS_FD_LANES_1_oFDCAN14_7b05104b_Tx, PduRSrcPduPduRBswModulesRef=Com
            ADAS_FD_LANES_1_oFDCAN14_5807fbbf_Tx (PduRDestPdu):
              PduRDestPduHandleId = 1
              PduRDestPduDirection = TRANSMIT
              PduRDestPduRoutingType = API_FORWARDING
              PduRDestPduDataProcessing = IMMEDIATE
              PduRPduLengthHandlingStrategy = IGNORE
              PduRDestPduCrossPartitionDestination = false
              PduRDestPduDataProvision = PDUR_DIRECT
              PduRTransmissionConfirmation = false
              PduRDestPduRef = ADAS_FD_LANES_1_oFDCAN14_5807fbbf_Tx
              PduRDestPduPduRBswModulesRef = CanIf
          ADAS_FD_LANES_2_oFDCAN2_1bd5f8a7_Tx: PduRRoutingPathCommunicationType=COMMUNICATION_INTERFACE
            ADAS_FD_LANES_2_oFDCAN2_52f1bbd0_Tx (PduRDestPdu):
              PduRDestPduHandleId = 2
              PduRDestPduDirection = TRANSMIT
              PduRDestPduRoutingType = API_FORWARDING
              PduRDestPduDataProcessing = IMMEDIATE
              PduRPduLengthHandlingStrategy = IGNORE
              PduRDestPduCrossPartitionDestination = false
              PduRDestPduDataProvision = PDUR_DIRECT
              PduRTransmissionConfirmation = false
              PduRDestPduRef = ADAS_FD_LANES_2_oFDCAN2_52f1bbd0_Tx
              PduRDestPduPduRBswModulesRef = CanIf
            PduRSrcPdu_8e993e9d (PduRSrcPdu): PduRSourcePduHandleId=2, PduRSrcPduDirection=TRANSMIT, PduRSrcPduRef=ADAS_FD_LANES_2_oFDCAN2_1bd5f8a7_Tx, PduRSrcPduPduRBswModulesRef=Com
          BRAKE2_FD_1_oFDCAN14_e3eb706b_Rx: PduRRoutingPathCommunicationType=COMMUNICATION_INTERFACE
            BRAKE2_FD_1_oFDCAN14_e3eb706b_Rx_a31db230_Rx (PduRDestPdu):
              PduRDestPduHandleId = 14
              PduRDestPduDirection = RECEIVE
              PduRDestPduRoutingType = API_FORWARDING
              PduRDestPduDataProcessing = IMMEDIATE
              PduRPduLengthHandlingStrategy = IGNORE
              PduRDestPduCrossPartitionDestination = false
              PduRTransmissionConfirmation = false
              PduRDestPduRef = BRAKE2_FD_1_oFDCAN14_c96aaaae_Rx
              PduRDestPduPduRBswModulesRef = Com
            PduRSrcPdu_a31db230 (PduRSrcPdu): PduRSourcePduHandleId=14, PduRSrcPduDirection=RECEIVE, PduRSrcPduRef=BRAKE2_FD_1_oFDCAN14_e3eb706b_Rx, PduRSrcPduPduRBswModulesRef=CanIf
          ADAS_FD_LANES_2_oFDCAN14_9032ab48_Tx: PduRRoutingPathCommunicationType=COMMUNICATION_INTERFACE
            ADAS_FD_LANES_2_oFDCAN14_eb93d67c_Tx (PduRDestPdu):
              PduRDestPduHandleId = 3
              PduRDestPduDirection = TRANSMIT
              PduRDestPduRoutingType = API_FORWARDING
              PduRDestPduDataProcessing = IMMEDIATE
              PduRPduLengthHandlingStrategy = IGNORE
              PduRDestPduCrossPartitionDestination = false
              PduRDestPduDataProvision = PDUR_DIRECT
              PduRTransmissionConfirmation = false
              PduRDestPduRef = ADAS_FD_LANES_2_oFDCAN14_eb93d67c_Tx
              PduRDestPduPduRBswModulesRef = CanIf
            PduRSrcPdu_fb2e887f (PduRSrcPdu): PduRSourcePduHandleId=3, PduRSrcPduDirection=TRANSMIT, PduRSrcPduRef=ADAS_FD_LANES_2_oFDCAN14_9032ab48_Tx, PduRSrcPduPduRBswModulesRef=Com
          HMI_Curr_Requested_Overlays_oFDCAN14_2159e0ee_Tx: PduRRoutingPathCommunicationType=COMMUNICATION_INTERFACE
            PduRSrcPdu_f0d8d493 (PduRSrcPdu):
              PduRSourcePduHandleId = 54
              PduRSrcPduDirection = TRANSMIT
              PduRSrcPduRef = HMI_Curr_Requested_Overlays_oFDCAN14_2159e0ee_Tx
              PduRSrcPduPduRBswModulesRef = Com
            HMI_Curr_Requested_Overlays_oFDCAN14_854dec1c_Tx (PduRDestPdu):
              PduRDestPduHandleId = 51
              PduRDestPduDirection = TRANSMIT
              PduRDestPduRoutingType = API_FORWARDING
              PduRDestPduDataProcessing = IMMEDIATE
              PduRPduLengthHandlingStrategy = IGNORE
              PduRDestPduCrossPartitionDestination = false
              PduRDestPduDataProvision = PDUR_DIRECT
              PduRTransmissionConfirmation = false
              PduRDestPduRef = HMI_Curr_Requested_Overlays_oFDCAN14_854dec1c_Tx
              PduRDestPduPduRBswModulesRef = CanIf
          SetUSSParkingMode_oFDCAN14_bb071e4b_Rx: PduRRoutingPathCommunicationType=COMMUNICATION_INTERFACE
            SetUSSParkingMode_oFDCAN14_bb071e4b_Rx_b7893264_Rx (PduRDestPdu):
              PduRDestPduHandleId = 53
              PduRDestPduDirection = RECEIVE
              PduRDestPduRoutingType = API_FORWARDING
              PduRDestPduDataProcessing = IMMEDIATE
              PduRPduLengthHandlingStrategy = IGNORE
              PduRDestPduCrossPartitionDestination = false
              PduRTransmissionConfirmation = false
              PduRDestPduRef = SetUSSParkingMode_oFDCAN14_a3a751a8_Rx
              PduRDestPduPduRBswModulesRef = Com
            PduRSrcPdu_b7893264 (PduRSrcPdu): PduRSourcePduHandleId=53, PduRSrcPduDirection=RECEIVE, PduRSrcPduRef=SetUSSParkingMode_oFDCAN14_bb071e4b_Rx, PduRSrcPduPduRBswModulesRef=CanIf
          Firing_Sequence_oFDCAN14_b74930e6_Tx: PduRRoutingPathCommunicationType=COMMUNICATION_INTERFACE
            PduRSrcPdu_e80ef8c0 (PduRSrcPdu): PduRSourcePduHandleId=51, PduRSrcPduDirection=TRANSMIT, PduRSrcPduRef=Firing_Sequence_oFDCAN14_b74930e6_Tx, PduRSrcPduPduRBswModulesRef=Com
            Firing_Sequence_oFDCAN14_ae988165_Tx (PduRDestPdu):
              PduRDestPduHandleId = 48
              PduRDestPduDirection = TRANSMIT
              PduRDestPduRoutingType = API_FORWARDING
              PduRDestPduDataProcessing = IMMEDIATE
              PduRPduLengthHandlingStrategy = IGNORE
              PduRDestPduCrossPartitionDestination = false
              PduRDestPduDataProvision = PDUR_DIRECT
              PduRTransmissionConfirmation = true
              PduRDestPduRef = Firing_Sequence_oFDCAN14_ae988165_Tx
              PduRDestPduPduRBswModulesRef = CanIf
          PntDebugData_1_oFDCAN14_60c2d55a_Tx: PduRRoutingPathCommunicationType=COMMUNICATION_INTERFACE
            PduRSrcPdu_5cbdc88a (PduRSrcPdu): PduRSourcePduHandleId=102, PduRSrcPduDirection=TRANSMIT, PduRSrcPduRef=PntDebugData_1_oFDCAN14_60c2d55a_Tx, PduRSrcPduPduRBswModulesRef=Com
            PntDebugData_1_oFDCAN14_f6ddecc4_Tx (PduRDestPdu):
              PduRDestPduHandleId = 99
              PduRDestPduDirection = TRANSMIT
              PduRDestPduRoutingType = API_FORWARDING
              PduRDestPduDataProcessing = IMMEDIATE
              PduRPduLengthHandlingStrategy = IGNORE
              PduRDestPduCrossPartitionDestination = false
              PduRDestPduDataProvision = PDUR_DIRECT
              PduRTransmissionConfirmation = true
              PduRDestPduRef = PntDebugData_1_oFDCAN14_f6ddecc4_Tx
              PduRDestPduPduRBswModulesRef = CanIf
          Distance_Point_Map_2_oFDCAN14_5eb50b47_Tx: PduRRoutingPathCommunicationType=COMMUNICATION_INTERFACE
            Distance_Point_Map_2_oFDCAN14_ba04c112_Tx (PduRDestPdu):
              PduRDestPduHandleId = 34
              PduRDestPduDirection = TRANSMIT
              PduRDestPduRoutingType = API_FORWARDING
              PduRDestPduDataProcessing = IMMEDIATE
              PduRPduLengthHandlingStrategy = IGNORE
              PduRDestPduCrossPartitionDestination = false
              PduRDestPduDataProvision = PDUR_DIRECT
              PduRTransmissionConfirmation = true
              PduRDestPduRef = Distance_Point_Map_2_oFDCAN14_ba04c112_Tx
              PduRDestPduPduRBswModulesRef = CanIf
            PduRSrcPdu_ff0919c6 (PduRSrcPdu): PduRSourcePduHandleId=37, PduRSrcPduDirection=TRANSMIT, PduRSrcPduRef=Distance_Point_Map_2_oFDCAN14_5eb50b47_Tx, PduRSrcPduPduRBswModulesRef=Com
          Distance_Point_Map_0_oFDCAN14_5a40db7a_Tx: PduRRoutingPathCommunicationType=COMMUNICATION_INTERFACE
            Distance_Point_Map_0_oFDCAN14_671cf790_Tx (PduRDestPdu):
              PduRDestPduHandleId = 32
              PduRDestPduDirection = TRANSMIT
              PduRDestPduRoutingType = API_FORWARDING
              PduRDestPduDataProcessing = IMMEDIATE
              PduRPduLengthHandlingStrategy = IGNORE
              PduRDestPduCrossPartitionDestination = false
              PduRDestPduDataProvision = PDUR_DIRECT
              PduRTransmissionConfirmation = true
              PduRDestPduRef = Distance_Point_Map_0_oFDCAN14_671cf790_Tx
              PduRDestPduPduRBswModulesRef = CanIf
            PduRSrcPdu_ef46a1ae (PduRSrcPdu): PduRSourcePduHandleId=35, PduRSrcPduDirection=TRANSMIT, PduRSrcPduRef=Distance_Point_Map_0_oFDCAN14_5a40db7a_Tx, PduRSrcPduPduRBswModulesRef=Com
          Distance_Point_Map_5_oFDCAN14_bc69103e_Tx: PduRRoutingPathCommunicationType=COMMUNICATION_INTERFACE
            Distance_Point_Map_5_oFDCAN14_68d18794_Tx (PduRDestPdu):
              PduRDestPduHandleId = 37
              PduRDestPduDirection = TRANSMIT
              PduRDestPduRoutingType = API_FORWARDING
              PduRDestPduDataProcessing = IMMEDIATE
              PduRPduLengthHandlingStrategy = IGNORE
              PduRDestPduCrossPartitionDestination = false
              PduRDestPduDataProvision = PDUR_DIRECT
              PduRTransmissionConfirmation = true
              PduRDestPduRef = Distance_Point_Map_5_oFDCAN14_68d18794_Tx
              PduRDestPduPduRBswModulesRef = CanIf
            PduRSrcPdu_8a4f2322 (PduRSrcPdu): PduRSourcePduHandleId=40, PduRSrcPduDirection=TRANSMIT, PduRSrcPduRef=Distance_Point_Map_5_oFDCAN14_bc69103e_Tx, PduRSrcPduPduRBswModulesRef=Com
          TRSC_Debug_Message2_oFDCAN14_a140f4d3_Tx: PduRRoutingPathCommunicationType=COMMUNICATION_INTERFACE
            TRSC_Debug_Message2_oFDCAN14_2d74f152_Tx (PduRDestPdu):
              PduRDestPduHandleId = 107
              PduRDestPduDirection = TRANSMIT
              PduRDestPduRoutingType = API_FORWARDING
              PduRDestPduDataProcessing = IMMEDIATE
              PduRPduLengthHandlingStrategy = IGNORE
              PduRDestPduCrossPartitionDestination = false
              PduRDestPduDataProvision = PDUR_DIRECT
              PduRTransmissionConfirmation = true
              PduRDestPduRef = TRSC_Debug_Message2_oFDCAN14_2d74f152_Tx
              PduRDestPduPduRBswModulesRef = CanIf
            PduRSrcPdu_603bb742 (PduRSrcPdu): PduRSourcePduHandleId=110, PduRSrcPduDirection=TRANSMIT, PduRSrcPduRef=TRSC_Debug_Message2_oFDCAN14_a140f4d3_Tx, PduRSrcPduPduRBswModulesRef=Com
          DebugModelOutput_oFDCAN14_00a76e2b_Tx: PduRRoutingPathCommunicationType=COMMUNICATION_INTERFACE
            DebugModelOutput_oFDCAN14_1f951e1f_Tx (PduRDestPdu):
              PduRDestPduHandleId = 13
              PduRDestPduDirection = TRANSMIT
              PduRDestPduRoutingType = API_FORWARDING
              PduRDestPduDataProcessing = IMMEDIATE
              PduRPduLengthHandlingStrategy = IGNORE
              PduRDestPduCrossPartitionDestination = false
              PduRDestPduDataProvision = PDUR_DIRECT
              PduRTransmissionConfirmation = true
              PduRDestPduRef = DebugModelOutput_oFDCAN14_1f951e1f_Tx
              PduRDestPduPduRBswModulesRef = CanIf
            PduRSrcPdu_f01792f6 (PduRSrcPdu): PduRSourcePduHandleId=16, PduRSrcPduDirection=TRANSMIT, PduRSrcPduRef=DebugModelOutput_oFDCAN14_00a76e2b_Tx, PduRSrcPduPduRBswModulesRef=Com
          Debug_TargetData_oFDCAN14_de74b1f2_Tx: PduRRoutingPathCommunicationType=COMMUNICATION_INTERFACE
            Debug_TargetData_oFDCAN14_2a76e006_Tx (PduRDestPdu):
              PduRDestPduHandleId = 30
              PduRDestPduDirection = TRANSMIT
              PduRDestPduRoutingType = API_FORWARDING
              PduRDestPduDataProcessing = IMMEDIATE
              PduRPduLengthHandlingStrategy = IGNORE
              PduRDestPduCrossPartitionDestination = false
              PduRDestPduDataProvision = PDUR_DIRECT
              PduRTransmissionConfirmation = true
              PduRDestPduRef = Debug_TargetData_oFDCAN14_2a76e006_Tx
              PduRDestPduPduRBswModulesRef = CanIf
            PduRSrcPdu_9bc0124e (PduRSrcPdu): PduRSourcePduHandleId=33, PduRSrcPduDirection=TRANSMIT, PduRSrcPduRef=Debug_TargetData_oFDCAN14_de74b1f2_Tx, PduRSrcPduPduRBswModulesRef=Com
          Debug_FeatureCollection_oFDCAN14_c41747ae_Tx: PduRRoutingPathCommunicationType=COMMUNICATION_INTERFACE
            Debug_FeatureCollection_oFDCAN14_c2b58aba_Tx (PduRDestPdu):
              PduRDestPduHandleId = 21
              PduRDestPduDirection = TRANSMIT
              PduRDestPduRoutingType = API_FORWARDING
              PduRDestPduDataProcessing = IMMEDIATE
              PduRPduLengthHandlingStrategy = IGNORE
              PduRDestPduCrossPartitionDestination = false
              PduRDestPduDataProvision = PDUR_DIRECT
              PduRTransmissionConfirmation = true
              PduRDestPduRef = Debug_FeatureCollection_oFDCAN14_c2b58aba_Tx
              PduRDestPduPduRBswModulesRef = CanIf
            PduRSrcPdu_d27a4076 (PduRSrcPdu):
              PduRSourcePduHandleId = 24
              PduRSrcPduDirection = TRANSMIT
              PduRSrcPduRef = Debug_FeatureCollection_oFDCAN14_c41747ae_Tx
              PduRSrcPduPduRBswModulesRef = Com
          MOT_Obj_0_1_oFDCAN14_7e1d9089_Tx: PduRRoutingPathCommunicationType=COMMUNICATION_INTERFACE
            MOT_Obj_0_1_oFDCAN14_38441535_Tx (PduRDestPdu):
              PduRDestPduHandleId = 87
              PduRDestPduDirection = TRANSMIT
              PduRDestPduRoutingType = API_FORWARDING
              PduRDestPduDataProcessing = IMMEDIATE
              PduRPduLengthHandlingStrategy = IGNORE
              PduRDestPduCrossPartitionDestination = false
              PduRDestPduDataProvision = PDUR_DIRECT
              PduRTransmissionConfirmation = true
              PduRDestPduRef = MOT_Obj_0_1_oFDCAN14_38441535_Tx
              PduRDestPduPduRBswModulesRef = CanIf
            PduRSrcPdu_e5b1c164 (PduRSrcPdu): PduRSourcePduHandleId=90, PduRSrcPduDirection=TRANSMIT, PduRSrcPduRef=MOT_Obj_0_1_oFDCAN14_7e1d9089_Tx, PduRSrcPduPduRBswModulesRef=Com
          TRSC_Debug_Message3_oFDCAN14_4e829fed_Tx: PduRRoutingPathCommunicationType=COMMUNICATION_INTERFACE
            TRSC_Debug_Message3_oFDCAN14_43f8ea13_Tx (PduRDestPdu):
              PduRDestPduHandleId = 108
              PduRDestPduDirection = TRANSMIT
              PduRDestPduRoutingType = API_FORWARDING
              PduRDestPduDataProcessing = IMMEDIATE
              PduRPduLengthHandlingStrategy = IGNORE
              PduRDestPduCrossPartitionDestination = false
              PduRDestPduDataProvision = PDUR_DIRECT
              PduRTransmissionConfirmation = true
              PduRDestPduRef = TRSC_Debug_Message3_oFDCAN14_43f8ea13_Tx
              PduRDestPduPduRBswModulesRef = CanIf
            PduRSrcPdu_95755eb6 (PduRSrcPdu): PduRSourcePduHandleId=111, PduRSrcPduDirection=TRANSMIT, PduRSrcPduRef=TRSC_Debug_Message3_oFDCAN14_4e829fed_Tx, PduRSrcPduPduRBswModulesRef=Com
          Log_SnrMeasData_06_oFDCAN14_792fb649_Tx: PduRRoutingPathCommunicationType=COMMUNICATION_INTERFACE
            Log_SnrMeasData_06_oFDCAN14_9acc1330_Tx (PduRDestPdu):
              PduRDestPduHandleId = 67
              PduRDestPduDirection = TRANSMIT
              PduRDestPduRoutingType = API_FORWARDING
              PduRDestPduDataProcessing = IMMEDIATE
              PduRPduLengthHandlingStrategy = IGNORE
              PduRDestPduCrossPartitionDestination = false
              PduRDestPduDataProvision = PDUR_DIRECT
              PduRTransmissionConfirmation = true
              PduRDestPduRef = Log_SnrMeasData_06_oFDCAN14_9acc1330_Tx
              PduRDestPduPduRBswModulesRef = CanIf
            PduRSrcPdu_6a3bdec4 (PduRSrcPdu):
              PduRSourcePduHandleId = 70
              PduRSrcPduDirection = TRANSMIT
              PduRSrcPduRef = Log_SnrMeasData_06_oFDCAN14_792fb649_Tx
              PduRSrcPduPduRBswModulesRef = Cdd_UssLog
          Distance_Point_Map_3_oFDCAN14_b1776079_Tx: PduRRoutingPathCommunicationType=COMMUNICATION_INTERFACE
            Distance_Point_Map_3_oFDCAN14_d488da53_Tx (PduRDestPdu):
              PduRDestPduHandleId = 35
              PduRDestPduDirection = TRANSMIT
              PduRDestPduRoutingType = API_FORWARDING
              PduRDestPduDataProcessing = IMMEDIATE
              PduRPduLengthHandlingStrategy = IGNORE
              PduRDestPduCrossPartitionDestination = false
              PduRDestPduDataProvision = PDUR_DIRECT
              PduRTransmissionConfirmation = true
              PduRDestPduRef = Distance_Point_Map_3_oFDCAN14_d488da53_Tx
              PduRDestPduPduRBswModulesRef = CanIf
            PduRSrcPdu_f65201f2 (PduRSrcPdu): PduRSourcePduHandleId=38, PduRSrcPduDirection=TRANSMIT, PduRSrcPduRef=Distance_Point_Map_3_oFDCAN14_b1776079_Tx, PduRSrcPduPduRBswModulesRef=Com
          Debug_EOLCalib_Data_1_oFDCAN14_ced31c72_Tx: PduRRoutingPathCommunicationType=COMMUNICATION_INTERFACE
            PduRSrcPdu_e8988ff7 (PduRSrcPdu): PduRSourcePduHandleId=20, PduRSrcPduDirection=TRANSMIT, PduRSrcPduRef=Debug_EOLCalib_Data_1_oFDCAN14_ced31c72_Tx, PduRSrcPduPduRBswModulesRef=Com
            Debug_EOLCalib_Data_1_oFDCAN14_e983026d_Tx (PduRDestPdu):
              PduRDestPduHandleId = 17
              PduRDestPduDirection = TRANSMIT
              PduRDestPduRoutingType = API_FORWARDING
              PduRDestPduDataProcessing = IMMEDIATE
              PduRPduLengthHandlingStrategy = IGNORE
              PduRDestPduCrossPartitionDestination = false
              PduRDestPduDataProvision = PDUR_DIRECT
              PduRTransmissionConfirmation = true
              PduRDestPduRef = Debug_EOLCalib_Data_1_oFDCAN14_e983026d_Tx
              PduRDestPduPduRBswModulesRef = CanIf
          Log_SnrMeasData_05_oFDCAN14_92180d4a_Tx: PduRRoutingPathCommunicationType=COMMUNICATION_INTERFACE
            Log_SnrMeasData_05_oFDCAN14_29583ef3_Tx (PduRDestPdu):
              PduRDestPduHandleId = 66
              PduRDestPduDirection = TRANSMIT
              PduRDestPduRoutingType = API_FORWARDING
              PduRDestPduDataProcessing = IMMEDIATE
              PduRPduLengthHandlingStrategy = IGNORE
              PduRDestPduCrossPartitionDestination = false
              PduRDestPduDataProvision = PDUR_DIRECT
              PduRTransmissionConfirmation = true
              PduRDestPduRef = Log_SnrMeasData_05_oFDCAN14_29583ef3_Tx
              PduRDestPduPduRBswModulesRef = CanIf
            PduRSrcPdu_7b41086b (PduRSrcPdu):
              PduRSourcePduHandleId = 69
              PduRSrcPduDirection = TRANSMIT
              PduRSrcPduRef = Log_SnrMeasData_05_oFDCAN14_92180d4a_Tx
              PduRSrcPduPduRBswModulesRef = Cdd_UssLog
          Debug_CalibSts_oFDCAN14_5de91463_Tx: PduRRoutingPathCommunicationType=COMMUNICATION_INTERFACE
            PduRSrcPdu_46a165ae (PduRSrcPdu): PduRSourcePduHandleId=18, PduRSrcPduDirection=TRANSMIT, PduRSrcPduRef=Debug_CalibSts_oFDCAN14_5de91463_Tx, PduRSrcPduPduRBswModulesRef=Com
            Debug_CalibSts_oFDCAN14_386fe58e_Tx (PduRDestPdu):
              PduRDestPduHandleId = 15
              PduRDestPduDirection = TRANSMIT
              PduRDestPduRoutingType = API_FORWARDING
              PduRDestPduDataProcessing = IMMEDIATE
              PduRPduLengthHandlingStrategy = IGNORE
              PduRDestPduCrossPartitionDestination = false
              PduRDestPduDataProvision = PDUR_DIRECT
              PduRTransmissionConfirmation = true
              PduRDestPduRef = Debug_CalibSts_oFDCAN14_386fe58e_Tx
              PduRDestPduPduRBswModulesRef = CanIf
          Debug_NFCD_Obj_0_4_oFDCAN14_839692dc_Tx: PduRRoutingPathCommunicationType=COMMUNICATION_INTERFACE
            PduRSrcPdu_ac70e828 (PduRSrcPdu): PduRSourcePduHandleId=29, PduRSrcPduDirection=TRANSMIT, PduRSrcPduRef=Debug_NFCD_Obj_0_4_oFDCAN14_839692dc_Tx, PduRSrcPduPduRBswModulesRef=Com
            Debug_NFCD_Obj_0_4_oFDCAN14_4fc85aea_Tx (PduRDestPdu):
              PduRDestPduHandleId = 26
              PduRDestPduDirection = TRANSMIT
              PduRDestPduRoutingType = API_FORWARDING
              PduRDestPduDataProcessing = IMMEDIATE
              PduRPduLengthHandlingStrategy = IGNORE
              PduRDestPduCrossPartitionDestination = false
              PduRDestPduDataProvision = PDUR_DIRECT
              PduRTransmissionConfirmation = true
              PduRDestPduRef = Debug_NFCD_Obj_0_4_oFDCAN14_4fc85aea_Tx
              PduRDestPduPduRBswModulesRef = CanIf
          LMD_SegmentDebug_1_oFDCAN14_bff9c431_Tx: PduRRoutingPathCommunicationType=COMMUNICATION_INTERFACE
            LMD_SegmentDebug_1_oFDCAN14_98429779_Tx (PduRDestPdu):
              PduRDestPduHandleId = 56
              PduRDestPduDirection = TRANSMIT
              PduRDestPduRoutingType = API_FORWARDING
              PduRDestPduDataProcessing = IMMEDIATE
              PduRPduLengthHandlingStrategy = IGNORE
              PduRDestPduCrossPartitionDestination = false
              PduRDestPduDataProvision = PDUR_DIRECT
              PduRTransmissionConfirmation = true
              PduRDestPduRef = LMD_SegmentDebug_1_oFDCAN14_98429779_Tx
              PduRDestPduPduRBswModulesRef = CanIf
            PduRSrcPdu_098444c3 (PduRSrcPdu): PduRSourcePduHandleId=59, PduRSrcPduDirection=TRANSMIT, PduRSrcPduRef=LMD_SegmentDebug_1_oFDCAN14_bff9c431_Tx, PduRSrcPduPduRBswModulesRef=Com
          LMD_SegmentDebug_2_2_oFDCAN14_ab533d87_Tx: PduRRoutingPathCommunicationType=COMMUNICATION_INTERFACE
            LMD_SegmentDebug_2_2_oFDCAN14_3cbb1069_Tx (PduRDestPdu):
              PduRDestPduHandleId = 58
              PduRDestPduDirection = TRANSMIT
              PduRDestPduRoutingType = API_FORWARDING
              PduRDestPduDataProcessing = IMMEDIATE
              PduRPduLengthHandlingStrategy = IGNORE
              PduRDestPduCrossPartitionDestination = false
              PduRDestPduDataProvision = PDUR_DIRECT
              PduRTransmissionConfirmation = true
              PduRDestPduRef = LMD_SegmentDebug_2_2_oFDCAN14_3cbb1069_Tx
              PduRDestPduPduRBswModulesRef = CanIf
            PduRSrcPdu_51493f0c (PduRSrcPdu): PduRSourcePduHandleId=61, PduRSrcPduDirection=TRANSMIT, PduRSrcPduRef=LMD_SegmentDebug_2_2_oFDCAN14_ab533d87_Tx, PduRSrcPduPduRBswModulesRef=Com
          Minimum_Sensor_Distance_2_oFDCAN14_2c87ab2a_Tx: PduRRoutingPathCommunicationType=COMMUNICATION_INTERFACE
            Minimum_Sensor_Distance_2_oFDCAN14_ffbdc42f_Tx (PduRDestPdu):
              PduRDestPduHandleId = 93
              PduRDestPduDirection = TRANSMIT
              PduRDestPduRoutingType = API_FORWARDING
              PduRDestPduDataProcessing = IMMEDIATE
              PduRPduLengthHandlingStrategy = IGNORE
              PduRDestPduCrossPartitionDestination = false
              PduRDestPduDataProvision = PDUR_DIRECT
              PduRTransmissionConfirmation = true
              PduRDestPduRef = Minimum_Sensor_Distance_2_oFDCAN14_ffbdc42f_Tx
              PduRDestPduPduRBswModulesRef = CanIf
            PduRSrcPdu_dadc8b69 (PduRSrcPdu):
              PduRSourcePduHandleId = 96
              PduRSrcPduDirection = TRANSMIT
              PduRSrcPduRef = Minimum_Sensor_Distance_2_oFDCAN14_2c87ab2a_Tx
              PduRSrcPduPduRBswModulesRef = Com
          USSDebugInfo2_oFDCAN14_72022366_Tx: PduRRoutingPathCommunicationType=COMMUNICATION_INTERFACE
            PduRSrcPdu_f900a90f (PduRSrcPdu): PduRSourcePduHandleId=115, PduRSrcPduDirection=TRANSMIT, PduRSrcPduRef=USSDebugInfo2_oFDCAN14_72022366_Tx, PduRSrcPduPduRBswModulesRef=Com
            USSDebugInfo2_oFDCAN14_899d6b1c_Tx (PduRDestPdu):
              PduRDestPduHandleId = 112
              PduRDestPduDirection = TRANSMIT
              PduRDestPduRoutingType = API_FORWARDING
              PduRDestPduDataProcessing = IMMEDIATE
              PduRPduLengthHandlingStrategy = IGNORE
              PduRDestPduCrossPartitionDestination = false
              PduRDestPduDataProvision = PDUR_DIRECT
              PduRTransmissionConfirmation = true
              PduRDestPduRef = USSDebugInfo2_oFDCAN14_899d6b1c_Tx
              PduRDestPduPduRBswModulesRef = CanIf
          HMI_Curr_Displayed_Overlays_oFDCAN14_7030d45b_Tx: PduRRoutingPathCommunicationType=COMMUNICATION_INTERFACE
            HMI_Curr_Displayed_Overlays_oFDCAN14_59fc11fc_Tx (PduRDestPdu):
              PduRDestPduHandleId = 49
              PduRDestPduDirection = TRANSMIT
              PduRDestPduRoutingType = API_FORWARDING
              PduRDestPduDataProcessing = IMMEDIATE
              PduRPduLengthHandlingStrategy = IGNORE
              PduRDestPduCrossPartitionDestination = false
              PduRDestPduDataProvision = PDUR_DIRECT
              PduRTransmissionConfirmation = true
              PduRDestPduRef = HMI_Curr_Displayed_Overlays_oFDCAN14_59fc11fc_Tx
              PduRDestPduPduRBswModulesRef = CanIf
            PduRSrcPdu_a61fa37b (PduRSrcPdu):
              PduRSourcePduHandleId = 52
              PduRSrcPduDirection = TRANSMIT
              PduRSrcPduRef = HMI_Curr_Displayed_Overlays_oFDCAN14_7030d45b_Tx
              PduRSrcPduPduRBswModulesRef = Com
          Diagnostics_Flags_oFDCAN14_e99d3c05_Tx: PduRRoutingPathCommunicationType=COMMUNICATION_INTERFACE
            Diagnostics_Flags_oFDCAN14_35bb7a38_Tx (PduRDestPdu):
              PduRDestPduHandleId = 31
              PduRDestPduDirection = TRANSMIT
              PduRDestPduRoutingType = API_FORWARDING
              PduRDestPduDataProcessing = IMMEDIATE
              PduRPduLengthHandlingStrategy = IGNORE
              PduRDestPduCrossPartitionDestination = false
              PduRDestPduDataProvision = PDUR_DIRECT
              PduRTransmissionConfirmation = true
              PduRDestPduRef = Diagnostics_Flags_oFDCAN14_35bb7a38_Tx
              PduRDestPduPduRBswModulesRef = CanIf
            PduRSrcPdu_55fe29ee (PduRSrcPdu): PduRSourcePduHandleId=34, PduRSrcPduDirection=TRANSMIT, PduRSrcPduRef=Diagnostics_Flags_oFDCAN14_e99d3c05_Tx, PduRSrcPduPduRBswModulesRef=Com
          Debug_NFCD_Obj_5_9_oFDCAN14_eecb6e7c_Tx: PduRRoutingPathCommunicationType=COMMUNICATION_INTERFACE
            Debug_NFCD_Obj_5_9_oFDCAN14_b6ee4791_Tx (PduRDestPdu):
              PduRDestPduHandleId = 27
              PduRDestPduDirection = TRANSMIT
              PduRDestPduRoutingType = API_FORWARDING
              PduRDestPduDataProcessing = IMMEDIATE
              PduRPduLengthHandlingStrategy = IGNORE
              PduRDestPduCrossPartitionDestination = false
              PduRDestPduDataProvision = PDUR_DIRECT
              PduRTransmissionConfirmation = true
              PduRDestPduRef = Debug_NFCD_Obj_5_9_oFDCAN14_b6ee4791_Tx
              PduRDestPduPduRBswModulesRef = CanIf
            PduRSrcPdu_1fd96fd5 (PduRSrcPdu): PduRSourcePduHandleId=30, PduRSrcPduDirection=TRANSMIT, PduRSrcPduRef=Debug_NFCD_Obj_5_9_oFDCAN14_eecb6e7c_Tx, PduRSrcPduPduRBswModulesRef=Com
          HMI_Curr_Requested_ProxiConfig_oFDCAN14_15e9b9db_Tx: PduRRoutingPathCommunicationType=COMMUNICATION_INTERFACE
            PduRSrcPdu_d5379018 (PduRSrcPdu):
              PduRSourcePduHandleId = 55
              PduRSrcPduDirection = TRANSMIT
              PduRSrcPduRef = HMI_Curr_Requested_ProxiConfig_oFDCAN14_15e9b9db_Tx
              PduRSrcPduPduRBswModulesRef = Com
            HMI_Curr_Requested_ProxiConfig_oFDCAN14_6d69f768_Tx (PduRDestPdu):
              PduRDestPduHandleId = 52
              PduRDestPduDirection = TRANSMIT
              PduRDestPduRoutingType = API_FORWARDING
              PduRDestPduDataProcessing = IMMEDIATE
              PduRPduLengthHandlingStrategy = IGNORE
              PduRDestPduCrossPartitionDestination = false
              PduRDestPduDataProvision = PDUR_DIRECT
              PduRTransmissionConfirmation = true
              PduRDestPduRef = HMI_Curr_Requested_ProxiConfig_oFDCAN14_6d69f768_Tx
              PduRDestPduPduRBswModulesRef = CanIf
          LMD_LaneLinesDebug_2_oFDCAN14_53848e56_Tx: PduRRoutingPathCommunicationType=COMMUNICATION_INTERFACE
            LMD_LaneLinesDebug_2_oFDCAN14_cef1a9ac_Tx (PduRDestPdu):
              PduRDestPduHandleId = 54
              PduRDestPduDirection = TRANSMIT
              PduRDestPduRoutingType = API_FORWARDING
              PduRDestPduDataProcessing = IMMEDIATE
              PduRPduLengthHandlingStrategy = IGNORE
              PduRDestPduCrossPartitionDestination = false
              PduRDestPduDataProvision = PDUR_DIRECT
              PduRTransmissionConfirmation = true
              PduRDestPduRef = LMD_LaneLinesDebug_2_oFDCAN14_cef1a9ac_Tx
              PduRDestPduPduRBswModulesRef = CanIf
            PduRSrcPdu_2c9622aa (PduRSrcPdu): PduRSourcePduHandleId=57, PduRSrcPduDirection=TRANSMIT, PduRSrcPduRef=LMD_LaneLinesDebug_2_oFDCAN14_53848e56_Tx, PduRSrcPduPduRBswModulesRef=Com
          Distance_Point_Map_4_oFDCAN14_53ab7b00_Tx: PduRRoutingPathCommunicationType=COMMUNICATION_INTERFACE
            PduRSrcPdu_f26cd3a4 (PduRSrcPdu): PduRSourcePduHandleId=39, PduRSrcPduDirection=TRANSMIT, PduRSrcPduRef=Distance_Point_Map_4_oFDCAN14_53ab7b00_Tx, PduRSrcPduPduRBswModulesRef=Com
            Distance_Point_Map_4_oFDCAN14_065d9cd5_Tx (PduRDestPdu):
              PduRDestPduHandleId = 36
              PduRDestPduDirection = TRANSMIT
              PduRDestPduRoutingType = API_FORWARDING
              PduRDestPduDataProcessing = IMMEDIATE
              PduRPduLengthHandlingStrategy = IGNORE
              PduRDestPduCrossPartitionDestination = false
              PduRDestPduDataProvision = PDUR_DIRECT
              PduRTransmissionConfirmation = true
              PduRDestPduRef = Distance_Point_Map_4_oFDCAN14_065d9cd5_Tx
              PduRDestPduPduRBswModulesRef = CanIf
          ME_DebugMsgSigned_oFDCAN14_128e3dcd_Tx: PduRRoutingPathCommunicationType=COMMUNICATION_INTERFACE
            PduRSrcPdu_e0b39384 (PduRSrcPdu): PduRSourcePduHandleId=73, PduRSrcPduDirection=TRANSMIT, PduRSrcPduRef=ME_DebugMsgSigned_oFDCAN14_128e3dcd_Tx, PduRSrcPduPduRBswModulesRef=Com
            ME_DebugMsgSigned_oFDCAN14_e9329857_Tx (PduRDestPdu):
              PduRDestPduHandleId = 70
              PduRDestPduDirection = TRANSMIT
              PduRDestPduRoutingType = API_FORWARDING
              PduRDestPduDataProcessing = IMMEDIATE
              PduRPduLengthHandlingStrategy = IGNORE
              PduRDestPduCrossPartitionDestination = false
              PduRDestPduDataProvision = PDUR_DIRECT
              PduRTransmissionConfirmation = true
              PduRDestPduRef = ME_DebugMsgSigned_oFDCAN14_e9329857_Tx
              PduRDestPduPduRBswModulesRef = CanIf
          Distance_Point_Map_1_oFDCAN14_b582b044_Tx: PduRRoutingPathCommunicationType=COMMUNICATION_INTERFACE
            PduRSrcPdu_24e0c614 (PduRSrcPdu): PduRSourcePduHandleId=36, PduRSrcPduDirection=TRANSMIT, PduRSrcPduRef=Distance_Point_Map_1_oFDCAN14_b582b044_Tx, PduRSrcPduPduRBswModulesRef=Com
            Distance_Point_Map_1_oFDCAN14_0990ecd1_Tx (PduRDestPdu):
              PduRDestPduHandleId = 33
              PduRDestPduDirection = TRANSMIT
              PduRDestPduRoutingType = API_FORWARDING
              PduRDestPduDataProcessing = IMMEDIATE
              PduRPduLengthHandlingStrategy = IGNORE
              PduRDestPduCrossPartitionDestination = false
              PduRDestPduDataProvision = PDUR_DIRECT
              PduRTransmissionConfirmation = true
              PduRDestPduRef = Distance_Point_Map_1_oFDCAN14_0990ecd1_Tx
              PduRDestPduPduRBswModulesRef = CanIf
          Minimum_Sensor_Distance_1_oFDCAN14_c7b01029_Tx: PduRRoutingPathCommunicationType=COMMUNICATION_INTERFACE
            PduRSrcPdu_6bf8a708 (PduRSrcPdu):
              PduRSourcePduHandleId = 95
              PduRSrcPduDirection = TRANSMIT
              PduRSrcPduRef = Minimum_Sensor_Distance_1_oFDCAN14_c7b01029_Tx
              PduRSrcPduPduRBswModulesRef = Com
            Minimum_Sensor_Distance_1_oFDCAN14_4c29e9ec_Tx (PduRDestPdu):
              PduRDestPduHandleId = 92
              PduRDestPduDirection = TRANSMIT
              PduRDestPduRoutingType = API_FORWARDING
              PduRDestPduDataProcessing = IMMEDIATE
              PduRPduLengthHandlingStrategy = IGNORE
              PduRDestPduCrossPartitionDestination = false
              PduRDestPduDataProvision = PDUR_DIRECT
              PduRTransmissionConfirmation = true
              PduRDestPduRef = Minimum_Sensor_Distance_1_oFDCAN14_4c29e9ec_Tx
              PduRDestPduPduRBswModulesRef = CanIf
          MOT_Obj_4_5_oFDCAN14_74f00b8c_Tx: PduRRoutingPathCommunicationType=COMMUNICATION_INTERFACE
            MOT_Obj_4_5_oFDCAN14_0e6b1ca1_Tx (PduRDestPdu):
              PduRDestPduHandleId = 89
              PduRDestPduDirection = TRANSMIT
              PduRDestPduRoutingType = API_FORWARDING
              PduRDestPduDataProcessing = IMMEDIATE
              PduRPduLengthHandlingStrategy = IGNORE
              PduRDestPduCrossPartitionDestination = false
              PduRDestPduDataProvision = PDUR_DIRECT
              PduRTransmissionConfirmation = true
              PduRDestPduRef = MOT_Obj_4_5_oFDCAN14_0e6b1ca1_Tx
              PduRDestPduPduRBswModulesRef = CanIf
            PduRSrcPdu_31f1f327 (PduRSrcPdu): PduRSourcePduHandleId=92, PduRSrcPduDirection=TRANSMIT, PduRSrcPduRef=MOT_Obj_4_5_oFDCAN14_74f00b8c_Tx, PduRSrcPduPduRBswModulesRef=Com
          Log_SnrMeasData_03_oFDCAN14_9f067d0d_Tx: PduRRoutingPathCommunicationType=COMMUNICATION_INTERFACE
            Log_SnrMeasData_03_oFDCAN14_95016334_Tx (PduRDestPdu):
              PduRDestPduHandleId = 64
              PduRDestPduDirection = TRANSMIT
              PduRDestPduRoutingType = API_FORWARDING
              PduRDestPduDataProcessing = IMMEDIATE
              PduRPduLengthHandlingStrategy = IGNORE
              PduRDestPduCrossPartitionDestination = false
              PduRDestPduDataProvision = PDUR_DIRECT
              PduRTransmissionConfirmation = true
              PduRDestPduRef = Log_SnrMeasData_03_oFDCAN14_95016334_Tx
              PduRDestPduPduRBswModulesRef = CanIf
            PduRSrcPdu_bc471ad4 (PduRSrcPdu):
              PduRSourcePduHandleId = 67
              PduRSrcPduDirection = TRANSMIT
              PduRSrcPduRef = Log_SnrMeasData_03_oFDCAN14_9f067d0d_Tx
              PduRSrcPduPduRBswModulesRef = Cdd_UssLog
          Distance_Point_Map_9_oFDCAN14_a655f0b0_Tx: PduRRoutingPathCommunicationType=COMMUNICATION_INTERFACE
            Distance_Point_Map_9_oFDCAN14_cb123a5b_Tx (PduRDestPdu):
              PduRDestPduHandleId = 41
              PduRDestPduDirection = TRANSMIT
              PduRDestPduRoutingType = API_FORWARDING
              PduRDestPduDataProcessing = IMMEDIATE
              PduRPduLengthHandlingStrategy = IGNORE
              PduRDestPduCrossPartitionDestination = false
              PduRDestPduDataProvision = PDUR_DIRECT
              PduRTransmissionConfirmation = true
              PduRDestPduRef = Distance_Point_Map_9_oFDCAN14_cb123a5b_Tx
              PduRDestPduPduRBswModulesRef = CanIf
            PduRSrcPdu_d8825a77 (PduRSrcPdu): PduRSourcePduHandleId=44, PduRSrcPduDirection=TRANSMIT, PduRSrcPduRef=Distance_Point_Map_9_oFDCAN14_a655f0b0_Tx, PduRSrcPduPduRBswModulesRef=Com
          Debug_OCCalib_Data_oFDCAN14_81599a4c_Tx: PduRRoutingPathCommunicationType=COMMUNICATION_INTERFACE
            Debug_OCCalib_Data_oFDCAN14_a09c1bc6_Tx (PduRDestPdu):
              PduRDestPduHandleId = 28
              PduRDestPduDirection = TRANSMIT
              PduRDestPduRoutingType = API_FORWARDING
              PduRDestPduDataProcessing = IMMEDIATE
              PduRPduLengthHandlingStrategy = IGNORE
              PduRDestPduCrossPartitionDestination = false
              PduRDestPduDataProvision = PDUR_DIRECT
              PduRTransmissionConfirmation = true
              PduRDestPduRef = Debug_OCCalib_Data_oFDCAN14_a09c1bc6_Tx
              PduRDestPduPduRBswModulesRef = CanIf
            PduRSrcPdu_54c672cc (PduRSrcPdu): PduRSourcePduHandleId=31, PduRSrcPduDirection=TRANSMIT, PduRSrcPduRef=Debug_OCCalib_Data_oFDCAN14_81599a4c_Tx, PduRSrcPduPduRBswModulesRef=Com
          HMI_Curr_Displayed_ProxiConfig_oFDCAN14_5938af7a_Tx: PduRRoutingPathCommunicationType=COMMUNICATION_INTERFACE
            PduRSrcPdu_3e6363a7 (PduRSrcPdu):
              PduRSourcePduHandleId = 53
              PduRSrcPduDirection = TRANSMIT
              PduRSrcPduRef = HMI_Curr_Displayed_ProxiConfig_oFDCAN14_5938af7a_Tx
              PduRSrcPduPduRBswModulesRef = Com
            HMI_Curr_Displayed_ProxiConfig_oFDCAN14_d9ff3bfe_Tx (PduRDestPdu):
              PduRDestPduHandleId = 50
              PduRDestPduDirection = TRANSMIT
              PduRDestPduRoutingType = API_FORWARDING
              PduRDestPduDataProcessing = IMMEDIATE
              PduRPduLengthHandlingStrategy = IGNORE
              PduRDestPduCrossPartitionDestination = false
              PduRDestPduDataProvision = PDUR_DIRECT
              PduRTransmissionConfirmation = true
              PduRDestPduRef = HMI_Curr_Displayed_ProxiConfig_oFDCAN14_d9ff3bfe_Tx
              PduRDestPduPduRBswModulesRef = CanIf
          USS_SectorInfoFB_oFDCAN14_4d009437_Tx: PduRRoutingPathCommunicationType=COMMUNICATION_INTERFACE
            PduRSrcPdu_69d38c9c (PduRSrcPdu): PduRSourcePduHandleId=116, PduRSrcPduDirection=TRANSMIT, PduRSrcPduRef=USS_SectorInfoFB_oFDCAN14_4d009437_Tx, PduRSrcPduPduRBswModulesRef=Com
            USS_SectorInfoFB_oFDCAN14_41f44d67_Tx (PduRDestPdu):
              PduRDestPduHandleId = 113
              PduRDestPduDirection = TRANSMIT
              PduRDestPduRoutingType = API_FORWARDING
              PduRDestPduDataProcessing = IMMEDIATE
              PduRPduLengthHandlingStrategy = IGNORE
              PduRDestPduCrossPartitionDestination = false
              PduRDestPduDataProvision = PDUR_DIRECT
              PduRTransmissionConfirmation = true
              PduRDestPduRef = USS_SectorInfoFB_oFDCAN14_41f44d67_Tx
              PduRDestPduPduRBswModulesRef = CanIf
          Minimum_Sensor_Distance_3_oFDCAN14_c345c014_Tx: PduRRoutingPathCommunicationType=COMMUNICATION_INTERFACE
            Minimum_Sensor_Distance_3_oFDCAN14_9131df6e_Tx (PduRDestPdu):
              PduRDestPduHandleId = 94
              PduRDestPduDirection = TRANSMIT
              PduRDestPduRoutingType = API_FORWARDING
              PduRDestPduDataProcessing = IMMEDIATE
              PduRPduLengthHandlingStrategy = IGNORE
              PduRDestPduCrossPartitionDestination = false
              PduRDestPduDataProvision = PDUR_DIRECT
              PduRTransmissionConfirmation = true
              PduRDestPduRef = Minimum_Sensor_Distance_3_oFDCAN14_9131df6e_Tx
              PduRDestPduPduRBswModulesRef = CanIf
            PduRSrcPdu_046ba2f9 (PduRSrcPdu):
              PduRSourcePduHandleId = 97
              PduRSrcPduDirection = TRANSMIT
              PduRSrcPduRef = Minimum_Sensor_Distance_3_oFDCAN14_c345c014_Tx
              PduRSrcPduPduRBswModulesRef = Com
          PntDebugData_3_oFDCAN14_64370567_Tx: PduRRoutingPathCommunicationType=COMMUNICATION_INTERFACE
            PntDebugData_3_oFDCAN14_2bc5da46_Tx (PduRDestPdu):
              PduRDestPduHandleId = 101
              PduRDestPduDirection = TRANSMIT
              PduRDestPduRoutingType = API_FORWARDING
              PduRDestPduDataProcessing = IMMEDIATE
              PduRPduLengthHandlingStrategy = IGNORE
              PduRDestPduCrossPartitionDestination = false
              PduRDestPduDataProvision = PDUR_DIRECT
              PduRTransmissionConfirmation = true
              PduRDestPduRef = PntDebugData_3_oFDCAN14_2bc5da46_Tx
              PduRDestPduPduRBswModulesRef = CanIf
            PduRSrcPdu_3fe80968 (PduRSrcPdu): PduRSourcePduHandleId=104, PduRSrcPduDirection=TRANSMIT, PduRSrcPduRef=PntDebugData_3_oFDCAN14_64370567_Tx, PduRSrcPduPduRBswModulesRef=Com
          LMD_LaneLinesDebug_1_oFDCAN14_b8b33555_Tx: PduRRoutingPathCommunicationType=COMMUNICATION_INTERFACE
            PduRSrcPdu_4d0e8da8 (PduRSrcPdu): PduRSourcePduHandleId=56, PduRSrcPduDirection=TRANSMIT, PduRSrcPduRef=LMD_LaneLinesDebug_1_oFDCAN14_b8b33555_Tx, PduRSrcPduPduRBswModulesRef=Com
            LMD_LaneLinesDebug_1_oFDCAN14_7d65846f_Tx (PduRDestPdu):
              PduRDestPduHandleId = 53
              PduRDestPduDirection = TRANSMIT
              PduRDestPduRoutingType = API_FORWARDING
              PduRDestPduDataProcessing = IMMEDIATE
              PduRPduLengthHandlingStrategy = IGNORE
              PduRDestPduCrossPartitionDestination = false
              PduRDestPduDataProvision = PDUR_DIRECT
              PduRTransmissionConfirmation = true
              PduRDestPduRef = LMD_LaneLinesDebug_1_oFDCAN14_7d65846f_Tx
              PduRDestPduPduRBswModulesRef = CanIf
          Log_SnrMeasData_01_oFDCAN14_9bf3ad30_Tx: PduRRoutingPathCommunicationType=COMMUNICATION_INTERFACE
            Log_SnrMeasData_01_oFDCAN14_481955b6_Tx (PduRDestPdu):
              PduRDestPduHandleId = 62
              PduRDestPduDirection = TRANSMIT
              PduRDestPduRoutingType = API_FORWARDING
              PduRDestPduDataProcessing = IMMEDIATE
              PduRPduLengthHandlingStrategy = IGNORE
              PduRDestPduCrossPartitionDestination = false
              PduRDestPduDataProvision = PDUR_DIRECT
              PduRTransmissionConfirmation = true
              PduRDestPduRef = Log_SnrMeasData_01_oFDCAN14_481955b6_Tx
              PduRDestPduPduRBswModulesRef = CanIf
            PduRSrcPdu_919e7b1e (PduRSrcPdu):
              PduRSourcePduHandleId = 65
              PduRSrcPduDirection = TRANSMIT
              PduRSrcPduRef = Log_SnrMeasData_01_oFDCAN14_9bf3ad30_Tx
              PduRSrcPduPduRBswModulesRef = Cdd_UssLog
          TRSC_FID_DebugMessage_oFDCAN14_6fc274ff_Tx: PduRRoutingPathCommunicationType=COMMUNICATION_INTERFACE
            PduRSrcPdu_be063e34 (PduRSrcPdu): PduRSourcePduHandleId=113, PduRSrcPduDirection=TRANSMIT, PduRSrcPduRef=TRSC_FID_DebugMessage_oFDCAN14_6fc274ff_Tx, PduRSrcPduPduRBswModulesRef=Com
            TRSC_FID_DebugMessage_oFDCAN14_25624ab4_Tx (PduRDestPdu):
              PduRDestPduHandleId = 110
              PduRDestPduDirection = TRANSMIT
              PduRDestPduRoutingType = API_FORWARDING
              PduRDestPduDataProcessing = IMMEDIATE
              PduRPduLengthHandlingStrategy = IGNORE
              PduRDestPduCrossPartitionDestination = false
              PduRDestPduDataProvision = PDUR_DIRECT
              PduRTransmissionConfirmation = true
              PduRDestPduRef = TRSC_FID_DebugMessage_oFDCAN14_25624ab4_Tx
              PduRDestPduPduRBswModulesRef = CanIf
          Log_SnrTemperature_oFDCAN14_a74624f8_Tx: PduRRoutingPathCommunicationType=COMMUNICATION_INTERFACE
            PduRSrcPdu_c9b02821 (PduRSrcPdu): PduRSourcePduHandleId=72, PduRSrcPduDirection=TRANSMIT, PduRSrcPduRef=Log_SnrTemperature_oFDCAN14_a74624f8_Tx, PduRSrcPduPduRBswModulesRef=Com
            Log_SnrTemperature_oFDCAN14_f8c16d66_Tx (PduRDestPdu):
              PduRDestPduHandleId = 69
              PduRDestPduDirection = TRANSMIT
              PduRDestPduRoutingType = API_FORWARDING
              PduRDestPduDataProcessing = IMMEDIATE
              PduRPduLengthHandlingStrategy = IGNORE
              PduRDestPduCrossPartitionDestination = false
              PduRDestPduDataProvision = PDUR_DIRECT
              PduRTransmissionConfirmation = true
              PduRDestPduRef = Log_SnrTemperature_oFDCAN14_f8c16d66_Tx
              PduRDestPduPduRBswModulesRef = CanIf
          Firing_Mode_oFDCAN14_be6e2cf4_Tx: PduRRoutingPathCommunicationType=COMMUNICATION_INTERFACE
            PduRSrcPdu_f30a0b0c (PduRSrcPdu): PduRSourcePduHandleId=49, PduRSrcPduDirection=TRANSMIT, PduRSrcPduRef=Firing_Mode_oFDCAN14_be6e2cf4_Tx, PduRSrcPduPduRBswModulesRef=Com
            Firing_Mode_oFDCAN14_9162ab4d_Tx (PduRDestPdu):
              PduRDestPduHandleId = 46
              PduRDestPduDirection = TRANSMIT
              PduRDestPduRoutingType = API_FORWARDING
              PduRDestPduDataProcessing = IMMEDIATE
              PduRPduLengthHandlingStrategy = IGNORE
              PduRDestPduCrossPartitionDestination = false
              PduRDestPduDataProvision = PDUR_DIRECT
              PduRTransmissionConfirmation = true
              PduRDestPduRef = Firing_Mode_oFDCAN14_9162ab4d_Tx
              PduRDestPduPduRBswModulesRef = CanIf
          PntDebugData_2_oFDCAN14_8bf56e59_Tx: PduRRoutingPathCommunicationType=COMMUNICATION_INTERFACE
            PntDebugData_2_oFDCAN14_4549c107_Tx (PduRDestPdu):
              PduRDestPduHandleId = 100
              PduRDestPduDirection = TRANSMIT
              PduRDestPduRoutingType = API_FORWARDING
              PduRDestPduDataProcessing = IMMEDIATE
              PduRPduLengthHandlingStrategy = IGNORE
              PduRDestPduCrossPartitionDestination = false
              PduRDestPduDataProvision = PDUR_DIRECT
              PduRTransmissionConfirmation = true
              PduRDestPduRef = PntDebugData_2_oFDCAN14_4549c107_Tx
              PduRDestPduPduRBswModulesRef = CanIf
            PduRSrcPdu_7c7d83cb (PduRSrcPdu): PduRSourcePduHandleId=103, PduRSrcPduDirection=TRANSMIT, PduRSrcPduRef=PntDebugData_2_oFDCAN14_8bf56e59_Tx, PduRSrcPduPduRBswModulesRef=Com
          Blockage_Flags_oFDCAN14_a22d2269_Tx: PduRRoutingPathCommunicationType=COMMUNICATION_INTERFACE
            Blockage_Flags_oFDCAN14_99421024_Tx (PduRDestPdu):
              PduRDestPduHandleId = 4
              PduRDestPduDirection = TRANSMIT
              PduRDestPduRoutingType = API_FORWARDING
              PduRDestPduDataProcessing = IMMEDIATE
              PduRPduLengthHandlingStrategy = IGNORE
              PduRDestPduCrossPartitionDestination = false
              PduRDestPduDataProvision = PDUR_DIRECT
              PduRTransmissionConfirmation = true
              PduRDestPduRef = Blockage_Flags_oFDCAN14_99421024_Tx
              PduRDestPduPduRBswModulesRef = CanIf
            PduRSrcPdu_782325e5 (PduRSrcPdu): PduRSourcePduHandleId=4, PduRSrcPduDirection=TRANSMIT, PduRSrcPduRef=Blockage_Flags_oFDCAN14_a22d2269_Tx, PduRSrcPduPduRBswModulesRef=Com
          Distance_Point_Map_6_oFDCAN14_575eab3d_Tx: PduRRoutingPathCommunicationType=COMMUNICATION_INTERFACE
            Distance_Point_Map_6_oFDCAN14_db45aa57_Tx (PduRDestPdu):
              PduRDestPduHandleId = 38
              PduRDestPduDirection = TRANSMIT
              PduRDestPduRoutingType = API_FORWARDING
              PduRDestPduDataProcessing = IMMEDIATE
              PduRPduLengthHandlingStrategy = IGNORE
              PduRDestPduCrossPartitionDestination = false
              PduRDestPduDataProvision = PDUR_DIRECT
              PduRTransmissionConfirmation = true
              PduRDestPduRef = Distance_Point_Map_6_oFDCAN14_db45aa57_Tx
              PduRDestPduPduRBswModulesRef = CanIf
            PduRSrcPdu_b3669d95 (PduRSrcPdu): PduRSourcePduHandleId=41, PduRSrcPduDirection=TRANSMIT, PduRSrcPduRef=Distance_Point_Map_6_oFDCAN14_575eab3d_Tx, PduRSrcPduPduRBswModulesRef=Com
          Log_SnrMeasData_07_oFDCAN14_96eddd77_Tx: PduRRoutingPathCommunicationType=COMMUNICATION_INTERFACE
            Log_SnrMeasData_07_oFDCAN14_f4400871_Tx (PduRDestPdu):
              PduRDestPduHandleId = 68
              PduRDestPduDirection = TRANSMIT
              PduRDestPduRoutingType = API_FORWARDING
              PduRDestPduDataProcessing = IMMEDIATE
              PduRPduLengthHandlingStrategy = IGNORE
              PduRDestPduCrossPartitionDestination = false
              PduRDestPduDataProvision = PDUR_DIRECT
              PduRTransmissionConfirmation = true
              PduRDestPduRef = Log_SnrMeasData_07_oFDCAN14_f4400871_Tx
              PduRDestPduPduRBswModulesRef = CanIf
            PduRSrcPdu_0f917068 (PduRSrcPdu):
              PduRSourcePduHandleId = 71
              PduRSrcPduDirection = TRANSMIT
              PduRSrcPduRef = Log_SnrMeasData_07_oFDCAN14_96eddd77_Tx
              PduRSrcPduPduRBswModulesRef = Cdd_UssLog
          Debug_ModuleState_oFDCAN14_33fb6c71_Tx: PduRRoutingPathCommunicationType=COMMUNICATION_INTERFACE
            PduRSrcPdu_d40b95bf (PduRSrcPdu): PduRSourcePduHandleId=28, PduRSrcPduDirection=TRANSMIT, PduRSrcPduRef=Debug_ModuleState_oFDCAN14_33fb6c71_Tx, PduRSrcPduPduRBswModulesRef=Com
            Debug_ModuleState_oFDCAN14_fcd53415_Tx (PduRDestPdu):
              PduRDestPduHandleId = 25
              PduRDestPduDirection = TRANSMIT
              PduRDestPduRoutingType = API_FORWARDING
              PduRDestPduDataProcessing = IMMEDIATE
              PduRPduLengthHandlingStrategy = IGNORE
              PduRDestPduCrossPartitionDestination = false
              PduRDestPduDataProvision = PDUR_DIRECT
              PduRTransmissionConfirmation = true
              PduRDestPduRef = Debug_ModuleState_oFDCAN14_fcd53415_Tx
              PduRDestPduPduRBswModulesRef = CanIf
          PntDebugData_0_oFDCAN14_8f00be64_Tx: PduRRoutingPathCommunicationType=COMMUNICATION_INTERFACE
            PntDebugData_0_oFDCAN14_9851f785_Tx (PduRDestPdu):
              PduRDestPduHandleId = 98
              PduRDestPduDirection = TRANSMIT
              PduRDestPduRoutingType = API_FORWARDING
              PduRDestPduDataProcessing = IMMEDIATE
              PduRPduLengthHandlingStrategy = IGNORE
              PduRDestPduCrossPartitionDestination = false
              PduRDestPduDataProvision = PDUR_DIRECT
              PduRTransmissionConfirmation = true
              PduRDestPduRef = PntDebugData_0_oFDCAN14_9851f785_Tx
              PduRDestPduPduRBswModulesRef = CanIf
            PduRSrcPdu_703eb300 (PduRSrcPdu): PduRSourcePduHandleId=101, PduRSrcPduDirection=TRANSMIT, PduRSrcPduRef=PntDebugData_0_oFDCAN14_8f00be64_Tx, PduRSrcPduPduRBswModulesRef=Com
          Distance_Point_Map_7_oFDCAN14_b89cc003_Tx: PduRRoutingPathCommunicationType=COMMUNICATION_INTERFACE
            Distance_Point_Map_7_oFDCAN14_b5c9b116_Tx (PduRDestPdu):
              PduRDestPduHandleId = 39
              PduRDestPduDirection = TRANSMIT
              PduRDestPduRoutingType = API_FORWARDING
              PduRDestPduDataProcessing = IMMEDIATE
              PduRPduLengthHandlingStrategy = IGNORE
              PduRDestPduCrossPartitionDestination = false
              PduRDestPduDataProvision = PDUR_DIRECT
              PduRTransmissionConfirmation = true
              PduRDestPduRef = Distance_Point_Map_7_oFDCAN14_b5c9b116_Tx
              PduRDestPduPduRBswModulesRef = CanIf
            PduRSrcPdu_e33865f2 (PduRSrcPdu): PduRSourcePduHandleId=42, PduRSrcPduDirection=TRANSMIT, PduRSrcPduRef=Distance_Point_Map_7_oFDCAN14_b89cc003_Tx, PduRSrcPduPduRBswModulesRef=Com
          Firing_Sensors_oFDCAN14_e037c3cb_Tx: PduRRoutingPathCommunicationType=COMMUNICATION_INTERFACE
            Firing_Sensors_oFDCAN14_913f5916_Tx (PduRDestPdu):
              PduRDestPduHandleId = 47
              PduRDestPduDirection = TRANSMIT
              PduRDestPduRoutingType = API_FORWARDING
              PduRDestPduDataProcessing = IMMEDIATE
              PduRPduLengthHandlingStrategy = IGNORE
              PduRDestPduCrossPartitionDestination = false
              PduRDestPduDataProvision = PDUR_DIRECT
              PduRTransmissionConfirmation = true
              PduRDestPduRef = Firing_Sensors_oFDCAN14_913f5916_Tx
              PduRDestPduPduRBswModulesRef = CanIf
            PduRSrcPdu_1042f3c2 (PduRSrcPdu): PduRSourcePduHandleId=50, PduRSrcPduDirection=TRANSMIT, PduRSrcPduRef=Firing_Sensors_oFDCAN14_e037c3cb_Tx, PduRSrcPduPduRBswModulesRef=Com
          THADebugInfo2_oFDCAN14_5a2a0376_Tx: PduRRoutingPathCommunicationType=COMMUNICATION_INTERFACE
            THADebugInfo2_oFDCAN14_30821deb_Tx (PduRDestPdu):
              PduRDestPduHandleId = 103
              PduRDestPduDirection = TRANSMIT
              PduRDestPduRoutingType = API_FORWARDING
              PduRDestPduDataProcessing = IMMEDIATE
              PduRPduLengthHandlingStrategy = IGNORE
              PduRDestPduCrossPartitionDestination = false
              PduRDestPduDataProvision = PDUR_DIRECT
              PduRTransmissionConfirmation = true
              PduRDestPduRef = THADebugInfo2_oFDCAN14_30821deb_Tx
              PduRDestPduPduRBswModulesRef = CanIf
            PduRSrcPdu_43c8c80b (PduRSrcPdu): PduRSourcePduHandleId=106, PduRSrcPduDirection=TRANSMIT, PduRSrcPduRef=THADebugInfo2_oFDCAN14_5a2a0376_Tx, PduRSrcPduPduRBswModulesRef=Com
          Debug_CurrentCalib_Data_2_oFDCAN14_a1406486_Tx: PduRRoutingPathCommunicationType=COMMUNICATION_INTERFACE
            PduRSrcPdu_088b5cb2 (PduRSrcPdu):
              PduRSourcePduHandleId = 19
              PduRSrcPduDirection = TRANSMIT
              PduRSrcPduRef = Debug_CurrentCalib_Data_2_oFDCAN14_a1406486_Tx
              PduRSrcPduPduRBswModulesRef = Com
            Debug_CurrentCalib_Data_2_oFDCAN14_2917323d_Tx (PduRDestPdu):
              PduRDestPduHandleId = 16
              PduRDestPduDirection = TRANSMIT
              PduRDestPduRoutingType = API_FORWARDING
              PduRDestPduDataProcessing = IMMEDIATE
              PduRPduLengthHandlingStrategy = IGNORE
              PduRDestPduCrossPartitionDestination = false
              PduRDestPduDataProvision = PDUR_DIRECT
              PduRTransmissionConfirmation = true
              PduRDestPduRef = Debug_CurrentCalib_Data_2_oFDCAN14_2917323d_Tx
              PduRDestPduPduRBswModulesRef = CanIf
          MOT_Obj_6_7_oFDCAN14_9c3e452e_Tx: PduRRoutingPathCommunicationType=COMMUNICATION_INTERFACE
            PduRSrcPdu_6038e225 (PduRSrcPdu): PduRSourcePduHandleId=93, PduRSrcPduDirection=TRANSMIT, PduRSrcPduRef=MOT_Obj_6_7_oFDCAN14_9c3e452e_Tx, PduRSrcPduPduRBswModulesRef=Com
            MOT_Obj_6_7_oFDCAN14_157c986b_Tx (PduRDestPdu):
              PduRDestPduHandleId = 90
              PduRDestPduDirection = TRANSMIT
              PduRDestPduRoutingType = API_FORWARDING
              PduRDestPduDataProcessing = IMMEDIATE
              PduRPduLengthHandlingStrategy = IGNORE
              PduRDestPduCrossPartitionDestination = false
              PduRDestPduDataProvision = PDUR_DIRECT
              PduRTransmissionConfirmation = true
              PduRDestPduRef = MOT_Obj_6_7_oFDCAN14_157c986b_Tx
              PduRDestPduPduRBswModulesRef = CanIf
          PntDebugData_Rx_oFDCAN14_481d274d_Rx: PduRRoutingPathCommunicationType=COMMUNICATION_INTERFACE
            PntDebugData_Rx_oFDCAN14_481d274d_Rx_92dfc557_Rx (PduRDestPdu):
              PduRDestPduHandleId = 52
              PduRDestPduDirection = RECEIVE
              PduRDestPduRoutingType = API_FORWARDING
              PduRDestPduDataProcessing = IMMEDIATE
              PduRPduLengthHandlingStrategy = IGNORE
              PduRDestPduCrossPartitionDestination = false
              PduRTransmissionConfirmation = false
              PduRDestPduRef = PntDebugData_Rx_oFDCAN14_5e3489b7_Rx
              PduRDestPduPduRBswModulesRef = Com
            PduRSrcPdu_92dfc557 (PduRSrcPdu): PduRSourcePduHandleId=52, PduRSrcPduDirection=RECEIVE, PduRSrcPduRef=PntDebugData_Rx_oFDCAN14_481d274d_Rx, PduRSrcPduPduRBswModulesRef=CanIf
          LMD_SegmentDebug_2_1_oFDCAN14_40648684_Tx: PduRRoutingPathCommunicationType=COMMUNICATION_INTERFACE
            LMD_SegmentDebug_2_1_oFDCAN14_8f2f3daa_Tx (PduRDestPdu):
              PduRDestPduHandleId = 57
              PduRDestPduDirection = TRANSMIT
              PduRDestPduRoutingType = API_FORWARDING
              PduRDestPduDataProcessing = IMMEDIATE
              PduRPduLengthHandlingStrategy = IGNORE
              PduRDestPduCrossPartitionDestination = false
              PduRDestPduDataProvision = PDUR_DIRECT
              PduRTransmissionConfirmation = true
              PduRDestPduRef = LMD_SegmentDebug_2_1_oFDCAN14_8f2f3daa_Tx
              PduRDestPduPduRBswModulesRef = CanIf
            PduRSrcPdu_be85d26b (PduRSrcPdu): PduRSourcePduHandleId=60, PduRSrcPduDirection=TRANSMIT, PduRSrcPduRef=LMD_SegmentDebug_2_1_oFDCAN14_40648684_Tx, PduRSrcPduPduRBswModulesRef=Com
          PLDDebugInfo1_oFDCAN14_d4cfffd1_Tx: PduRRoutingPathCommunicationType=COMMUNICATION_INTERFACE
            PduRSrcPdu_c4e0a670 (PduRSrcPdu): PduRSourcePduHandleId=99, PduRSrcPduDirection=TRANSMIT, PduRSrcPduRef=PLDDebugInfo1_oFDCAN14_d4cfffd1_Tx, PduRSrcPduPduRBswModulesRef=Com
            PLDDebugInfo1_oFDCAN14_d750a426_Tx (PduRDestPdu):
              PduRDestPduHandleId = 96
              PduRDestPduDirection = TRANSMIT
              PduRDestPduRoutingType = API_FORWARDING
              PduRDestPduDataProcessing = IMMEDIATE
              PduRPduLengthHandlingStrategy = IGNORE
              PduRDestPduCrossPartitionDestination = false
              PduRDestPduDataProvision = PDUR_DIRECT
              PduRTransmissionConfirmation = true
              PduRDestPduRef = PLDDebugInfo1_oFDCAN14_d750a426_Tx
              PduRDestPduPduRBswModulesRef = CanIf
          FODDebug_oFDCAN14_6c6e4cde_Tx: PduRRoutingPathCommunicationType=COMMUNICATION_INTERFACE
            FODDebug_oFDCAN14_f1ba2bbb_Tx (PduRDestPdu):
              PduRDestPduHandleId = 44
              PduRDestPduDirection = TRANSMIT
              PduRDestPduRoutingType = API_FORWARDING
              PduRDestPduDataProcessing = IMMEDIATE
              PduRPduLengthHandlingStrategy = IGNORE
              PduRDestPduCrossPartitionDestination = false
              PduRDestPduDataProvision = PDUR_DIRECT
              PduRTransmissionConfirmation = true
              PduRDestPduRef = FODDebug_oFDCAN14_f1ba2bbb_Tx
              PduRDestPduPduRBswModulesRef = CanIf
            PduRSrcPdu_52d1ab4f (PduRSrcPdu): PduRSourcePduHandleId=47, PduRSrcPduDirection=TRANSMIT, PduRSrcPduRef=FODDebug_oFDCAN14_6c6e4cde_Tx, PduRSrcPduPduRBswModulesRef=Com
          TRSC_Detection_DebugMessage_oFDCAN14_8347a9d4_Tx: PduRRoutingPathCommunicationType=COMMUNICATION_INTERFACE
            TRSC_Detection_DebugMessage_oFDCAN14_7bfeb44b_Tx (PduRDestPdu):
              PduRDestPduHandleId = 109
              PduRDestPduDirection = TRANSMIT
              PduRDestPduRoutingType = API_FORWARDING
              PduRDestPduDataProcessing = IMMEDIATE
              PduRPduLengthHandlingStrategy = IGNORE
              PduRDestPduCrossPartitionDestination = false
              PduRDestPduDataProvision = PDUR_DIRECT
              PduRTransmissionConfirmation = true
              PduRDestPduRef = TRSC_Detection_DebugMessage_oFDCAN14_7bfeb44b_Tx
              PduRDestPduPduRBswModulesRef = CanIf
            PduRSrcPdu_29cc8cc9 (PduRSrcPdu):
              PduRSourcePduHandleId = 112
              PduRSrcPduDirection = TRANSMIT
              PduRSrcPduRef = TRSC_Detection_DebugMessage_oFDCAN14_8347a9d4_Tx
              PduRSrcPduPduRBswModulesRef = Com
          Distance_Point_Map_10_oFDCAN14_e0b543dc_Tx: PduRRoutingPathCommunicationType=COMMUNICATION_INTERFACE
            PduRSrcPdu_549ae1db (PduRSrcPdu): PduRSourcePduHandleId=45, PduRSrcPduDirection=TRANSMIT, PduRSrcPduRef=Distance_Point_Map_10_oFDCAN14_e0b543dc_Tx, PduRSrcPduPduRBswModulesRef=Com
            Distance_Point_Map_10_oFDCAN14_1c0010fe_Tx (PduRDestPdu):
              PduRDestPduHandleId = 42
              PduRDestPduDirection = TRANSMIT
              PduRDestPduRoutingType = API_FORWARDING
              PduRDestPduDataProcessing = IMMEDIATE
              PduRPduLengthHandlingStrategy = IGNORE
              PduRDestPduCrossPartitionDestination = false
              PduRDestPduDataProvision = PDUR_DIRECT
              PduRTransmissionConfirmation = true
              PduRDestPduRef = Distance_Point_Map_10_oFDCAN14_1c0010fe_Tx
              PduRDestPduPduRBswModulesRef = CanIf
          FPADebugInfo1_oFDCAN14_58ac202e_Tx: PduRRoutingPathCommunicationType=COMMUNICATION_INTERFACE
            PduRSrcPdu_ef84c718 (PduRSrcPdu): PduRSourcePduHandleId=48, PduRSrcPduDirection=TRANSMIT, PduRSrcPduRef=FPADebugInfo1_oFDCAN14_58ac202e_Tx, PduRSrcPduPduRBswModulesRef=Com
            FPADebugInfo1_oFDCAN14_2f618197_Tx (PduRDestPdu):
              PduRDestPduHandleId = 45
              PduRDestPduDirection = TRANSMIT
              PduRDestPduRoutingType = API_FORWARDING
              PduRDestPduDataProcessing = IMMEDIATE
              PduRPduLengthHandlingStrategy = IGNORE
              PduRDestPduCrossPartitionDestination = false
              PduRDestPduDataProvision = PDUR_DIRECT
              PduRTransmissionConfirmation = true
              PduRDestPduRef = FPADebugInfo1_oFDCAN14_2f618197_Tx
              PduRDestPduPduRBswModulesRef = CanIf
          LMD_SegmentDebug_1_2_oFDCAN14_dccdef77_Tx: PduRRoutingPathCommunicationType=COMMUNICATION_INTERFACE
            LMD_SegmentDebug_1_2_oFDCAN14_99b37b05_Tx (PduRDestPdu):
              PduRDestPduHandleId = 55
              PduRDestPduDirection = TRANSMIT
              PduRDestPduRoutingType = API_FORWARDING
              PduRDestPduDataProcessing = IMMEDIATE
              PduRPduLengthHandlingStrategy = IGNORE
              PduRDestPduCrossPartitionDestination = false
              PduRDestPduDataProvision = PDUR_DIRECT
              PduRTransmissionConfirmation = true
              PduRDestPduRef = LMD_SegmentDebug_1_2_oFDCAN14_99b37b05_Tx
              PduRDestPduPduRBswModulesRef = CanIf
            PduRSrcPdu_46f4792c (PduRSrcPdu): PduRSourcePduHandleId=58, PduRSrcPduDirection=TRANSMIT, PduRSrcPduRef=LMD_SegmentDebug_1_2_oFDCAN14_dccdef77_Tx, PduRSrcPduPduRBswModulesRef=Com
          MOT_Obj_2_3_oFDCAN14_96d3de2b_Tx: PduRRoutingPathCommunicationType=COMMUNICATION_INTERFACE
            MOT_Obj_2_3_oFDCAN14_235391ff_Tx (PduRDestPdu):
              PduRDestPduHandleId = 88
              PduRDestPduDirection = TRANSMIT
              PduRDestPduRoutingType = API_FORWARDING
              PduRDestPduDataProcessing = IMMEDIATE
              PduRPduLengthHandlingStrategy = IGNORE
              PduRDestPduCrossPartitionDestination = false
              PduRDestPduDataProvision = PDUR_DIRECT
              PduRTransmissionConfirmation = true
              PduRDestPduRef = MOT_Obj_2_3_oFDCAN14_235391ff_Tx
              PduRDestPduPduRBswModulesRef = CanIf
            PduRSrcPdu_3d54ad71 (PduRSrcPdu): PduRSourcePduHandleId=91, PduRSrcPduDirection=TRANSMIT, PduRSrcPduRef=MOT_Obj_2_3_oFDCAN14_96d3de2b_Tx, PduRSrcPduPduRBswModulesRef=Com
          Debug_FPA_HMI_InfoToVC_oFDCAN14_2e591963_Tx: PduRRoutingPathCommunicationType=COMMUNICATION_INTERFACE
            PduRSrcPdu_634dabfc (PduRSrcPdu): PduRSourcePduHandleId=23, PduRSrcPduDirection=TRANSMIT, PduRSrcPduRef=Debug_FPA_HMI_InfoToVC_oFDCAN14_2e591963_Tx, PduRSrcPduPduRBswModulesRef=Com
            Debug_FPA_HMI_InfoToVC_oFDCAN14_250b6023_Tx (PduRDestPdu):
              PduRDestPduHandleId = 20
              PduRDestPduDirection = TRANSMIT
              PduRDestPduRoutingType = API_FORWARDING
              PduRDestPduDataProcessing = IMMEDIATE
              PduRPduLengthHandlingStrategy = IGNORE
              PduRDestPduCrossPartitionDestination = false
              PduRDestPduDataProvision = PDUR_DIRECT
              PduRTransmissionConfirmation = true
              PduRDestPduRef = Debug_FPA_HMI_InfoToVC_oFDCAN14_250b6023_Tx
              PduRDestPduPduRBswModulesRef = CanIf
          Debug_AP_Variables_oFDCAN14_ad556bd1_Tx: PduRRoutingPathCommunicationType=COMMUNICATION_INTERFACE
            PduRSrcPdu_b2a869ec (PduRSrcPdu): PduRSourcePduHandleId=17, PduRSrcPduDirection=TRANSMIT, PduRSrcPduRef=Debug_AP_Variables_oFDCAN14_ad556bd1_Tx, PduRSrcPduPduRBswModulesRef=Com
            Debug_AP_Variables_oFDCAN14_9068652c_Tx (PduRDestPdu):
              PduRDestPduHandleId = 14
              PduRDestPduDirection = TRANSMIT
              PduRDestPduRoutingType = API_FORWARDING
              PduRDestPduDataProcessing = IMMEDIATE
              PduRPduLengthHandlingStrategy = IGNORE
              PduRDestPduCrossPartitionDestination = false
              PduRDestPduDataProvision = PDUR_DIRECT
              PduRTransmissionConfirmation = true
              PduRDestPduRef = Debug_AP_Variables_oFDCAN14_9068652c_Tx
              PduRDestPduPduRBswModulesRef = CanIf
          ME_SystemStatus_oFDCAN14_19d0baf4_Tx: PduRRoutingPathCommunicationType=COMMUNICATION_INTERFACE
            ME_SystemStatus_oFDCAN14_3ca06526_Tx (PduRDestPdu):
              PduRDestPduHandleId = 86
              PduRDestPduDirection = TRANSMIT
              PduRDestPduRoutingType = API_FORWARDING
              PduRDestPduDataProcessing = IMMEDIATE
              PduRPduLengthHandlingStrategy = IGNORE
              PduRDestPduCrossPartitionDestination = false
              PduRDestPduDataProvision = PDUR_DIRECT
              PduRTransmissionConfirmation = true
              PduRDestPduRef = ME_SystemStatus_oFDCAN14_3ca06526_Tx
              PduRDestPduPduRBswModulesRef = CanIf
            PduRSrcPdu_b1ea4624 (PduRSrcPdu): PduRSourcePduHandleId=89, PduRSrcPduDirection=TRANSMIT, PduRSrcPduRef=ME_SystemStatus_oFDCAN14_19d0baf4_Tx, PduRSrcPduPduRBswModulesRef=Com
          Debug_ErrCodeAlgo_oFDCAN14_53b8e02d_Tx: PduRRoutingPathCommunicationType=COMMUNICATION_INTERFACE
            Debug_ErrCodeAlgo_oFDCAN14_8f5e00dc_Tx (PduRDestPdu):
              PduRDestPduHandleId = 19
              PduRDestPduDirection = TRANSMIT
              PduRDestPduRoutingType = API_FORWARDING
              PduRDestPduDataProcessing = IMMEDIATE
              PduRPduLengthHandlingStrategy = IGNORE
              PduRDestPduCrossPartitionDestination = false
              PduRDestPduDataProvision = PDUR_DIRECT
              PduRTransmissionConfirmation = true
              PduRDestPduRef = Debug_ErrCodeAlgo_oFDCAN14_8f5e00dc_Tx
              PduRDestPduPduRBswModulesRef = CanIf
            PduRSrcPdu_64c495bf (PduRSrcPdu): PduRSourcePduHandleId=22, PduRSrcPduDirection=TRANSMIT, PduRSrcPduRef=Debug_ErrCodeAlgo_oFDCAN14_53b8e02d_Tx, PduRSrcPduPduRBswModulesRef=Com
          Debug_SCCalib_Data_oFDCAN14_fdb6856d_Tx: PduRRoutingPathCommunicationType=COMMUNICATION_INTERFACE
            PduRSrcPdu_56bb1cda (PduRSrcPdu): PduRSourcePduHandleId=32, PduRSrcPduDirection=TRANSMIT, PduRSrcPduRef=Debug_SCCalib_Data_oFDCAN14_fdb6856d_Tx, PduRSrcPduPduRBswModulesRef=Com
            Debug_SCCalib_Data_oFDCAN14_f9ffef76_Tx (PduRDestPdu):
              PduRDestPduHandleId = 29
              PduRDestPduDirection = TRANSMIT
              PduRDestPduRoutingType = API_FORWARDING
              PduRDestPduDataProcessing = IMMEDIATE
              PduRPduLengthHandlingStrategy = IGNORE
              PduRDestPduCrossPartitionDestination = false
              PduRDestPduDataProvision = PDUR_DIRECT
              PduRTransmissionConfirmation = true
              PduRDestPduRef = Debug_SCCalib_Data_oFDCAN14_f9ffef76_Tx
              PduRDestPduPduRBswModulesRef = CanIf
          USSDebugInfo1_oFDCAN14_99359865_Tx: PduRRoutingPathCommunicationType=COMMUNICATION_INTERFACE
            USSDebugInfo1_oFDCAN14_3a0946df_Tx (PduRDestPdu):
              PduRDestPduHandleId = 111
              PduRDestPduDirection = TRANSMIT
              PduRDestPduRoutingType = API_FORWARDING
              PduRDestPduDataProcessing = IMMEDIATE
              PduRPduLengthHandlingStrategy = IGNORE
              PduRDestPduCrossPartitionDestination = false
              PduRDestPduDataProvision = PDUR_DIRECT
              PduRTransmissionConfirmation = true
              PduRDestPduRef = USSDebugInfo1_oFDCAN14_3a0946df_Tx
              PduRDestPduPduRBswModulesRef = CanIf
            PduRSrcPdu_23d3eab5 (PduRSrcPdu): PduRSourcePduHandleId=114, PduRSrcPduDirection=TRANSMIT, PduRSrcPduRef=USSDebugInfo1_oFDCAN14_99359865_Tx, PduRSrcPduPduRBswModulesRef=Com
          Distance_Point_Map_11_oFDCAN14_0f7728e2_Tx: PduRRoutingPathCommunicationType=COMMUNICATION_INTERFACE
            Distance_Point_Map_11_oFDCAN14_728c0bbf_Tx (PduRDestPdu):
              PduRDestPduHandleId = 43
              PduRDestPduDirection = TRANSMIT
              PduRDestPduRoutingType = API_FORWARDING
              PduRDestPduDataProcessing = IMMEDIATE
              PduRPduLengthHandlingStrategy = IGNORE
              PduRDestPduCrossPartitionDestination = false
              PduRDestPduDataProvision = PDUR_DIRECT
              PduRTransmissionConfirmation = true
              PduRDestPduRef = Distance_Point_Map_11_oFDCAN14_728c0bbf_Tx
              PduRDestPduPduRBswModulesRef = CanIf
            PduRSrcPdu_c37785b8 (PduRSrcPdu): PduRSourcePduHandleId=46, PduRSrcPduDirection=TRANSMIT, PduRSrcPduRef=Distance_Point_Map_11_oFDCAN14_0f7728e2_Tx, PduRSrcPduPduRBswModulesRef=Com
          Distance_Point_Map_8_oFDCAN14_49979b8e_Tx: PduRRoutingPathCommunicationType=COMMUNICATION_INTERFACE
            PduRSrcPdu_89f2f86d (PduRSrcPdu): PduRSourcePduHandleId=43, PduRSrcPduDirection=TRANSMIT, PduRSrcPduRef=Distance_Point_Map_8_oFDCAN14_49979b8e_Tx, PduRSrcPduPduRBswModulesRef=Com
            Distance_Point_Map_8_oFDCAN14_a59e211a_Tx (PduRDestPdu):
              PduRDestPduHandleId = 40
              PduRDestPduDirection = TRANSMIT
              PduRDestPduRoutingType = API_FORWARDING
              PduRDestPduDataProcessing = IMMEDIATE
              PduRPduLengthHandlingStrategy = IGNORE
              PduRDestPduCrossPartitionDestination = false
              PduRDestPduDataProvision = PDUR_DIRECT
              PduRTransmissionConfirmation = true
              PduRDestPduRef = Distance_Point_Map_8_oFDCAN14_a59e211a_Tx
              PduRDestPduPduRBswModulesRef = CanIf
          TRSC_Debug_Message1_oFDCAN14_4a774fd0_Tx: PduRRoutingPathCommunicationType=COMMUNICATION_INTERFACE
            TRSC_Debug_Message1_oFDCAN14_9ee0dc91_Tx (PduRDestPdu):
              PduRDestPduHandleId = 106
              PduRDestPduDirection = TRANSMIT
              PduRDestPduRoutingType = API_FORWARDING
              PduRDestPduDataProcessing = IMMEDIATE
              PduRPduLengthHandlingStrategy = IGNORE
              PduRDestPduCrossPartitionDestination = false
              PduRDestPduDataProvision = PDUR_DIRECT
              PduRTransmissionConfirmation = true
              PduRDestPduRef = TRSC_Debug_Message1_oFDCAN14_9ee0dc91_Tx
              PduRDestPduPduRBswModulesRef = CanIf
            PduRSrcPdu_3d4f267c (PduRSrcPdu): PduRSourcePduHandleId=109, PduRSrcPduDirection=TRANSMIT, PduRSrcPduRef=TRSC_Debug_Message1_oFDCAN14_4a774fd0_Tx, PduRSrcPduPduRBswModulesRef=Com
          Log_SnrMeasData_04_oFDCAN14_7dda6674_Tx: PduRRoutingPathCommunicationType=COMMUNICATION_INTERFACE
            Log_SnrMeasData_04_oFDCAN14_47d425b2_Tx (PduRDestPdu):
              PduRDestPduHandleId = 65
              PduRDestPduDirection = TRANSMIT
              PduRDestPduRoutingType = API_FORWARDING
              PduRDestPduDataProcessing = IMMEDIATE
              PduRPduLengthHandlingStrategy = IGNORE
              PduRDestPduCrossPartitionDestination = false
              PduRDestPduDataProvision = PDUR_DIRECT
              PduRTransmissionConfirmation = true
              PduRDestPduRef = Log_SnrMeasData_04_oFDCAN14_47d425b2_Tx
              PduRDestPduPduRBswModulesRef = CanIf
            PduRSrcPdu_615c44f0 (PduRSrcPdu):
              PduRSourcePduHandleId = 68
              PduRSrcPduDirection = TRANSMIT
              PduRSrcPduRef = Log_SnrMeasData_04_oFDCAN14_7dda6674_Tx
              PduRSrcPduPduRBswModulesRef = Cdd_UssLog
          DebugModelOutput_Feature_KPI_Tx_oFDCAN14_b487b5f0_Tx: PduRRoutingPathCommunicationType=COMMUNICATION_INTERFACE
            PduRSrcPdu_0d83ad0d (PduRSrcPdu):
              PduRSourcePduHandleId = 15
              PduRSrcPduDirection = TRANSMIT
              PduRSrcPduRef = DebugModelOutput_Feature_KPI_Tx_oFDCAN14_b487b5f0_Tx
              PduRSrcPduPduRBswModulesRef = Com
            DebugModelOutput_Feature_KPI_Tx_oFDCAN14_2d37299a_Tx (PduRDestPdu):
              PduRDestPduHandleId = 12
              PduRDestPduDirection = TRANSMIT
              PduRDestPduRoutingType = API_FORWARDING
              PduRDestPduDataProcessing = IMMEDIATE
              PduRPduLengthHandlingStrategy = IGNORE
              PduRDestPduCrossPartitionDestination = false
              PduRDestPduDataProvision = PDUR_DIRECT
              PduRTransmissionConfirmation = true
              PduRDestPduRef = DebugModelOutput_Feature_KPI_Tx_oFDCAN14_2d37299a_Tx
              PduRDestPduPduRBswModulesRef = CanIf
          THADebugInfo1_oFDCAN14_b11db875_Tx: PduRRoutingPathCommunicationType=COMMUNICATION_INTERFACE
            THADebugInfo1_oFDCAN14_83163028_Tx (PduRDestPdu):
              PduRDestPduHandleId = 102
              PduRDestPduDirection = TRANSMIT
              PduRDestPduRoutingType = API_FORWARDING
              PduRDestPduDataProcessing = IMMEDIATE
              PduRPduLengthHandlingStrategy = IGNORE
              PduRDestPduCrossPartitionDestination = false
              PduRDestPduDataProvision = PDUR_DIRECT
              PduRTransmissionConfirmation = true
              PduRDestPduRef = THADebugInfo1_oFDCAN14_83163028_Tx
              PduRDestPduPduRBswModulesRef = CanIf
            PduRSrcPdu_2f74beb6 (PduRSrcPdu): PduRSourcePduHandleId=105, PduRSrcPduDirection=TRANSMIT, PduRSrcPduRef=THADebugInfo1_oFDCAN14_b11db875_Tx, PduRSrcPduPduRBswModulesRef=Com
          ME_DebugMsgUnsigned_oFDCAN14_a51f0125_Tx: PduRRoutingPathCommunicationType=COMMUNICATION_INTERFACE
            PduRSrcPdu_74298cac (PduRSrcPdu): PduRSourcePduHandleId=74, PduRSrcPduDirection=TRANSMIT, PduRSrcPduRef=ME_DebugMsgUnsigned_oFDCAN14_a51f0125_Tx, PduRSrcPduPduRBswModulesRef=Com
            ME_DebugMsgUnsigned_oFDCAN14_6e07688e_Tx (PduRDestPdu):
              PduRDestPduHandleId = 71
              PduRDestPduDirection = TRANSMIT
              PduRDestPduRoutingType = API_FORWARDING
              PduRDestPduDataProcessing = IMMEDIATE
              PduRPduLengthHandlingStrategy = IGNORE
              PduRDestPduCrossPartitionDestination = false
              PduRDestPduDataProvision = PDUR_DIRECT
              PduRTransmissionConfirmation = true
              PduRDestPduRef = ME_DebugMsgUnsigned_oFDCAN14_6e07688e_Tx
              PduRDestPduPduRBswModulesRef = CanIf
          MOT_Obj_8_9_oFDCAN14_6bc6a683_Tx: PduRRoutingPathCommunicationType=COMMUNICATION_INTERFACE
            PduRSrcPdu_4fd42681 (PduRSrcPdu): PduRSourcePduHandleId=94, PduRSrcPduDirection=TRANSMIT, PduRSrcPduRef=MOT_Obj_8_9_oFDCAN14_6bc6a683_Tx, PduRSrcPduPduRBswModulesRef=Com
            MOT_Obj_8_9_oFDCAN14_541a061d_Tx (PduRDestPdu):
              PduRDestPduHandleId = 91
              PduRDestPduDirection = TRANSMIT
              PduRDestPduRoutingType = API_FORWARDING
              PduRDestPduDataProcessing = IMMEDIATE
              PduRPduLengthHandlingStrategy = IGNORE
              PduRDestPduCrossPartitionDestination = false
              PduRDestPduDataProvision = PDUR_DIRECT
              PduRTransmissionConfirmation = true
              PduRDestPduRef = MOT_Obj_8_9_oFDCAN14_541a061d_Tx
              PduRDestPduPduRBswModulesRef = CanIf
          Debug_EOLCalib_Data_2_oFDCAN14_25e4a771_Tx: PduRRoutingPathCommunicationType=COMMUNICATION_INTERFACE
            Debug_EOLCalib_Data_2_oFDCAN14_5a172fae_Tx (PduRDestPdu):
              PduRDestPduHandleId = 18
              PduRDestPduDirection = TRANSMIT
              PduRDestPduRoutingType = API_FORWARDING
              PduRDestPduDataProcessing = IMMEDIATE
              PduRPduLengthHandlingStrategy = IGNORE
              PduRDestPduCrossPartitionDestination = false
              PduRDestPduDataProvision = PDUR_DIRECT
              PduRTransmissionConfirmation = true
              PduRDestPduRef = Debug_EOLCalib_Data_2_oFDCAN14_5a172fae_Tx
              PduRDestPduPduRBswModulesRef = CanIf
            PduRSrcPdu_6a05b7f9 (PduRSrcPdu): PduRSourcePduHandleId=21, PduRSrcPduDirection=TRANSMIT, PduRSrcPduRef=Debug_EOLCalib_Data_2_oFDCAN14_25e4a771_Tx, PduRSrcPduPduRBswModulesRef=Com
          Log_SnrMeasData_02_oFDCAN14_70c41633_Tx: PduRRoutingPathCommunicationType=COMMUNICATION_INTERFACE
            PduRSrcPdu_770508de (PduRSrcPdu):
              PduRSourcePduHandleId = 66
              PduRSrcPduDirection = TRANSMIT
              PduRSrcPduRef = Log_SnrMeasData_02_oFDCAN14_70c41633_Tx
              PduRSrcPduPduRBswModulesRef = Cdd_UssLog
            Log_SnrMeasData_02_oFDCAN14_fb8d7875_Tx (PduRDestPdu):
              PduRDestPduHandleId = 63
              PduRDestPduDirection = TRANSMIT
              PduRDestPduRoutingType = API_FORWARDING
              PduRDestPduDataProcessing = IMMEDIATE
              PduRPduLengthHandlingStrategy = IGNORE
              PduRDestPduCrossPartitionDestination = false
              PduRDestPduDataProvision = PDUR_DIRECT
              PduRTransmissionConfirmation = true
              PduRDestPduRef = Log_SnrMeasData_02_oFDCAN14_fb8d7875_Tx
              PduRDestPduPduRBswModulesRef = CanIf
          PLDDebugInfo2_oFDCAN14_3ff844d2_Tx: PduRRoutingPathCommunicationType=COMMUNICATION_INTERFACE
            PLDDebugInfo2_oFDCAN14_64c489e5_Tx (PduRDestPdu):
              PduRDestPduHandleId = 97
              PduRDestPduDirection = TRANSMIT
              PduRDestPduRoutingType = API_FORWARDING
              PduRDestPduDataProcessing = IMMEDIATE
              PduRPduLengthHandlingStrategy = IGNORE
              PduRDestPduCrossPartitionDestination = false
              PduRDestPduDataProvision = PDUR_DIRECT
              PduRTransmissionConfirmation = true
              PduRDestPduRef = PLDDebugInfo2_oFDCAN14_64c489e5_Tx
              PduRDestPduPduRBswModulesRef = CanIf
            PduRSrcPdu_fc7ecfd5 (PduRSrcPdu): PduRSourcePduHandleId=100, PduRSrcPduDirection=TRANSMIT, PduRSrcPduRef=PLDDebugInfo2_oFDCAN14_3ff844d2_Tx, PduRSrcPduPduRBswModulesRef=Com
          Debug_HMI_Input_Data_oFDCAN14_d0bca7c0_Tx: PduRRoutingPathCommunicationType=COMMUNICATION_INTERFACE
            PduRSrcPdu_f9f2a2bd (PduRSrcPdu): PduRSourcePduHandleId=25, PduRSrcPduDirection=TRANSMIT, PduRSrcPduRef=Debug_HMI_Input_Data_oFDCAN14_d0bca7c0_Tx, PduRSrcPduPduRBswModulesRef=Com
            Debug_HMI_Input_Data_oFDCAN14_f2609efd_Tx (PduRDestPdu):
              PduRDestPduHandleId = 22
              PduRDestPduDirection = TRANSMIT
              PduRDestPduRoutingType = API_FORWARDING
              PduRDestPduDataProcessing = IMMEDIATE
              PduRPduLengthHandlingStrategy = IGNORE
              PduRDestPduCrossPartitionDestination = false
              PduRDestPduDataProvision = PDUR_DIRECT
              PduRTransmissionConfirmation = true
              PduRDestPduRef = Debug_HMI_Input_Data_oFDCAN14_f2609efd_Tx
              PduRDestPduPduRBswModulesRef = CanIf
          Debug_HMI_Trailer_Views_Data_oFDCAN14_a6759e51_Tx: PduRRoutingPathCommunicationType=COMMUNICATION_INTERFACE
            Debug_HMI_Trailer_Views_Data_oFDCAN14_14db284c_Tx (PduRDestPdu):
              PduRDestPduHandleId = 24
              PduRDestPduDirection = TRANSMIT
              PduRDestPduRoutingType = API_FORWARDING
              PduRDestPduDataProcessing = IMMEDIATE
              PduRPduLengthHandlingStrategy = IGNORE
              PduRDestPduCrossPartitionDestination = false
              PduRTransmissionConfirmation = true
              PduRDestPduDataProvision = PDUR_DIRECT
              PduRDestPduRef = Debug_HMI_Trailer_Views_Data_oFDCAN14_14db284c_Tx
              PduRDestPduPduRBswModulesRef = CanIf
            PduRSrcPdu_5010c127 (PduRSrcPdu):
              PduRSourcePduHandleId = 27
              PduRSrcPduDirection = TRANSMIT
              PduRSrcPduRef = Debug_HMI_Trailer_Views_Data_oFDCAN14_a6759e51_Tx
              PduRSrcPduPduRBswModulesRef = Com
          ME_SnsDat_Rear_Direct_2_oFDCAN14_b9e07ed5_Tx: PduRRoutingPathCommunicationType=COMMUNICATION_INTERFACE
            ME_SnsDat_Rear_Direct_2_oFDCAN14_b1a7fdfd_Tx (PduRDestPdu):
              PduRDestPduHandleId = 81
              PduRDestPduDirection = TRANSMIT
              PduRDestPduRoutingType = API_FORWARDING
              PduRDestPduDataProcessing = IMMEDIATE
              PduRPduLengthHandlingStrategy = IGNORE
              PduRDestPduCrossPartitionDestination = false
              PduRTransmissionConfirmation = true
              PduRDestPduDataProvision = PDUR_DIRECT
              PduRDestPduRef = ME_SnsDat_Rear_Direct_2_oFDCAN14_b1a7fdfd_Tx
              PduRDestPduPduRBswModulesRef = CanIf
            PduRSrcPdu_45b1ddd7 (PduRSrcPdu):
              PduRSourcePduHandleId = 84
              PduRSrcPduDirection = TRANSMIT
              PduRSrcPduRef = ME_SnsDat_Rear_Direct_2_oFDCAN14_b9e07ed5_Tx
              PduRSrcPduPduRBswModulesRef = Com
          ME_SnsDat_Rear_Direct_oFDCAN14_25ea33b4_Tx: PduRRoutingPathCommunicationType=COMMUNICATION_INTERFACE
            PduRSrcPdu_20355d3f (PduRSrcPdu): PduRSourcePduHandleId=85, PduRSrcPduDirection=TRANSMIT, PduRSrcPduRef=ME_SnsDat_Rear_Direct_oFDCAN14_25ea33b4_Tx, PduRSrcPduPduRBswModulesRef=Com
            ME_SnsDat_Rear_Direct_oFDCAN14_caebeaa6_Tx (PduRDestPdu):
              PduRDestPduHandleId = 82
              PduRDestPduDirection = TRANSMIT
              PduRDestPduRoutingType = API_FORWARDING
              PduRDestPduDataProcessing = IMMEDIATE
              PduRPduLengthHandlingStrategy = IGNORE
              PduRDestPduCrossPartitionDestination = false
              PduRTransmissionConfirmation = true
              PduRDestPduDataProvision = PDUR_DIRECT
              PduRDestPduRef = ME_SnsDat_Rear_Direct_oFDCAN14_caebeaa6_Tx
              PduRDestPduPduRBswModulesRef = CanIf
          ME_SnsDat_Front_Indirect_2_oFDCAN14_c2537c7b_Tx: PduRRoutingPathCommunicationType=COMMUNICATION_INTERFACE
            ME_SnsDat_Front_Indirect_2_oFDCAN14_d5066aa1_Tx (PduRDestPdu):
              PduRDestPduHandleId = 80
              PduRDestPduDirection = TRANSMIT
              PduRDestPduRoutingType = API_FORWARDING
              PduRDestPduDataProcessing = IMMEDIATE
              PduRPduLengthHandlingStrategy = IGNORE
              PduRDestPduCrossPartitionDestination = false
              PduRTransmissionConfirmation = true
              PduRDestPduDataProvision = PDUR_DIRECT
              PduRDestPduRef = ME_SnsDat_Front_Indirect_2_oFDCAN14_d5066aa1_Tx
              PduRDestPduPduRBswModulesRef = CanIf
            PduRSrcPdu_a25cde99 (PduRSrcPdu):
              PduRSourcePduHandleId = 83
              PduRSrcPduDirection = TRANSMIT
              PduRSrcPduRef = ME_SnsDat_Front_Indirect_2_oFDCAN14_c2537c7b_Tx
              PduRSrcPduPduRBswModulesRef = Com
          ME_SnsDat_Rear_Indirect_1_oFDCAN14_a3a78688_Tx: PduRRoutingPathCommunicationType=COMMUNICATION_INTERFACE
            ME_SnsDat_Rear_Indirect_1_oFDCAN14_fcf9f154_Tx (PduRDestPdu):
              PduRDestPduHandleId = 83
              PduRDestPduDirection = TRANSMIT
              PduRDestPduRoutingType = API_FORWARDING
              PduRDestPduDataProcessing = IMMEDIATE
              PduRPduLengthHandlingStrategy = IGNORE
              PduRDestPduCrossPartitionDestination = false
              PduRTransmissionConfirmation = true
              PduRDestPduDataProvision = PDUR_DIRECT
              PduRDestPduRef = ME_SnsDat_Rear_Indirect_1_oFDCAN14_fcf9f154_Tx
              PduRDestPduPduRBswModulesRef = CanIf
            PduRSrcPdu_aef6db3c (PduRSrcPdu):
              PduRSourcePduHandleId = 86
              PduRSrcPduDirection = TRANSMIT
              PduRSrcPduRef = ME_SnsDat_Rear_Indirect_1_oFDCAN14_a3a78688_Tx
              PduRSrcPduPduRBswModulesRef = Com
          ME_SnsDat_Front_Indirect_1_oFDCAN14_2964c778_Tx: PduRRoutingPathCommunicationType=COMMUNICATION_INTERFACE
            PduRSrcPdu_0d89d795 (PduRSrcPdu):
              PduRSourcePduHandleId = 82
              PduRSrcPduDirection = TRANSMIT
              PduRSrcPduRef = ME_SnsDat_Front_Indirect_1_oFDCAN14_2964c778_Tx
              PduRSrcPduPduRBswModulesRef = Com
            ME_SnsDat_Front_Indirect_1_oFDCAN14_66924762_Tx (PduRDestPdu):
              PduRDestPduHandleId = 79
              PduRDestPduDirection = TRANSMIT
              PduRDestPduRoutingType = API_FORWARDING
              PduRDestPduDataProcessing = IMMEDIATE
              PduRPduLengthHandlingStrategy = IGNORE
              PduRDestPduCrossPartitionDestination = false
              PduRTransmissionConfirmation = true
              PduRDestPduDataProvision = PDUR_DIRECT
              PduRDestPduRef = ME_SnsDat_Front_Indirect_1_oFDCAN14_66924762_Tx
              PduRDestPduPduRBswModulesRef = CanIf
          ME_Debug_SensorTestData_2_oFDCAN14_ddb83a88_Tx: PduRRoutingPathCommunicationType=COMMUNICATION_INTERFACE
            PduRSrcPdu_cc1d86f5 (PduRSrcPdu):
              PduRSourcePduHandleId = 76
              PduRSrcPduDirection = TRANSMIT
              PduRSrcPduRef = ME_Debug_SensorTestData_2_oFDCAN14_ddb83a88_Tx
              PduRSrcPduPduRBswModulesRef = Com
            ME_Debug_SensorTestData_2_oFDCAN14_c720309c_Tx (PduRDestPdu):
              PduRDestPduHandleId = 73
              PduRDestPduDirection = TRANSMIT
              PduRDestPduRoutingType = API_FORWARDING
              PduRDestPduDataProcessing = IMMEDIATE
              PduRPduLengthHandlingStrategy = IGNORE
              PduRDestPduCrossPartitionDestination = false
              PduRDestPduDataProvision = PDUR_DIRECT
              PduRTransmissionConfirmation = true
              PduRDestPduRef = ME_Debug_SensorTestData_2_oFDCAN14_c720309c_Tx
              PduRDestPduPduRBswModulesRef = CanIf
          ME_Debug_SensorTestData_1_oFDCAN14_368f818b_Tx: PduRRoutingPathCommunicationType=COMMUNICATION_INTERFACE
            ME_Debug_SensorTestData_1_oFDCAN14_74b41d5f_Tx (PduRDestPdu):
              PduRDestPduHandleId = 72
              PduRDestPduDirection = TRANSMIT
              PduRDestPduRoutingType = API_FORWARDING
              PduRDestPduDataProcessing = IMMEDIATE
              PduRPduLengthHandlingStrategy = IGNORE
              PduRDestPduCrossPartitionDestination = false
              PduRDestPduDataProvision = PDUR_DIRECT
              PduRTransmissionConfirmation = true
              PduRDestPduRef = ME_Debug_SensorTestData_1_oFDCAN14_74b41d5f_Tx
              PduRDestPduPduRBswModulesRef = CanIf
            PduRSrcPdu_14e82cb0 (PduRSrcPdu):
              PduRSourcePduHandleId = 75
              PduRSrcPduDirection = TRANSMIT
              PduRSrcPduRef = ME_Debug_SensorTestData_1_oFDCAN14_368f818b_Tx
              PduRSrcPduPduRBswModulesRef = Com
          ME_SnsDat_Front_Direct_2_oFDCAN14_8dab0270_Tx: PduRRoutingPathCommunicationType=COMMUNICATION_INTERFACE
            PduRSrcPdu_036d6a43 (PduRSrcPdu):
              PduRSourcePduHandleId = 80
              PduRSrcPduDirection = TRANSMIT
              PduRSrcPduRef = ME_SnsDat_Front_Direct_2_oFDCAN14_8dab0270_Tx
              PduRSrcPduPduRBswModulesRef = Com
            ME_SnsDat_Front_Direct_2_oFDCAN14_0f179e9e_Tx (PduRDestPdu):
              PduRDestPduHandleId = 77
              PduRDestPduDirection = TRANSMIT
              PduRDestPduRoutingType = API_FORWARDING
              PduRDestPduDataProcessing = IMMEDIATE
              PduRPduLengthHandlingStrategy = IGNORE
              PduRDestPduCrossPartitionDestination = false
              PduRTransmissionConfirmation = true
              PduRDestPduDataProvision = PDUR_DIRECT
              PduRDestPduRef = ME_SnsDat_Front_Direct_2_oFDCAN14_0f179e9e_Tx
              PduRDestPduPduRBswModulesRef = CanIf
          ME_Debug_SensorTestData_3_oFDCAN14_327a51b6_Tx: PduRRoutingPathCommunicationType=COMMUNICATION_INTERFACE
            ME_Debug_SensorTestData_3_oFDCAN14_a9ac2bdd_Tx (PduRDestPdu):
              PduRDestPduHandleId = 74
              PduRDestPduDirection = TRANSMIT
              PduRDestPduRoutingType = API_FORWARDING
              PduRDestPduDataProcessing = IMMEDIATE
              PduRPduLengthHandlingStrategy = IGNORE
              PduRDestPduCrossPartitionDestination = false
              PduRDestPduDataProvision = PDUR_DIRECT
              PduRTransmissionConfirmation = true
              PduRDestPduRef = ME_Debug_SensorTestData_3_oFDCAN14_a9ac2bdd_Tx
              PduRDestPduPduRBswModulesRef = CanIf
            PduRSrcPdu_b134addd (PduRSrcPdu):
              PduRSourcePduHandleId = 77
              PduRSrcPduDirection = TRANSMIT
              PduRSrcPduRef = ME_Debug_SensorTestData_3_oFDCAN14_327a51b6_Tx
              PduRSrcPduPduRBswModulesRef = Com
          ME_SnsDat_Rear_Indirect_2_oFDCAN14_48903d8b_Tx: PduRRoutingPathCommunicationType=COMMUNICATION_INTERFACE
            ME_SnsDat_Rear_Indirect_2_oFDCAN14_4f6ddc97_Tx (PduRDestPdu):
              PduRDestPduHandleId = 84
              PduRDestPduDirection = TRANSMIT
              PduRDestPduRoutingType = API_FORWARDING
              PduRDestPduDataProcessing = IMMEDIATE
              PduRPduLengthHandlingStrategy = IGNORE
              PduRDestPduCrossPartitionDestination = false
              PduRTransmissionConfirmation = true
              PduRDestPduDataProvision = PDUR_DIRECT
              PduRDestPduRef = ME_SnsDat_Rear_Indirect_2_oFDCAN14_4f6ddc97_Tx
              PduRDestPduPduRBswModulesRef = CanIf
            PduRSrcPdu_4239045a (PduRSrcPdu):
              PduRSourcePduHandleId = 87
              PduRSrcPduDirection = TRANSMIT
              PduRSrcPduRef = ME_SnsDat_Rear_Indirect_2_oFDCAN14_48903d8b_Tx
              PduRSrcPduPduRBswModulesRef = Com
          Debug_HMI_Internal_Data_oFDCAN14_66bd4100_Tx: PduRRoutingPathCommunicationType=COMMUNICATION_INTERFACE
            Debug_HMI_Internal_Data_oFDCAN14_4a1b027e_Tx (PduRDestPdu):
              PduRDestPduHandleId = 23
              PduRDestPduDirection = TRANSMIT
              PduRDestPduRoutingType = API_FORWARDING
              PduRDestPduDataProcessing = IMMEDIATE
              PduRPduLengthHandlingStrategy = IGNORE
              PduRDestPduCrossPartitionDestination = false
              PduRTransmissionConfirmation = true
              PduRDestPduDataProvision = PDUR_DIRECT
              PduRDestPduRef = Debug_HMI_Internal_Data_oFDCAN14_4a1b027e_Tx
              PduRDestPduPduRBswModulesRef = CanIf
            PduRSrcPdu_6db30f7a (PduRSrcPdu):
              PduRSourcePduHandleId = 26
              PduRSrcPduDirection = TRANSMIT
              PduRSrcPduRef = Debug_HMI_Internal_Data_oFDCAN14_66bd4100_Tx
              PduRSrcPduPduRBswModulesRef = Com
          ME_SnsDat_Front_Direct_oFDCAN14_ef61fa06_Tx: PduRRoutingPathCommunicationType=COMMUNICATION_INTERFACE
            ME_SnsDat_Front_Direct_oFDCAN14_b2df9b13_Tx (PduRDestPdu):
              PduRDestPduHandleId = 78
              PduRDestPduDirection = TRANSMIT
              PduRDestPduRoutingType = API_FORWARDING
              PduRDestPduDataProcessing = IMMEDIATE
              PduRPduLengthHandlingStrategy = IGNORE
              PduRDestPduCrossPartitionDestination = false
              PduRTransmissionConfirmation = true
              PduRDestPduDataProvision = PDUR_DIRECT
              PduRDestPduRef = ME_SnsDat_Front_Direct_oFDCAN14_b2df9b13_Tx
              PduRDestPduPduRBswModulesRef = CanIf
            PduRSrcPdu_5718ac60 (PduRSrcPdu): PduRSourcePduHandleId=81, PduRSrcPduDirection=TRANSMIT, PduRSrcPduRef=ME_SnsDat_Front_Direct_oFDCAN14_ef61fa06_Tx, PduRSrcPduPduRBswModulesRef=Com
          UssCsmStateChangeReasons_oFDCAN14_338dbf06_Tx: PduRRoutingPathCommunicationType=COMMUNICATION_INTERFACE
            UssCsmStateChangeReasons_oFDCAN14_21391911_Tx (PduRDestPdu):
              PduRDestPduHandleId = 114
              PduRDestPduDirection = TRANSMIT
              PduRDestPduRoutingType = API_FORWARDING
              PduRDestPduDataProcessing = IMMEDIATE
              PduRPduLengthHandlingStrategy = IGNORE
              PduRDestPduCrossPartitionDestination = false
              PduRDestPduDataProvision = PDUR_DIRECT
              PduRTransmissionConfirmation = true
              PduRDestPduRef = UssCsmStateChangeReasons_oFDCAN14_21391911_Tx
              PduRDestPduPduRBswModulesRef = CanIf
            PduRSrcPdu_4a89c027 (PduRSrcPdu):
              PduRSourcePduHandleId = 117
              PduRSrcPduDirection = TRANSMIT
              PduRSrcPduRef = UssCsmStateChangeReasons_oFDCAN14_338dbf06_Tx
              PduRSrcPduPduRBswModulesRef = Com
          Log_PackedNoiseMeasData_oFDCAN14_b57e278e_Tx: PduRRoutingPathCommunicationType=COMMUNICATION_INTERFACE
            PduRSrcPdu_4c3354d5 (PduRSrcPdu):
              PduRSourcePduHandleId = 64
              PduRSrcPduDirection = TRANSMIT
              PduRSrcPduRef = Log_PackedNoiseMeasData_oFDCAN14_b57e278e_Tx
              PduRSrcPduPduRBswModulesRef = Cdd_UssLog
            Log_PackedNoiseMeasData_oFDCAN14_967b3578_Tx (PduRDestPdu):
              PduRDestPduHandleId = 61
              PduRDestPduDirection = TRANSMIT
              PduRDestPduRoutingType = API_FORWARDING
              PduRDestPduDataProcessing = IMMEDIATE
              PduRPduLengthHandlingStrategy = IGNORE
              PduRDestPduCrossPartitionDestination = false
              PduRDestPduDataProvision = PDUR_DIRECT
              PduRTransmissionConfirmation = true
              PduRDestPduRef = Log_PackedNoiseMeasData_oFDCAN14_967b3578_Tx
              PduRDestPduPduRBswModulesRef = CanIf
          Log_PackedDiagFlagData1_v_oFDCAN14_3f2e5ac7_Tx: PduRRoutingPathCommunicationType=COMMUNICATION_INTERFACE
            PduRSrcPdu_9b3a0dc2 (PduRSrcPdu):
              PduRSourcePduHandleId = 62
              PduRSrcPduDirection = TRANSMIT
              PduRSrcPduRef = Log_PackedDiagFlagData1_v_oFDCAN14_3f2e5ac7_Tx
              PduRSrcPduPduRBswModulesRef = Cdd_UssLog
            Log_PackedDiagFlagData1_v_oFDCAN14_a37af45a_Tx (PduRDestPdu):
              PduRDestPduHandleId = 59
              PduRDestPduDirection = TRANSMIT
              PduRDestPduRoutingType = API_FORWARDING
              PduRDestPduDataProcessing = IMMEDIATE
              PduRPduLengthHandlingStrategy = IGNORE
              PduRDestPduCrossPartitionDestination = false
              PduRDestPduDataProvision = PDUR_DIRECT
              PduRTransmissionConfirmation = true
              PduRDestPduRef = Log_PackedDiagFlagData1_v_oFDCAN14_a37af45a_Tx
              PduRDestPduPduRBswModulesRef = CanIf
          Log_PackedDiagFlagData2_v_oFDCAN14_48b08837_Tx: PduRRoutingPathCommunicationType=COMMUNICATION_INTERFACE
            PduRSrcPdu_50134c72 (PduRSrcPdu):
              PduRSourcePduHandleId = 63
              PduRSrcPduDirection = TRANSMIT
              PduRSrcPduRef = Log_PackedDiagFlagData2_v_oFDCAN14_48b08837_Tx
              PduRSrcPduPduRBswModulesRef = Cdd_UssLog
            Log_PackedDiagFlagData2_v_oFDCAN14_06729f36_Tx (PduRDestPdu):
              PduRDestPduHandleId = 60
              PduRDestPduDirection = TRANSMIT
              PduRDestPduRoutingType = API_FORWARDING
              PduRDestPduDataProcessing = IMMEDIATE
              PduRPduLengthHandlingStrategy = IGNORE
              PduRDestPduCrossPartitionDestination = false
              PduRDestPduDataProvision = PDUR_DIRECT
              PduRTransmissionConfirmation = true
              PduRDestPduRef = Log_PackedDiagFlagData2_v_oFDCAN14_06729f36_Tx
              PduRDestPduPduRBswModulesRef = CanIf
          ME_SystemDebugData_1_oFDCAN14_73975cf6_Tx: PduRRoutingPathCommunicationType=COMMUNICATION_INTERFACE
            PduRSrcPdu_449ee227 (PduRSrcPdu): PduRSourcePduHandleId=88, PduRSrcPduDirection=TRANSMIT, PduRSrcPduRef=ME_SystemDebugData_1_oFDCAN14_73975cf6_Tx, PduRSrcPduPduRBswModulesRef=Com
            ME_SystemDebugData_1_oFDCAN14_d1a1dda3_Tx (PduRDestPdu):
              PduRDestPduHandleId = 85
              PduRDestPduDirection = TRANSMIT
              PduRDestPduRoutingType = API_FORWARDING
              PduRDestPduDataProcessing = IMMEDIATE
              PduRPduLengthHandlingStrategy = IGNORE
              PduRDestPduCrossPartitionDestination = false
              PduRDestPduDataProvision = PDUR_DIRECT
              PduRTransmissionConfirmation = true
              PduRDestPduRef = ME_SystemDebugData_1_oFDCAN14_d1a1dda3_Tx
              PduRDestPduPduRBswModulesRef = CanIf
          ME_MCUOsDebugData1_oFDCAN14_0343bfd6_Tx: PduRRoutingPathCommunicationType=COMMUNICATION_INTERFACE
            PduRSrcPdu_9d508691 (PduRSrcPdu): PduRSourcePduHandleId=78, PduRSrcPduDirection=TRANSMIT, PduRSrcPduRef=ME_MCUOsDebugData1_oFDCAN14_0343bfd6_Tx, PduRSrcPduPduRBswModulesRef=Com
            ME_MCUOsDebugData1_oFDCAN14_137bf977_Tx (PduRDestPdu):
              PduRDestPduHandleId = 75
              PduRDestPduDirection = TRANSMIT
              PduRDestPduRoutingType = API_FORWARDING
              PduRDestPduDataProcessing = IMMEDIATE
              PduRPduLengthHandlingStrategy = IGNORE
              PduRDestPduCrossPartitionDestination = false
              PduRDestPduDataProvision = PDUR_DIRECT
              PduRTransmissionConfirmation = true
              PduRDestPduRef = ME_MCUOsDebugData1_oFDCAN14_137bf977_Tx
              PduRDestPduPduRBswModulesRef = CanIf
          ME_MCUOsDebugData2_oFDCAN14_e87404d5_Tx: PduRRoutingPathCommunicationType=COMMUNICATION_INTERFACE
            PduRSrcPdu_81d06a10 (PduRSrcPdu): PduRSourcePduHandleId=79, PduRSrcPduDirection=TRANSMIT, PduRSrcPduRef=ME_MCUOsDebugData2_oFDCAN14_e87404d5_Tx, PduRSrcPduPduRBswModulesRef=Com
            ME_MCUOsDebugData2_oFDCAN14_a0efd4b4_Tx (PduRDestPdu):
              PduRDestPduHandleId = 76
              PduRDestPduDirection = TRANSMIT
              PduRDestPduRoutingType = API_FORWARDING
              PduRDestPduDataProcessing = IMMEDIATE
              PduRPduLengthHandlingStrategy = IGNORE
              PduRDestPduCrossPartitionDestination = false
              PduRDestPduDataProvision = PDUR_DIRECT
              PduRTransmissionConfirmation = true
              PduRDestPduRef = ME_MCUOsDebugData2_oFDCAN14_a0efd4b4_Tx
              PduRDestPduPduRBswModulesRef = CanIf
      PduRLock_PduRExclusiveArea (PduRLock)
        PduRExclusiveArea: PduRExclusiveAreaId=0
    5 x PduRBswModules, all with PduRCancelReceive=false, PduRChangeParameterRequestApi=false, PduRTriggertransmit=false:
      CanIf: PduRCancelTransmit=false, PduRCommunicationInterface=true, PduRLowerModule=true, PduRTransportProtocol=false, PduRTxConfirmation=true, PduRUpperModule=false, PduRUseTag=false, PduRBswModuleRef=CanIf
      CanTp: PduRCancelTransmit=true, PduRCommunicationInterface=false, PduRLowerModule=true, PduRTransportProtocol=true, PduRTxConfirmation=false, PduRUpperModule=false, PduRUseTag=false, PduRBswModuleRef=CanTp
      Com: PduRCancelTransmit=false, PduRCommunicationInterface=true, PduRLowerModule=false, PduRTransportProtocol=false, PduRTxConfirmation=true, PduRUpperModule=true, PduRUseTag=false, PduRBswModuleRef=Com
      Dcm: PduRCancelTransmit=true, PduRCommunicationInterface=false, PduRLowerModule=false, PduRTransportProtocol=true, PduRTxConfirmation=false, PduRUpperModule=true, PduRUseTag=true, PduRBswModuleRef=Dcm
      Cdd_UssLog: PduRCancelTransmit=false, PduRCommunicationInterface=true, PduRLowerModule=false, PduRTransportProtocol=false, PduRTxConfirmation=true, PduRUpperModule=true, PduRUseTag=false, PduRBswModuleRef=Cdd_UssLog
