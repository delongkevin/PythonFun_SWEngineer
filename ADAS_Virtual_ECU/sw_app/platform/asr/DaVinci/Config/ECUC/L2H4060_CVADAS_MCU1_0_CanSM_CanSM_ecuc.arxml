AUTOSAR XML (schema 00048)
package /ActiveEcuC
  module config CanSM: implementation-config-variant=VARIANT-PRE-COMPILE, module-description=CanSM_Impl
    CanSMConfiguration: CanSMModeRequestRepetitionMax=10, CanSMModeRequestRepetitionTime=0.1
      CHNL_7d164bae (CanSMManagerNetwork):
        CanSMBorCounterL1ToL2 = 5
        CanSMBorTimeL1 = 1
        CanSMBorTimeL2 = 3
        CanSMBorTimeTxEnsured = 5
        CanSMBorTxConfirmationPolling = false
        CanSMComMNetworkHandleRef = CN_FDCAN2_28a8fc44
        CanSMTransceiverId = CanIfTrcvCfg
        CT_FDCAN2_40f2f53c (CanSMController): CanSMControllerId=CT_FDCAN2_c5d3d1a7
      CHNL_79fa912a (CanSMManagerNetwork):
        CanSMBorCounterL1ToL2 = 5
        CanSMBorTimeL1 = 1
        CanSMBorTimeL2 = 3
        CanSMBorTimeTxEnsured = 5
        CanSMBorTxConfirmationPolling = false
        CanSMComMNetworkHandleRef = CN_FDCAN14_a902658e
        CT_FDCAN14_693719eb (CanSMController): CanSMControllerId=CT_FDCAN14_90ecad61
    CanSMGeneral:
      CanSMDevErrorDetect = true
      CanSMMainFunctionTimePeriod = 0.01
      CanSMVersionInfoApi = false
      CanSMBorCheckLevel = false
      CanSMSafeBswChecks = false
      CanSMSetBaudrateApi = false
      CanSMBusOffBegin = Appl_BusOffBegin
      CanSMBusOffEnd = Appl_BusOffEnd
      CanSMPreventBusSleepAtStartUp = true
      CanSMGeneration: CanSMOutOfBoundsWriteSanitizer=false, CanSMOutOfBoundsReadSanitizer=false
