AUTOSAR XML (schema 00048)
package /ActiveEcuC
  module config NvM: implementation-config-variant=VARIANT-PRE-COMPILE, module-description=NvM_Impl
    11 x NvMBlockDescriptor, all with NvMBlockJobPriority=127, NvMBlockUseCrc=true, NvMBlockUseSyncMechanism=false, NvMBlockWriteProt=false, NvMBswMBlockStatusInformation=false, NvMResistantToChangedSw=true, NvMWriteBlockOnce=false, NvMUseInitCallback=false, NvMBlockUseCRCCompMechanism=false, NvMInvokeCallbacksForReadAll=true, NvMInvokeCallbacksForWriteAll=true, NvMCheckLossOfRedundancy=false, NvMBlockCrcType=NVM_CRC16, NvMAutomaticBlockLength=false, NvMBlockLengthCheck=false:
      NvMBlockDescriptor_ApplUpdate: NvMBlockManagementType=NVM_BLOCK_NATIVE, NvMNvBlockLength=1, NvMNvBlockNum=1, NvMNvramBlockIdentifier=2, NvMUseServicePorts=false, NvMUseJobendCallback=false, NvMBlockUseSetRamBlockStatus=false, NvMSelectBlockForReadAll=false, NvMSelectBlockForWriteAll=false, NvMBlockLengthCheckType=false, NvMCalcRamBlockCrc=false
        NvMTargetBlockReference
          NvMEaRef: NvMNameOfEaBlock=EaBlock_ApplUpdate
      CDD_CryptoMgrNvMBlockDescriptor_SecAccessDelayFlag: NvMBlockManagementType=NVM_BLOCK_NATIVE, NvMNvBlockLength=1, NvMNvBlockNum=1, NvMNvramBlockIdentifier=3, NvMUseServicePorts=true, NvMUseJobendCallback=false, NvMBlockUseSetRamBlockStatus=true, NvMSelectBlockForReadAll=true, NvMRamBlockDataAddress=Rte_CDD_CryptoMgr_Rte_CDD_CryptoMgr_Rte_SWC_CDD_CryptoMngr_SecAccessDelayFlag_MirrorBlock, NvMRomBlockDataAddress=Rte_CDD_CryptoMgr_Rte_CDD_CryptoMgr_Rte_SWC_CDD_CryptoMngr_SecAccessDelayFlag_DefaultValue  # UC:Derived from NvBlockNeeds
        NvMTargetBlockReference
          NvMEaRef: NvMNameOfEaBlock=EaBlockDescriptor_SecAccessDelayFlag
      CDD_CryptoMgrNvMBlockDescriptor_SecAccessInvalidCount: NvMBlockManagementType=NVM_BLOCK_NATIVE, NvMNvBlockLength=1, NvMNvBlockNum=1, NvMNvramBlockIdentifier=4, NvMUseServicePorts=true, NvMUseJobendCallback=false, NvMBlockUseSetRamBlockStatus=true, NvMSelectBlockForReadAll=true, NvMRamBlockDataAddress=Rte_CDD_CryptoMgr_Rte_CDD_CryptoMgr_Rte_SWC_CDD_CryptoMngr_SecAccessInvalidCount_MirrorBlock, NvMRomBlockDataAddress=Rte_CDD_CryptoMgr_Rte_CDD_CryptoMgr_Rte_SWC_CDD_CryptoMngr_SecAccessInvalidCount_DefaultValue  # UC:Derived from NvBlockNeeds
        NvMTargetBlockReference
          NvMEaRef: NvMNameOfEaBlock=EaBlockDescriptor_SecAccessInvalidCount
      NvMBlockDescriptor_ApplValidity: NvMBlockManagementType=NVM_BLOCK_NATIVE, NvMNvBlockLength=1, NvMNvBlockNum=1, NvMNvramBlockIdentifier=5, NvMUseServicePorts=false, NvMUseJobendCallback=false, NvMBlockUseSetRamBlockStatus=false, NvMCalcRamBlockCrc=false, NvMBlockLengthCheckType=false
        NvMTargetBlockReference
          NvMEaRef: NvMNameOfEaBlock=EaBlockDescriptor_ApplValidity
      NvMBlockDescriptor_DcmDslRxTesterSourceAddr: NvMBlockManagementType=NVM_BLOCK_NATIVE, NvMNvBlockLength=2, NvMNvBlockNum=1, NvMNvramBlockIdentifier=6, NvMUseServicePorts=false, NvMUseJobendCallback=false, NvMBlockUseSetRamBlockStatus=false, NvMCalcRamBlockCrc=false
        NvMTargetBlockReference
          NvMEaRef: NvMNameOfEaBlock=EaBlockDescriptor_DcmDslRxTesterSourceAddr
      NvMBlockDescriptor_ValidityFlags: NvMBlockManagementType=NVM_BLOCK_NATIVE, NvMNvBlockLength=2, NvMNvBlockNum=1, NvMNvramBlockIdentifier=7, NvMUseServicePorts=false, NvMUseJobendCallback=false, NvMBlockUseSetRamBlockStatus=false, NvMCalcRamBlockCrc=false
        NvMTargetBlockReference
          NvMEaRef: NvMNameOfEaBlock=EaBlockDescriptor_ValidityFlags
      NvMBlockDescriptor_ExhaustRegulationTan: NvMBlockManagementType=NVM_BLOCK_NATIVE, NvMNvBlockLength=6, NvMNvBlockNum=1, NvMNvramBlockIdentifier=8, NvMUseServicePorts=false, NvMUseJobendCallback=false, NvMBlockUseSetRamBlockStatus=false, NvMCalcRamBlockCrc=false
        NvMTargetBlockReference
          NvMEaRef: NvMNameOfEaBlock=EaBlockDescriptor_ExhaustRegulationTan
      NvMBlockDescriptor_ResetResponseFlag: NvMBlockManagementType=NVM_BLOCK_NATIVE, NvMNvBlockLength=1, NvMNvBlockNum=1, NvMNvramBlockIdentifier=9, NvMUseServicePorts=false, NvMUseJobendCallback=false, NvMBlockUseSetRamBlockStatus=false, NvMCalcRamBlockCrc=false
        NvMTargetBlockReference
          NvMEaRef: NvMNameOfEaBlock=EaBlockDescriptor_ResetResponseFlag
      NvMBlockDescriptor_DID_2010_ProgrammingStatus: NvMBlockManagementType=NVM_BLOCK_NATIVE, NvMNvBlockLength=2, NvMNvBlockNum=1, NvMNvramBlockIdentifier=11, NvMUseServicePorts=false, NvMUseJobendCallback=false, NvMBlockUseSetRamBlockStatus=false, NvMCalcRamBlockCrc=false
        NvMTargetBlockReference
          NvMEaRef: NvMNameOfEaBlock=EaBlockDescriptor_DID_2010_ProgrammingStatus
      NvMBlockDescriptor_MetaData: NvMBlockManagementType=NVM_BLOCK_DATASET, NvMNvBlockLength=126, NvMNvBlockNum=10, NvMNvramBlockIdentifier=12, NvMUseServicePorts=true, NvMUseJobendCallback=true, NvMBlockUseSetRamBlockStatus=false, NvMCalcRamBlockCrc=false
        NvMTargetBlockReference
          NvMEaRef: NvMNameOfEaBlock=EaBlockDescriptor_MetaData
      NvMConfigBlock: NvMNvramBlockIdentifier=1, NvMBlockManagementType=NVM_BLOCK_REDUNDANT, NvMNvBlockNum=2, NvMNvBlockLength=2, NvMSelectBlockForReadAll=true, NvMSelectBlockForWriteAll=true, NvMCalcRamBlockCrc=false, NvMRomBlockDataAddress=NULL_PTR, NvMBlockPostReadTransformCallback=NULL_PTR, NvMBlockPreWriteTransformCallback=NULL_PTR, NvMBlockUseSetRamBlockStatus=true, NvMUseServicePorts=false, NvMUseJobendCallback=false, NvMRamBlockDataAddress=NULL_PTR
        NvMTargetBlockReference
          NvMEaRef: NvMNameOfEaBlock=EaBlockConfiguration
    NvMCommon:
      NvMApiConfigClass = NVM_API_CONFIG_CLASS_3
      NvMBswMMultiBlockJobStatusInformation = true
      NvMCompiledConfigId = 5
      NvMCrcNumOfBytes = 64
      NvMDatasetSelectionBits = 4
      NvMDevErrorDetect = false
      NvMDrvModeSwitch = true
      NvMDynamicConfiguration = false
      NvMJobPrioritization = false
      NvMPollingMode = true
      NvMSetRamBlockStatusApi = true
      NvMSizeStandardJobQueue = 35
      NvMVersionInfoApi = false
      NvMMaxNoOfWriteRetries = 1
      NvMMainFunctionPeriod = 0.01
      NvMUseBlockIdCheck = false
      NvMRepairRedundantBlocksApi = true
      NvMSafeBswChecks = false
      NvMDetectedLossOfRedundancyCallback = NvM_LossOfRedundancyCbk
      NvMSizeImmediateJobQueue = 5
    NvMCommonVendorParams:
      NvMDataIntegrityIntBuffer = true
      NvMKillWriteAllApi = true
      NvMCfgCbkIncludeList = vRoE.h
      NvMCfgCbkIncludeList = Eep_Public.h
      NvMCfgCbkIncludeList = Dem_Cbk.h
      NvMCfgCbkIncludeList = Dem.h
      NvMJobForwardingToMemoryCore = false
      NvMPreReadAllApi = false
      NvMCfgCbkIncludeList = NvMdef_User_Types.h
    72 x NvMBlockDescriptor, all with NvMBlockUseSyncMechanism=false, NvMBlockWriteProt=false, NvMBswMBlockStatusInformation=false, NvMWriteBlockOnce=false:
      NvM_Dem_ADMIN: NvMBlockJobPriority=127, NvMBlockManagementType=NVM_BLOCK_NATIVE, NvMBlockUseCrc=true, NvMNvBlockLength=12, NvMNvBlockNum=1, NvMNvramBlockIdentifier=27, NvMResistantToChangedSw=false, NvMUseServicePorts=false, NvMUseJobendCallback=true, NvMUseInitCallback=true, NvMBlockUseCRCCompMechanism=false, NvMBlockUseSetRamBlockStatus=true, NvMInvokeCallbacksForReadAll=false, NvMInvokeCallbacksForWriteAll=false, NvMCheckLossOfRedundancy=false, NvMAutomaticBlockLength=true, NvMBlockCrcType=NVM_CRC16, NvMSelectBlockForReadAll=true, NvMBlockLengthCheck=true, NvMInitBlockCallback=Dem_NvM_InitAdminData, NvMRamBlockDataAddress=Dem_Cfg_AdminData, NvMReadRamBlockFromNvCallback=NULL_PTR, NvMRomBlockDataAddress=NULL_PTR, NvMSelectBlockForWriteAll=true, NvMSingleBlockCallback=Dem_NvM_JobFinished, NvMWriteRamBlockToNvCallback=NULL_PTR
        NvMTargetBlockReference
          NvMEaRef: NvMNameOfEaBlock=EaBlockDem_AdminData
      NvM_Dem_Aging: NvMBlockJobPriority=127, NvMBlockManagementType=NVM_BLOCK_NATIVE, NvMBlockUseCrc=true, NvMNvBlockLength=132, NvMNvBlockNum=1, NvMNvramBlockIdentifier=28, NvMResistantToChangedSw=false, NvMUseServicePorts=false, NvMUseJobendCallback=true, NvMUseInitCallback=false, NvMBlockUseCRCCompMechanism=false, NvMBlockUseSetRamBlockStatus=true, NvMInvokeCallbacksForReadAll=false, NvMInvokeCallbacksForWriteAll=false, NvMCheckLossOfRedundancy=false, NvMAutomaticBlockLength=true, NvMBlockCrcType=NVM_CRC16, NvMSelectBlockForReadAll=true, NvMBlockLengthCheck=true, NvMRamBlockDataAddress=Dem_Cfg_AgingData, NvMReadRamBlockFromNvCallback=NULL_PTR, NvMRomBlockDataAddress=NULL_PTR, NvMSelectBlockForWriteAll=true, NvMSingleBlockCallback=Dem_NvM_JobFinished, NvMWriteRamBlockToNvCallback=NULL_PTR
        NvMTargetBlockReference
          NvMEaRef: NvMNameOfEaBlock=EaBlockDem_Aging
      NvM_Dem_PRIMARY0: NvMBlockJobPriority=127, NvMBlockManagementType=NVM_BLOCK_NATIVE, NvMBlockUseCrc=true, NvMNvBlockLength=84, NvMNvBlockNum=1, NvMNvramBlockIdentifier=29, NvMResistantToChangedSw=false, NvMUseServicePorts=false, NvMUseJobendCallback=true, NvMUseInitCallback=false, NvMBlockUseCRCCompMechanism=false, NvMBlockUseSetRamBlockStatus=true, NvMInvokeCallbacksForReadAll=false, NvMInvokeCallbacksForWriteAll=false, NvMCheckLossOfRedundancy=false, NvMAutomaticBlockLength=true, NvMBlockCrcType=NVM_CRC16, NvMSelectBlockForReadAll=true, NvMSelectBlockForWriteAll=true, NvMBlockLengthCheck=true, NvMRamBlockDataAddress=Dem_Cfg_PrimaryEntry_0, NvMRomBlockDataAddress=Dem_Cfg_MemoryEntryInit, NvMSingleBlockCallback=Dem_NvM_JobFinished, NvMWriteRamBlockToNvCallback=NULL_PTR
        NvMTargetBlockReference
          NvMEaRef: NvMNameOfEaBlock=EaBlockDem_Primary0
      NvM_Dem_PRIMARY1: NvMBlockJobPriority=127, NvMBlockManagementType=NVM_BLOCK_NATIVE, NvMBlockUseCrc=true, NvMNvBlockLength=84, NvMNvBlockNum=1, NvMNvramBlockIdentifier=30, NvMResistantToChangedSw=false, NvMUseServicePorts=false, NvMUseJobendCallback=true, NvMUseInitCallback=false, NvMBlockUseCRCCompMechanism=false, NvMBlockUseSetRamBlockStatus=true, NvMInvokeCallbacksForReadAll=false, NvMInvokeCallbacksForWriteAll=false, NvMCheckLossOfRedundancy=false, NvMAutomaticBlockLength=true, NvMBlockCrcType=NVM_CRC16, NvMSelectBlockForReadAll=true, NvMBlockLengthCheck=true, NvMRamBlockDataAddress=Dem_Cfg_PrimaryEntry_1, NvMRomBlockDataAddress=Dem_Cfg_MemoryEntryInit, NvMSelectBlockForWriteAll=true, NvMSingleBlockCallback=Dem_NvM_JobFinished, NvMWriteRamBlockToNvCallback=NULL_PTR
        NvMTargetBlockReference
          NvMEaRef: NvMNameOfEaBlock=EaBlockDem_Primary1
      NvM_Dem_PRIMARY2: NvMBlockJobPriority=127, NvMBlockManagementType=NVM_BLOCK_NATIVE, NvMBlockUseCrc=true, NvMNvBlockLength=84, NvMNvBlockNum=1, NvMNvramBlockIdentifier=31, NvMResistantToChangedSw=false, NvMUseServicePorts=false, NvMUseJobendCallback=true, NvMUseInitCallback=false, NvMBlockUseCRCCompMechanism=false, NvMBlockUseSetRamBlockStatus=true, NvMInvokeCallbacksForReadAll=false, NvMInvokeCallbacksForWriteAll=false, NvMCheckLossOfRedundancy=false, NvMAutomaticBlockLength=true, NvMBlockCrcType=NVM_CRC16, NvMSelectBlockForReadAll=true, NvMBlockLengthCheck=true, NvMRamBlockDataAddress=Dem_Cfg_PrimaryEntry_2, NvMRomBlockDataAddress=Dem_Cfg_MemoryEntryInit, NvMSelectBlockForWriteAll=true, NvMSingleBlockCallback=Dem_NvM_JobFinished, NvMWriteRamBlockToNvCallback=NULL_PTR
        NvMTargetBlockReference
          NvMEaRef: NvMNameOfEaBlock=EaBlockDem_Primary2
      NvM_Dem_PRIMARY3: NvMBlockJobPriority=127, NvMBlockManagementType=NVM_BLOCK_NATIVE, NvMBlockUseCrc=true, NvMNvBlockLength=84, NvMNvBlockNum=1, NvMNvramBlockIdentifier=32, NvMResistantToChangedSw=false, NvMUseServicePorts=false, NvMUseJobendCallback=true, NvMUseInitCallback=false, NvMBlockUseCRCCompMechanism=false, NvMBlockUseSetRamBlockStatus=true, NvMInvokeCallbacksForReadAll=false, NvMInvokeCallbacksForWriteAll=false, NvMCheckLossOfRedundancy=false, NvMAutomaticBlockLength=true, NvMBlockCrcType=NVM_CRC16, NvMSelectBlockForReadAll=true, NvMBlockLengthCheck=true, NvMRamBlockDataAddress=Dem_Cfg_PrimaryEntry_3, NvMRomBlockDataAddress=Dem_Cfg_MemoryEntryInit, NvMSelectBlockForWriteAll=true, NvMSingleBlockCallback=Dem_NvM_JobFinished, NvMWriteRamBlockToNvCallback=NULL_PTR
        NvMTargetBlockReference
          NvMEaRef: NvMNameOfEaBlock=EaBlockDem_Primary3
      NvM_Dem_PRIMARY4: NvMBlockJobPriority=127, NvMBlockManagementType=NVM_BLOCK_NATIVE, NvMBlockUseCrc=true, NvMNvBlockLength=84, NvMNvBlockNum=1, NvMNvramBlockIdentifier=33, NvMResistantToChangedSw=false, NvMUseServicePorts=false, NvMUseJobendCallback=true, NvMUseInitCallback=false, NvMBlockUseCRCCompMechanism=false, NvMBlockUseSetRamBlockStatus=true, NvMInvokeCallbacksForReadAll=false, NvMInvokeCallbacksForWriteAll=false, NvMCheckLossOfRedundancy=false, NvMAutomaticBlockLength=true, NvMBlockCrcType=NVM_CRC16, NvMSelectBlockForReadAll=true, NvMBlockLengthCheck=true, NvMRamBlockDataAddress=Dem_Cfg_PrimaryEntry_4, NvMRomBlockDataAddress=Dem_Cfg_MemoryEntryInit, NvMSelectBlockForWriteAll=true, NvMSingleBlockCallback=Dem_NvM_JobFinished, NvMWriteRamBlockToNvCallback=NULL_PTR
        NvMTargetBlockReference
          NvMEaRef: NvMNameOfEaBlock=EaBlockDem_Primary4
      NvM_Dem_PRIMARY5: NvMBlockJobPriority=127, NvMBlockManagementType=NVM_BLOCK_NATIVE, NvMBlockUseCrc=true, NvMNvBlockLength=84, NvMNvBlockNum=1, NvMNvramBlockIdentifier=34, NvMResistantToChangedSw=false, NvMUseServicePorts=false, NvMUseJobendCallback=true, NvMUseInitCallback=false, NvMBlockUseCRCCompMechanism=false, NvMBlockUseSetRamBlockStatus=true, NvMInvokeCallbacksForReadAll=false, NvMInvokeCallbacksForWriteAll=false, NvMCheckLossOfRedundancy=false, NvMAutomaticBlockLength=true, NvMBlockCrcType=NVM_CRC16, NvMSelectBlockForReadAll=true, NvMBlockLengthCheck=true, NvMRamBlockDataAddress=Dem_Cfg_PrimaryEntry_5, NvMRomBlockDataAddress=Dem_Cfg_MemoryEntryInit, NvMSelectBlockForWriteAll=true, NvMSingleBlockCallback=Dem_NvM_JobFinished, NvMWriteRamBlockToNvCallback=NULL_PTR
        NvMTargetBlockReference
          NvMEaRef: NvMNameOfEaBlock=EaBlockDem_Primary5
      NvM_Dem_PRIMARY6: NvMBlockJobPriority=127, NvMBlockManagementType=NVM_BLOCK_NATIVE, NvMBlockUseCrc=true, NvMNvBlockLength=84, NvMNvBlockNum=1, NvMNvramBlockIdentifier=35, NvMResistantToChangedSw=false, NvMUseServicePorts=false, NvMUseJobendCallback=true, NvMUseInitCallback=false, NvMBlockUseCRCCompMechanism=false, NvMBlockUseSetRamBlockStatus=true, NvMInvokeCallbacksForReadAll=false, NvMInvokeCallbacksForWriteAll=false, NvMCheckLossOfRedundancy=false, NvMAutomaticBlockLength=true, NvMBlockCrcType=NVM_CRC16, NvMSelectBlockForReadAll=true, NvMBlockLengthCheck=true, NvMRamBlockDataAddress=Dem_Cfg_PrimaryEntry_6, NvMRomBlockDataAddress=Dem_Cfg_MemoryEntryInit, NvMSelectBlockForWriteAll=true, NvMSingleBlockCallback=Dem_NvM_JobFinished, NvMWriteRamBlockToNvCallback=NULL_PTR
        NvMTargetBlockReference
          NvMEaRef: NvMNameOfEaBlock=EaBlockDem_Primary6
      NvM_Dem_PRIMARY7: NvMBlockJobPriority=127, NvMBlockManagementType=NVM_BLOCK_NATIVE, NvMBlockUseCrc=true, NvMNvBlockLength=84, NvMNvBlockNum=1, NvMNvramBlockIdentifier=36, NvMResistantToChangedSw=false, NvMUseServicePorts=false, NvMUseJobendCallback=true, NvMUseInitCallback=false, NvMBlockUseCRCCompMechanism=false, NvMBlockUseSetRamBlockStatus=true, NvMInvokeCallbacksForReadAll=false, NvMInvokeCallbacksForWriteAll=false, NvMCheckLossOfRedundancy=false, NvMBlockCrcType=NVM_CRC16, NvMAutomaticBlockLength=true, NvMBlockLengthCheck=true, NvMSelectBlockForReadAll=true, NvMSelectBlockForWriteAll=true, NvMRamBlockDataAddress=Dem_Cfg_PrimaryEntry_7, NvMRomBlockDataAddress=Dem_Cfg_MemoryEntryInit, NvMSingleBlockCallback=Dem_NvM_JobFinished, NvMWriteRamBlockToNvCallback=NULL_PTR
        NvMTargetBlockReference
          NvMEaRef: NvMNameOfEaBlock=EaBlockDem_Primary7
      NvM_Dem_PRIMARY8: NvMBlockJobPriority=127, NvMBlockManagementType=NVM_BLOCK_NATIVE, NvMBlockUseCrc=true, NvMNvBlockLength=84, NvMNvBlockNum=1, NvMNvramBlockIdentifier=37, NvMResistantToChangedSw=false, NvMUseServicePorts=false, NvMUseJobendCallback=true, NvMUseInitCallback=false, NvMBlockUseCRCCompMechanism=false, NvMBlockUseSetRamBlockStatus=true, NvMInvokeCallbacksForReadAll=false, NvMInvokeCallbacksForWriteAll=false, NvMCheckLossOfRedundancy=false, NvMAutomaticBlockLength=true, NvMBlockCrcType=NVM_CRC16, NvMSelectBlockForReadAll=true, NvMBlockLengthCheck=true, NvMRamBlockDataAddress=Dem_Cfg_PrimaryEntry_8, NvMRomBlockDataAddress=Dem_Cfg_MemoryEntryInit, NvMSelectBlockForWriteAll=true, NvMSingleBlockCallback=Dem_NvM_JobFinished, NvMWriteRamBlockToNvCallback=NULL_PTR
        NvMTargetBlockReference
          NvMEaRef: NvMNameOfEaBlock=EaBlockDem_Primary8
      NvM_Dem_PRIMARY9: NvMBlockJobPriority=127, NvMBlockManagementType=NVM_BLOCK_NATIVE, NvMBlockUseCrc=true, NvMNvBlockLength=84, NvMNvBlockNum=1, NvMNvramBlockIdentifier=38, NvMResistantToChangedSw=false, NvMUseServicePorts=false, NvMUseJobendCallback=true, NvMUseInitCallback=false, NvMBlockUseCRCCompMechanism=false, NvMBlockUseSetRamBlockStatus=true, NvMInvokeCallbacksForReadAll=false, NvMInvokeCallbacksForWriteAll=false, NvMCheckLossOfRedundancy=false, NvMAutomaticBlockLength=true, NvMBlockCrcType=NVM_CRC16, NvMSelectBlockForReadAll=true, NvMBlockLengthCheck=true, NvMRamBlockDataAddress=Dem_Cfg_PrimaryEntry_9, NvMRomBlockDataAddress=Dem_Cfg_MemoryEntryInit, NvMSelectBlockForWriteAll=true, NvMSingleBlockCallback=Dem_NvM_JobFinished, NvMWriteRamBlockToNvCallback=NULL_PTR
        NvMTargetBlockReference
          NvMEaRef: NvMNameOfEaBlock=EaBlockDem_Primary9
      NvM_Dem_STATUS: NvMBlockJobPriority=127, NvMBlockManagementType=NVM_BLOCK_NATIVE, NvMBlockUseCrc=true, NvMNvBlockLength=76, NvMNvBlockNum=1, NvMNvramBlockIdentifier=39, NvMResistantToChangedSw=false, NvMUseServicePorts=false, NvMUseJobendCallback=true, NvMUseInitCallback=true, NvMBlockUseCRCCompMechanism=false, NvMBlockUseSetRamBlockStatus=true, NvMInvokeCallbacksForReadAll=false, NvMInvokeCallbacksForWriteAll=false, NvMCheckLossOfRedundancy=false, NvMAutomaticBlockLength=true, NvMBlockCrcType=NVM_CRC16, NvMRamBlockDataAddress=Dem_Cfg_StatusData, NvMRomBlockDataAddress=NULL_PTR, NvMSelectBlockForReadAll=true, NvMBlockLengthCheck=true, NvMInitBlockCallback=Dem_NvM_InitStatusData, NvMReadRamBlockFromNvCallback=NULL_PTR, NvMSelectBlockForWriteAll=true, NvMSingleBlockCallback=Dem_NvM_JobFinished, NvMWriteRamBlockToNvCallback=NULL_PTR
        NvMTargetBlockReference
          NvMEaRef: NvMNameOfEaBlock=EaBlockDem_EventStatus
      SWC_DIDMgrDID_191D_PowerLatch: NvMBlockJobPriority=127, NvMBlockManagementType=NVM_BLOCK_NATIVE, NvMBlockUseCrc=true, NvMNvBlockLength=1, NvMNvBlockNum=1, NvMNvramBlockIdentifier=47, NvMResistantToChangedSw=true, NvMUseServicePorts=true, NvMUseJobendCallback=false, NvMUseInitCallback=false, NvMBlockUseCRCCompMechanism=false, NvMBlockUseSetRamBlockStatus=true, NvMInvokeCallbacksForReadAll=true, NvMInvokeCallbacksForWriteAll=true, NvMCheckLossOfRedundancy=false, NvMSelectBlockForReadAll=true, NvMRamBlockDataAddress=Rte_SWC_DIDMgr_DID_191D_PowerLatch_MirrorBlock, NvMRomBlockDataAddress=Rte_SWC_DIDMgr_DID_191D_PowerLatch_DefaultValue, NvMSelectBlockForWriteAll=true, NvMAutomaticBlockLength=true, NvMBlockLengthCheck=true, NvMBlockCrcType=NVM_CRC16  # UC:Derived from NvBlockNeeds
        NvMTargetBlockReference
          NvMEaRef: NvMNameOfEaBlock=EaSWC_DIDMgrDID_191D_PowerLatch
      SWC_DIDMgrDID_2002_OdoFlashing: NvMBlockJobPriority=127, NvMBlockManagementType=NVM_BLOCK_NATIVE, NvMBlockUseCrc=true, NvMNvBlockLength=2, NvMNvBlockNum=1, NvMNvramBlockIdentifier=25, NvMResistantToChangedSw=true, NvMUseServicePorts=true, NvMUseJobendCallback=false, NvMUseInitCallback=false, NvMBlockUseCRCCompMechanism=false, NvMBlockUseSetRamBlockStatus=true, NvMInvokeCallbacksForReadAll=true, NvMInvokeCallbacksForWriteAll=true, NvMCheckLossOfRedundancy=false, NvMSelectBlockForReadAll=true, NvMRamBlockDataAddress=Rte_SWC_DIDMgr_DID_2002_OdoFlashing_MirrorBlock, NvMRomBlockDataAddress=Rte_SWC_DIDMgr_DID_2002_OdoFlashing_DefaultValue, NvMSelectBlockForWriteAll=true, NvMAutomaticBlockLength=true, NvMBlockLengthCheck=true, NvMBlockCrcType=NVM_CRC16  # UC:Derived from NvBlockNeeds
        NvMTargetBlockReference
          NvMEaRef: NvMNameOfEaBlock=EaBlockDescriptor_DID_2002_OdoFlashing
      SWC_DIDMgrDID_2002_ProgReqFlag: NvMBlockJobPriority=127, NvMBlockManagementType=NVM_BLOCK_NATIVE, NvMBlockUseCrc=true, NvMNvBlockLength=1, NvMNvBlockNum=1, NvMNvramBlockIdentifier=55, NvMResistantToChangedSw=true, NvMUseServicePorts=true, NvMUseJobendCallback=false, NvMUseInitCallback=false, NvMBlockUseCRCCompMechanism=false, NvMBlockUseSetRamBlockStatus=true, NvMInvokeCallbacksForReadAll=true, NvMInvokeCallbacksForWriteAll=true, NvMCheckLossOfRedundancy=false, NvMSelectBlockForReadAll=true, NvMRamBlockDataAddress=Rte_SWC_DIDMgr_DID_2002_ProgReqFlag_MirrorBlock, NvMRomBlockDataAddress=Rte_SWC_DIDMgr_DID_2002_ProgReqFlag_DefaultValue, NvMSelectBlockForWriteAll=true, NvMAutomaticBlockLength=true, NvMBlockLengthCheck=true, NvMBlockCrcType=NVM_CRC16  # UC:Derived from NvBlockNeeds
        NvMTargetBlockReference
          NvMEaRef: NvMNameOfEaBlock=EaSWC_DIDMgrDID_2002_ProgReqFlag
      SWC_DIDMgrDID_200A_IgOnCounter: NvMBlockJobPriority=127, NvMBlockManagementType=NVM_BLOCK_NATIVE, NvMBlockUseCrc=true, NvMNvBlockLength=2, NvMNvBlockNum=1, NvMNvramBlockIdentifier=48, NvMResistantToChangedSw=true, NvMUseServicePorts=true, NvMUseJobendCallback=false, NvMUseInitCallback=false, NvMBlockUseCRCCompMechanism=false, NvMBlockUseSetRamBlockStatus=true, NvMInvokeCallbacksForReadAll=true, NvMInvokeCallbacksForWriteAll=true, NvMCheckLossOfRedundancy=false, NvMSelectBlockForReadAll=true, NvMRamBlockDataAddress=Rte_SWC_DIDMgr_DID_200A_IgOnCounter_MirrorBlock, NvMRomBlockDataAddress=Rte_SWC_DIDMgr_DID_200A_IgOnCounter_DefaultValue, NvMSelectBlockForWriteAll=true, NvMAutomaticBlockLength=true, NvMBlockLengthCheck=true, NvMBlockCrcType=NVM_CRC16  # UC:Derived from NvBlockNeeds
        NvMTargetBlockReference
          NvMEaRef: NvMNameOfEaBlock=EaSWC_DIDMgrDID_200A_IgOnCounter
      SWC_DIDMgrDID_200B_TimeSinceFirstDTC: NvMBlockJobPriority=127, NvMBlockManagementType=NVM_BLOCK_NATIVE, NvMBlockUseCrc=true, NvMNvBlockLength=4, NvMNvBlockNum=1, NvMNvramBlockIdentifier=49, NvMResistantToChangedSw=true, NvMUseServicePorts=true, NvMUseJobendCallback=false, NvMUseInitCallback=false, NvMBlockUseCRCCompMechanism=false, NvMBlockUseSetRamBlockStatus=true, NvMInvokeCallbacksForReadAll=true, NvMInvokeCallbacksForWriteAll=true, NvMCheckLossOfRedundancy=false, NvMSelectBlockForReadAll=true, NvMRamBlockDataAddress=Rte_SWC_DIDMgr_DID_200B_TimeSinceFirstDTC_MirrorBlock, NvMRomBlockDataAddress=Rte_SWC_DIDMgr_DID_200B_TimeSinceFirstDTC_DefaultValue, NvMSelectBlockForWriteAll=true, NvMAutomaticBlockLength=true, NvMBlockLengthCheck=true, NvMBlockCrcType=NVM_CRC16  # UC:Derived from NvBlockNeeds
        NvMTargetBlockReference
          NvMEaRef: NvMNameOfEaBlock=EaSWC_DIDMgrDID_200B_TimeSinceFirstDTC
      SWC_DIDMgrDID_200C_TimeSinceIgnOnFirstDTC: NvMBlockJobPriority=127, NvMBlockManagementType=NVM_BLOCK_NATIVE, NvMBlockUseCrc=true, NvMNvBlockLength=2, NvMNvBlockNum=1, NvMNvramBlockIdentifier=50, NvMResistantToChangedSw=true, NvMUseServicePorts=true, NvMUseJobendCallback=false, NvMUseInitCallback=false, NvMBlockUseCRCCompMechanism=false, NvMBlockUseSetRamBlockStatus=true, NvMInvokeCallbacksForReadAll=true, NvMInvokeCallbacksForWriteAll=true, NvMCheckLossOfRedundancy=false, NvMSelectBlockForReadAll=true, NvMRamBlockDataAddress=Rte_SWC_DIDMgr_DID_200C_TimeSinceIgnOnFirstDTC_MirrorBlock, NvMRomBlockDataAddress=Rte_SWC_DIDMgr_DID_200C_TimeSinceIgnOnFirstDTC_DefaultValue, NvMSelectBlockForWriteAll=true, NvMAutomaticBlockLength=true, NvMBlockLengthCheck=true, NvMBlockCrcType=NVM_CRC16  # UC:Derived from NvBlockNeeds
        NvMTargetBlockReference
          NvMEaRef: NvMNameOfEaBlock=EaSWC_DIDMgrDID_200C_TimeSinceIgnOnFirstDTC
      SWC_DIDMgrDID_200D_LastClearDTCOdo: NvMBlockJobPriority=127, NvMBlockManagementType=NVM_BLOCK_NATIVE, NvMBlockUseCrc=true, NvMNvBlockLength=2, NvMNvBlockNum=1, NvMNvramBlockIdentifier=51, NvMResistantToChangedSw=true, NvMUseServicePorts=true, NvMUseJobendCallback=false, NvMUseInitCallback=false, NvMBlockUseCRCCompMechanism=false, NvMBlockUseSetRamBlockStatus=true, NvMInvokeCallbacksForReadAll=true, NvMInvokeCallbacksForWriteAll=true, NvMCheckLossOfRedundancy=false, NvMSelectBlockForReadAll=true, NvMRamBlockDataAddress=Rte_SWC_DIDMgr_DID_200D_LastClearDTCOdo_MirrorBlock, NvMRomBlockDataAddress=Rte_SWC_DIDMgr_DID_200D_LastClearDTCOdo_DefaultValue, NvMSelectBlockForWriteAll=true, NvMAutomaticBlockLength=true, NvMBlockLengthCheck=true, NvMBlockCrcType=NVM_CRC16  # UC:Derived from NvBlockNeeds
        NvMTargetBlockReference
          NvMEaRef: NvMNameOfEaBlock=EaSWC_DIDMgrDID_200D_LastClearDTCOdo
      SWC_DIDMgrDID_FD33_MagnaTesting: NvMBlockJobPriority=127, NvMBlockManagementType=NVM_BLOCK_NATIVE, NvMBlockUseCrc=true, NvMNvBlockLength=10, NvMNvBlockNum=1, NvMNvramBlockIdentifier=56, NvMResistantToChangedSw=true, NvMUseServicePorts=true, NvMUseJobendCallback=false, NvMUseInitCallback=false, NvMBlockUseCRCCompMechanism=false, NvMBlockUseSetRamBlockStatus=true, NvMInvokeCallbacksForReadAll=true, NvMInvokeCallbacksForWriteAll=true, NvMCheckLossOfRedundancy=false, NvMSelectBlockForReadAll=true, NvMRamBlockDataAddress=Rte_SWC_DIDMgr_DID_FD33_MagnaTesting_MirrorBlock, NvMRomBlockDataAddress=Rte_SWC_DIDMgr_DID_FD33_MagnaTesting_DefaultValue, NvMSelectBlockForWriteAll=true, NvMAutomaticBlockLength=true, NvMBlockLengthCheck=true, NvMBlockCrcType=NVM_CRC16  # UC:Derived from NvBlockNeeds
        NvMTargetBlockReference
          NvMEaRef: NvMNameOfEaBlock=EaSWC_DIDMgrDID_FD33_MagnaTesting
      SWC_DIDMgrECU_LifeTime: NvMBlockJobPriority=127, NvMBlockManagementType=NVM_BLOCK_NATIVE, NvMBlockUseCrc=true, NvMNvBlockLength=4, NvMNvBlockNum=1, NvMNvramBlockIdentifier=52, NvMResistantToChangedSw=true, NvMUseServicePorts=true, NvMUseJobendCallback=false, NvMUseInitCallback=false, NvMBlockUseCRCCompMechanism=false, NvMBlockUseSetRamBlockStatus=true, NvMInvokeCallbacksForReadAll=true, NvMInvokeCallbacksForWriteAll=true, NvMCheckLossOfRedundancy=false, NvMSelectBlockForReadAll=true, NvMRamBlockDataAddress=Rte_SWC_DIDMgr_ECU_LifeTime_MirrorBlock, NvMRomBlockDataAddress=Rte_SWC_DIDMgr_ECU_LifeTime_DefaultValue, NvMSelectBlockForWriteAll=true, NvMAutomaticBlockLength=true, NvMBlockLengthCheck=true, NvMBlockCrcType=NVM_CRC16  # UC:Derived from NvBlockNeeds
        NvMTargetBlockReference
          NvMEaRef: NvMNameOfEaBlock=EaSWC_DIDMgrECU_LifeTime
      SWC_DIDMgr_vRoE_Activation_State: NvMBlockJobPriority=127, NvMBlockManagementType=NVM_BLOCK_NATIVE, NvMBlockUseCrc=true, NvMNvBlockLength=1, NvMNvBlockNum=1, NvMNvramBlockIdentifier=46, NvMResistantToChangedSw=true, NvMUseServicePorts=true, NvMUseJobendCallback=false, NvMUseInitCallback=false, NvMBlockUseCRCCompMechanism=false, NvMBlockUseSetRamBlockStatus=true, NvMInvokeCallbacksForReadAll=true, NvMInvokeCallbacksForWriteAll=true, NvMCheckLossOfRedundancy=false, NvMSelectBlockForReadAll=true, NvMRamBlockDataAddress=Rte_SWC_DIDMgr_vRoE_Activation_State_MirrorBlock, NvMRomBlockDataAddress=Rte_SWC_DIDMgr_vRoE_Activation_State_DefaultValue, NvMSelectBlockForWriteAll=false, NvMAutomaticBlockLength=true, NvMBlockLengthCheck=true, NvMBlockCrcType=NVM_CRC16  # UC:Derived from NvBlockNeeds
        NvMTargetBlockReference
          NvMEaRef: NvMNameOfEaBlock=EaSWC_vRoE_Activation_State
      SWC_ProxiConfigMgrProxiConfigTable: NvMBlockJobPriority=0, NvMBlockUseCrc=true, NvMNvBlockLength=66, NvMNvBlockNum=2, NvMNvramBlockIdentifier=53, NvMResistantToChangedSw=true, NvMUseServicePorts=true, NvMUseJobendCallback=false, NvMUseInitCallback=false, NvMBlockUseCRCCompMechanism=true, NvMBlockUseSetRamBlockStatus=true, NvMInvokeCallbacksForReadAll=true, NvMInvokeCallbacksForWriteAll=true, NvMCheckLossOfRedundancy=true, NvMSelectBlockForReadAll=true, NvMRomBlockDataAddress=Rte_SWC_ProxiConfigMgr_ProxiConfigTable_DefaultValue, NvMSelectBlockForWriteAll=false, NvMAutomaticBlockLength=true, NvMBlockLengthCheck=true, NvMBlockCrcType=NVM_CRC16, NvMRamBlockDataAddress=Rte_SWC_ProxiConfigMgr_ProxiConfigTable_MirrorBlock_copy, NvMCalcRamBlockCrc=true, NvMStaticBlockIDCheck=false, NvMWriteVerification=false, NvMBlockManagementType=NVM_BLOCK_REDUNDANT  # UC:Derived from NvBlockNeeds
        NvMTargetBlockReference
          NvMEaRef: NvMNameOfEaBlock=EaSWC_ProxiMgrProxiConfigTable
      SWC_ProxiConfigMgrProxiErrorData: NvMBlockJobPriority=127, NvMBlockManagementType=NVM_BLOCK_NATIVE, NvMBlockUseCrc=true, NvMNvBlockLength=9, NvMNvBlockNum=1, NvMNvramBlockIdentifier=54, NvMResistantToChangedSw=true, NvMUseServicePorts=true, NvMUseJobendCallback=false, NvMUseInitCallback=false, NvMBlockUseCRCCompMechanism=false, NvMBlockUseSetRamBlockStatus=true, NvMInvokeCallbacksForReadAll=true, NvMInvokeCallbacksForWriteAll=true, NvMCheckLossOfRedundancy=false, NvMSelectBlockForReadAll=true, NvMRomBlockDataAddress=Rte_SWC_ProxiConfigMgr_ProxiErrorData_DefaultValue, NvMSelectBlockForWriteAll=true, NvMAutomaticBlockLength=true, NvMBlockLengthCheck=true, NvMBlockCrcType=NVM_CRC16, NvMRamBlockDataAddress=Rte_SWC_ProxiConfigMgr_ProxiErrorData_MirrorBlock_copy  # UC:Derived from NvBlockNeeds
        NvMTargetBlockReference
          NvMEaRef: NvMNameOfEaBlock=EaSWC_ProxiMgrProxiErrorData
      SWC_PartNumMgrDID_FD31_EOLCodingState: NvMBlockJobPriority=127, NvMBlockManagementType=NVM_BLOCK_NATIVE, NvMBlockUseCrc=true, NvMNvBlockLength=4, NvMNvBlockNum=1, NvMNvramBlockIdentifier=57, NvMResistantToChangedSw=true, NvMUseServicePorts=true, NvMUseJobendCallback=false, NvMUseInitCallback=false, NvMBlockUseCRCCompMechanism=false, NvMBlockUseSetRamBlockStatus=true, NvMInvokeCallbacksForReadAll=true, NvMInvokeCallbacksForWriteAll=true, NvMCheckLossOfRedundancy=false, NvMSelectBlockForReadAll=true, NvMRamBlockDataAddress=Rte_SWC_PartNumMgr_DID_FD31_EOLCodingState_MirrorBlock, NvMRomBlockDataAddress=Rte_SWC_PartNumMgr_DID_FD31_EOLCodingState_DefaultValue, NvMSelectBlockForWriteAll=true, NvMAutomaticBlockLength=true, NvMBlockLengthCheck=true, NvMBlockCrcType=NVM_CRC16  # UC:Derived from NvBlockNeeds
        NvMTargetBlockReference
          NvMEaRef: NvMNameOfEaBlock=EaSWC_PartNumMgrDID_FD31_EOLCodingState
      SWC_PartNumMgrDID_F110_Ecu_Diag_Info: NvMBlockJobPriority=127, NvMBlockManagementType=NVM_BLOCK_NATIVE, NvMBlockUseCrc=true, NvMNvBlockLength=6, NvMNvBlockNum=1, NvMNvramBlockIdentifier=24, NvMResistantToChangedSw=true, NvMUseServicePorts=true, NvMUseJobendCallback=false, NvMUseInitCallback=false, NvMBlockUseCRCCompMechanism=false, NvMBlockUseSetRamBlockStatus=true, NvMInvokeCallbacksForReadAll=true, NvMInvokeCallbacksForWriteAll=true, NvMCheckLossOfRedundancy=false, NvMSelectBlockForReadAll=true, NvMRamBlockDataAddress=Rte_SWC_PartNumMgr_DID_F110_Ecu_Diag_Info_MirrorBlock, NvMRomBlockDataAddress=Rte_SWC_PartNumMgr_DID_F110_Ecu_Diag_Info_DefaultValue, NvMSelectBlockForWriteAll=false, NvMAutomaticBlockLength=false, NvMBlockLengthCheck=true, NvMBlockCrcType=NVM_CRC16, NvMCalcRamBlockCrc=false  # UC:Derived from NvBlockNeeds
        NvMTargetBlockReference
          NvMEaRef: NvMNameOfEaBlock=EaBlockDescriptor_DID_F110_Ecu_Diag_Id_FlashDefinitionNumber
      SWC_PartNumMgrDID_F132_EBOM_Ecu_PartNum: NvMBlockJobPriority=127, NvMBlockManagementType=NVM_BLOCK_NATIVE, NvMBlockUseCrc=true, NvMNvBlockLength=10, NvMNvBlockNum=1, NvMNvramBlockIdentifier=21, NvMResistantToChangedSw=true, NvMUseServicePorts=true, NvMUseJobendCallback=false, NvMUseInitCallback=false, NvMBlockUseCRCCompMechanism=false, NvMBlockUseSetRamBlockStatus=true, NvMInvokeCallbacksForReadAll=true, NvMInvokeCallbacksForWriteAll=true, NvMCheckLossOfRedundancy=false, NvMSelectBlockForReadAll=true, NvMRamBlockDataAddress=Rte_SWC_PartNumMgr_DID_F132_EBOM_Ecu_PartNum_MirrorBlock, NvMRomBlockDataAddress=Rte_SWC_PartNumMgr_DID_F132_EBOM_Ecu_PartNum_DefaultValue, NvMSelectBlockForWriteAll=false, NvMAutomaticBlockLength=false, NvMBlockLengthCheck=true, NvMBlockCrcType=NVM_CRC16, NvMCalcRamBlockCrc=false  # UC:Derived from NvBlockNeeds
        NvMTargetBlockReference
          NvMEaRef: NvMNameOfEaBlock=EaBlockDescriptor_DID_F132_EBOM_Ecu_PartNum
      SWC_PartNumMgrDID_F133_EBOM_Asm_PartNum: NvMBlockJobPriority=127, NvMBlockManagementType=NVM_BLOCK_NATIVE, NvMBlockUseCrc=true, NvMNvBlockLength=10, NvMNvBlockNum=1, NvMNvramBlockIdentifier=16, NvMResistantToChangedSw=true, NvMUseServicePorts=true, NvMUseJobendCallback=false, NvMUseInitCallback=false, NvMBlockUseCRCCompMechanism=false, NvMBlockUseSetRamBlockStatus=true, NvMInvokeCallbacksForReadAll=true, NvMInvokeCallbacksForWriteAll=true, NvMCheckLossOfRedundancy=false, NvMSelectBlockForReadAll=true, NvMRamBlockDataAddress=Rte_SWC_PartNumMgr_DID_F133_EBOM_Asm_PartNum_MirrorBlock, NvMRomBlockDataAddress=Rte_SWC_PartNumMgr_DID_F133_EBOM_Asm_PartNum_DefaultValue, NvMSelectBlockForWriteAll=false, NvMAutomaticBlockLength=false, NvMBlockLengthCheck=true, NvMBlockCrcType=NVM_CRC16, NvMBlockLengthCheckType=false, NvMCalcRamBlockCrc=false  # UC:Derived from NvBlockNeeds
        NvMTargetBlockReference
          NvMEaRef: NvMNameOfEaBlock=EaBlockDescriptor_DID_F133_EBOM_Asm_PartNum
      SWC_PartNumMgrDID_F134_CODEP_Asm_PartNum: NvMBlockJobPriority=127, NvMBlockManagementType=NVM_BLOCK_NATIVE, NvMBlockUseCrc=true, NvMNvBlockLength=11, NvMNvBlockNum=1, NvMNvramBlockIdentifier=20, NvMResistantToChangedSw=true, NvMUseServicePorts=true, NvMUseJobendCallback=false, NvMUseInitCallback=false, NvMBlockUseCRCCompMechanism=false, NvMBlockUseSetRamBlockStatus=true, NvMInvokeCallbacksForReadAll=true, NvMInvokeCallbacksForWriteAll=true, NvMCheckLossOfRedundancy=false, NvMSelectBlockForReadAll=true, NvMRamBlockDataAddress=Rte_SWC_PartNumMgr_DID_F134_CODEP_Asm_PartNum_MirrorBlock, NvMRomBlockDataAddress=Rte_SWC_PartNumMgr_DID_F134_CODEP_Asm_PartNum_DefaultValue, NvMSelectBlockForWriteAll=false, NvMAutomaticBlockLength=false, NvMBlockLengthCheck=true, NvMBlockCrcType=NVM_CRC16, NvMCalcRamBlockCrc=false  # UC:Derived from NvBlockNeeds
        NvMTargetBlockReference
          NvMEaRef: NvMNameOfEaBlock=EaBlockDescriptor_DID_F134_CODEP_Asm_PartNum
      SWC_PartNumMgrDID_F180_Boot_SW_Ver_Info: NvMBlockJobPriority=127, NvMBlockManagementType=NVM_BLOCK_NATIVE, NvMBlockUseCrc=true, NvMNvBlockLength=13, NvMNvBlockNum=1, NvMNvramBlockIdentifier=10, NvMResistantToChangedSw=true, NvMUseServicePorts=true, NvMUseJobendCallback=false, NvMUseInitCallback=false, NvMBlockUseCRCCompMechanism=false, NvMBlockUseSetRamBlockStatus=true, NvMInvokeCallbacksForReadAll=true, NvMInvokeCallbacksForWriteAll=true, NvMCheckLossOfRedundancy=false, NvMSelectBlockForReadAll=true, NvMRamBlockDataAddress=Rte_SWC_PartNumMgr_DID_F180_Boot_SW_Ver_Info_MirrorBlock, NvMRomBlockDataAddress=Rte_SWC_PartNumMgr_DID_F180_Boot_SW_Ver_Info_DefaultValue, NvMSelectBlockForWriteAll=false, NvMAutomaticBlockLength=false, NvMBlockLengthCheck=true, NvMBlockCrcType=NVM_CRC16, NvMCalcRamBlockCrc=false  # UC:Derived from NvBlockNeeds
        NvMTargetBlockReference
          NvMEaRef: NvMNameOfEaBlock=EaBlockDescriptor_DID_F180_Boot_SW_Ver_Info
      SWC_PartNumMgrDID_F187_CODEP_Ecu_PartNum: NvMBlockJobPriority=127, NvMBlockManagementType=NVM_BLOCK_NATIVE, NvMBlockUseCrc=true, NvMNvBlockLength=11, NvMNvBlockNum=1, NvMNvramBlockIdentifier=19, NvMResistantToChangedSw=true, NvMUseServicePorts=true, NvMUseJobendCallback=false, NvMUseInitCallback=false, NvMBlockUseCRCCompMechanism=false, NvMBlockUseSetRamBlockStatus=true, NvMInvokeCallbacksForReadAll=true, NvMInvokeCallbacksForWriteAll=true, NvMCheckLossOfRedundancy=false, NvMSelectBlockForReadAll=true, NvMRamBlockDataAddress=Rte_SWC_PartNumMgr_DID_F187_CODEP_Ecu_PartNum_MirrorBlock, NvMRomBlockDataAddress=Rte_SWC_PartNumMgr_DID_F187_CODEP_Ecu_PartNum_DefaultValue, NvMAutomaticBlockLength=false, NvMBlockLengthCheck=true, NvMBlockCrcType=NVM_CRC16, NvMSelectBlockForWriteAll=false, NvMCalcRamBlockCrc=false  # UC:Derived from NvBlockNeeds
        NvMTargetBlockReference
          NvMEaRef: NvMNameOfEaBlock=EaBlockDescriptor_DID_F187_CODEP_Ecu_PartNum
      SWC_PartNumMgrDID_F188_FCA_ESLM_Ecu_SW_Num: NvMBlockJobPriority=127, NvMBlockManagementType=NVM_BLOCK_NATIVE, NvMBlockUseCrc=true, NvMNvBlockLength=11, NvMNvBlockNum=1, NvMNvramBlockIdentifier=15, NvMResistantToChangedSw=true, NvMUseServicePorts=true, NvMUseJobendCallback=false, NvMUseInitCallback=false, NvMBlockUseCRCCompMechanism=false, NvMBlockUseSetRamBlockStatus=true, NvMInvokeCallbacksForReadAll=true, NvMInvokeCallbacksForWriteAll=true, NvMCheckLossOfRedundancy=false, NvMSelectBlockForReadAll=true, NvMSelectBlockForWriteAll=false, NvMAutomaticBlockLength=false, NvMBlockLengthCheck=false, NvMBlockCrcType=NVM_CRC16, NvMRamBlockDataAddress=Rte_SWC_PartNumMgr_DID_F188_FCA_ESLM_Ecu_SW_Num_MirrorBlock, NvMRomBlockDataAddress=Rte_SWC_PartNumMgr_DID_F188_FCA_ESLM_Ecu_SW_Num_DefaultValue, NvMCalcRamBlockCrc=false  # UC:Derived from NvBlockNeeds
        NvMTargetBlockReference
          NvMEaRef: NvMNameOfEaBlock=EaBlockDescriptor_DID_F188_FCA_ESLM_Ecu_SW_Num
      SWC_PartNumMgrDID_F18A_FCA_ESLM_Ecu_SW_Cal_Num: NvMBlockJobPriority=127, NvMBlockManagementType=NVM_BLOCK_NATIVE, NvMBlockUseCrc=true, NvMNvBlockLength=10, NvMNvBlockNum=1, NvMNvramBlockIdentifier=17, NvMResistantToChangedSw=true, NvMUseServicePorts=true, NvMUseJobendCallback=false, NvMUseInitCallback=false, NvMBlockUseCRCCompMechanism=false, NvMBlockUseSetRamBlockStatus=true, NvMInvokeCallbacksForReadAll=true, NvMInvokeCallbacksForWriteAll=true, NvMCheckLossOfRedundancy=false, NvMSelectBlockForReadAll=true, NvMRamBlockDataAddress=Rte_SWC_PartNumMgr_DID_F18A_FCA_ESLM_Ecu_SW_Cal_Num_MirrorBlock, NvMRomBlockDataAddress=Rte_SWC_PartNumMgr_DID_F18A_FCA_ESLM_Ecu_SW_Cal_Num_DefaultValue, NvMAutomaticBlockLength=false, NvMBlockLengthCheck=true, NvMBlockCrcType=NVM_CRC16, NvMCalcRamBlockCrc=false  # UC:Derived from NvBlockNeeds
        NvMTargetBlockReference
          NvMEaRef: NvMNameOfEaBlock=EaBlockDescriptor_DID_F18A_FCA_ESLM_Ecu_SW_Cal_Num
      SWC_PartNumMgrDID_F18B_FCA_ESLM_ECU_SW_App_Num: NvMBlockJobPriority=127, NvMBlockManagementType=NVM_BLOCK_NATIVE, NvMBlockUseCrc=true, NvMNvBlockLength=10, NvMNvBlockNum=1, NvMNvramBlockIdentifier=18, NvMResistantToChangedSw=true, NvMUseServicePorts=true, NvMUseJobendCallback=false, NvMUseInitCallback=false, NvMBlockUseCRCCompMechanism=false, NvMBlockUseSetRamBlockStatus=true, NvMInvokeCallbacksForReadAll=true, NvMInvokeCallbacksForWriteAll=true, NvMCheckLossOfRedundancy=false, NvMSelectBlockForReadAll=true, NvMRamBlockDataAddress=Rte_SWC_PartNumMgr_DID_F18B_FCA_ESLM_ECU_SW_App_Num_MirrorBlock, NvMRomBlockDataAddress=Rte_SWC_PartNumMgr_DID_F18B_FCA_ESLM_ECU_SW_App_Num_DefaultValue, NvMSelectBlockForWriteAll=false, NvMAutomaticBlockLength=false, NvMBlockLengthCheck=true, NvMBlockCrcType=NVM_CRC16, NvMCalcRamBlockCrc=false  # UC:Derived from NvBlockNeeds
        NvMTargetBlockReference
          NvMEaRef: NvMNameOfEaBlock=EaBlockDescriptor_DID_F18B_FCA_ESLM_ECU_SW_App_Num
      SWC_PartNumMgrDID_F194_Supplier_Ecu_SW_PartNum: NvMBlockJobPriority=127, NvMBlockManagementType=NVM_BLOCK_NATIVE, NvMBlockUseCrc=true, NvMNvBlockLength=11, NvMNvBlockNum=1, NvMNvramBlockIdentifier=22, NvMResistantToChangedSw=true, NvMUseServicePorts=true, NvMUseJobendCallback=false, NvMUseInitCallback=false, NvMBlockUseCRCCompMechanism=false, NvMBlockUseSetRamBlockStatus=true, NvMInvokeCallbacksForReadAll=true, NvMInvokeCallbacksForWriteAll=true, NvMCheckLossOfRedundancy=false, NvMSelectBlockForReadAll=true, NvMRamBlockDataAddress=Rte_SWC_PartNumMgr_DID_F194_Supplier_Ecu_SW_PartNum_MirrorBlock, NvMRomBlockDataAddress=Rte_SWC_PartNumMgr_DID_F194_Supplier_Ecu_SW_PartNum_DefaultValue, NvMSelectBlockForWriteAll=false, NvMAutomaticBlockLength=false, NvMBlockLengthCheck=true, NvMBlockCrcType=NVM_CRC16, NvMCalcRamBlockCrc=false  # UC:Derived from NvBlockNeeds
        NvMTargetBlockReference
          NvMEaRef: NvMNameOfEaBlock=EaBlockDescriptor_DID_F194_Supplier_Ecu_SW_PartNum
      SWC_PartNumMgrDID_F195_Supplier_Ecu_SW_VerNum: NvMBlockJobPriority=127, NvMBlockManagementType=NVM_BLOCK_NATIVE, NvMBlockUseCrc=true, NvMNvBlockLength=2, NvMNvBlockNum=1, NvMNvramBlockIdentifier=23, NvMResistantToChangedSw=true, NvMUseServicePorts=true, NvMUseJobendCallback=false, NvMUseInitCallback=false, NvMBlockUseCRCCompMechanism=false, NvMBlockUseSetRamBlockStatus=true, NvMInvokeCallbacksForReadAll=true, NvMInvokeCallbacksForWriteAll=true, NvMCheckLossOfRedundancy=false, NvMSelectBlockForReadAll=true, NvMRamBlockDataAddress=Rte_SWC_PartNumMgr_DID_F195_Supplier_Ecu_SW_VerNum_MirrorBlock, NvMRomBlockDataAddress=Rte_SWC_PartNumMgr_DID_F195_Supplier_Ecu_SW_VerNum_DefaultValue, NvMAutomaticBlockLength=false, NvMBlockLengthCheck=true, NvMBlockCrcType=NVM_CRC16, NvMCalcRamBlockCrc=false  # UC:Derived from NvBlockNeeds
        NvMTargetBlockReference
          NvMEaRef: NvMNameOfEaBlock=EaBlockDescriptor_DID_F195_Supplier_Ecu_SW_VerNum
      CalDataProviderSVSCamCurrentCalibData: NvMBlockJobPriority=127, NvMBlockUseCrc=true, NvMNvBlockLength=200, NvMNvBlockNum=2, NvMNvramBlockIdentifier=58, NvMResistantToChangedSw=true, NvMUseServicePorts=true, NvMUseJobendCallback=false, NvMUseInitCallback=false, NvMBlockUseCRCCompMechanism=true, NvMBlockUseSetRamBlockStatus=true, NvMInvokeCallbacksForReadAll=true, NvMInvokeCallbacksForWriteAll=true, NvMCheckLossOfRedundancy=true, NvMSelectBlockForReadAll=true, NvMRomBlockDataAddress=Rte_CalDataProvider_SVSCamCurrentCalibData_DefaultValue, NvMSelectBlockForWriteAll=true, NvMBlockCrcType=NVM_CRC16, NvMAutomaticBlockLength=true, NvMBlockLengthCheck=true, NvMRamBlockDataAddress=Rte_CalDataProvider_SVSCamCurrentCalibData_MirrorBlock_copy, NvMCalcRamBlockCrc=true, NvMStaticBlockIDCheck=false, NvMWriteVerification=false, NvMBlockManagementType=NVM_BLOCK_REDUNDANT  # UC:Derived from NvBlockNeeds
        NvMTargetBlockReference
          NvMEaRef: NvMNameOfEaBlock=EaCalDataProviderSVSCamCurrentCalibData
      CalDataProviderSVSCamEOLCalibData: NvMBlockJobPriority=127, NvMBlockUseCrc=true, NvMNvBlockLength=200, NvMNvramBlockIdentifier=59, NvMResistantToChangedSw=true, NvMUseServicePorts=true, NvMUseJobendCallback=false, NvMUseInitCallback=false, NvMBlockUseCRCCompMechanism=true, NvMBlockUseSetRamBlockStatus=true, NvMInvokeCallbacksForReadAll=true, NvMInvokeCallbacksForWriteAll=true, NvMCheckLossOfRedundancy=true, NvMSelectBlockForReadAll=true, NvMRomBlockDataAddress=Rte_CalDataProvider_SVSCamEOLCalibData_DefaultValue, NvMSelectBlockForWriteAll=true, NvMBlockCrcType=NVM_CRC16, NvMAutomaticBlockLength=true, NvMBlockLengthCheck=true, NvMRamBlockDataAddress=Rte_CalDataProvider_SVSCamEOLCalibData_MirrorBlock_copy, NvMNvBlockNum=2, NvMCalcRamBlockCrc=true, NvMStaticBlockIDCheck=false, NvMWriteVerification=false, NvMBlockManagementType=NVM_BLOCK_REDUNDANT  # UC:Derived from NvBlockNeeds
        NvMTargetBlockReference
          NvMEaRef: NvMNameOfEaBlock=EaCalDataProviderSVSCamEOLCalibData
      CalDataProviderSVSCamOCCalibData: NvMBlockJobPriority=127, NvMBlockUseCrc=true, NvMNvBlockLength=100, NvMNvBlockNum=2, NvMNvramBlockIdentifier=60, NvMResistantToChangedSw=true, NvMUseServicePorts=true, NvMUseJobendCallback=false, NvMUseInitCallback=false, NvMBlockUseCRCCompMechanism=true, NvMBlockUseSetRamBlockStatus=true, NvMInvokeCallbacksForReadAll=true, NvMInvokeCallbacksForWriteAll=true, NvMCheckLossOfRedundancy=true, NvMSelectBlockForReadAll=true, NvMRomBlockDataAddress=Rte_CalDataProvider_SVSCamOCCalibData_DefaultValue, NvMSelectBlockForWriteAll=true, NvMBlockCrcType=NVM_CRC16, NvMAutomaticBlockLength=true, NvMBlockLengthCheck=true, NvMRamBlockDataAddress=Rte_CalDataProvider_SVSCamOCCalibData_MirrorBlock_copy, NvMCalcRamBlockCrc=true, NvMStaticBlockIDCheck=false, NvMWriteVerification=false, NvMBlockManagementType=NVM_BLOCK_REDUNDANT  # UC:Derived from NvBlockNeeds
        NvMTargetBlockReference
          NvMEaRef: NvMNameOfEaBlock=EaCalDataProviderSVSCamOCCalibData
      CalDataProviderSVSCamSCCalibData: NvMBlockJobPriority=127, NvMBlockUseCrc=true, NvMNvBlockLength=100, NvMNvBlockNum=2, NvMNvramBlockIdentifier=61, NvMResistantToChangedSw=true, NvMUseServicePorts=true, NvMUseJobendCallback=false, NvMUseInitCallback=false, NvMBlockUseCRCCompMechanism=true, NvMBlockUseSetRamBlockStatus=true, NvMInvokeCallbacksForReadAll=true, NvMInvokeCallbacksForWriteAll=true, NvMCheckLossOfRedundancy=true, NvMSelectBlockForReadAll=true, NvMRomBlockDataAddress=Rte_CalDataProvider_SVSCamSCCalibData_DefaultValue, NvMSelectBlockForWriteAll=true, NvMBlockCrcType=NVM_CRC16, NvMAutomaticBlockLength=true, NvMBlockLengthCheck=true, NvMRamBlockDataAddress=Rte_CalDataProvider_SVSCamSCCalibData_MirrorBlock_copy, NvMCalcRamBlockCrc=true, NvMStaticBlockIDCheck=false, NvMWriteVerification=false, NvMBlockManagementType=NVM_BLOCK_REDUNDANT  # UC:Derived from NvBlockNeeds
        NvMTargetBlockReference
          NvMEaRef: NvMNameOfEaBlock=EaCalDataProviderSVSCamSCCalibData
      SWC_PartNumMgrUssSensorMarrData: NvMBlockJobPriority=127, NvMBlockManagementType=NVM_BLOCK_NATIVE, NvMBlockUseCrc=true, NvMNvBlockLength=56, NvMNvBlockNum=1, NvMNvramBlockIdentifier=62, NvMResistantToChangedSw=true, NvMUseServicePorts=true, NvMUseJobendCallback=false, NvMUseInitCallback=false, NvMBlockUseCRCCompMechanism=false, NvMBlockUseSetRamBlockStatus=true, NvMInvokeCallbacksForReadAll=true, NvMInvokeCallbacksForWriteAll=true, NvMCheckLossOfRedundancy=false, NvMSelectBlockForReadAll=true, NvMRamBlockDataAddress=Rte_SWC_PartNumMgr_UssSensorMarrData_MirrorBlock, NvMRomBlockDataAddress=Rte_SWC_PartNumMgr_UssSensorMarrData_DefaultValue, NvMSelectBlockForWriteAll=true, NvMBlockCrcType=NVM_CRC16, NvMAutomaticBlockLength=true, NvMBlockLengthCheck=true  # UC:Derived from NvBlockNeeds
        NvMTargetBlockReference
          NvMEaRef: NvMNameOfEaBlock=EaSWC_PartNumMgrUssSensorMarrData
      SWC_DIDMgrDID_FD01_PrevCalibDataCopy: NvMBlockJobPriority=127, NvMBlockManagementType=NVM_BLOCK_NATIVE, NvMBlockUseCrc=true, NvMNvBlockLength=192, NvMNvBlockNum=1, NvMNvramBlockIdentifier=63, NvMResistantToChangedSw=true, NvMUseServicePorts=true, NvMUseJobendCallback=false, NvMUseInitCallback=false, NvMBlockUseCRCCompMechanism=false, NvMBlockUseSetRamBlockStatus=true, NvMInvokeCallbacksForReadAll=true, NvMInvokeCallbacksForWriteAll=true, NvMCheckLossOfRedundancy=false, NvMSelectBlockForReadAll=true, NvMRamBlockDataAddress=Rte_SWC_DIDMgr_DID_FD01_PrevCalibDataCopy_MirrorBlock, NvMRomBlockDataAddress=Rte_SWC_DIDMgr_DID_FD01_PrevCalibDataCopy_DefaultValue, NvMSelectBlockForWriteAll=true, NvMBlockCrcType=NVM_CRC16, NvMAutomaticBlockLength=true, NvMBlockLengthCheck=true  # UC:Derived from NvBlockNeeds
        NvMTargetBlockReference
          NvMEaRef: NvMNameOfEaBlock=EaSWC_DIDMgrDID_FD01_PrevCalibDataCopy
      SWC_DIDMgrDID_FD42_FailsafeDebug: NvMBlockJobPriority=127, NvMBlockManagementType=NVM_BLOCK_NATIVE, NvMBlockUseCrc=true, NvMNvBlockLength=1, NvMNvBlockNum=1, NvMNvramBlockIdentifier=64, NvMResistantToChangedSw=true, NvMUseServicePorts=true, NvMUseJobendCallback=false, NvMUseInitCallback=false, NvMBlockUseCRCCompMechanism=false, NvMBlockUseSetRamBlockStatus=true, NvMInvokeCallbacksForReadAll=true, NvMInvokeCallbacksForWriteAll=true, NvMCheckLossOfRedundancy=false, NvMSelectBlockForReadAll=true, NvMRamBlockDataAddress=Rte_SWC_DIDMgr_DID_FD42_FailsafeDebug_MirrorBlock, NvMRomBlockDataAddress=Rte_SWC_DIDMgr_DID_FD42_FailsafeDebug_DefaultValue, NvMSelectBlockForWriteAll=false, NvMCalcRamBlockCrc=false, NvMBlockCrcType=NVM_CRC16, NvMAutomaticBlockLength=true, NvMBlockLengthCheck=true  # UC:Derived from NvBlockNeeds
        NvMTargetBlockReference
          NvMEaRef: NvMNameOfEaBlock=EaSWC_DIDMgrDID_FD42_FailsafeDebug
      SWC_DIDMgrDID_RearBrakeEvent: NvMBlockJobPriority=127, NvMBlockManagementType=NVM_BLOCK_NATIVE, NvMBlockUseCrc=true, NvMNvBlockLength=44, NvMNvBlockNum=1, NvMNvramBlockIdentifier=65, NvMResistantToChangedSw=true, NvMUseServicePorts=true, NvMUseJobendCallback=false, NvMUseInitCallback=false, NvMBlockUseCRCCompMechanism=false, NvMBlockUseSetRamBlockStatus=true, NvMInvokeCallbacksForReadAll=true, NvMInvokeCallbacksForWriteAll=true, NvMCheckLossOfRedundancy=false, NvMSelectBlockForReadAll=true, NvMRamBlockDataAddress=Rte_SWC_DIDMgr_DID_RearBrakeEvent_MirrorBlock, NvMRomBlockDataAddress=Rte_SWC_DIDMgr_DID_RearBrakeEvent_DefaultValue, NvMSelectBlockForWriteAll=false, NvMBlockCrcType=NVM_CRC16, NvMAutomaticBlockLength=true, NvMBlockLengthCheck=true  # UC:Derived from NvBlockNeeds
        NvMTargetBlockReference
          NvMEaRef: NvMNameOfEaBlock=EaSWC_DIDMgrDID_RearBrakeEvent
      SWC_DIDMgrDID_SPMAbrtEvent: NvMBlockJobPriority=127, NvMBlockManagementType=NVM_BLOCK_NATIVE, NvMBlockUseCrc=true, NvMNvBlockLength=56, NvMNvBlockNum=1, NvMNvramBlockIdentifier=66, NvMResistantToChangedSw=true, NvMUseServicePorts=true, NvMUseJobendCallback=false, NvMUseInitCallback=false, NvMBlockUseCRCCompMechanism=false, NvMBlockUseSetRamBlockStatus=true, NvMInvokeCallbacksForReadAll=true, NvMInvokeCallbacksForWriteAll=true, NvMCheckLossOfRedundancy=false, NvMSelectBlockForReadAll=true, NvMRamBlockDataAddress=Rte_SWC_DIDMgr_DID_SPMAbrtEvent_MirrorBlock, NvMRomBlockDataAddress=Rte_SWC_DIDMgr_DID_SPMAbrtEvent_DefaultValue, NvMSelectBlockForWriteAll=false, NvMBlockCrcType=NVM_CRC16, NvMAutomaticBlockLength=true, NvMBlockLengthCheck=true  # UC:Derived from NvBlockNeeds
        NvMTargetBlockReference
          NvMEaRef: NvMNameOfEaBlock=EaSWC_DIDMgrDID_SPMAbrtEvent
      CDD_IPCHandlerFeatureAP_HMI_NvMData: NvMBlockJobPriority=127, NvMBlockManagementType=NVM_BLOCK_NATIVE, NvMBlockUseCrc=true, NvMNvBlockNum=1, NvMNvramBlockIdentifier=67, NvMResistantToChangedSw=true, NvMUseServicePorts=true, NvMUseJobendCallback=false, NvMUseInitCallback=false, NvMBlockUseCRCCompMechanism=false, NvMBlockUseSetRamBlockStatus=true, NvMInvokeCallbacksForReadAll=true, NvMInvokeCallbacksForWriteAll=true, NvMCheckLossOfRedundancy=false, NvMSelectBlockForReadAll=true, NvMRomBlockDataAddress=Rte_CDD_IPCHandler_FeatureAP_HMI_NvMData_DefaultValue, NvMSelectBlockForWriteAll=true, NvMBlockCrcType=NVM_CRC16, NvMAutomaticBlockLength=true, NvMBlockLengthCheck=true, NvMNvBlockLength=1, NvMRamBlockDataAddress=Rte_CDD_IPCHandler_FeatureAP_HMI_NvMData_MirrorBlock_copy  # UC:Derived from NvBlockNeeds
        NvMTargetBlockReference
          NvMEaRef: NvMNameOfEaBlock=EaCDD_IPCHandlerFeatureAP_HMI_NvMData
      CDD_CryptoMgrNvMBlockDescriptor_SecureLogGroup1: NvMBlockJobPriority=127, NvMBlockManagementType=NVM_BLOCK_NATIVE, NvMBlockUseCrc=false, NvMNvBlockLength=488, NvMNvBlockNum=1, NvMNvramBlockIdentifier=68, NvMResistantToChangedSw=true, NvMUseServicePorts=true, NvMUseJobendCallback=false, NvMUseInitCallback=false, NvMBlockUseCRCCompMechanism=false, NvMBlockUseSetRamBlockStatus=true, NvMInvokeCallbacksForReadAll=true, NvMInvokeCallbacksForWriteAll=true, NvMCheckLossOfRedundancy=false, NvMCsmMacSize=16, NvMSelectBlockForWriteAll=true, NvMBlockLengthCheck=false, NvMRomBlockDataAddress=Rte_CDD_CryptoMgr_Rte_SWC_CDD_CryptoMngr_SecureLogGroup1_DefaultValue, NvMRamBlockDataAddress=Rte_CDD_CryptoMgr_Rte_SWC_CDD_CryptoMngr_SecureLogGroup1_Mirror_Copy, NvMCsmMacGenerationJobReference=CsmJob_SecureLog_MacGen, NvMCsmMacVerificationJobReference=CsmJob_SecureLog_MacVerify  # UC:Derived from NvBlockNeeds
        NvMTargetBlockReference
          NvMEaRef: NvMNameOfEaBlock=EaBlockConfiguration_SecureLogGroup1
      CDD_CryptoMgrNvMBlockDescriptor_SecureLogGroup2: NvMBlockJobPriority=127, NvMBlockManagementType=NVM_BLOCK_NATIVE, NvMBlockUseCrc=false, NvMNvBlockLength=488, NvMNvBlockNum=1, NvMNvramBlockIdentifier=69, NvMResistantToChangedSw=true, NvMUseServicePorts=true, NvMUseJobendCallback=false, NvMUseInitCallback=false, NvMBlockUseCRCCompMechanism=false, NvMBlockUseSetRamBlockStatus=true, NvMInvokeCallbacksForReadAll=false, NvMInvokeCallbacksForWriteAll=true, NvMCheckLossOfRedundancy=false, NvMCsmMacSize=16, NvMSelectBlockForWriteAll=true, NvMBlockLengthCheck=false, NvMRomBlockDataAddress=Rte_CDD_CryptoMgr_Rte_SWC_CDD_CryptoMngr_SecureLogGroup2_DefaultValue, NvMRamBlockDataAddress=Rte_CDD_CryptoMgr_Rte_SWC_CDD_CryptoMngr_SecureLogGroup2_Mirror_Copy, NvMCsmMacGenerationJobReference=CsmJob_SecureLog_MacGen, NvMCsmMacVerificationJobReference=CsmJob_SecureLog_MacVerify  # UC:Derived from NvBlockNeeds
        NvMTargetBlockReference
          NvMEaRef: NvMNameOfEaBlock=EaBlockConfiguration_SecureLogGroup2
      SWC_DIDMgrDID_FD86_FunctionalSettings: NvMBlockJobPriority=127, NvMBlockManagementType=NVM_BLOCK_NATIVE, NvMBlockUseCrc=true, NvMNvBlockLength=8, NvMNvBlockNum=1, NvMNvramBlockIdentifier=70, NvMResistantToChangedSw=true, NvMUseServicePorts=true, NvMUseJobendCallback=false, NvMUseInitCallback=false, NvMBlockUseCRCCompMechanism=false, NvMBlockUseSetRamBlockStatus=true, NvMInvokeCallbacksForReadAll=true, NvMInvokeCallbacksForWriteAll=true, NvMCheckLossOfRedundancy=false, NvMSelectBlockForReadAll=true, NvMRamBlockDataAddress=Rte_SWC_DIDMgr_DID_FD86_FunctionalSettings_MirrorBlock, NvMRomBlockDataAddress=Rte_SWC_DIDMgr_DID_FD86_FunctionalSettings_DefaultValue, NvMSelectBlockForWriteAll=true, NvMBlockCrcType=NVM_CRC16, NvMAutomaticBlockLength=true, NvMBlockLengthCheck=true  # UC:Derived from NvBlockNeeds
        NvMTargetBlockReference
          NvMEaRef: NvMNameOfEaBlock=EaSWC_DIDMgrDID_FD86_FunctionalSettings
      SWC_DIDMgrDID_2939_WakeupReason: NvMBlockJobPriority=127, NvMBlockManagementType=NVM_BLOCK_NATIVE, NvMBlockUseCrc=false, NvMNvBlockLength=20, NvMNvBlockNum=1, NvMNvramBlockIdentifier=40, NvMResistantToChangedSw=true, NvMUseServicePorts=true, NvMUseJobendCallback=false, NvMUseInitCallback=false, NvMBlockUseCRCCompMechanism=false, NvMBlockUseSetRamBlockStatus=true, NvMInvokeCallbacksForReadAll=true, NvMInvokeCallbacksForWriteAll=true, NvMCheckLossOfRedundancy=false, NvMSelectBlockForReadAll=true, NvMRamBlockDataAddress=Rte_SWC_DIDMgr_DID_2939_WakeupReason_MirrorBlock, NvMRomBlockDataAddress=Rte_SWC_DIDMgr_DID_2939_WakeupReason_DefaultValue, NvMSelectBlockForWriteAll=true, NvMBlockLengthCheck=true  # UC:Derived from NvBlockNeeds
        NvMTargetBlockReference
          NvMEaRef: NvMNameOfEaBlock=EaCDD_GenericBswDID_2939_WakeupReason
      SWC_DIDMgrDID_FDF0_SleepProcess: NvMBlockJobPriority=127, NvMBlockManagementType=NVM_BLOCK_NATIVE, NvMBlockUseCrc=false, NvMNvBlockLength=1, NvMNvBlockNum=1, NvMNvramBlockIdentifier=41, NvMResistantToChangedSw=true, NvMUseServicePorts=true, NvMUseJobendCallback=false, NvMUseInitCallback=false, NvMBlockUseCRCCompMechanism=false, NvMBlockUseSetRamBlockStatus=true, NvMInvokeCallbacksForReadAll=true, NvMInvokeCallbacksForWriteAll=true, NvMCheckLossOfRedundancy=false, NvMSelectBlockForReadAll=true, NvMRamBlockDataAddress=Rte_SWC_DIDMgr_DID_FDF0_SleepProcess_MirrorBlock, NvMRomBlockDataAddress=Rte_SWC_DIDMgr_DID_FDF0_SleepProcess_DefaultValue, NvMBlockLengthCheck=true  # UC:Derived from NvBlockNeeds
        NvMTargetBlockReference
          NvMEaRef: NvMNameOfEaBlock=EaCDD_GenericBswDID_FDF0_SleepProcess
      SWC_RIDMgrDID_5201_PlantModeStatus: NvMBlockJobPriority=127, NvMBlockManagementType=NVM_BLOCK_NATIVE, NvMBlockUseCrc=false, NvMNvBlockLength=1, NvMNvBlockNum=1, NvMNvramBlockIdentifier=42, NvMResistantToChangedSw=true, NvMUseServicePorts=true, NvMUseJobendCallback=false, NvMUseInitCallback=false, NvMBlockUseCRCCompMechanism=false, NvMBlockUseSetRamBlockStatus=true, NvMInvokeCallbacksForReadAll=true, NvMInvokeCallbacksForWriteAll=true, NvMCheckLossOfRedundancy=false, NvMSelectBlockForReadAll=true, NvMRamBlockDataAddress=Rte_SWC_RIDMgr_DID_5201_PlantModeStatus_MirrorBlock, NvMRomBlockDataAddress=Rte_SWC_RIDMgr_DID_5201_PlantModeStatus_DefaultValue, NvMSelectBlockForWriteAll=false, NvMWriteVerification=true, NvMBlockLengthCheck=true  # UC:Derived from NvBlockNeeds
        NvMTargetBlockReference
          NvMEaRef: NvMNameOfEaBlock=EaSWC_ConfigMgrDID_5201_PlantMode
      SWC_RIDMgrVIN_CurrentVal: NvMBlockJobPriority=127, NvMBlockManagementType=NVM_BLOCK_NATIVE, NvMBlockUseCrc=false, NvMNvBlockLength=17, NvMNvBlockNum=1, NvMNvramBlockIdentifier=43, NvMResistantToChangedSw=true, NvMUseServicePorts=true, NvMUseJobendCallback=false, NvMUseInitCallback=false, NvMBlockUseCRCCompMechanism=false, NvMBlockUseSetRamBlockStatus=true, NvMInvokeCallbacksForReadAll=true, NvMInvokeCallbacksForWriteAll=true, NvMCheckLossOfRedundancy=false, NvMSelectBlockForReadAll=true, NvMRamBlockDataAddress=Rte_SWC_RIDMgr_VIN_CurrentVal_MirrorBlock, NvMRomBlockDataAddress=Rte_SWC_RIDMgr_VIN_CurrentVal_DefaultValue, NvMSelectBlockForWriteAll=false, NvMWriteVerification=true, NvMBlockLengthCheck=true  # UC:Derived from NvBlockNeeds
        NvMTargetBlockReference
          NvMEaRef: NvMNameOfEaBlock=EaSWC_ConfigMgrVIN_CurrentVal
      SWC_RIDMgrVIN_Lock: NvMBlockJobPriority=127, NvMBlockManagementType=NVM_BLOCK_NATIVE, NvMBlockUseCrc=false, NvMNvBlockLength=1, NvMNvBlockNum=1, NvMNvramBlockIdentifier=44, NvMResistantToChangedSw=true, NvMUseServicePorts=true, NvMUseJobendCallback=false, NvMUseInitCallback=false, NvMBlockUseCRCCompMechanism=false, NvMBlockUseSetRamBlockStatus=true, NvMInvokeCallbacksForReadAll=true, NvMInvokeCallbacksForWriteAll=true, NvMCheckLossOfRedundancy=false, NvMSelectBlockForReadAll=true, NvMRamBlockDataAddress=Rte_SWC_RIDMgr_VIN_Lock_MirrorBlock, NvMRomBlockDataAddress=Rte_SWC_RIDMgr_VIN_Lock_DefaultValue, NvMSelectBlockForWriteAll=false, NvMWriteVerification=true, NvMBlockLengthCheck=true  # UC:Derived from NvBlockNeeds
        NvMTargetBlockReference
          NvMEaRef: NvMNameOfEaBlock=EaSWC_ConfigMgrDID_2013_VIN_Lock_Status
      SWC_RIDMgrVIN_OdometerCnt: NvMBlockJobPriority=127, NvMBlockManagementType=NVM_BLOCK_NATIVE, NvMBlockUseCrc=false, NvMNvBlockLength=1, NvMNvBlockNum=1, NvMNvramBlockIdentifier=45, NvMResistantToChangedSw=true, NvMUseServicePorts=true, NvMUseJobendCallback=false, NvMUseInitCallback=false, NvMBlockUseCRCCompMechanism=false, NvMBlockUseSetRamBlockStatus=true, NvMInvokeCallbacksForReadAll=true, NvMInvokeCallbacksForWriteAll=true, NvMCheckLossOfRedundancy=false, NvMSelectBlockForReadAll=true, NvMRamBlockDataAddress=Rte_SWC_RIDMgr_VIN_OdometerCnt_MirrorBlock, NvMRomBlockDataAddress=Rte_SWC_RIDMgr_VIN_OdometerCnt_DefaultValue, NvMSelectBlockForWriteAll=true, NvMBlockLengthCheck=true  # UC:Derived from NvBlockNeeds
        NvMTargetBlockReference
          NvMEaRef: NvMNameOfEaBlock=EaSWC_ConfigMgrVIN_OdometerCnt
      SWC_RIDMgrVIN_OriginalVal: NvMBlockJobPriority=127, NvMBlockManagementType=NVM_BLOCK_NATIVE, NvMBlockUseCrc=false, NvMNvBlockLength=17, NvMNvBlockNum=1, NvMNvramBlockIdentifier=26, NvMResistantToChangedSw=true, NvMUseServicePorts=true, NvMUseJobendCallback=false, NvMUseInitCallback=false, NvMBlockUseCRCCompMechanism=false, NvMBlockUseSetRamBlockStatus=true, NvMInvokeCallbacksForReadAll=true, NvMInvokeCallbacksForWriteAll=true, NvMCheckLossOfRedundancy=false, NvMSelectBlockForReadAll=true, NvMRamBlockDataAddress=Rte_SWC_RIDMgr_VIN_OriginalVal_MirrorBlock, NvMRomBlockDataAddress=Rte_SWC_RIDMgr_VIN_OriginalVal_DefaultValue, NvMSelectBlockForWriteAll=false, NvMWriteVerification=true, NvMBlockLengthCheck=true  # UC:Derived from NvBlockNeeds
        NvMTargetBlockReference
          NvMEaRef: NvMNameOfEaBlock=EaSWC_ConfigMgrVIN_OriginalVal
      NvMBlockDescriptor_FileHeader: NvMBlockJobPriority=127, NvMBlockManagementType=NVM_BLOCK_DATASET, NvMBlockUseCrc=true, NvMNvBlockLength=176, NvMNvBlockNum=9, NvMNvramBlockIdentifier=13, NvMResistantToChangedSw=true, NvMUseServicePorts=true, NvMUseJobendCallback=true, NvMUseInitCallback=false, NvMBlockUseCRCCompMechanism=false, NvMBlockUseSetRamBlockStatus=false, NvMInvokeCallbacksForReadAll=true, NvMInvokeCallbacksForWriteAll=true, NvMCheckLossOfRedundancy=false, NvMAutomaticBlockLength=false, NvMBlockCrcType=NVM_CRC16, NvMBlockLengthCheck=false, NvMCalcRamBlockCrc=false
        NvMTargetBlockReference
          NvMEaRef: NvMNameOfEaBlock=EaBlockDescriptor_FileHeader
      NvMBlockDescriptor_CertAccessInfo: NvMBlockJobPriority=127, NvMBlockManagementType=NVM_BLOCK_DATASET, NvMBlockUseCrc=true, NvMNvBlockLength=46, NvMNvBlockNum=10, NvMNvramBlockIdentifier=14, NvMResistantToChangedSw=true, NvMUseServicePorts=true, NvMUseJobendCallback=true, NvMUseInitCallback=false, NvMBlockUseCRCCompMechanism=false, NvMBlockUseSetRamBlockStatus=false, NvMInvokeCallbacksForReadAll=true, NvMInvokeCallbacksForWriteAll=true, NvMCheckLossOfRedundancy=false, NvMAutomaticBlockLength=false, NvMBlockCrcType=NVM_CRC16, NvMBlockLengthCheck=false, NvMCalcRamBlockCrc=false
        NvMTargetBlockReference
          NvMEaRef: NvMNameOfEaBlock=EaBlockDescriptor_SerialNumber
      CDD_IPCHandlerFPA_SlotData: NvMBlockJobPriority=127, NvMBlockUseCrc=true, NvMNvBlockLength=56, NvMNvBlockNum=2, NvMNvramBlockIdentifier=71, NvMResistantToChangedSw=true, NvMUseServicePorts=true, NvMUseJobendCallback=false, NvMUseInitCallback=false, NvMBlockUseCRCCompMechanism=true, NvMBlockUseSetRamBlockStatus=true, NvMInvokeCallbacksForReadAll=true, NvMInvokeCallbacksForWriteAll=true, NvMCheckLossOfRedundancy=true, NvMRomBlockNum=0, NvMSelectBlockForReadAll=true, NvMRomBlockDataAddress=Rte_CDD_IPCHandler_FPA_Slot_Data_DefaultValue, NvMSelectBlockForWriteAll=false, NvMBlockCrcType=NVM_CRC16, NvMAutomaticBlockLength=true, NvMRamBlockDataAddress=Rte_CDD_IPCHandler_FPA_Slot_Data_MirrorBlock_copy, NvMCalcRamBlockCrc=true, NvMStaticBlockIDCheck=false, NvMWriteVerification=false, NvMBlockManagementType=NVM_BLOCK_REDUNDANT  # UC:Derived from NvBlockNeeds
        NvMTargetBlockReference
          NvMEaRef: NvMNameOfEaBlock=EaSWC_DIDMgrDID_CDD_IPCHandlerFPA_SlotData
      Safety_GuardSafeStat2_ResetReason: NvMBlockJobPriority=127, NvMBlockManagementType=NVM_BLOCK_NATIVE, NvMBlockUseCrc=true, NvMNvBlockNum=1, NvMNvramBlockIdentifier=72, NvMResistantToChangedSw=true, NvMUseServicePorts=true, NvMUseJobendCallback=false, NvMUseInitCallback=false, NvMBlockUseCRCCompMechanism=false, NvMBlockUseSetRamBlockStatus=true, NvMInvokeCallbacksForReadAll=true, NvMInvokeCallbacksForWriteAll=true, NvMCheckLossOfRedundancy=false, NvMSelectBlockForReadAll=true, NvMRomBlockDataAddress=Rte_Safety_Guard_SafeStat2_ResetReason_DefaultValue, NvMBlockCrcType=NVM_CRC16, NvMNvBlockLength=2, NvMRamBlockDataAddress=Rte_Safety_Guard_SafeStat2_ResetReason_MirrorBlock_copy  # UC:Derived from NvBlockNeeds
        NvMTargetBlockReference
          NvMEaRef: NvMNameOfEaBlock=EaSafety_GuardSafeStat2_ResetReason
      CalDataProviderFrontCamSerialNumber: NvMBlockJobPriority=0, NvMBlockManagementType=NVM_BLOCK_REDUNDANT, NvMBlockUseCrc=true, NvMNvBlockLength=10, NvMNvBlockNum=2, NvMNvramBlockIdentifier=73, NvMResistantToChangedSw=true, NvMUseServicePorts=true, NvMUseJobendCallback=false, NvMUseInitCallback=false, NvMBlockUseCRCCompMechanism=true, NvMBlockUseSetRamBlockStatus=true, NvMInvokeCallbacksForReadAll=true, NvMInvokeCallbacksForWriteAll=true, NvMCheckLossOfRedundancy=true, NvMCalcRamBlockCrc=true, NvMSelectBlockForReadAll=true, NvMRomBlockDataAddress=Rte_CalDataProvider_FrontCamSerialNumber_DefaultValue, NvMSelectBlockForWriteAll=false, NvMStaticBlockIDCheck=false, NvMWriteVerification=false, NvMBlockCrcType=NVM_CRC16, NvMAutomaticBlockLength=true, NvMBlockLengthCheck=true, NvMRamBlockDataAddress=Rte_CalDataProvider_FrontCamSerialNumber_MirrorBlock_copy  # UC:Derived from NvBlockNeeds
        NvMTargetBlockReference
          NvMEaRef: NvMNameOfEaBlock=EaCalDataProviderFrontCamSerialNumber
      CalDataProviderLeftCamSerialNumber: NvMBlockJobPriority=0, NvMBlockManagementType=NVM_BLOCK_REDUNDANT, NvMBlockUseCrc=true, NvMNvBlockLength=10, NvMNvBlockNum=2, NvMNvramBlockIdentifier=74, NvMResistantToChangedSw=true, NvMUseServicePorts=true, NvMUseJobendCallback=false, NvMUseInitCallback=false, NvMBlockUseCRCCompMechanism=true, NvMBlockUseSetRamBlockStatus=true, NvMInvokeCallbacksForReadAll=true, NvMInvokeCallbacksForWriteAll=true, NvMCheckLossOfRedundancy=true, NvMCalcRamBlockCrc=true, NvMSelectBlockForReadAll=true, NvMRomBlockDataAddress=Rte_CalDataProvider_LeftCamSerialNumber_DefaultValue, NvMSelectBlockForWriteAll=false, NvMStaticBlockIDCheck=false, NvMWriteVerification=false, NvMBlockCrcType=NVM_CRC16, NvMAutomaticBlockLength=true, NvMBlockLengthCheck=true, NvMRamBlockDataAddress=Rte_CalDataProvider_LeftCamSerialNumber_MirrorBlock_copy  # UC:Derived from NvBlockNeeds
        NvMTargetBlockReference
          NvMEaRef: NvMNameOfEaBlock=EaCalDataProviderLeftCamSerialNumber
      CalDataProviderRearCamSerialNumber: NvMBlockJobPriority=0, NvMBlockManagementType=NVM_BLOCK_REDUNDANT, NvMBlockUseCrc=true, NvMNvBlockLength=10, NvMNvBlockNum=2, NvMNvramBlockIdentifier=75, NvMResistantToChangedSw=true, NvMUseServicePorts=true, NvMUseJobendCallback=false, NvMUseInitCallback=false, NvMBlockUseCRCCompMechanism=true, NvMBlockUseSetRamBlockStatus=true, NvMInvokeCallbacksForReadAll=true, NvMInvokeCallbacksForWriteAll=true, NvMCheckLossOfRedundancy=true, NvMCalcRamBlockCrc=true, NvMSelectBlockForReadAll=true, NvMRomBlockDataAddress=Rte_CalDataProvider_RearCamSerialNumber_DefaultValue, NvMSelectBlockForWriteAll=false, NvMStaticBlockIDCheck=false, NvMWriteVerification=false, NvMBlockCrcType=NVM_CRC16, NvMAutomaticBlockLength=true, NvMBlockLengthCheck=true, NvMRamBlockDataAddress=Rte_CalDataProvider_RearCamSerialNumber_MirrorBlock_copy  # UC:Derived from NvBlockNeeds
        NvMTargetBlockReference
          NvMEaRef: NvMNameOfEaBlock=EaCalDataProviderRearCamSerialNumber
      CalDataProviderRightCamSerialNumber: NvMBlockJobPriority=0, NvMBlockManagementType=NVM_BLOCK_REDUNDANT, NvMBlockUseCrc=true, NvMNvBlockLength=10, NvMNvBlockNum=2, NvMNvramBlockIdentifier=76, NvMResistantToChangedSw=true, NvMUseServicePorts=true, NvMUseJobendCallback=false, NvMUseInitCallback=false, NvMBlockUseCRCCompMechanism=true, NvMBlockUseSetRamBlockStatus=true, NvMInvokeCallbacksForReadAll=true, NvMInvokeCallbacksForWriteAll=true, NvMCheckLossOfRedundancy=true, NvMCalcRamBlockCrc=true, NvMSelectBlockForReadAll=true, NvMRomBlockDataAddress=Rte_CalDataProvider_RightCamSerialNumber_DefaultValue, NvMSelectBlockForWriteAll=false, NvMStaticBlockIDCheck=false, NvMWriteVerification=false, NvMBlockCrcType=NVM_CRC16, NvMAutomaticBlockLength=true, NvMBlockLengthCheck=true, NvMRamBlockDataAddress=Rte_CalDataProvider_RightCamSerialNumber_MirrorBlock_copy  # UC:Derived from NvBlockNeeds
        NvMTargetBlockReference
          NvMEaRef: NvMNameOfEaBlock=EaCalDataProviderRightCamSerialNumber
      CDD_CryptoMgrNvMBlockDescriptor_SecondCounter: NvMBlockJobPriority=127, NvMBlockManagementType=NVM_BLOCK_NATIVE, NvMBlockUseCrc=true, NvMNvBlockLength=4, NvMNvBlockNum=1, NvMNvramBlockIdentifier=77, NvMResistantToChangedSw=true, NvMUseServicePorts=false, NvMUseJobendCallback=false, NvMUseInitCallback=false, NvMBlockUseCRCCompMechanism=false, NvMBlockUseSetRamBlockStatus=true, NvMInvokeCallbacksForReadAll=true, NvMInvokeCallbacksForWriteAll=true, NvMCheckLossOfRedundancy=false, NvMSelectBlockForReadAll=true, NvMRamBlockDataAddress=Rte_CDD_CryptoMgr_NvMBlockDescriptor_SecondCounter_MirrorBlock, NvMRomBlockDataAddress=Rte_CDD_CryptoMgr_NvMBlockDescriptor_SecondCounter_DefaultValue, NvMSelectBlockForWriteAll=true, NvMBlockCrcType=NVM_CRC16  # UC:Derived from NvBlockNeeds
        NvMTargetBlockReference
          NvMEaRef: NvMNameOfEaBlock=EaBlockDescriptor_SecondCounter
      CDD_CryptoMgrNvMBlockDescriptor_SystemTimestamp: NvMBlockJobPriority=127, NvMBlockManagementType=NVM_BLOCK_NATIVE, NvMBlockUseCrc=true, NvMNvBlockNum=1, NvMNvramBlockIdentifier=78, NvMResistantToChangedSw=true, NvMUseServicePorts=false, NvMUseJobendCallback=false, NvMUseInitCallback=false, NvMBlockUseCRCCompMechanism=false, NvMBlockUseSetRamBlockStatus=true, NvMInvokeCallbacksForReadAll=true, NvMInvokeCallbacksForWriteAll=true, NvMCheckLossOfRedundancy=false, NvMSelectBlockForReadAll=true, NvMRamBlockDataAddress=Rte_CDD_CryptoMgr_NvMBlockDescriptor_SystemTimestamp_MirrorBlock, NvMRomBlockDataAddress=Rte_CDD_CryptoMgr_NvMBlockDescriptor_SystemTimestamp_DefaultValue, NvMSelectBlockForWriteAll=true, NvMBlockCrcType=NVM_CRC16, NvMNvBlockLength=15  # UC:Derived from NvBlockNeeds
        NvMTargetBlockReference
          NvMEaRef: NvMNameOfEaBlock=EaBlockDescriptor_SystemTimestamp
      CDD_SafetyCDD_PMICLastResetReason_BISTStatus: NvMBlockJobPriority=0, NvMBlockManagementType=NVM_BLOCK_NATIVE, NvMBlockUseCrc=true, NvMNvBlockLength=2, NvMNvBlockNum=1, NvMNvramBlockIdentifier=79, NvMResistantToChangedSw=true, NvMUseServicePorts=true, NvMUseJobendCallback=false, NvMUseInitCallback=false, NvMBlockUseCRCCompMechanism=false, NvMBlockUseSetRamBlockStatus=true, NvMInvokeCallbacksForReadAll=true, NvMInvokeCallbacksForWriteAll=true, NvMCheckLossOfRedundancy=false, NvMSelectBlockForReadAll=true, NvMRomBlockDataAddress=Rte_CDD_Safety_CDD_PMICLastResetReason_BISTStatus_DefaultValue, NvMSelectBlockForWriteAll=true, NvMAutomaticBlockLength=true, NvMBlockLengthCheck=true, NvMBlockCrcType=NVM_CRC16, NvMRamBlockDataAddress=Rte_CDD_Safety_CDD_PMICLastResetReason_BISTStatus_MirrorBlock_copy  # UC:Derived from NvBlockNeeds
        NvMTargetBlockReference
          NvMEaRef: NvMNameOfEaBlock=EaCDD_SafetyCDD_PMICLastResetReason_BISTStatus
      CDD_CryptoMgrNvMBlockDescriptor_CertificateExpired: NvMBlockJobPriority=127, NvMBlockManagementType=NVM_BLOCK_NATIVE, NvMBlockUseCrc=true, NvMNvBlockLength=1, NvMNvBlockNum=1, NvMNvramBlockIdentifier=80, NvMResistantToChangedSw=true, NvMUseServicePorts=false, NvMUseJobendCallback=false, NvMUseInitCallback=false, NvMBlockUseCRCCompMechanism=false, NvMBlockUseSetRamBlockStatus=true, NvMInvokeCallbacksForReadAll=true, NvMInvokeCallbacksForWriteAll=true, NvMCheckLossOfRedundancy=false, NvMSelectBlockForReadAll=true, NvMRamBlockDataAddress=Rte_CDD_CryptoMgr_NvMBlockDescriptor_CertificateExpired_MirrorBlock, NvMRomBlockDataAddress=Rte_CDD_CryptoMgr_NvMBlockDescriptor_CertificateExpired_DefaultValue, NvMSelectBlockForWriteAll=false, NvMBlockCrcType=NVM_CRC16  # UC:Derived from NvBlockNeeds
        NvMTargetBlockReference
          NvMEaRef: NvMNameOfEaBlock=EaBlockDescriptor_CertificateExpired
      SWC_DIDMgrDID_FD74_BuffMarkCompErr: NvMBlockJobPriority=127, NvMBlockManagementType=NVM_BLOCK_NATIVE, NvMBlockUseCrc=true, NvMNvBlockLength=2, NvMNvBlockNum=1, NvMNvramBlockIdentifier=81, NvMResistantToChangedSw=true, NvMUseServicePorts=true, NvMUseJobendCallback=false, NvMUseInitCallback=false, NvMBlockUseCRCCompMechanism=false, NvMBlockUseSetRamBlockStatus=true, NvMInvokeCallbacksForReadAll=true, NvMInvokeCallbacksForWriteAll=true, NvMCheckLossOfRedundancy=false, NvMSelectBlockForReadAll=true, NvMRamBlockDataAddress=Rte_SWC_DIDMgr_DID_FD74_BuffMarkCompErr_MirrorBlock, NvMRomBlockDataAddress=Rte_SWC_DIDMgr_DID_FD74_BuffMarkCompErr_DefaultValue, NvMSelectBlockForWriteAll=true, NvMBlockCrcType=NVM_CRC16  # UC:Derived from NvBlockNeeds
        NvMTargetBlockReference
          NvMEaRef: NvMNameOfEaBlock=EaSWC_DIDMgrDID_FD74_BuffMarkCompErr
      SWC_DIDMgrDID_FD74_PHY_TuningErr: NvMBlockJobPriority=127, NvMBlockManagementType=NVM_BLOCK_NATIVE, NvMBlockUseCrc=true, NvMNvBlockLength=2, NvMNvBlockNum=1, NvMNvramBlockIdentifier=82, NvMResistantToChangedSw=true, NvMUseServicePorts=true, NvMUseJobendCallback=false, NvMUseInitCallback=false, NvMBlockUseCRCCompMechanism=false, NvMBlockUseSetRamBlockStatus=true, NvMInvokeCallbacksForReadAll=true, NvMInvokeCallbacksForWriteAll=true, NvMCheckLossOfRedundancy=false, NvMSelectBlockForReadAll=true, NvMRamBlockDataAddress=Rte_SWC_DIDMgr_DID_FD74_PHY_TuningErr_MirrorBlock, NvMRomBlockDataAddress=Rte_SWC_DIDMgr_DID_FD74_PHY_TuningErr_DefaultValue, NvMSelectBlockForWriteAll=true, NvMBlockCrcType=NVM_CRC16  # UC:Derived from NvBlockNeeds
        NvMTargetBlockReference
          NvMEaRef: NvMNameOfEaBlock=EaSWC_DIDMgrDID_FD74_PHY_TuningErr
      SWC_DTCMgrDTC_APARequestSts_PAMRequestSts: NvMBlockJobPriority=127, NvMBlockManagementType=NVM_BLOCK_NATIVE, NvMBlockUseCrc=true, NvMNvBlockLength=1, NvMNvBlockNum=1, NvMNvramBlockIdentifier=83, NvMResistantToChangedSw=true, NvMUseServicePorts=true, NvMUseJobendCallback=false, NvMUseInitCallback=false, NvMBlockUseCRCCompMechanism=false, NvMBlockUseSetRamBlockStatus=true, NvMInvokeCallbacksForReadAll=true, NvMInvokeCallbacksForWriteAll=true, NvMCheckLossOfRedundancy=false, NvMBlockCrcType=NVM_CRC16, NvMRamBlockDataAddress=Rte_SWC_DTCMgr_DTC_APARequestSts_PAMRequestSts_MirrorBlock, NvMRomBlockDataAddress=Rte_SWC_DTCMgr_DTC_APARequestSts_PAMRequestSts_DefaultValue, NvMSelectBlockForReadAll=true, NvMSelectBlockForWriteAll=true  # UC:Derived from NvBlockNeeds
        NvMTargetBlockReference
          NvMEaRef: NvMNameOfEaBlock=EaSWC_DTCMgrDTC_APARequestSts_PAMRequestSts
