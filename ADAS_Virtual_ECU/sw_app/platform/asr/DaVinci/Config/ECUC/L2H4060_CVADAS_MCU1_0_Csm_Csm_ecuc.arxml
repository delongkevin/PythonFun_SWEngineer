AUTOSAR XML (schema 00048)
package /ActiveEcuC
  module config Csm: implementation-config-variant=VARIANT-PRE-COMPILE, module-description=Csm_Impl
    CsmAEADEncryptConfig (CsmPrimitives)
      CsmAEADEncrypt
        CsmAEADEncryptConfig:
          CsmAEADEncryptAlgorithmFamiliy = CRYPTO_ALGOFAM_CUSTOM
          CsmAEADEncryptAlgorithmFamily = CRYPTO_ALGOFAM_CUSTOM
          CsmAEADEncryptAlgorithmKeyLength = 16
          CsmAEADEncryptAlgorithmMode = CRYPTO_ALGOMODE_CUSTOM
          CsmAEADEncryptProcessing = CSM_SYNCHRONOUS
          CsmAEADEncryptTagLength = 4
          CsmAEADEncryptAlgorithmSecondaryFamily = CRYPTO_ALGOFAM_NOT_SET
          CsmAEADEncryptKeyRef = CsmKey_KeyMCertificate_ADA_L4
          CsmAEADEncryptAlgorithmFamilyCustomRef = Crypto_30_vHsm_KeyM_vHsm_KeyM
          CsmAEADEncryptAlgorithmModeCustomRef = Crypto_30_vHsm_KeyM_CertElementGet
    CsmPrimitives_CsmSignatureVerify_ADA (CsmPrimitives)
      CsmPrimitives_CsmSignatureVerify (CsmSignatureVerify)
        CsmPrimitives_CsmSignatureVerify_ADA (CsmSignatureVerifyConfig):
          CsmSignatureVerifyAlgorithmFamiliy = CRYPTO_ALGOFAM_RSA
          CsmSignatureVerifyAlgorithmFamily = CRYPTO_ALGOFAM_RSA
          CsmSignatureVerifyAlgorithmMode = CRYPTO_ALGOMODE_RSASSA_PKCS1_v1_5
          CsmSignatureVerifyAlgorithmSecondaryFamily = CRYPTO_ALGOFAM_SHA2_256
          CsmSignatureVerifyCompareLength = 256
          CsmSignatureVerifyProcessing = CSM_SYNCHRONOUS
          CsmSignatureVerifyKeyLength = 256
          CsmSignatureVerifySwcInterfaceVersion = CSM_ASR_VERSION_4_03
    CsmGeneral:
      CsmAsymPrivateKeyMaxLength = 32
      CsmAsymPublicKeyMaxLength = 1024
      CsmDevErrorDetect = true
      CsmMainFunctionPeriod = 0.01
      CsmSymKeyMaxLength = 16
      CsmUseDeprecated = false
      CsmVersionInfoApi = false
      CsmCallbackStartNotification = false
      CsmCancelationDuringProcessing = false
      CsmSafeBswChecks = false
      CsmCustomIncludeFiles = Crypto_30_vHsm_Custom.h
      CsmJobTypeLayout:
        CsmJobTypeLayoutAsr430Compatibility = true
        CsmJobTypeLayoutVarMembers = false
        CsmJobTypeLayoutInput64 = false
        CsmJobTypeLayoutOutput64Ptr = false
        CsmJobTypeLayoutRedirectionInfoRef = false
    CsmCallout (CsmCallouts)
      CsmCallout: CsmPreJobCalloutFunc=CsmPreJobCalloutFunc_CsmCallout_ADASigVerify, CsmPostJobCalloutFunc=CsmPostJobCalloutFunc_CsmCallout_ADASigVerify
    CsmQueues
      5 x CsmQueue, all with CsmQueueSize=1, CsmTriggerAsynchJobsInCallback=false, CsmJobSharing=true:
        CsmQueue_vHsm_Hal: CsmChannelRef=CryIfChannel_vHsm_Hal
        CsmQueue_vHsm_Core: CsmChannelRef=CryIfChannel_vHsm_Core
        CsmQueue_vHsm_KeyMRemote: CsmChannelRef=CryIfChannel_vHsm_KeyMRemote
        CsmQueue_vHsm_LibCv: CsmChannelRef=CryIfChannel_vHsm_LibCv
        CsmQueue_Custom: CsmChannelRef=CryIfChannel_VHsm_Custom
    CsmJobs
      8 x CsmJob, all with CsmJobUsePort=false, CsmJobInterfaceUsePort=CRYPTO_USE_FNC:
        CsmJob_GetRoleFromTesterCertificate: CsmJobId=2, CsmJobPriority=0, CsmProcessingMode=CRYPTO_PROCESSING_SYNC, CsmJobKeyRef=CsmKey_KeyMCertificate_ADA_L4, CsmJobPrimitiveRef=Csm/CsmAEADEncryptConfig, CsmJobQueueRef=CsmQueue_vHsm_KeyMRemote
        CsmJob_SignatureVerify_ADA: CsmJobId=7, CsmJobPriority=0, CsmProcessingMode=CRYPTO_PROCESSING_SYNC, CsmJobServiceInterfaceContextUsePort=CRYPTO_USE_FUNC, CsmJobKeyRef=CsmKey_RsaSignatureVerifyKey_ADA_L4, CsmJobPrimitiveRef=Csm/CsmPrimitives_CsmSignatureVerify_ADA, CsmJobQueueRef=CsmQueue_vHsm_LibCv, CsmJobCalloutRef=CsmCallout/CsmCallout
        CsmJob_SecureLog_MacGen: CsmJobId=4, CsmJobPriority=0, CsmProcessingMode=CRYPTO_PROCESSING_SYNC, CsmJobServiceInterfaceContextUsePort=CRYPTO_USE_FUNC, CsmJobKeyRef=CsmKey_SecureLog, CsmJobPrimitiveRef=Csm/CsmPrimitives_SecureLog_CMAC, CsmJobQueueRef=CsmQueue_vHsm_Hal
        CsmJob_Random: CsmJobId=3, CsmJobPriority=1, CsmProcessingMode=CRYPTO_PROCESSING_SYNC, CsmJobKeyRef=CsmKey_Random, CsmJobPrimitiveRef=Csm/CsmPrimitives_RandomTrng, CsmJobQueueRef=CsmQueue_vHsm_Hal
        CsmJob_SignatureVerify: CsmJobId=6, CsmJobPriority=0, CsmProcessingMode=CRYPTO_PROCESSING_ASYNC, CsmJobServiceInterfaceContextUsePort=CRYPTO_USE_FUNC, CsmJobKeyRef=CsmKey_RSAKey, CsmJobPrimitiveRef=Csm/CsmPrimitives_CsmSignatureVerify, CsmJobQueueRef=CsmQueue_vHsm_LibCv, CsmJobPrimitiveCallbackRef=CsmCallback
        CsmJob_CsmHash: CsmJobId=1, CsmJobPriority=0, CsmProcessingMode=CRYPTO_PROCESSING_SYNC, CsmJobServiceInterfaceContextUsePort=CRYPTO_USE_FUNC, CsmJobKeyRef=CsmKey_RSAKey, CsmJobPrimitiveRef=Csm/CsmPrimitives_CsmHash, CsmJobQueueRef=CsmQueue_vHsm_LibCv
        CsmJob_SecureLog_MacVerify: CsmJobId=5, CsmJobPriority=0, CsmProcessingMode=CRYPTO_PROCESSING_SYNC, CsmJobKeyRef=CsmKey_SecureLog, CsmJobPrimitiveRef=Csm/CsmPrimitives_CMACVerify, CsmJobQueueRef=CsmQueue_vHsm_Hal
        CsmJob_ReadDCLEntries: CsmJobId=0, CsmJobPriority=0, CsmProcessingMode=CRYPTO_PROCESSING_SYNC, CsmJobKeyRef=CsmKey_KeyMCertificate_ADA_L4, CsmJobPrimitiveRef=Csm/CsmPrimitives_ReadDCLEntries, CsmJobQueueRef=CsmQueue_Custom
    CsmKey (CsmKeys)
      8 x CsmKey, all with CsmKeyUsePort=false:
        CsmKey_SecureLog: CsmKeyId=7, CsmKeySwcInterfaceVersion=CSM_ASR_VERSION_4_04, CsmKeyRef=CryIfKey_SecureLog
        CsmKey_Random: CsmKeyId=3, CsmKeyRef=Random
        CsmKey_RSAKey: CsmKeyId=2, CsmKeySwcInterfaceVersion=CSM_ASR_VERSION_4_04, CsmKeyRef=RSAKey
        CsmKey_KeyMCertificate_ADA_L4: CsmKeyId=1, CsmKeyRef=CryIfKey_CryIfKey_KeyMCertificate_ADA_L4
        CsmKey_RoleFlag: CsmKeyId=4, CsmKeyRef=CryIfKey_CryIfKey_RoleFlag
        CsmKey_RsaSignatureVerifyKey_ADA_L4: CsmKeyId=5, CsmKeyRef=CryIfKey_CryIfKey_RsaSignatureVerifyKey_ADA_L4
        CsmKey_SecondCounter: CsmKeyId=6, CsmKeyRef=CryIfKey_CryIfKey_SecondCounter
        CsmKey_CurrentTimeStamp: CsmKeyId=0, CsmKeyRef=CryIfKey_CryIfKey_CurrentTimeStamp
    4 x CsmPrimitives:
      CsmPrimitives_CsmHash
        CsmPrimitives_CsmHash (CsmHash)
          CsmPrimitives_CsmHash (CsmHashConfig):
            CsmHashAlgorithmFamiliy = CRYPTO_ALGOFAM_SHA2_256
            CsmHashAlgorithmFamily = CRYPTO_ALGOFAM_SHA2_256
            CsmHashAlgorithmMode = CRYPTO_ALGOMODE_NOT_SET
            CsmHashAlgorithmSecondaryFamily = CRYPTO_ALGOFAM_NOT_SET
            CsmHashProcessing = CSM_SYNCHRONOUS
            CsmHashResultLength = 32
            CsmHashSwcInterfaceVersion = CSM_ASR_VERSION_4_04
      CsmPrimitives_CsmSignatureVerify
        CsmPrimitives_CsmSignatureVerify (CsmSignatureVerify)
          CsmPrimitives_CsmSignatureVerify (CsmSignatureVerifyConfig):
            CsmSignatureVerifyAlgorithmFamiliy = CRYPTO_ALGOFAM_RSA
            CsmSignatureVerifyAlgorithmFamily = CRYPTO_ALGOFAM_RSA
            CsmSignatureVerifyAlgorithmMode = CRYPTO_ALGOMODE_RSASSA_PKCS1_v1_5
            CsmSignatureVerifyAlgorithmSecondaryFamily = CRYPTO_ALGOFAM_SHA2_256
            CsmSignatureVerifyCompareLength = 256
            CsmSignatureVerifyProcessing = CSM_ASYNCHRONOUS
            CsmSignatureVerifyKeyLength = 256
            CsmSignatureVerifySwcInterfaceVersion = CSM_ASR_VERSION_4_03
      CsmPrimitives_RandomTrng
        CsmRandomGenerate
          CsmPrimitives_RandomTrng (CsmRandomGenerateConfig):
            CsmRandomGenerateAlgorithmFamiliy = CRYPTO_ALGOFAM_RNG
            CsmRandomGenerateAlgorithmFamily = CRYPTO_ALGOFAM_RNG
            CsmRandomGenerateAlgorithmMode = CRYPTO_ALGOMODE_NOT_SET
            CsmRandomGenerateAlgorithmSecondaryFamily = CRYPTO_ALGOFAM_NOT_SET
            CsmRandomGenerateProcessing = CSM_SYNCHRONOUS
            CsmRandomGenerateResultLength = 32
      CsmPrimitives_SecureLog_CMAC
        CsmMacGenerate
          CsmPrimitives_SecureLog_CMAC (CsmMacGenerateConfig):
            CsmMacGenerateAlgorithmFamiliy = CRYPTO_ALGOFAM_AES
            CsmMacGenerateAlgorithmFamily = CRYPTO_ALGOFAM_AES
            CsmMacGenerateAlgorithmKeyLength = 16
            CsmMacGenerateAlgorithmMode = CRYPTO_ALGOMODE_CMAC
            CsmMacGenerateAlgorithmSecondaryFamily = CRYPTO_ALGOFAM_NOT_SET
            CsmMacGenerateProcessing = CSM_SYNCHRONOUS
            CsmMacGenerateResultLength = 16
            CsmMacGenerateSwcInterfaceVersion = CSM_ASR_VERSION_4_04
    CsmCallbacks
      CsmCallback: CsmCallbackFunc=CsmCallbackFunc_CsmCallback, CsmCallbackId=0, CsmBswCallbackAsrVersion=CSM_ASR_VERSION_4_04
    CsmPrimitives_CMACVerify (CsmPrimitives)
      CsmMacVerify
        CsmPrimitives_CMACVerify (CsmMacVerifyConfig):
          CsmMacVerifyAlgorithmFamiliy = CRYPTO_ALGOFAM_AES
          CsmMacVerifyAlgorithmFamily = CRYPTO_ALGOFAM_AES
          CsmMacVerifyAlgorithmSecondaryFamily = CRYPTO_ALGOFAM_NOT_SET
          CsmMacVerifyCompareLength = 16
          CsmMacVerifyProcessing = CSM_SYNCHRONOUS
          CsmMacVerifyAlgorithmMode = CRYPTO_ALGOMODE_CMAC
          CsmMacVerifyAlgorithmKeyLength = 16
    CsmPrimitives_ReadDCLEntries (CsmPrimitives)
      CsmRandomGenerate
        CsmPrimitives_ReadDCLEntries (CsmRandomGenerateConfig):
          CsmRandomGenerateAlgorithmFamiliy = CRYPTO_ALGOFAM_CUSTOM
          CsmRandomGenerateAlgorithmFamily = CRYPTO_ALGOFAM_CUSTOM
          CsmRandomGenerateAlgorithmMode = CRYPTO_ALGOMODE_CUSTOM
          CsmRandomGenerateAlgorithmSecondaryFamily = CRYPTO_ALGOFAM_NOT_SET
          CsmRandomGenerateProcessing = CSM_SYNCHRONOUS
          CsmRandomGenerateResultLength = 1536
          CsmRandomGenerateAlgorithmFamilyCustom = CRYPTO_ALGOFAM_CUSTOM
          CsmRandomGenerateAlgorithmModeCustom = CRYPTO_ALGOMODE_CUSTOM
