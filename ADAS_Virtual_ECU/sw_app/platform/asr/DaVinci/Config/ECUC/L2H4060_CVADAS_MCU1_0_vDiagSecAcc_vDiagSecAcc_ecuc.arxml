AUTOSAR XML (schema 00048)
package /ActiveEcuC
  module config vDiagSecAcc: implementation-config-variant=VARIANT-PRE-COMPILE, module-description=vDiagSecAcc_Impl
    vDiagSecAccSecurityLevels
      vDiagSecAccSecurityLevel: vDiagSecAccLevel=11, vDiagSecAccSeedLength=32, vDiagSecAccKeyLength=256, vDiagSecAccId=0, vDiagSecAccCompareKeyCsmJobRef=CsmJob_SignatureVerify_ADA
        vDiagSecAccCompareKeyType
          vDiagSecAccSignatureVerify
    vDiagSecAccGeneral: vDiagSecAccVersionInfoApi=false, vDiagSecAccDevErrorDetect=true, vDiagSecAccSafeBswChecks=false, vDiagSecAccRandomGenerateJobRef=CsmJob_Random
