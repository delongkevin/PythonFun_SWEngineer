AUTOSAR XML (schema 00048)
package /ActiveEcuC
  module config I2c: implementation-config-variant=VARIANT-PRE-COMPILE, module-description=I2c_Impl
    16 x I2cHardwareConfiguration:
      AM64x_I2C0: I2cUnitBase=536870912, I2cUnitEnd=536871127
      AM64x_I2C1: I2cUnitBase=536936448, I2cUnitEnd=536936663
      AM64x_I2C2: I2cUnitBase=537001984, I2cUnitEnd=537002199
      AM64x_I2C3: I2cUnitBase=537067520, I2cUnitEnd=537067735
      AM64x_MCU_I2C0: I2cUnitBase=76546048, I2cUnitEnd=76546263
      AM64x_MCU_I2C1: I2cUnitBase=76611584, I2cUnitEnd=76611799
      TDA4x_DRA8xx_I2C0: I2cUnitBase=33554432, I2cUnitEnd=33554647
      TDA4x_DRA8xx_I2C1: I2cUnitBase=33619968, I2cUnitEnd=33620183
      TDA4x_DRA8xx_I2C2: I2cUnitBase=33685504, I2cUnitEnd=33685719
      TDA4x_DRA8xx_I2C3: I2cUnitBase=33751040, I2cUnitEnd=33751255
      TDA4x_DRA8xx_I2C4: I2cUnitBase=33816576, I2cUnitEnd=33816791
      TDA4x_DRA8xx_I2C5: I2cUnitBase=33882112, I2cUnitEnd=33882327
      TDA4x_DRA8xx_I2C6: I2cUnitBase=33947648, I2cUnitEnd=33947863
      TDA4x_DRA8xx_MCU_I2C0: I2cUnitBase=1085276160, I2cUnitEnd=1085276375
      TDA4x_DRA8xx_MCU_I2C1: I2cUnitBase=1085341696, I2cUnitEnd=1085341911
      TDA4x_DRA8xx_WKUP_I2C0: I2cUnitBase=1108475904, I2cUnitEnd=1108476119
    I2cConfigSet
      I2cChannel_EEPROM_ReadCom (I2cChannel): I2cChannelId=0, I2cDeviceAddress=80, I2cChainChannel=false, I2cDefaultData=255
      I2cBus_EEPROM (I2cBus): I2cBusId=0, I2cTransferRate=400, I2cTimeout=0.04, I2cHwUnitAssignment=I2cHardwareUnit_EEPROM
      I2cHardwareUnit_EEPROM (I2cHardwareUnit): I2cUnitId=0, I2cMaxResetWaitCycles=500000, I2cClockFrequencyManual=100000000, I2cHardwareConfigurationRef=TDA4x_DRA8xx_MCU_I2C1
      I2cSequence_EEPROM_Read (I2cSequence):
        I2cPriority = 1
        I2cEndNotification = Eep_30_XXi2c01_ComEnd
        I2cSequenceId = 0
        I2cHandleNackAsError = false
        I2cErrorNotification = NULL_PTR
        I2cAssignedBus = I2cBus_EEPROM
        I2cChannelList_EEPROM_ReadCom (I2cChannelList): I2cChannelIndex=1, I2cChannelAssignment=I2cChannel_EEPROM_ReadCom
        I2cChannelList_EEPROM_ReadData (I2cChannelList): I2cChannelIndex=2, I2cChannelAssignment=I2cChannel_EEPROM_ReadData
      4 x I2cChannel, all with I2cDeviceAddress=80, I2cDefaultData=255:
        I2cChannel_EEPROM_ReadData: I2cChannelId=1, I2cChainChannel=false
        I2cChannel_EEPROM_WriteCom: I2cChannelId=2, I2cChainChannel=false
        I2cChannel_EEPROM_WriteData: I2cChannelId=3, I2cChainChannel=true
        I2cChannel_EEPROM_Ack: I2cChannelId=4, I2cChainChannel=false
      I2cSequence_EEPROM_Write (I2cSequence):
        I2cPriority = 1
        I2cEndNotification = Eep_30_XXi2c01_ComEnd
        I2cSequenceId = 1
        I2cHandleNackAsError = false
        I2cErrorNotification = NULL_PTR
        I2cAssignedBus = I2cBus_EEPROM
        I2cChannelList_EEPROM_WriteData (I2cChannelList): I2cChannelIndex=2, I2cChannelAssignment=I2cChannel_EEPROM_WriteData
        I2cChannelList_EEPROM_WriteCom (I2cChannelList): I2cChannelIndex=1, I2cChannelAssignment=I2cChannel_EEPROM_WriteCom
      I2cSequence_EEPROM_Status (I2cSequence):
        I2cPriority = 1
        I2cEndNotification = Eep_30_XXi2c01_ComEnd
        I2cSequenceId = 2
        I2cHandleNackAsError = false
        I2cErrorNotification = NULL_PTR
        I2cAssignedBus = I2cBus_EEPROM
        I2cChannelList_EEPROM_Ack (I2cChannelList): I2cChannelIndex=1, I2cChannelAssignment=I2cChannel_EEPROM_Ack
    I2cGeneral:
      I2cDevErrorDetect = true
      I2cGetStatusApi = true
      I2cCancelApi = true
      I2cVersionInfoApi = true
      I2cIrqType = I2C_ISR_CAT2
      I2cQueueDepth = 10
      I2cMainFunctionPeriod = 0.01
      I2cProtectedMode = false
      I2cSafeBswChecks = false
      I2cUserConfigFile = 
      I2cUserCallbackHeaderFile = Eep_30_XXi2c01_Cbk.h
      I2cUserCallbackHeaderFile = CDD_PMIC.h
      I2cPollingMode = false
      I2cMaxHwLoopCycle = 1000
