AUTOSAR XML (schema 00048)
package /ActiveEcuC
  module config CryIf: implementation-config-variant=VARIANT-PRE-COMPILE, module-description=CryIf_Impl
    CryIfGeneral:
      CryIfDevErrorDetect = true
      CryIfVersionInfoApi = false
      CryIfMaxNumberOfKeyElements = 10
      CryIfMaxSizeOfKeyElement = 32
      CryIfRedirection = false
      CryIfSafeBswChecks = false
    CryIfCryptoModule: CryIfSupportsKeyElementCopyPartial=true, CryIfCancelJobApiUsesJobType=true, CryIfCryptoModuleRef=Crypto
    3 x CryIfKey:
      RSAKey: CryIfKeyId=6, CryIfKeyRef=CryIfKey_UserRsaSignVerify_Key
      Random: CryIfKeyId=7, CryIfKeyRef=Random
      CryIfKey_SecureLog: CryIfKeyId=5, CryIfKeyRef=CryIfKey_UserSecureLog_Key
    4 x CryIfChannel:
      CryIfChannel_vHsm_Hal: CryIfChannelId=2, CryIfDriverObjectRef=Crypto_30_vHsm_Hal
      CryIfChannel_vHsm_KeyMRemote: CryIfChannelId=3, CryIfDriverObjectRef=Crypto_30_vHsm_KeyMRemote
      CryIfChannel_vHsm_LibCv: CryIfChannelId=4, CryIfDriverObjectRef=Crypto_30_vHsm_LibCv
      CryIfChannel_vHsm_Core: CryIfChannelId=1, CryIfDriverObjectRef=Crypto_30_vHsm_Core
    5 x CryIfKey:
      CryIfKey_CryIfKey_KeyMCertificate_ADA_L4: CryIfKeyId=1, CryIfKeyRef=CryIfKey_KeyMCertificate_ADA_L4
      CryIfKey_CryIfKey_RoleFlag: CryIfKeyId=2, CryIfKeyRef=CryIfKey_RoleFlag
      CryIfKey_CryIfKey_RsaSignatureVerifyKey_ADA_L4: CryIfKeyId=3, CryIfKeyRef=CryIfKey_RsaSignatureVerifyKey_ADA_L4
      CryIfKey_CryIfKey_SecondCounter: CryIfKeyId=4, CryIfKeyRef=CryIfKey_SecondCounter
      CryIfKey_CryIfKey_CurrentTimeStamp: CryIfKeyId=0, CryIfKeyRef=CryIfKey_CurrentTimeStamp
    CryIfChannel_VHsm_Custom (CryIfChannel): CryIfChannelId=0, CryIfDriverObjectRef=Crypto_30_vHsm_Custom
