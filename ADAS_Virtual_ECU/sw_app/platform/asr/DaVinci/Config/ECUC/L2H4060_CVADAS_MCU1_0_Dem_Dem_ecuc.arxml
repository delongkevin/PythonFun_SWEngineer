AUTOSAR XML (schema 00048)
package /ActiveEcuC
  module config Dem: implementation-config-variant=VARIANT-PRE-COMPILE, module-description=Dem_Impl
    DemGeneral:
      DemAgingCycleCounterProcessing = DEM_PROCESS_AGINGCTR_INTERN
      DemDebounceCounterBasedSupport = true
      DemEnableConditionSupport = true
      DemPTOSupport = false
      DemDtcStatusAvailabilityMask = 127
      DemGeneralInterfaceSupport = false
      DemDataElementDefaultEndianness = LITTLE_ENDIAN
      DemAgingRequieresTestedCycle = false
      DemMaxNumberEventEntryMirror = 0
      DemTriggerMonitorInitBeforeClearOk = true
      DemExtendedDataCapture = DEM_TRIGGER_EVENT_MEMORY_STORAGE
      DemFreezeFrameCapture = DEM_TRIGGER_EVENT_MEMORY_STORAGE
      DemOperationCycleProcessing = DEM_PROCESS_OPCYC_STATE
      DemMaxNumberTimeSeriesSnapshots = 0
      DemAvailabilitySupport = DEM_NO_AVAILABILITY
      DemAvailabilityStorage = false
      DemBswErrorBufferSize = 0
      DemClearDTCBehavior = DEM_CLRRESP_NONVOLATILE_FINISH
      DemClearDTCLimitation = DEM_ALL_SUPPORTED_DTCS
      DemDebounceTimeBasedSupport = false
      DemDevErrorDetect = true
      DemEventCombinationSupport = DEM_EVCOMB_DISABLED
      DemEventDisplacementStrategy = DEM_DISPLACEMENT_LEGACY_403
      DemEventMemoryEntryStorageTrigger = DEM_STORAGE_ON_TEST_FAILED
      DemMaxNumberEventEntryOBDFreezeFrame = 0
      DemMaxNumberEventEntryPermanent = 0
      DemMaxNumberPrestoredFF = 0
      DemOBDSupport = DEM_OBD_NO_OBD_SUPPORT
      DemOccurrenceCounterProcessing = DEM_PROCESS_OCCCTR_TF
      DemOperationCycleStatusStorage = false
      DemResetConfirmedBitOnOverflow = false
      DemStatusBitHandlingTestFailedSinceLastClear = DEM_STATUS_BIT_NORMAL
      DemStatusBitStorageTestFailed = true
      DemStorageConditionSupport = true
      DemSuppressionSupport = DEM_NO_SUPPRESSION
      DemTaskTime = 0.01
      DemTriggerDcmReports = false
      DemTriggerDltReports = false
      DemTriggerFiMReports = false
      DemTriggerFiMReportsExtended = false
      DemTriggerMonitorInitForEnableConditions = false
      DemTypeOfDTCSupported = DEM_DTC_TRANSLATION_J2012DA_FORMAT_04
      DemVersionInfoApi = false
      DemBswApiVersion = DEM_BSW_API_4_XX_XX
      DemBswApiVersionNvM = DEM_BSW_API_4_XX_XX
      DemBswApiVersionFiM = DEM_BSW_API_4_XX_XX
      DemAgingAfterHealing = DEM_AGING_WHILE_HEALING
      DemAgingBehavior = DEM_AGING_TYPE_1
      DemAgingCounterBehavior = DEM_AGING_COUNT_ALWAYS
      DemAgingCounterReporting = DEM_AGING_NORMAL_REPORTING
      DemAgingRetainEnvironmentalData = false
      DemCompiledPostbuildCrc = 1136585083
      DemCompiledPostbuildCrcMode = DEM_POSTBUILD_CRC_AUTOMATIC
      DemEventDisplacementFallbackStrategy = DEM_FALLBACK_DISCARD_NEW_EVENT
      DemGeneralDiagnosticInfoSupport = true
      DemJ1939Support = false
      DemNvSynchronizeSupport = false
      DemPendingDtcProcessing = DEM_PROCESS_PDTC_ALL_DTC
      DemResetDebounceBehavior = DEM_RESET_DEBOUNCE_ON_DISABLE_ENABLE_CONDITIONS
      DemResetTestFailedOnOperationCycleStart = true
      DemRetryStorageSupport = false
      DemSafeBswChecks = true
      DemUseMemcopyMacros = false
      DemUseRte = true
      DemUserControlledWirBehavior = DEM_ENABLED_DURING_CONTROLDTCSETTING
      DemUserDefinedCompareAndSwap = false
      DemWarningIndicatorRequestedProcessing = DEM_PROCESS_WIR_STOREDONLY
      DemUseMultiPartitionFiM = false
      DemReportSuppressedDTCsInService19x0A = false
      DemSupportAgingForAllDTCs = true
      DemLatchTestFailedBehavior = DEM_LATCH_TF_CONFIRMED_AND_THIS_CYCLE
      DemUseNvm = true
      DemUserControlledWirSupport = false
      DemCompiledConfigId = 1
      DemDcmSupport = true
      DemExtendedDataVisibility = DEM_VISIBILITY_ALL_DTC
      DemHeaderFileInclusion = vRoE.h
      DemClearEventsWithoutDTCEventMemoryRef = PrimaryMemory
      DemClient: DemClientId=0
      DemEventMemorySet
        PrimaryMemory (DemPrimaryMemory): DemTypeOfFreezeFrameRecordNumeration=DEM_FF_RECNUM_CONFIGURED, DemMaxNumberEventEntryPrimary=10
      DemPostbuild:
        DemEventAvailableDefaultSupport = true
        DemMaxSizeFreezeFrame = 21
        DemMaxNumberDtr = 0
        DemMaxSizeGlobalFreezeFrame = 0
        DemMaxSizeOBDonUDSFreezeFrame = 0
        DemMaxNumberEventsWithMonitorActivityData = 0
      Dem_Cfg_Aging_0 (DemNvRamBlockId): DemNvRamBlockIdType=DEM_NVBLOCK_AGING, DemNvRamBlockIdRef=NvM_Dem_Aging
      DID_222001_Odometer_0x2001 (DemDidClass): DemDidIdentifier=8193, DemDidDataClassRef=Data_DID_0x2001_Odometer_24
      IgnitionCycle (DemOperationCycle): DemOperationCycleType=DEM_OPCYC_IGNITION, DemOperationCycleAutomaticEnd=false, DemOperationCycleAutostart=false
      Data_DID_0x1004_Battery_Voltage_24 (DemDataClass):
        DemDataElementDataSize = 1
        DemDataElementDataType = UINT8_N
        DemDataElementEndianness = opaque
        DemDataElementUsePort = USE_DATA_CLIENT_SERVER_PORT
        DemDataElementStoreNonVolatile = true
      DID_221008_ECU_Life_Time_0x1008 (DemDidClass): DemDidIdentifier=4104, DemDidDataClassRef=Data_DID_0x1008_ECU_Life_Time_24
      Data_DID_0x1008_ECU_Life_Time_24 (DemDataClass):
        DemDataElementDataSize = 3
        DemDataElementDataType = UINT8_N
        DemDataElementEndianness = opaque
        DemDataElementUsePort = USE_DATA_CLIENT_SERVER_PORT
        DemDataElementStoreNonVolatile = true
      DID_22200A_Ignition_ON_Counter_0x200a (DemDidClass): DemDidIdentifier=8202, DemDidDataClassRef=Data_DID_0x200a_Ignition_ON_Counter_24
      Data_DID_0x1009_ECU_Time_Since_Ignition_ON (DemDataClass):
        DemDataElementDataSize = 2
        DemDataElementDataType = UINT8_N
        DemDataElementEndianness = opaque
        DemDataElementUsePort = USE_DATA_CLIENT_SERVER_PORT
        DemDataElementStoreNonVolatile = true
      ExtendedDataRecord_OccurrenceCounter (DemExtendedDataRecordClass):
        DemExtendedDataRecordNumber = 1
        DemExtendedDataRecordTrigger = DEM_RECORD_TRIGGER_TESTFAILED
        DemExtendedDataRecordUpdate = DEM_UPDATE_RECORD_NO
        DemDataClassRef = Data_OccurrenceCounter_Aging_Counter_ID
        DemDataClassRef = Data_OccurrenceCounter_Aging_Counter
        DemDataClassRef = Data_OccurrenceCounter_Frequency_Counter_ID
        DemDataClassRef = Data_OccurrenceCounter_DID_DataObject
        DemDataClassRef = Data_OccurrenceCounter_Cycles_to_Switch_off_the_Warning_Indication_ID
        DemDataClassRef = Data_OccurrenceCounter_Reserved
        DemDataClassRef = Data_OccurrenceCounter_Supplier_Internal_Code
        DemDataClassRef = Data_OccurrenceCounter_Current_Gear
        DemDataClassRef = Data_OccurrenceCounter_Vehicle_Speed
        DemDataClassRef = Data_OccurrenceCounter_External_Temperature
        DemDataClassRef = Data_OccurrenceCounter_Odometer_Value
        DemDataClassRef = Data_OccurrenceCounter_Reserved_2
        DemDataClassRef = Data_OccurrenceCounter_ECU_Voltage
        DemDataClassRef = Data_OccurrenceCounter_Steering_Wheel_Angle
        DemDataClassRef = Data_OccurrenceCounter_Reserved_1
        DemDataClassRef = Data_OccurrenceCounter_Door_Status
        DemDataClassRef = Data_OccurrenceCounter_LiftgateAjar
        DemDataClassRef = Data_OccurrenceCounter_Touch_Screen_Status
        DemDataClassRef = Data_OccurrenceCounter_Touch_Screen_X_Coordinate
        DemDataClassRef = Data_OccurrenceCounter_Touch_Screen_Y_Coordinate
        DemDataClassRef = Data_OccurrenceCounter_Radio_Display_Status
        DemDataClassRef = Data_OccurrenceCounter_TRSKM_and_USS_status
        DemDataClassRef = Data_OccurrenceCounter_TRSC_Stat
        DemDataClassRef = Data_OccurrenceCounter_Camera_Occlusion
        DemDataClassRef = Data_OccurrenceCounter_THA_state
        DemDataClassRef = Data_OccurrenceCounter_DisplayStatus
        DemDataClassRef = Data_OccurrenceCounter_TireLines
        DemDataClassRef = Data_OccurrenceCounter_Calibration_Not_Started
        DemDataClassRef = Data_OccurrenceCounter_Calibration_Pending
        DemDataClassRef = Data_OccurrenceCounter_Calibration_Running
        DemDataClassRef = Data_OccurrenceCounter_Calibrated_Successfully
        DemDataClassRef = Data_OccurrenceCounter_Calibration_Aborted_Failed
        DemDataClassRef = Data_OccurrenceCounter_New_Bit_Field
      Data_OccurrenceCounter_Aging_Counter_ID (DemDataClass):
        DemDataElementDataSize = 2
        DemDataElementDataType = UINT16
        DemDataElementEndianness = BIG_ENDIAN
        DemDataElementUsePort = USE_DATA_CLIENT_SERVER_PORT
        DemDataElementStoreNonVolatile = true
      DID_221004_Battery_Voltage_0x1004 (DemDidClass): DemDidIdentifier=4100, DemDidDataClassRef=Data_DID_0x1004_Battery_Voltage_24
      Data_OccurrenceCounter_Frequency_Counter_ID (DemDataClass):
        DemDataElementDataSize = 2
        DemDataElementDataType = UINT16
        DemDataElementEndianness = BIG_ENDIAN
        DemDataElementUsePort = USE_DATA_CLIENT_SERVER_PORT
        DemDataElementStoreNonVolatile = true
      DID_221009_ECU_Time_Since_Ignition_ON_0x1009 (DemDidClass): DemDidIdentifier=4105, DemDidDataClassRef=Data_DID_0x1009_ECU_Time_Since_Ignition_ON
      Data_DID_0x200a_Ignition_ON_Counter_24 (DemDataClass):
        DemDataElementDataSize = 2
        DemDataElementDataType = UINT8_N
        DemDataElementEndianness = opaque
        DemDataElementUsePort = USE_DATA_CLIENT_SERVER_PORT
        DemDataElementStoreNonVolatile = true
      DID_221002_Vehicle_Speed_0x1002 (DemDidClass): DemDidIdentifier=4098, DemDidDataClassRef=Data_DID_0x1002_Vehicle_Speed_24
      Data_DID_0x1002_Vehicle_Speed_24 (DemDataClass):
        DemDataElementDataSize = 2
        DemDataElementDataType = UINT8_N
        DemDataElementEndianness = opaque
        DemDataElementUsePort = USE_DATA_CLIENT_SERVER_PORT
        DemDataElementStoreNonVolatile = true
      FreezeFrame_a2168519 (DemFreezeFrameClass):
        DemDidClassRef = DID_221008_ECU_Life_Time_0x1008
        DemDidClassRef = DID_221009_ECU_Time_Since_Ignition_ON_0x1009
        DemDidClassRef = DID_22200A_Ignition_ON_Counter_0x200a
        DemDidClassRef = DID_222001_Odometer_0x2001
        DemDidClassRef = DID_221004_Battery_Voltage_0x1004
        DemDidClassRef = DID_221921_Operational_Mode_Status_0x1921
        DemDidClassRef = DID_221002_Vehicle_Speed_0x1002
      DID_221921_Operational_Mode_Status_0x1921 (DemDidClass): DemDidIdentifier=6433, DemDidDataClassRef=Data_DID_0x1921_CombinedSignal
      Data_DID_0x2001_Odometer_24 (DemDataClass):
        DemDataElementDataSize = 2
        DemDataElementDataType = UINT8_N
        DemDataElementEndianness = opaque
        DemDataElementUsePort = USE_DATA_CLIENT_SERVER_PORT
        DemDataElementStoreNonVolatile = true
      DemCallbackDTCStatusChanged: DemCallbackDTCStatusChangedFnc=vRoE_OnDTCStatusChange
      DemFreezeFrameRecNumClass: DemFreezeFrameRecordNumber=1, DemFreezeFrameRecordUpdate=DEM_UPDATE_RECORD_NO, DemFreezeFrameRecordTrigger=DEM_RECORD_TRIGGER_TESTFAILED
      12 x DemNvRamBlockId:
        DemNvRamBlockId_000: DemNvRamBlockIdType=DEM_NVBLOCK_PRIMARY, DemNvRamBlockIdIndex=0, DemNvRamBlockIdRef=NvM_Dem_PRIMARY0
        DemNvRamBlockId_001: DemNvRamBlockIdType=DEM_NVBLOCK_PRIMARY, DemNvRamBlockIdIndex=1, DemNvRamBlockIdRef=NvM_Dem_PRIMARY1
        DemNvRamBlockId_002: DemNvRamBlockIdType=DEM_NVBLOCK_PRIMARY, DemNvRamBlockIdIndex=2, DemNvRamBlockIdRef=NvM_Dem_PRIMARY2
        DemNvRamBlockId_003: DemNvRamBlockIdType=DEM_NVBLOCK_PRIMARY, DemNvRamBlockIdIndex=3, DemNvRamBlockIdRef=NvM_Dem_PRIMARY3
        DemNvRamBlockId_004: DemNvRamBlockIdType=DEM_NVBLOCK_PRIMARY, DemNvRamBlockIdIndex=4, DemNvRamBlockIdRef=NvM_Dem_PRIMARY4
        DemNvRamBlockId_005: DemNvRamBlockIdType=DEM_NVBLOCK_PRIMARY, DemNvRamBlockIdIndex=5, DemNvRamBlockIdRef=NvM_Dem_PRIMARY5
        DemNvRamBlockId_006: DemNvRamBlockIdType=DEM_NVBLOCK_PRIMARY, DemNvRamBlockIdIndex=6, DemNvRamBlockIdRef=NvM_Dem_PRIMARY6
        DemNvRamBlockId_007: DemNvRamBlockIdType=DEM_NVBLOCK_PRIMARY, DemNvRamBlockIdIndex=7, DemNvRamBlockIdRef=NvM_Dem_PRIMARY7
        DemNvRamBlockId_008: DemNvRamBlockIdType=DEM_NVBLOCK_PRIMARY, DemNvRamBlockIdIndex=8, DemNvRamBlockIdRef=NvM_Dem_PRIMARY8
        DemNvRamBlockId_009: DemNvRamBlockIdType=DEM_NVBLOCK_PRIMARY, DemNvRamBlockIdIndex=9, DemNvRamBlockIdRef=NvM_Dem_PRIMARY9
        DemNvRamBlockId_ADMIN: DemNvRamBlockIdType=DEM_NVBLOCK_ADMIN, DemNvRamBlockIdRef=NvM_Dem_ADMIN
        DemNvRamBlockId_STATUS: DemNvRamBlockIdType=DEM_NVBLOCK_STATUS, DemNvRamBlockIdRef=NvM_Dem_STATUS
      4 x DemEnableConditionGroup:
        EnableConditionGroup_dc41854c: DemEnableConditionRef=EC1, DemEnableConditionRef=EC2
        EnableConditionGroup_35222079: DemEnableConditionRef=EC1, DemEnableConditionRef=EC4
        EnableConditionGroup_EC2: DemEnableConditionRef=EC2
        EnableConditionGroup_bf4488aa: DemEnableConditionRef=EC1, DemEnableConditionRef=EC2, DemEnableConditionRef=EC4, DemEnableConditionRef=EC5, DemEnableConditionRef=EC7
      4 x DemEnableCondition, all with DemEnableConditionStatus=false:
        EC7: DemEnableConditionId=7
        EC5: DemEnableConditionId=6
        EC4: DemEnableConditionId=5
        EC2: DemEnableConditionId=4
      EnableConditionGroup_d35ce624 (DemEnableConditionGroup): DemEnableConditionRef=EC1, DemEnableConditionRef=EC2, DemEnableConditionRef=EC4, DemEnableConditionRef=EC5
      EC1 (DemEnableCondition): DemEnableConditionId=1, DemEnableConditionStatus=false
      EnableConditionGroup_f0773a88 (DemEnableConditionGroup): DemEnableConditionRef=EC1_EC8, DemEnableConditionRef=EC2
      EC1_EC8 (DemEnableCondition): DemEnableConditionId=3, DemEnableConditionStatus=false
      EnableConditionGroup_2b31122d (DemEnableConditionGroup): DemEnableConditionRef=EC1_EC4_EC8, DemEnableConditionRef=EC2
      EC1_EC4_EC8 (DemEnableCondition): DemEnableConditionId=2, DemEnableConditionStatus=false
      EnableConditionGroup_5926f32a (DemEnableConditionGroup): DemEnableConditionRef=EC2, DemEnableConditionRef=EC9
      EnableConditionGroup_58fca5ad (DemEnableConditionGroup): DemEnableConditionRef=EC1, DemEnableConditionRef=EC2, DemEnableConditionRef=EC4, DemEnableConditionRef=EC5, DemEnableConditionRef=EC9
      EC9 (DemEnableCondition): DemEnableConditionId=8, DemEnableConditionStatus=false
      19 x DemDataClass, all with DemDataElementStoreNonVolatile=true:
        Data_OccurrenceCounter_Touch_Screen_Y_Coordinate: DemDataElementDataSize=2, DemDataElementDataType=UINT16, DemDataElementEndianness=BIG_ENDIAN, DemDataElementUsePort=USE_DATA_CLIENT_SERVER_PORT
        Data_OccurrenceCounter_Odometer_Value: DemDataElementDataSize=3, DemDataElementDataType=UINT8_N, DemDataElementEndianness=opaque, DemDataElementUsePort=USE_DATA_CLIENT_SERVER_PORT
        Data_OccurrenceCounter_Camera_Occlusion: DemDataElementDataSize=1, DemDataElementDataType=UINT8, DemDataElementUsePort=USE_DATA_CLIENT_SERVER_PORT
        Data_OccurrenceCounter_THA_state: DemDataElementDataSize=1, DemDataElementDataType=UINT8, DemDataElementUsePort=USE_DATA_CLIENT_SERVER_PORT
        Data_OccurrenceCounter_Supplier_Internal_Code: DemDataElementDataSize=9, DemDataElementDataType=UINT8_N, DemDataElementEndianness=opaque, DemDataElementUsePort=USE_DATA_CLIENT_SERVER_PORT_WITH_EVENTID
        Data_OccurrenceCounter_Current_Gear: DemDataElementDataSize=1, DemDataElementDataType=UINT8, DemDataElementUsePort=USE_DATA_CLIENT_SERVER_PORT
        Data_OccurrenceCounter_Vehicle_Speed: DemDataElementDataSize=2, DemDataElementDataType=UINT16, DemDataElementEndianness=BIG_ENDIAN, DemDataElementUsePort=USE_DATA_CLIENT_SERVER_PORT
        Data_OccurrenceCounter_DisplayStatus: DemDataElementDataSize=1, DemDataElementDataType=UINT8, DemDataElementUsePort=USE_DATA_CLIENT_SERVER_PORT
        Data_OccurrenceCounter_TRSC_Stat: DemDataElementDataSize=1, DemDataElementDataType=UINT8, DemDataElementUsePort=USE_DATA_CLIENT_SERVER_PORT
        Data_OccurrenceCounter_ECU_Voltage: DemDataElementDataSize=1, DemDataElementDataType=UINT8, DemDataElementUsePort=USE_DATA_CLIENT_SERVER_PORT
        Data_OccurrenceCounter_Touch_Screen_X_Coordinate: DemDataElementDataSize=2, DemDataElementDataType=UINT16, DemDataElementEndianness=BIG_ENDIAN, DemDataElementUsePort=USE_DATA_CLIENT_SERVER_PORT
        Data_OccurrenceCounter_Touch_Screen_Status: DemDataElementDataSize=1, DemDataElementDataType=UINT8, DemDataElementUsePort=USE_DATA_CLIENT_SERVER_PORT
        Data_OccurrenceCounter_External_Temperature: DemDataElementDataSize=2, DemDataElementDataType=UINT16, DemDataElementEndianness=BIG_ENDIAN, DemDataElementUsePort=USE_DATA_CLIENT_SERVER_PORT
        Data_OccurrenceCounter_TireLines: DemDataElementDataSize=1, DemDataElementDataType=UINT8, DemDataElementUsePort=USE_DATA_CLIENT_SERVER_PORT
        Data_OccurrenceCounter_Door_Status: DemDataElementDataSize=1, DemDataElementDataType=UINT8, DemDataElementUsePort=USE_DATA_CLIENT_SERVER_PORT
        Data_OccurrenceCounter_Radio_Display_Status: DemDataElementDataSize=1, DemDataElementDataType=UINT8, DemDataElementUsePort=USE_DATA_CLIENT_SERVER_PORT
        Data_OccurrenceCounter_Aging_Counter: DemDataElementDataSize=1, DemDataElementInternalData=DEM_AGINGCTR_UPCNT, DemDataElementUsePort=USE_DATA_INTERNAL
        Data_OccurrenceCounter_DID_DataObject: DemDataElementDataSize=1, DemDataElementInternalData=DEM_OCCCTR, DemDataElementUsePort=USE_DATA_INTERNAL
        Data_OccurrenceCounter_TRSKM_and_USS_status: DemDataElementDataSize=1, DemDataElementDataType=UINT8, DemDataElementUsePort=USE_DATA_CLIENT_SERVER_PORT
      EnableConditionGroup_5090bf01 (DemEnableConditionGroup): DemEnableConditionRef=EC2, DemEnableConditionRef=EC5
      11 x DemDataClass, all with DemDataElementUsePort=USE_DATA_CLIENT_SERVER_PORT, DemDataElementStoreNonVolatile=true:
        Data_OccurrenceCounter_LiftgateAjar: DemDataElementDataSize=1, DemDataElementDataType=UINT8
        Data_OccurrenceCounter_Cycles_to_Switch_off_the_Warning_Indication_ID: DemDataElementDataSize=2, DemDataElementDataType=UINT16, DemDataElementEndianness=BIG_ENDIAN
        Data_OccurrenceCounter_Steering_Wheel_Angle: DemDataElementDataSize=2, DemDataElementDataType=UINT16, DemDataElementEndianness=BIG_ENDIAN
        Data_OccurrenceCounter_Reserved: DemDataElementDataSize=1, DemDataElementDataType=UINT8
        Data_OccurrenceCounter_Reserved_1: DemDataElementDataSize=1, DemDataElementDataType=UINT8
        Data_OccurrenceCounter_Calibration_Aborted_Failed: DemDataElementDataSize=1, DemDataElementDataType=UINT8
        Data_OccurrenceCounter_Calibration_Pending: DemDataElementDataSize=1, DemDataElementDataType=UINT8
        Data_OccurrenceCounter_Calibration_Running: DemDataElementDataSize=1, DemDataElementDataType=UINT8
        Data_OccurrenceCounter_New_Bit_Field: DemDataElementDataSize=1, DemDataElementDataType=UINT8
        Data_OccurrenceCounter_Calibration_Not_Started: DemDataElementDataSize=1, DemDataElementDataType=UINT8
        Data_OccurrenceCounter_Calibrated_Successfully: DemDataElementDataSize=1, DemDataElementDataType=UINT8
      EnableConditionGroup_9fd149a3 (DemEnableConditionGroup): DemEnableConditionRef=EC2, DemEnableConditionRef=EC5, DemEnableConditionRef=EC9
      Data_OccurrenceCounter_Reserved_2 (DemDataClass): DemDataElementDataSize=1, DemDataElementUsePort=USE_DATA_CLIENT_SERVER_PORT, DemDataElementStoreNonVolatile=true, DemDataElementDataType=UINT8
      EnableConditionGroup_EC1 (DemEnableConditionGroup): DemEnableConditionRef=EC1
      EnableConditionGroup_eab14353 (DemEnableConditionGroup): DemEnableConditionRef=EC2, DemEnableConditionRef=EC4, DemEnableConditionRef=EC5, DemEnableConditionRef=EC9
      Data_DID_0x1921_CombinedSignal (DemDataClass):
        DemDataElementDataSize = 9
        DemDataElementDataType = UINT8_N
        DemDataElementEndianness = opaque
        DemDataElementUsePort = USE_DATA_CLIENT_SERVER_PORT
        DemDataElementStoreNonVolatile = true
      ExtendedDataClass_240799f9 (DemExtendedDataClass): DemExtendedDataRecordClassRef=ExtendedDataRecord_OccurrenceCounter
      EC10 (DemEnableCondition): DemEnableConditionId=9, DemEnableConditionStatus=false
      EnableConditionGroup_a3268155 (DemEnableConditionGroup): DemEnableConditionRef=EC1, DemEnableConditionRef=EC10, DemEnableConditionRef=EC2
    DemConfigSet
      DtcAttributes_41914fb7 (DemDTCAttributes): DemMemoryDestinationRef=PrimaryMemory
      DemDTCAttributesPrimary (DemDTCAttributes): DemMemoryDestinationRef=PrimaryMemory
      6 x DemEventParameter, all with DemEventTimeSeries=DEM_TIMESERIES_SNAPSHOT_NONE, DemEventAvailable=true, DemEventKind=DEM_EVENT_KIND_SWC, DemEventAvailableInVariant=true, DemEventLatchTestFailed=false, DemEventCreateInfoPort=true, DemFreezeFrameClassRef=FreezeFrame_a2168519:
        Dem_SystemInternalFailure: DemEventId=67
          DemEventClass:
            DemAgingAllowed = false
            DemConsiderPtoStatus = false
            DemEventPriority = 2
            DemFFPrestorageSupported = false
            DemEventFailureCycleCounterThreshold = 0
            DemOperationCycleRef = IgnitionCycle
            DemDebounceAlgorithmClass
              DemDebounceCounterBased:
                DemDebounceBehavior = DEM_DEBOUNCE_FREEZE
                DemDebounceCounterDecrementStepSize = 1
                DemDebounceCounterFailedThreshold = 127
                DemDebounceCounterIncrementStepSize = 1
                DemDebounceCounterJumpDown = true
                DemDebounceCounterJumpDownValue = 0
                DemDebounceCounterJumpUp = true
                DemDebounceCounterJumpUpValue = 0
                DemDebounceCounterPassedThreshold = -128
                DemDebounceCounterStorage = false
                DemDebounceContinuous = false
        Invalid_Data_Received_From_Power_Steering_Control_Module_U042000: DemEventId=19, DemDTCClassRef=DTCClass_DtcClass_Invalid_Data_Received_From_Power_Steering_Control_Module_U042000, DemExtendedDataClassRef=ExtendedDataClass_240799f9, DemFreezeFrameRecNumClassRef=DemFreezeFrameRecNumClass
          DemEventClass:
            DemAgingAllowed = true
            DemAgingCycleCounterThreshold = 40
            DemEventPriority = 2
            DemEventSignificance = DEM_EVENT_SIGNIFICANCE_FAULT
            DemEventFailureCycleCounterThreshold = 0
            DemConsiderPtoStatus = false
            DemFFPrestorageSupported = false
            DemAgingCycleRef = IgnitionCycle
            DemEnableConditionGroupRef = EnableConditionGroup_58fca5ad
            DemOperationCycleRef = IgnitionCycle
            DemDebounceAlgorithmClass
              DemDebounceCounterBased:
                DemDebounceCounterDecrementStepSize = 128
                DemDebounceCounterIncrementStepSize = 127
                DemDebounceCounterJumpDown = false
                DemDebounceCounterJumpUp = false
                DemDebounceBehavior = DEM_DEBOUNCE_FREEZE
                DemDebounceCounterFailedThreshold = 127
                DemDebounceCounterJumpDownValue = 0
                DemDebounceCounterJumpUpValue = 0
                DemDebounceCounterPassedThreshold = -128
                DemDebounceCounterStorage = false
                DemDebounceContinuous = false
        Lost_Communication_with_Left_Camera_U026600: DemEventId=29, DemDTCClassRef=DTCClass_DtcClass_Lost_Communication_with_Left_Camera_U026600, DemExtendedDataClassRef=ExtendedDataClass_240799f9, DemFreezeFrameRecNumClassRef=DemFreezeFrameRecNumClass
          DemEventClass:
            DemAgingAllowed = true
            DemAgingCycleCounterThreshold = 40
            DemEventPriority = 2
            DemEventSignificance = DEM_EVENT_SIGNIFICANCE_FAULT
            DemEventFailureCycleCounterThreshold = 0
            DemConsiderPtoStatus = false
            DemFFPrestorageSupported = false
            DemAgingCycleRef = IgnitionCycle
            DemEnableConditionGroupRef = EnableConditionGroup_a3268155
            DemOperationCycleRef = IgnitionCycle
            DemDebounceAlgorithmClass
              DemDebounceCounterBased:
                DemDebounceCounterDecrementStepSize = 128
                DemDebounceCounterIncrementStepSize = 127
                DemDebounceCounterJumpDown = false
                DemDebounceCounterJumpUp = false
                DemDebounceBehavior = DEM_DEBOUNCE_FREEZE
                DemDebounceCounterFailedThreshold = 127
                DemDebounceCounterJumpDownValue = 0
                DemDebounceCounterJumpUpValue = 0
                DemDebounceCounterPassedThreshold = -128
                DemDebounceCounterStorage = false
                DemDebounceContinuous = false
        Front_Sensors_PS_VltgeBelowThreshold_B212A16: DemEventId=10, DemDTCClassRef=DTCClass_DtcClass_Front_Sensors_PS_VltgeBelowThreshold_B212A16, DemExtendedDataClassRef=ExtendedDataClass_240799f9, DemFreezeFrameRecNumClassRef=DemFreezeFrameRecNumClass
          DemEventClass:
            DemAgingAllowed = true
            DemAgingCycleCounterThreshold = 40
            DemEventPriority = 2
            DemEventSignificance = DEM_EVENT_SIGNIFICANCE_FAULT
            DemEventFailureCycleCounterThreshold = 0
            DemConsiderPtoStatus = false
            DemFFPrestorageSupported = false
            DemAgingCycleRef = IgnitionCycle
            DemEnableConditionGroupRef = EnableConditionGroup_f0773a88
            DemOperationCycleRef = IgnitionCycle
            DemDebounceAlgorithmClass
              DemDebounceCounterBased:
                DemDebounceCounterDecrementStepSize = 128
                DemDebounceCounterIncrementStepSize = 127
                DemDebounceCounterJumpDown = false
                DemDebounceCounterJumpUp = false
                DemDebounceBehavior = DEM_DEBOUNCE_FREEZE
                DemDebounceCounterFailedThreshold = 127
                DemDebounceCounterJumpDownValue = 0
                DemDebounceCounterJumpUpValue = 0
                DemDebounceCounterPassedThreshold = -128
                DemDebounceCounterStorage = false
                DemDebounceContinuous = false
        Left_Camera_Circuit_Voltage_Out_of_Range_B23C61C: DemEventId=20, DemDTCClassRef=DTCClass_DtcClass_Left_Camera_Circuit_Voltage_Out_of_Range_B23C61C, DemExtendedDataClassRef=ExtendedDataClass_240799f9, DemFreezeFrameRecNumClassRef=DemFreezeFrameRecNumClass
          DemEventClass:
            DemAgingAllowed = true
            DemAgingCycleCounterThreshold = 40
            DemEventPriority = 2
            DemEventSignificance = DEM_EVENT_SIGNIFICANCE_FAULT
            DemEventFailureCycleCounterThreshold = 0
            DemConsiderPtoStatus = false
            DemFFPrestorageSupported = false
            DemAgingCycleRef = IgnitionCycle
            DemEnableConditionGroupRef = EnableConditionGroup_a3268155
            DemOperationCycleRef = IgnitionCycle
            DemDebounceAlgorithmClass
              DemDebounceCounterBased:
                DemDebounceCounterDecrementStepSize = 128
                DemDebounceCounterIncrementStepSize = 127
                DemDebounceCounterJumpDown = false
                DemDebounceCounterJumpUp = false
                DemDebounceBehavior = DEM_DEBOUNCE_FREEZE
                DemDebounceCounterFailedThreshold = 127
                DemDebounceCounterJumpDownValue = 0
                DemDebounceCounterJumpUpValue = 0
                DemDebounceCounterPassedThreshold = -128
                DemDebounceCounterStorage = false
                DemDebounceContinuous = false
        Rear_Sensors_PS_VltgeBelowThreshold_B212B16: DemEventId=62, DemDTCClassRef=DTCClass_DtcClass_Rear_Sensors_PS_VltgeBelowThreshold_B212B16, DemExtendedDataClassRef=ExtendedDataClass_240799f9, DemFreezeFrameRecNumClassRef=DemFreezeFrameRecNumClass
          DemEventClass:
            DemAgingAllowed = true
            DemAgingCycleCounterThreshold = 40
            DemEventPriority = 2
            DemEventSignificance = DEM_EVENT_SIGNIFICANCE_FAULT
            DemEventFailureCycleCounterThreshold = 0
            DemConsiderPtoStatus = false
            DemFFPrestorageSupported = false
            DemAgingCycleRef = IgnitionCycle
            DemEnableConditionGroupRef = EnableConditionGroup_f0773a88
            DemOperationCycleRef = IgnitionCycle
            DemDebounceAlgorithmClass
              DemDebounceCounterBased:
                DemDebounceCounterDecrementStepSize = 128
                DemDebounceCounterIncrementStepSize = 127
                DemDebounceCounterJumpDown = false
                DemDebounceCounterJumpUp = false
                DemDebounceBehavior = DEM_DEBOUNCE_FREEZE
                DemDebounceCounterFailedThreshold = 127
                DemDebounceCounterJumpDownValue = 0
                DemDebounceCounterJumpUpValue = 0
                DemDebounceCounterPassedThreshold = -128
                DemDebounceCounterStorage = false
                DemDebounceContinuous = false
      DTCClass_DtcClass_Loss_Communication_with_TRS_Knob_Module_U12B900 (DemDTCClass): DemDTCSeverity=DEM_DTC_SEV_NO_SEVERITY, DemUdsDTC=13809920, DemImmediateNvStorage=false, DemDTCAttributesRef=DtcAttributes_41914fb7
      Rear_Sensors_PS_Bus_Sig_Msg_Failures_B212B08 (DemEventParameter):
        DemEventKind = DEM_EVENT_KIND_SWC
        DemEventTimeSeries = DEM_TIMESERIES_SNAPSHOT_NONE
        DemEventAvailable = true
        DemEventId = 60
        DemEventAvailableInVariant = true
        DemEventLatchTestFailed = false
        DemEventCreateInfoPort = true
        DemDTCClassRef = DTCClass_DtcClass_Rear_Sensors_PS_Bus_Sig_Msg_Failures_B212B08
        DemExtendedDataClassRef = ExtendedDataClass_240799f9
        DemFreezeFrameClassRef = FreezeFrame_a2168519
        DemFreezeFrameRecNumClassRef = DemFreezeFrameRecNumClass
        DemEventClass:
          DemAgingAllowed = true
          DemAgingCycleCounterThreshold = 40
          DemEventPriority = 2
          DemEventSignificance = DEM_EVENT_SIGNIFICANCE_FAULT
          DemEventFailureCycleCounterThreshold = 0
          DemConsiderPtoStatus = false
          DemFFPrestorageSupported = false
          DemAgingCycleRef = IgnitionCycle
          DemEnableConditionGroupRef = EnableConditionGroup_f0773a88
          DemOperationCycleRef = IgnitionCycle
          DemDebounceAlgorithmClass
            DemDebounceCounterBased:
              DemDebounceCounterDecrementStepSize = 128
              DemDebounceCounterIncrementStepSize = 127
              DemDebounceCounterJumpDown = false
              DemDebounceCounterJumpUp = false
              DemDebounceBehavior = DEM_DEBOUNCE_FREEZE
              DemDebounceCounterFailedThreshold = 127
              DemDebounceCounterJumpDownValue = 0
              DemDebounceCounterJumpUpValue = 0
              DemDebounceCounterPassedThreshold = -128
              DemDebounceCounterStorage = false
              DemDebounceContinuous = false
      DTCClass_DtcClass_PTS_Sensor_10_Performance_or_Incorrect_Operation_B129792 (DemDTCClass): DemDTCSeverity=DEM_DTC_SEV_NO_SEVERITY, DemUdsDTC=9607058, DemImmediateNvStorage=false, DemDTCAttributesRef=DtcAttributes_41914fb7
      Rear_Camera_Circuit_Voltage_Out_of_Range_B217A1C (DemEventParameter):
        DemEventKind = DEM_EVENT_KIND_SWC
        DemEventTimeSeries = DEM_TIMESERIES_SNAPSHOT_NONE
        DemEventAvailable = true
        DemEventId = 58
        DemEventAvailableInVariant = true
        DemEventLatchTestFailed = false
        DemEventCreateInfoPort = true
        DemDTCClassRef = DTCClass_DtcClass_Rear_Camera_Circuit_Voltage_Out_of_Range_B217A1C
        DemExtendedDataClassRef = ExtendedDataClass_240799f9
        DemFreezeFrameClassRef = FreezeFrame_a2168519
        DemFreezeFrameRecNumClassRef = DemFreezeFrameRecNumClass
        DemEventClass:
          DemAgingAllowed = true
          DemAgingCycleCounterThreshold = 40
          DemEventPriority = 2
          DemEventSignificance = DEM_EVENT_SIGNIFICANCE_FAULT
          DemEventFailureCycleCounterThreshold = 0
          DemConsiderPtoStatus = false
          DemFFPrestorageSupported = false
          DemAgingCycleRef = IgnitionCycle
          DemEnableConditionGroupRef = EnableConditionGroup_dc41854c
          DemOperationCycleRef = IgnitionCycle
          DemDebounceAlgorithmClass
            DemDebounceCounterBased:
              DemDebounceCounterDecrementStepSize = 128
              DemDebounceCounterIncrementStepSize = 127
              DemDebounceCounterJumpDown = false
              DemDebounceCounterJumpUp = false
              DemDebounceBehavior = DEM_DEBOUNCE_FREEZE
              DemDebounceCounterFailedThreshold = 127
              DemDebounceCounterJumpDownValue = 0
              DemDebounceCounterJumpUpValue = 0
              DemDebounceCounterPassedThreshold = -128
              DemDebounceCounterStorage = false
              DemDebounceContinuous = false
      7 x DemDTCClass, all with DemDTCSeverity=DEM_DTC_SEV_NO_SEVERITY, DemImmediateNvStorage=false, DemDTCAttributesRef=DtcAttributes_41914fb7:
        DTCClass_DtcClass_Front_Sensors_PS_VltgeBelowThreshold_B212A16: DemUdsDTC=10562070
        DTCClass_DtcClass_Rear_Sensors_PS_Bus_Sig_Msg_Failures_B212B08: DemUdsDTC=10562312
        DTCClass_DtcClass_PTS_Sensor_7_Performance_or_Incorrect_Operation_B129492: DemUdsDTC=9606290
        DTCClass_DtcClass_Vehicle_Configuration_Mismatch_B223B00: DemUdsDTC=10631936
        DTCClass_DtcClass_ECU_Internal_Performance_B22A900: DemUdsDTC=10660096
        DTCClass_DtcClass_PTS_Sensor_11_Circuit_Open_B129813: DemUdsDTC=9607187
        DTCClass_DtcClass_PTS_Sensor_2_Performance_or_Incorrect_Operation_B128F92: DemUdsDTC=9605010
      PTS_Sensor_12_Performance_or_Incorrect_Operation_B129992 (DemEventParameter):
        DemEventKind = DEM_EVENT_KIND_SWC
        DemEventTimeSeries = DEM_TIMESERIES_SNAPSHOT_NONE
        DemEventAvailable = true
        DemEventId = 56
        DemEventAvailableInVariant = true
        DemEventLatchTestFailed = false
        DemEventCreateInfoPort = true
        DemDTCClassRef = DTCClass_DtcClass_PTS_Sensor_12_Performance_or_Incorrect_Operation_B129992
        DemExtendedDataClassRef = ExtendedDataClass_240799f9
        DemFreezeFrameClassRef = FreezeFrame_a2168519
        DemFreezeFrameRecNumClassRef = DemFreezeFrameRecNumClass
        DemEventClass:
          DemAgingAllowed = true
          DemAgingCycleCounterThreshold = 40
          DemEventPriority = 2
          DemEventSignificance = DEM_EVENT_SIGNIFICANCE_FAULT
          DemEventFailureCycleCounterThreshold = 0
          DemConsiderPtoStatus = false
          DemFFPrestorageSupported = false
          DemAgingCycleRef = IgnitionCycle
          DemEnableConditionGroupRef = EnableConditionGroup_2b31122d
          DemOperationCycleRef = IgnitionCycle
          DemDebounceAlgorithmClass
            DemDebounceCounterBased:
              DemDebounceCounterDecrementStepSize = 128
              DemDebounceCounterIncrementStepSize = 127
              DemDebounceCounterJumpDown = false
              DemDebounceCounterJumpUp = false
              DemDebounceBehavior = DEM_DEBOUNCE_FREEZE
              DemDebounceCounterFailedThreshold = 127
              DemDebounceCounterJumpDownValue = 0
              DemDebounceCounterJumpUpValue = 0
              DemDebounceCounterPassedThreshold = -128
              DemDebounceCounterStorage = false
              DemDebounceContinuous = false
      DTCClass_DtcClass_PTS_Sensor_5_Circuit_Open_B129213 (DemDTCClass): DemDTCSeverity=DEM_DTC_SEV_NO_SEVERITY, DemUdsDTC=9605651, DemImmediateNvStorage=false, DemDTCAttributesRef=DtcAttributes_41914fb7
      6 x DemEventParameter, all with DemEventKind=DEM_EVENT_KIND_SWC, DemEventTimeSeries=DEM_TIMESERIES_SNAPSHOT_NONE, DemEventAvailable=true, DemEventAvailableInVariant=true, DemEventLatchTestFailed=false, DemEventCreateInfoPort=true, DemExtendedDataClassRef=ExtendedDataClass_240799f9, DemFreezeFrameClassRef=FreezeFrame_a2168519, DemFreezeFrameRecNumClassRef=DemFreezeFrameRecNumClass:
        Battery_Voltage_Over_Voltage_B210C17: DemEventId=1, DemDTCClassRef=DTCClass_DtcClass_Battery_Voltage_Over_Voltage_B210C17
          DemEventClass:
            DemAgingAllowed = true
            DemAgingCycleCounterThreshold = 40
            DemEventPriority = 2
            DemEventSignificance = DEM_EVENT_SIGNIFICANCE_FAULT
            DemEventFailureCycleCounterThreshold = 0
            DemConsiderPtoStatus = false
            DemFFPrestorageSupported = false
            DemAgingCycleRef = IgnitionCycle
            DemEnableConditionGroupRef = EnableConditionGroup_EC1
            DemOperationCycleRef = IgnitionCycle
            DemDebounceAlgorithmClass
              DemDebounceCounterBased:
                DemDebounceCounterDecrementStepSize = 128
                DemDebounceCounterIncrementStepSize = 127
                DemDebounceCounterJumpDown = false
                DemDebounceCounterJumpUp = false
                DemDebounceBehavior = DEM_DEBOUNCE_FREEZE
                DemDebounceCounterFailedThreshold = 127
                DemDebounceCounterJumpDownValue = 0
                DemDebounceCounterJumpUpValue = 0
                DemDebounceCounterPassedThreshold = -128
                DemDebounceCounterStorage = false
                DemDebounceContinuous = false
        Front_Sensors_PS_VltgeAboveThreshold_B212A17: DemEventId=9, DemDTCClassRef=DTCClass_DtcClass_Front_Sensors_PS_VltgeAboveThreshold_B212A17
          DemEventClass:
            DemAgingAllowed = true
            DemAgingCycleCounterThreshold = 40
            DemEventPriority = 2
            DemEventSignificance = DEM_EVENT_SIGNIFICANCE_FAULT
            DemEventFailureCycleCounterThreshold = 0
            DemConsiderPtoStatus = false
            DemFFPrestorageSupported = false
            DemAgingCycleRef = IgnitionCycle
            DemEnableConditionGroupRef = EnableConditionGroup_f0773a88
            DemOperationCycleRef = IgnitionCycle
            DemDebounceAlgorithmClass
              DemDebounceCounterBased:
                DemDebounceCounterDecrementStepSize = 128
                DemDebounceCounterIncrementStepSize = 127
                DemDebounceCounterJumpDown = false
                DemDebounceCounterJumpUp = false
                DemDebounceBehavior = DEM_DEBOUNCE_FREEZE
                DemDebounceCounterFailedThreshold = 127
                DemDebounceCounterJumpDownValue = 0
                DemDebounceCounterJumpUpValue = 0
                DemDebounceCounterPassedThreshold = -128
                DemDebounceCounterStorage = false
                DemDebounceContinuous = false
        PTS_Sensor_4_Circuit_Open_B129113: DemEventId=40, DemDTCClassRef=DTCClass_DtcClass_PTS_Sensor_4_Circuit_Open_B129113
          DemEventClass:
            DemAgingAllowed = true
            DemAgingCycleCounterThreshold = 40
            DemEventPriority = 2
            DemEventSignificance = DEM_EVENT_SIGNIFICANCE_FAULT
            DemEventFailureCycleCounterThreshold = 0
            DemConsiderPtoStatus = false
            DemFFPrestorageSupported = false
            DemAgingCycleRef = IgnitionCycle
            DemEnableConditionGroupRef = EnableConditionGroup_2b31122d
            DemOperationCycleRef = IgnitionCycle
            DemDebounceAlgorithmClass
              DemDebounceCounterBased:
                DemDebounceCounterDecrementStepSize = 128
                DemDebounceCounterIncrementStepSize = 127
                DemDebounceCounterJumpDown = false
                DemDebounceCounterJumpUp = false
                DemDebounceBehavior = DEM_DEBOUNCE_FREEZE
                DemDebounceCounterFailedThreshold = 127
                DemDebounceCounterJumpDownValue = 0
                DemDebounceCounterJumpUpValue = 0
                DemDebounceCounterPassedThreshold = -128
                DemDebounceCounterStorage = false
                DemDebounceContinuous = false
        PTS_Sensor_12_Circuit_Open_B129913: DemEventId=55, DemDTCClassRef=DTCClass_DtcClass_PTS_Sensor_12_Circuit_Open_B129913
          DemEventClass:
            DemAgingAllowed = true
            DemAgingCycleCounterThreshold = 40
            DemEventPriority = 2
            DemEventSignificance = DEM_EVENT_SIGNIFICANCE_FAULT
            DemEventFailureCycleCounterThreshold = 0
            DemConsiderPtoStatus = false
            DemFFPrestorageSupported = false
            DemAgingCycleRef = IgnitionCycle
            DemEnableConditionGroupRef = EnableConditionGroup_2b31122d
            DemOperationCycleRef = IgnitionCycle
            DemDebounceAlgorithmClass
              DemDebounceCounterBased:
                DemDebounceCounterDecrementStepSize = 128
                DemDebounceCounterIncrementStepSize = 127
                DemDebounceCounterJumpDown = false
                DemDebounceCounterJumpUp = false
                DemDebounceBehavior = DEM_DEBOUNCE_FREEZE
                DemDebounceCounterFailedThreshold = 127
                DemDebounceCounterJumpDownValue = 0
                DemDebounceCounterJumpUpValue = 0
                DemDebounceCounterPassedThreshold = -128
                DemDebounceCounterStorage = false
                DemDebounceContinuous = false
        PTS_Sensor_11_Performance_or_Incorrect_Operation_B129892: DemEventId=54, DemDTCClassRef=DTCClass_DtcClass_PTS_Sensor_11_Performance_or_Incorrect_Operation_B129892
          DemEventClass:
            DemAgingAllowed = true
            DemAgingCycleCounterThreshold = 40
            DemEventPriority = 2
            DemEventSignificance = DEM_EVENT_SIGNIFICANCE_FAULT
            DemEventFailureCycleCounterThreshold = 0
            DemConsiderPtoStatus = false
            DemFFPrestorageSupported = false
            DemAgingCycleRef = IgnitionCycle
            DemEnableConditionGroupRef = EnableConditionGroup_2b31122d
            DemOperationCycleRef = IgnitionCycle
            DemDebounceAlgorithmClass
              DemDebounceCounterBased:
                DemDebounceCounterDecrementStepSize = 128
                DemDebounceCounterIncrementStepSize = 127
                DemDebounceCounterJumpDown = false
                DemDebounceCounterJumpUp = false
                DemDebounceBehavior = DEM_DEBOUNCE_FREEZE
                DemDebounceCounterFailedThreshold = 127
                DemDebounceCounterJumpDownValue = 0
                DemDebounceCounterJumpUpValue = 0
                DemDebounceCounterPassedThreshold = -128
                DemDebounceCounterStorage = false
                DemDebounceContinuous = false
        Lost_Communication_With_Radio_U018400: DemEventId=27, DemDTCClassRef=DTCClass_DtcClass_Lost_Communication_With_Radio_U018400
          DemEventClass:
            DemAgingAllowed = true
            DemAgingCycleCounterThreshold = 40
            DemEventPriority = 2
            DemEventSignificance = DEM_EVENT_SIGNIFICANCE_FAULT
            DemEventFailureCycleCounterThreshold = 0
            DemConsiderPtoStatus = false
            DemFFPrestorageSupported = false
            DemAgingCycleRef = IgnitionCycle
            DemEnableConditionGroupRef = EnableConditionGroup_58fca5ad
            DemOperationCycleRef = IgnitionCycle
            DemDebounceAlgorithmClass
              DemDebounceCounterBased:
                DemDebounceCounterDecrementStepSize = 128
                DemDebounceCounterIncrementStepSize = 127
                DemDebounceCounterJumpDown = false
                DemDebounceCounterJumpUp = false
                DemDebounceBehavior = DEM_DEBOUNCE_FREEZE
                DemDebounceCounterFailedThreshold = 127
                DemDebounceCounterJumpDownValue = 0
                DemDebounceCounterJumpUpValue = 0
                DemDebounceCounterPassedThreshold = -128
                DemDebounceCounterStorage = false
                DemDebounceContinuous = false
      DTCClass_DtcClass_Implausible_data_received_from_ECM_U040100 (DemDTCClass): DemDTCSeverity=DEM_DTC_SEV_NO_SEVERITY, DemUdsDTC=12845312, DemImmediateNvStorage=false, DemDTCAttributesRef=DtcAttributes_41914fb7
      DTCClass_DtcClass_PTS_Sensor_6_Circuit_Open_B129313 (DemDTCClass): DemDTCSeverity=DEM_DTC_SEV_NO_SEVERITY, DemUdsDTC=9605907, DemImmediateNvStorage=false, DemDTCAttributesRef=DtcAttributes_41914fb7
      Park_Assist_PTS_Switch_Stuck_B12852A (DemEventParameter):
        DemEventKind = DEM_EVENT_KIND_SWC
        DemEventTimeSeries = DEM_TIMESERIES_SNAPSHOT_NONE
        DemEventAvailable = true
        DemEventId = 57
        DemEventAvailableInVariant = true
        DemEventLatchTestFailed = false
        DemEventCreateInfoPort = true
        DemDTCClassRef = DTCClass_DtcClass_Park_Assist_PTS_Switch_Stuck_B12852A
        DemExtendedDataClassRef = ExtendedDataClass_240799f9
        DemFreezeFrameClassRef = FreezeFrame_a2168519
        DemFreezeFrameRecNumClassRef = DemFreezeFrameRecNumClass
        DemEventClass:
          DemAgingAllowed = true
          DemAgingCycleCounterThreshold = 40
          DemEventPriority = 2
          DemEventSignificance = DEM_EVENT_SIGNIFICANCE_FAULT
          DemEventFailureCycleCounterThreshold = 0
          DemConsiderPtoStatus = false
          DemFFPrestorageSupported = false
          DemAgingCycleRef = IgnitionCycle
          DemEnableConditionGroupRef = EnableConditionGroup_d35ce624
          DemOperationCycleRef = IgnitionCycle
          DemDebounceAlgorithmClass
            DemDebounceCounterBased:
              DemDebounceCounterDecrementStepSize = 128
              DemDebounceCounterIncrementStepSize = 127
              DemDebounceCounterJumpDown = false
              DemDebounceCounterJumpUp = false
              DemDebounceBehavior = DEM_DEBOUNCE_FREEZE
              DemDebounceCounterFailedThreshold = 127
              DemDebounceCounterJumpDownValue = 0
              DemDebounceCounterJumpUpValue = 0
              DemDebounceCounterPassedThreshold = -128
              DemDebounceCounterStorage = false
              DemDebounceContinuous = false
      DTCClass_DtcClass_HS_FD_CANR_Comm_Bus_Performance_U100B00 (DemDTCClass): DemDTCSeverity=DEM_DTC_SEV_NO_SEVERITY, DemUdsDTC=13634304, DemImmediateNvStorage=false, DemDTCAttributesRef=DtcAttributes_41914fb7
      PTS_Sensor_5_Circuit_Open_B129213 (DemEventParameter):
        DemEventKind = DEM_EVENT_KIND_SWC
        DemEventTimeSeries = DEM_TIMESERIES_SNAPSHOT_NONE
        DemEventAvailable = true
        DemEventId = 42
        DemEventAvailableInVariant = true
        DemEventLatchTestFailed = false
        DemEventCreateInfoPort = true
        DemDTCClassRef = DTCClass_DtcClass_PTS_Sensor_5_Circuit_Open_B129213
        DemExtendedDataClassRef = ExtendedDataClass_240799f9
        DemFreezeFrameClassRef = FreezeFrame_a2168519
        DemFreezeFrameRecNumClassRef = DemFreezeFrameRecNumClass
        DemEventClass:
          DemAgingAllowed = true
          DemAgingCycleCounterThreshold = 40
          DemEventPriority = 2
          DemEventSignificance = DEM_EVENT_SIGNIFICANCE_FAULT
          DemEventFailureCycleCounterThreshold = 0
          DemConsiderPtoStatus = false
          DemFFPrestorageSupported = false
          DemAgingCycleRef = IgnitionCycle
          DemEnableConditionGroupRef = EnableConditionGroup_2b31122d
          DemOperationCycleRef = IgnitionCycle
          DemDebounceAlgorithmClass
            DemDebounceCounterBased:
              DemDebounceCounterDecrementStepSize = 128
              DemDebounceCounterIncrementStepSize = 127
              DemDebounceCounterJumpDown = false
              DemDebounceCounterJumpUp = false
              DemDebounceBehavior = DEM_DEBOUNCE_FREEZE
              DemDebounceCounterFailedThreshold = 127
              DemDebounceCounterJumpDownValue = 0
              DemDebounceCounterJumpUpValue = 0
              DemDebounceCounterPassedThreshold = -128
              DemDebounceCounterStorage = false
              DemDebounceContinuous = false
      DTCClass_DtcClass_PTS_Sensor_8_Performance_or_Incorrect_Operation_B129592 (DemDTCClass): DemDTCSeverity=DEM_DTC_SEV_NO_SEVERITY, DemUdsDTC=9606546, DemImmediateNvStorage=false, DemDTCAttributesRef=DtcAttributes_41914fb7
      PTS_Sensor_5_Performance_or_Incorrect_Operation_B129292 (DemEventParameter):
        DemEventKind = DEM_EVENT_KIND_SWC
        DemEventTimeSeries = DEM_TIMESERIES_SNAPSHOT_NONE
        DemEventAvailable = true
        DemEventId = 43
        DemEventAvailableInVariant = true
        DemEventLatchTestFailed = false
        DemEventCreateInfoPort = true
        DemDTCClassRef = DTCClass_DtcClass_PTS_Sensor_5_Performance_or_Incorrect_Operation_B129292
        DemExtendedDataClassRef = ExtendedDataClass_240799f9
        DemFreezeFrameClassRef = FreezeFrame_a2168519
        DemFreezeFrameRecNumClassRef = DemFreezeFrameRecNumClass
        DemEventClass:
          DemAgingAllowed = true
          DemAgingCycleCounterThreshold = 40
          DemEventPriority = 2
          DemEventSignificance = DEM_EVENT_SIGNIFICANCE_FAULT
          DemEventFailureCycleCounterThreshold = 0
          DemConsiderPtoStatus = false
          DemFFPrestorageSupported = false
          DemAgingCycleRef = IgnitionCycle
          DemEnableConditionGroupRef = EnableConditionGroup_2b31122d
          DemOperationCycleRef = IgnitionCycle
          DemDebounceAlgorithmClass
            DemDebounceCounterBased:
              DemDebounceCounterDecrementStepSize = 128
              DemDebounceCounterIncrementStepSize = 127
              DemDebounceCounterJumpDown = false
              DemDebounceCounterJumpUp = false
              DemDebounceBehavior = DEM_DEBOUNCE_FREEZE
              DemDebounceCounterFailedThreshold = 127
              DemDebounceCounterJumpDownValue = 0
              DemDebounceCounterJumpUpValue = 0
              DemDebounceCounterPassedThreshold = -128
              DemDebounceCounterStorage = false
              DemDebounceContinuous = false
      4 x DemDTCClass, all with DemDTCSeverity=DEM_DTC_SEV_NO_SEVERITY, DemImmediateNvStorage=false, DemDTCAttributesRef=DtcAttributes_41914fb7:
        DTCClass_DtcClass_Park_Assist_PTS_Switch_Stuck_B12852A: DemUdsDTC=9602346
        DTCClass_DtcClass_Lost_Communication_with_Right_Camera_U026700: DemUdsDTC=12740352
        DTCClass_DtcClass_Lost_Communication_With_BCM_U014000: DemUdsDTC=12664832
        DTCClass_DtcClass_Implausible_Data_Received_From_Body_Control_Module_U042200: DemUdsDTC=12853760
      Battery_Voltage_Under_Voltage_B210C16 (DemEventParameter):
        DemEventKind = DEM_EVENT_KIND_SWC
        DemEventTimeSeries = DEM_TIMESERIES_SNAPSHOT_NONE
        DemEventAvailable = true
        DemEventId = 2
        DemEventAvailableInVariant = true
        DemEventLatchTestFailed = false
        DemEventCreateInfoPort = true
        DemDTCClassRef = DTCClass_DtcClass_Battery_Voltage_Under_Voltage_B210C16
        DemExtendedDataClassRef = ExtendedDataClass_240799f9
        DemFreezeFrameClassRef = FreezeFrame_a2168519
        DemFreezeFrameRecNumClassRef = DemFreezeFrameRecNumClass
        DemEventClass:
          DemAgingAllowed = true
          DemAgingCycleCounterThreshold = 40
          DemEventPriority = 2
          DemEventSignificance = DEM_EVENT_SIGNIFICANCE_FAULT
          DemEventFailureCycleCounterThreshold = 0
          DemConsiderPtoStatus = false
          DemFFPrestorageSupported = false
          DemAgingCycleRef = IgnitionCycle
          DemEnableConditionGroupRef = EnableConditionGroup_35222079
          DemOperationCycleRef = IgnitionCycle
          DemDebounceAlgorithmClass
            DemDebounceCounterBased:
              DemDebounceCounterDecrementStepSize = 128
              DemDebounceCounterIncrementStepSize = 127
              DemDebounceCounterJumpDown = false
              DemDebounceCounterJumpUp = false
              DemDebounceBehavior = DEM_DEBOUNCE_FREEZE
              DemDebounceCounterFailedThreshold = 127
              DemDebounceCounterJumpDownValue = 0
              DemDebounceCounterJumpUpValue = 0
              DemDebounceCounterPassedThreshold = -128
              DemDebounceCounterStorage = false
              DemDebounceContinuous = false
      PTS_Sensor_4_Performance_or_Incorrect_Operation_B129192 (DemEventParameter):
        DemEventKind = DEM_EVENT_KIND_SWC
        DemEventTimeSeries = DEM_TIMESERIES_SNAPSHOT_NONE
        DemEventAvailable = true
        DemEventId = 41
        DemEventAvailableInVariant = true
        DemEventLatchTestFailed = false
        DemEventCreateInfoPort = true
        DemDTCClassRef = DTCClass_DtcClass_PTS_Sensor_4_Performance_or_Incorrect_Operation_B129192
        DemExtendedDataClassRef = ExtendedDataClass_240799f9
        DemFreezeFrameClassRef = FreezeFrame_a2168519
        DemFreezeFrameRecNumClassRef = DemFreezeFrameRecNumClass
        DemEventClass:
          DemAgingAllowed = true
          DemAgingCycleCounterThreshold = 40
          DemEventPriority = 2
          DemEventSignificance = DEM_EVENT_SIGNIFICANCE_FAULT
          DemEventFailureCycleCounterThreshold = 0
          DemConsiderPtoStatus = false
          DemFFPrestorageSupported = false
          DemAgingCycleRef = IgnitionCycle
          DemEnableConditionGroupRef = EnableConditionGroup_2b31122d
          DemOperationCycleRef = IgnitionCycle
          DemDebounceAlgorithmClass
            DemDebounceCounterBased:
              DemDebounceCounterDecrementStepSize = 128
              DemDebounceCounterIncrementStepSize = 127
              DemDebounceCounterJumpDown = false
              DemDebounceCounterJumpUp = false
              DemDebounceBehavior = DEM_DEBOUNCE_FREEZE
              DemDebounceCounterFailedThreshold = 127
              DemDebounceCounterJumpDownValue = 0
              DemDebounceCounterJumpUpValue = 0
              DemDebounceCounterPassedThreshold = -128
              DemDebounceCounterStorage = false
              DemDebounceContinuous = false
      DTCClass_DtcClass_ECU_In_Plant_Mode_C221200 (DemDTCClass): DemDTCSeverity=DEM_DTC_SEV_NO_SEVERITY, DemUdsDTC=6427136, DemImmediateNvStorage=false, DemDTCAttributesRef=DtcAttributes_41914fb7
      HS_FD_CAN2_Comm_Bus_Performance_U104E00 (DemEventParameter):
        DemEventKind = DEM_EVENT_KIND_SWC
        DemEventTimeSeries = DEM_TIMESERIES_SNAPSHOT_NONE
        DemEventAvailable = true
        DemEventId = 11
        DemEventAvailableInVariant = true
        DemEventLatchTestFailed = false
        DemEventCreateInfoPort = true
        DemDTCClassRef = DTCClass_DtcClass_HS_FD_CAN2_Comm_Bus_Performance_U104E00
        DemExtendedDataClassRef = ExtendedDataClass_240799f9
        DemFreezeFrameClassRef = FreezeFrame_a2168519
        DemFreezeFrameRecNumClassRef = DemFreezeFrameRecNumClass
        DemEventClass:
          DemAgingAllowed = true
          DemAgingCycleCounterThreshold = 40
          DemEventPriority = 2
          DemEventSignificance = DEM_EVENT_SIGNIFICANCE_FAULT
          DemEventFailureCycleCounterThreshold = 0
          DemConsiderPtoStatus = false
          DemFFPrestorageSupported = false
          DemAgingCycleRef = IgnitionCycle
          DemEnableConditionGroupRef = EnableConditionGroup_5926f32a
          DemOperationCycleRef = IgnitionCycle
          DemDebounceAlgorithmClass
            DemDebounceCounterBased:
              DemDebounceCounterDecrementStepSize = 128
              DemDebounceCounterIncrementStepSize = 127
              DemDebounceCounterJumpDown = false
              DemDebounceCounterJumpUp = false
              DemDebounceBehavior = DEM_DEBOUNCE_FREEZE
              DemDebounceCounterFailedThreshold = 127
              DemDebounceCounterJumpDownValue = 0
              DemDebounceCounterJumpUpValue = 0
              DemDebounceCounterPassedThreshold = -128
              DemDebounceCounterStorage = false
              DemDebounceContinuous = false
      DTCClass_DtcClass_Rear_Camera_Performance_or_Incorrect_Operation_B217A92 (DemDTCClass): DemDTCSeverity=DEM_DTC_SEV_NO_SEVERITY, DemUdsDTC=10582674, DemImmediateNvStorage=false, DemDTCAttributesRef=DtcAttributes_41914fb7
      PTS_Sensor_9_Circuit_Open_B129613 (DemEventParameter):
        DemEventKind = DEM_EVENT_KIND_SWC
        DemEventTimeSeries = DEM_TIMESERIES_SNAPSHOT_NONE
        DemEventAvailable = true
        DemEventId = 49
        DemEventAvailableInVariant = true
        DemEventLatchTestFailed = false
        DemEventCreateInfoPort = true
        DemDTCClassRef = DTCClass_DtcClass_PTS_Sensor_9_Circuit_Open_B129613
        DemExtendedDataClassRef = ExtendedDataClass_240799f9
        DemFreezeFrameClassRef = FreezeFrame_a2168519
        DemFreezeFrameRecNumClassRef = DemFreezeFrameRecNumClass
        DemEventClass:
          DemAgingAllowed = true
          DemAgingCycleCounterThreshold = 40
          DemEventPriority = 2
          DemEventSignificance = DEM_EVENT_SIGNIFICANCE_FAULT
          DemEventFailureCycleCounterThreshold = 0
          DemConsiderPtoStatus = false
          DemFFPrestorageSupported = false
          DemAgingCycleRef = IgnitionCycle
          DemEnableConditionGroupRef = EnableConditionGroup_2b31122d
          DemOperationCycleRef = IgnitionCycle
          DemDebounceAlgorithmClass
            DemDebounceCounterBased:
              DemDebounceCounterDecrementStepSize = 128
              DemDebounceCounterIncrementStepSize = 127
              DemDebounceCounterJumpDown = false
              DemDebounceCounterJumpUp = false
              DemDebounceBehavior = DEM_DEBOUNCE_FREEZE
              DemDebounceCounterFailedThreshold = 127
              DemDebounceCounterJumpDownValue = 0
              DemDebounceCounterJumpUpValue = 0
              DemDebounceCounterPassedThreshold = -128
              DemDebounceCounterStorage = false
              DemDebounceContinuous = false
      DTCClass_DtcClass_PTS_Sensor_7_Circuit_Open_B129413 (DemDTCClass): DemDTCSeverity=DEM_DTC_SEV_NO_SEVERITY, DemUdsDTC=9606163, DemImmediateNvStorage=false, DemDTCAttributesRef=DtcAttributes_41914fb7
      DTCClass_DtcClass_Battery_Voltage_Over_Voltage_B210C17 (DemDTCClass): DemDTCSeverity=DEM_DTC_SEV_NO_SEVERITY, DemUdsDTC=10554391, DemImmediateNvStorage=false, DemDTCAttributesRef=DtcAttributes_41914fb7
      Loss_of_Comm_With_Engine_Control_Module_U010000 (DemEventParameter):
        DemEventKind = DEM_EVENT_KIND_SWC
        DemEventTimeSeries = DEM_TIMESERIES_SNAPSHOT_NONE
        DemEventAvailable = true
        DemEventId = 23
        DemEventAvailableInVariant = true
        DemEventLatchTestFailed = false
        DemEventCreateInfoPort = true
        DemDTCClassRef = DTCClass_DtcClass_Loss_of_Comm_With_Engine_Control_Module_U010000
        DemExtendedDataClassRef = ExtendedDataClass_240799f9
        DemFreezeFrameClassRef = FreezeFrame_a2168519
        DemFreezeFrameRecNumClassRef = DemFreezeFrameRecNumClass
        DemEventClass:
          DemAgingAllowed = true
          DemAgingCycleCounterThreshold = 40
          DemEventPriority = 2
          DemEventSignificance = DEM_EVENT_SIGNIFICANCE_FAULT
          DemEventFailureCycleCounterThreshold = 0
          DemConsiderPtoStatus = false
          DemFFPrestorageSupported = false
          DemAgingCycleRef = IgnitionCycle
          DemEnableConditionGroupRef = EnableConditionGroup_58fca5ad
          DemOperationCycleRef = IgnitionCycle
          DemDebounceAlgorithmClass
            DemDebounceCounterBased:
              DemDebounceCounterDecrementStepSize = 128
              DemDebounceCounterIncrementStepSize = 127
              DemDebounceCounterJumpDown = false
              DemDebounceCounterJumpUp = false
              DemDebounceBehavior = DEM_DEBOUNCE_FREEZE
              DemDebounceCounterFailedThreshold = 127
              DemDebounceCounterJumpDownValue = 0
              DemDebounceCounterJumpUpValue = 0
              DemDebounceCounterPassedThreshold = -128
              DemDebounceCounterStorage = false
              DemDebounceContinuous = false
      Lost_Communication_with_Right_Camera_U026700 (DemEventParameter):
        DemEventKind = DEM_EVENT_KIND_SWC
        DemEventTimeSeries = DEM_TIMESERIES_SNAPSHOT_NONE
        DemEventAvailable = true
        DemEventId = 32
        DemEventAvailableInVariant = true
        DemEventLatchTestFailed = false
        DemEventCreateInfoPort = true
        DemDTCClassRef = DTCClass_DtcClass_Lost_Communication_with_Right_Camera_U026700
        DemExtendedDataClassRef = ExtendedDataClass_240799f9
        DemFreezeFrameClassRef = FreezeFrame_a2168519
        DemFreezeFrameRecNumClassRef = DemFreezeFrameRecNumClass
        DemEventClass:
          DemAgingAllowed = true
          DemAgingCycleCounterThreshold = 40
          DemEventPriority = 2
          DemEventSignificance = DEM_EVENT_SIGNIFICANCE_FAULT
          DemEventFailureCycleCounterThreshold = 0
          DemConsiderPtoStatus = false
          DemFFPrestorageSupported = false
          DemAgingCycleRef = IgnitionCycle
          DemEnableConditionGroupRef = EnableConditionGroup_a3268155
          DemOperationCycleRef = IgnitionCycle
          DemDebounceAlgorithmClass
            DemDebounceCounterBased:
              DemDebounceCounterDecrementStepSize = 128
              DemDebounceCounterIncrementStepSize = 127
              DemDebounceCounterJumpDown = false
              DemDebounceCounterJumpUp = false
              DemDebounceBehavior = DEM_DEBOUNCE_FREEZE
              DemDebounceCounterFailedThreshold = 127
              DemDebounceCounterJumpDownValue = 0
              DemDebounceCounterJumpUpValue = 0
              DemDebounceCounterPassedThreshold = -128
              DemDebounceCounterStorage = false
              DemDebounceContinuous = false
      8 x DemDTCClass, all with DemDTCSeverity=DEM_DTC_SEV_NO_SEVERITY, DemImmediateNvStorage=false, DemDTCAttributesRef=DtcAttributes_41914fb7:
        DTCClass_DtcClass_Lost_Communication_with_ORC_U015100: DemUdsDTC=12669184
        DTCClass_DtcClass_Loss_of_Comm_With_Engine_Control_Module_U010000: DemUdsDTC=12648448
        DTCClass_DtcClass_Implausible_Data_from_ORC_module_U045500: DemUdsDTC=12866816
        DTCClass_DtcClass_Front_Sensors_PS_VltgeAboveThreshold_B212A17: DemUdsDTC=10562071
        DTCClass_DtcClass_PTS_Sensor_1_Performance_or_Incorrect_Operation_B128E92: DemUdsDTC=9604754
        DTCClass_DtcClass_PTS_Sensor_11_Performance_or_Incorrect_Operation_B129892: DemUdsDTC=9607314
        DTCClass_DtcClass_PTS_Sensor_4_Performance_or_Incorrect_Operation_B129192: DemUdsDTC=9605522
        DTCClass_DtcClass_Implausible_Data_From_BSC_Module_1_U041800: DemUdsDTC=12851200
      PTS_Sensor_1_Performance_or_Incorrect_Operation_B128E92 (DemEventParameter):
        DemEventKind = DEM_EVENT_KIND_SWC
        DemEventTimeSeries = DEM_TIMESERIES_SNAPSHOT_NONE
        DemEventAvailable = true
        DemEventId = 35
        DemEventAvailableInVariant = true
        DemEventLatchTestFailed = false
        DemEventCreateInfoPort = true
        DemDTCClassRef = DTCClass_DtcClass_PTS_Sensor_1_Performance_or_Incorrect_Operation_B128E92
        DemExtendedDataClassRef = ExtendedDataClass_240799f9
        DemFreezeFrameClassRef = FreezeFrame_a2168519
        DemFreezeFrameRecNumClassRef = DemFreezeFrameRecNumClass
        DemEventClass:
          DemAgingAllowed = true
          DemAgingCycleCounterThreshold = 40
          DemEventPriority = 2
          DemEventSignificance = DEM_EVENT_SIGNIFICANCE_FAULT
          DemEventFailureCycleCounterThreshold = 0
          DemConsiderPtoStatus = false
          DemFFPrestorageSupported = false
          DemAgingCycleRef = IgnitionCycle
          DemEnableConditionGroupRef = EnableConditionGroup_2b31122d
          DemOperationCycleRef = IgnitionCycle
          DemDebounceAlgorithmClass
            DemDebounceCounterBased:
              DemDebounceCounterDecrementStepSize = 128
              DemDebounceCounterIncrementStepSize = 127
              DemDebounceCounterJumpDown = false
              DemDebounceCounterJumpUp = false
              DemDebounceBehavior = DEM_DEBOUNCE_FREEZE
              DemDebounceCounterFailedThreshold = 127
              DemDebounceCounterJumpDownValue = 0
              DemDebounceCounterJumpUpValue = 0
              DemDebounceCounterPassedThreshold = -128
              DemDebounceCounterStorage = false
              DemDebounceContinuous = false
      DTCClass_DtcClass_Lost_Communication_With_Radio_U018400 (DemDTCClass): DemDTCSeverity=DEM_DTC_SEV_NO_SEVERITY, DemUdsDTC=12682240, DemImmediateNvStorage=false, DemDTCAttributesRef=DtcAttributes_41914fb7
      DTCClass_DtcClass_PPP_Assist_Switch_Stuck_B12B22A (DemDTCClass): DemDTCSeverity=DEM_DTC_SEV_NO_SEVERITY, DemUdsDTC=9613866, DemImmediateNvStorage=false, DemDTCAttributesRef=DtcAttributes_41914fb7
      Rear_Camera_Performance_or_Incorrect_Operation_B217A92 (DemEventParameter):
        DemEventKind = DEM_EVENT_KIND_SWC
        DemEventTimeSeries = DEM_TIMESERIES_SNAPSHOT_NONE
        DemEventAvailable = true
        DemEventId = 59
        DemEventAvailableInVariant = true
        DemEventLatchTestFailed = false
        DemEventCreateInfoPort = true
        DemDTCClassRef = DTCClass_DtcClass_Rear_Camera_Performance_or_Incorrect_Operation_B217A92
        DemExtendedDataClassRef = ExtendedDataClass_240799f9
        DemFreezeFrameClassRef = FreezeFrame_a2168519
        DemFreezeFrameRecNumClassRef = DemFreezeFrameRecNumClass
        DemEventClass:
          DemAgingAllowed = true
          DemAgingCycleCounterThreshold = 40
          DemEventPriority = 2
          DemEventSignificance = DEM_EVENT_SIGNIFICANCE_FAULT
          DemEventFailureCycleCounterThreshold = 0
          DemConsiderPtoStatus = false
          DemFFPrestorageSupported = false
          DemAgingCycleRef = IgnitionCycle
          DemEnableConditionGroupRef = EnableConditionGroup_dc41854c
          DemOperationCycleRef = IgnitionCycle
          DemDebounceAlgorithmClass
            DemDebounceCounterBased:
              DemDebounceCounterDecrementStepSize = 128
              DemDebounceCounterIncrementStepSize = 127
              DemDebounceCounterJumpDown = false
              DemDebounceCounterJumpUp = false
              DemDebounceBehavior = DEM_DEBOUNCE_FREEZE
              DemDebounceCounterFailedThreshold = 127
              DemDebounceCounterJumpDownValue = 0
              DemDebounceCounterJumpUpValue = 0
              DemDebounceCounterPassedThreshold = -128
              DemDebounceCounterStorage = false
              DemDebounceContinuous = false
      DTCClass_DtcClass_Front_Sensors_PS_Bus_Sig_Msg_Failures_B212A08 (DemDTCClass): DemDTCSeverity=DEM_DTC_SEV_NO_SEVERITY, DemUdsDTC=10562056, DemImmediateNvStorage=false, DemDTCAttributesRef=DtcAttributes_41914fb7
      DTCClass_DtcClass_PTS_Sensor_8_Circuit_Open_B129513 (DemDTCClass): DemDTCSeverity=DEM_DTC_SEV_NO_SEVERITY, DemUdsDTC=9606419, DemImmediateNvStorage=false, DemDTCAttributesRef=DtcAttributes_41914fb7
      PTS_Sensor_2_Performance_or_Incorrect_Operation_B128F92 (DemEventParameter):
        DemEventKind = DEM_EVENT_KIND_SWC
        DemEventTimeSeries = DEM_TIMESERIES_SNAPSHOT_NONE
        DemEventAvailable = true
        DemEventId = 37
        DemEventAvailableInVariant = true
        DemEventLatchTestFailed = false
        DemEventCreateInfoPort = true
        DemDTCClassRef = DTCClass_DtcClass_PTS_Sensor_2_Performance_or_Incorrect_Operation_B128F92
        DemExtendedDataClassRef = ExtendedDataClass_240799f9
        DemFreezeFrameClassRef = FreezeFrame_a2168519
        DemFreezeFrameRecNumClassRef = DemFreezeFrameRecNumClass
        DemEventClass:
          DemAgingAllowed = true
          DemAgingCycleCounterThreshold = 40
          DemEventPriority = 2
          DemEventSignificance = DEM_EVENT_SIGNIFICANCE_FAULT
          DemEventFailureCycleCounterThreshold = 0
          DemConsiderPtoStatus = false
          DemFFPrestorageSupported = false
          DemAgingCycleRef = IgnitionCycle
          DemEnableConditionGroupRef = EnableConditionGroup_2b31122d
          DemOperationCycleRef = IgnitionCycle
          DemDebounceAlgorithmClass
            DemDebounceCounterBased:
              DemDebounceCounterDecrementStepSize = 128
              DemDebounceCounterIncrementStepSize = 127
              DemDebounceCounterJumpDown = false
              DemDebounceCounterJumpUp = false
              DemDebounceBehavior = DEM_DEBOUNCE_FREEZE
              DemDebounceCounterFailedThreshold = 127
              DemDebounceCounterJumpDownValue = 0
              DemDebounceCounterJumpUpValue = 0
              DemDebounceCounterPassedThreshold = -128
              DemDebounceCounterStorage = false
              DemDebounceContinuous = false
      DTCClass_DtcClass_HS_FD_CAN2_Comm_Bus_Performance_U104E00 (DemDTCClass): DemDTCSeverity=DEM_DTC_SEV_NO_SEVERITY, DemUdsDTC=13651456, DemImmediateNvStorage=false, DemDTCAttributesRef=DtcAttributes_41914fb7
      Right_Camera_Circuit_Voltage_Out_of_Range_B23C71C (DemEventParameter):
        DemEventKind = DEM_EVENT_KIND_SWC
        DemEventTimeSeries = DEM_TIMESERIES_SNAPSHOT_NONE
        DemEventAvailable = true
        DemEventId = 63
        DemEventAvailableInVariant = true
        DemEventLatchTestFailed = false
        DemEventCreateInfoPort = true
        DemDTCClassRef = DTCClass_DtcClass_Right_Camera_Circuit_Voltage_Out_of_Range_B23C71C
        DemExtendedDataClassRef = ExtendedDataClass_240799f9
        DemFreezeFrameClassRef = FreezeFrame_a2168519
        DemFreezeFrameRecNumClassRef = DemFreezeFrameRecNumClass
        DemEventClass:
          DemAgingAllowed = true
          DemAgingCycleCounterThreshold = 40
          DemEventPriority = 2
          DemEventSignificance = DEM_EVENT_SIGNIFICANCE_FAULT
          DemEventFailureCycleCounterThreshold = 0
          DemConsiderPtoStatus = false
          DemFFPrestorageSupported = false
          DemAgingCycleRef = IgnitionCycle
          DemEnableConditionGroupRef = EnableConditionGroup_a3268155
          DemOperationCycleRef = IgnitionCycle
          DemDebounceAlgorithmClass
            DemDebounceCounterBased:
              DemDebounceCounterDecrementStepSize = 128
              DemDebounceCounterIncrementStepSize = 127
              DemDebounceCounterJumpDown = false
              DemDebounceCounterJumpUp = false
              DemDebounceBehavior = DEM_DEBOUNCE_FREEZE
              DemDebounceCounterFailedThreshold = 127
              DemDebounceCounterJumpDownValue = 0
              DemDebounceCounterJumpUpValue = 0
              DemDebounceCounterPassedThreshold = -128
              DemDebounceCounterStorage = false
              DemDebounceContinuous = false
      PTS_Sensor_8_Circuit_Open_B129513 (DemEventParameter):
        DemEventKind = DEM_EVENT_KIND_SWC
        DemEventTimeSeries = DEM_TIMESERIES_SNAPSHOT_NONE
        DemEventAvailable = true
        DemEventId = 47
        DemEventAvailableInVariant = true
        DemEventLatchTestFailed = false
        DemEventCreateInfoPort = true
        DemDTCClassRef = DTCClass_DtcClass_PTS_Sensor_8_Circuit_Open_B129513
        DemExtendedDataClassRef = ExtendedDataClass_240799f9
        DemFreezeFrameClassRef = FreezeFrame_a2168519
        DemFreezeFrameRecNumClassRef = DemFreezeFrameRecNumClass
        DemEventClass:
          DemAgingAllowed = true
          DemAgingCycleCounterThreshold = 40
          DemEventPriority = 2
          DemEventSignificance = DEM_EVENT_SIGNIFICANCE_FAULT
          DemEventFailureCycleCounterThreshold = 0
          DemConsiderPtoStatus = false
          DemFFPrestorageSupported = false
          DemAgingCycleRef = IgnitionCycle
          DemEnableConditionGroupRef = EnableConditionGroup_2b31122d
          DemOperationCycleRef = IgnitionCycle
          DemDebounceAlgorithmClass
            DemDebounceCounterBased:
              DemDebounceCounterDecrementStepSize = 128
              DemDebounceCounterIncrementStepSize = 127
              DemDebounceCounterJumpDown = false
              DemDebounceCounterJumpUp = false
              DemDebounceBehavior = DEM_DEBOUNCE_FREEZE
              DemDebounceCounterFailedThreshold = 127
              DemDebounceCounterJumpDownValue = 0
              DemDebounceCounterJumpUpValue = 0
              DemDebounceCounterPassedThreshold = -128
              DemDebounceCounterStorage = false
              DemDebounceContinuous = false
      DTCClass_DtcClass_Implausible_Data_Received_from_Radio_U048500 (DemDTCClass): DemDTCSeverity=DEM_DTC_SEV_NO_SEVERITY, DemUdsDTC=12879104, DemImmediateNvStorage=false, DemDTCAttributesRef=DtcAttributes_41914fb7
      Implausible_Data_Received_from_Radio_U048500 (DemEventParameter):
        DemEventKind = DEM_EVENT_KIND_SWC
        DemEventTimeSeries = DEM_TIMESERIES_SNAPSHOT_NONE
        DemEventAvailable = true
        DemEventId = 15
        DemEventAvailableInVariant = true
        DemEventLatchTestFailed = false
        DemEventCreateInfoPort = true
        DemDTCClassRef = DTCClass_DtcClass_Implausible_Data_Received_from_Radio_U048500
        DemExtendedDataClassRef = ExtendedDataClass_240799f9
        DemFreezeFrameClassRef = FreezeFrame_a2168519
        DemFreezeFrameRecNumClassRef = DemFreezeFrameRecNumClass
        DemEventClass:
          DemAgingAllowed = true
          DemAgingCycleCounterThreshold = 40
          DemEventPriority = 2
          DemEventSignificance = DEM_EVENT_SIGNIFICANCE_FAULT
          DemEventFailureCycleCounterThreshold = 0
          DemConsiderPtoStatus = false
          DemFFPrestorageSupported = false
          DemAgingCycleRef = IgnitionCycle
          DemEnableConditionGroupRef = EnableConditionGroup_58fca5ad
          DemOperationCycleRef = IgnitionCycle
          DemDebounceAlgorithmClass
            DemDebounceCounterBased:
              DemDebounceCounterDecrementStepSize = 128
              DemDebounceCounterIncrementStepSize = 127
              DemDebounceCounterJumpDown = false
              DemDebounceCounterJumpUp = false
              DemDebounceBehavior = DEM_DEBOUNCE_FREEZE
              DemDebounceCounterFailedThreshold = 127
              DemDebounceCounterJumpDownValue = 0
              DemDebounceCounterJumpUpValue = 0
              DemDebounceCounterPassedThreshold = -128
              DemDebounceCounterStorage = false
              DemDebounceContinuous = false
      DTCClass_DtcClass_PTS_Sensor_3_Performance_or_Incorrect_Operation_B129092 (DemDTCClass): DemDTCSeverity=DEM_DTC_SEV_NO_SEVERITY, DemUdsDTC=9605266, DemImmediateNvStorage=false, DemDTCAttributesRef=DtcAttributes_41914fb7
      Implausible_Data_received_from_TRSKM_module_U14A000 (DemEventParameter):
        DemEventKind = DEM_EVENT_KIND_SWC
        DemEventTimeSeries = DEM_TIMESERIES_SNAPSHOT_NONE
        DemEventAvailable = true
        DemEventId = 17
        DemEventAvailableInVariant = true
        DemEventLatchTestFailed = false
        DemEventCreateInfoPort = true
        DemDTCClassRef = DTCClass_DtcClass_Implausible_Data_received_from_TRSKM_module_U14A000
        DemExtendedDataClassRef = ExtendedDataClass_240799f9
        DemFreezeFrameClassRef = FreezeFrame_a2168519
        DemFreezeFrameRecNumClassRef = DemFreezeFrameRecNumClass
        DemEventClass:
          DemAgingAllowed = true
          DemAgingCycleCounterThreshold = 40
          DemEventPriority = 2
          DemEventSignificance = DEM_EVENT_SIGNIFICANCE_FAULT
          DemEventFailureCycleCounterThreshold = 0
          DemConsiderPtoStatus = false
          DemFFPrestorageSupported = false
          DemAgingCycleRef = IgnitionCycle
          DemEnableConditionGroupRef = EnableConditionGroup_58fca5ad
          DemOperationCycleRef = IgnitionCycle
          DemDebounceAlgorithmClass
            DemDebounceCounterBased:
              DemDebounceCounterDecrementStepSize = 128
              DemDebounceCounterIncrementStepSize = 127
              DemDebounceCounterJumpDown = false
              DemDebounceCounterJumpUp = false
              DemDebounceBehavior = DEM_DEBOUNCE_FREEZE
              DemDebounceCounterFailedThreshold = 127
              DemDebounceCounterJumpDownValue = 0
              DemDebounceCounterJumpUpValue = 0
              DemDebounceCounterPassedThreshold = -128
              DemDebounceCounterStorage = false
              DemDebounceContinuous = false
      Front_Camera_Performance_or_Incorrect_Operation_B23C592 (DemEventParameter):
        DemEventKind = DEM_EVENT_KIND_SWC
        DemEventTimeSeries = DEM_TIMESERIES_SNAPSHOT_NONE
        DemEventAvailable = true
        DemEventId = 7
        DemEventAvailableInVariant = true
        DemEventLatchTestFailed = false
        DemEventCreateInfoPort = true
        DemDTCClassRef = DTCClass_DtcClass_Front_Camera_Performance_or_Incorrect_Operation_B23C592
        DemExtendedDataClassRef = ExtendedDataClass_240799f9
        DemFreezeFrameClassRef = FreezeFrame_a2168519
        DemFreezeFrameRecNumClassRef = DemFreezeFrameRecNumClass
        DemEventClass:
          DemAgingAllowed = true
          DemAgingCycleCounterThreshold = 40
          DemEventPriority = 2
          DemEventSignificance = DEM_EVENT_SIGNIFICANCE_FAULT
          DemEventFailureCycleCounterThreshold = 0
          DemConsiderPtoStatus = false
          DemFFPrestorageSupported = false
          DemAgingCycleRef = IgnitionCycle
          DemEnableConditionGroupRef = EnableConditionGroup_a3268155
          DemOperationCycleRef = IgnitionCycle
          DemDebounceAlgorithmClass
            DemDebounceCounterBased:
              DemDebounceCounterDecrementStepSize = 128
              DemDebounceCounterIncrementStepSize = 127
              DemDebounceCounterJumpDown = false
              DemDebounceCounterJumpUp = false
              DemDebounceBehavior = DEM_DEBOUNCE_FREEZE
              DemDebounceCounterFailedThreshold = 127
              DemDebounceCounterJumpDownValue = 0
              DemDebounceCounterJumpUpValue = 0
              DemDebounceCounterPassedThreshold = -128
              DemDebounceCounterStorage = false
              DemDebounceContinuous = false
      DTCClass_DtcClass_PTS_Sensor_9_Circuit_Open_B129613 (DemDTCClass): DemDTCSeverity=DEM_DTC_SEV_NO_SEVERITY, DemUdsDTC=9606675, DemImmediateNvStorage=false, DemDTCAttributesRef=DtcAttributes_41914fb7
      DTCClass_DtcClass_PTS_Sensor_2_Circuit_Open_B128F13 (DemDTCClass): DemDTCSeverity=DEM_DTC_SEV_NO_SEVERITY, DemUdsDTC=9604883, DemImmediateNvStorage=false, DemDTCAttributesRef=DtcAttributes_41914fb7
      Loss_Communication_with_TRS_Knob_Module_U12B900 (DemEventParameter):
        DemEventKind = DEM_EVENT_KIND_SWC
        DemEventTimeSeries = DEM_TIMESERIES_SNAPSHOT_NONE
        DemEventAvailable = true
        DemEventId = 22
        DemEventAvailableInVariant = true
        DemEventLatchTestFailed = false
        DemEventCreateInfoPort = true
        DemDTCClassRef = DTCClass_DtcClass_Loss_Communication_with_TRS_Knob_Module_U12B900
        DemExtendedDataClassRef = ExtendedDataClass_240799f9
        DemFreezeFrameClassRef = FreezeFrame_a2168519
        DemFreezeFrameRecNumClassRef = DemFreezeFrameRecNumClass
        DemEventClass:
          DemAgingAllowed = true
          DemAgingCycleCounterThreshold = 40
          DemEventPriority = 2
          DemEventSignificance = DEM_EVENT_SIGNIFICANCE_FAULT
          DemEventFailureCycleCounterThreshold = 0
          DemConsiderPtoStatus = false
          DemFFPrestorageSupported = false
          DemAgingCycleRef = IgnitionCycle
          DemEnableConditionGroupRef = EnableConditionGroup_58fca5ad
          DemOperationCycleRef = IgnitionCycle
          DemDebounceAlgorithmClass
            DemDebounceCounterBased:
              DemDebounceCounterDecrementStepSize = 128
              DemDebounceCounterIncrementStepSize = 127
              DemDebounceCounterJumpDown = false
              DemDebounceCounterJumpUp = false
              DemDebounceBehavior = DEM_DEBOUNCE_FREEZE
              DemDebounceCounterFailedThreshold = 127
              DemDebounceCounterJumpDownValue = 0
              DemDebounceCounterJumpUpValue = 0
              DemDebounceCounterPassedThreshold = -128
              DemDebounceCounterStorage = false
              DemDebounceContinuous = false
      DTCClass_DtcClass_Front_Camera_Circuit_Voltage_Out_of_Range_B23C51C (DemDTCClass): DemDTCSeverity=DEM_DTC_SEV_NO_SEVERITY, DemUdsDTC=10732828, DemImmediateNvStorage=false, DemDTCAttributesRef=DtcAttributes_41914fb7
      DTCClass_DtcClass_Lost_Communication_With_PSC_Module_A_U013100 (DemDTCClass): DemDTCSeverity=DEM_DTC_SEV_NO_SEVERITY, DemUdsDTC=12660992, DemImmediateNvStorage=false, DemDTCAttributesRef=DtcAttributes_41914fb7
      5 x DemEventParameter, all with DemEventKind=DEM_EVENT_KIND_SWC, DemEventTimeSeries=DEM_TIMESERIES_SNAPSHOT_NONE, DemEventAvailable=true, DemEventAvailableInVariant=true, DemEventLatchTestFailed=false, DemEventCreateInfoPort=true, DemExtendedDataClassRef=ExtendedDataClass_240799f9, DemFreezeFrameClassRef=FreezeFrame_a2168519, DemFreezeFrameRecNumClassRef=DemFreezeFrameRecNumClass:
        PTS_Sensor_7_Circuit_Open_B129413: DemEventId=45, DemDTCClassRef=DTCClass_DtcClass_PTS_Sensor_7_Circuit_Open_B129413
          DemEventClass:
            DemAgingAllowed = true
            DemAgingCycleCounterThreshold = 40
            DemEventPriority = 2
            DemEventSignificance = DEM_EVENT_SIGNIFICANCE_FAULT
            DemEventFailureCycleCounterThreshold = 0
            DemConsiderPtoStatus = false
            DemFFPrestorageSupported = false
            DemAgingCycleRef = IgnitionCycle
            DemEnableConditionGroupRef = EnableConditionGroup_2b31122d
            DemOperationCycleRef = IgnitionCycle
            DemDebounceAlgorithmClass
              DemDebounceCounterBased:
                DemDebounceCounterDecrementStepSize = 128
                DemDebounceCounterIncrementStepSize = 127
                DemDebounceCounterJumpDown = false
                DemDebounceCounterJumpUp = false
                DemDebounceBehavior = DEM_DEBOUNCE_FREEZE
                DemDebounceCounterFailedThreshold = 127
                DemDebounceCounterJumpDownValue = 0
                DemDebounceCounterJumpUpValue = 0
                DemDebounceCounterPassedThreshold = -128
                DemDebounceCounterStorage = false
                DemDebounceContinuous = false
        Front_Sensors_PS_Bus_Sig_Msg_Failures_B212A08: DemEventId=8, DemDTCClassRef=DTCClass_DtcClass_Front_Sensors_PS_Bus_Sig_Msg_Failures_B212A08
          DemEventClass:
            DemAgingAllowed = true
            DemAgingCycleCounterThreshold = 40
            DemEventPriority = 2
            DemEventSignificance = DEM_EVENT_SIGNIFICANCE_FAULT
            DemEventFailureCycleCounterThreshold = 0
            DemConsiderPtoStatus = false
            DemFFPrestorageSupported = false
            DemAgingCycleRef = IgnitionCycle
            DemEnableConditionGroupRef = EnableConditionGroup_f0773a88
            DemOperationCycleRef = IgnitionCycle
            DemDebounceAlgorithmClass
              DemDebounceCounterBased:
                DemDebounceCounterDecrementStepSize = 128
                DemDebounceCounterIncrementStepSize = 127
                DemDebounceCounterJumpDown = false
                DemDebounceCounterJumpUp = false
                DemDebounceBehavior = DEM_DEBOUNCE_FREEZE
                DemDebounceCounterFailedThreshold = 127
                DemDebounceCounterJumpDownValue = 0
                DemDebounceCounterJumpUpValue = 0
                DemDebounceCounterPassedThreshold = -128
                DemDebounceCounterStorage = false
                DemDebounceContinuous = false
        Lost_Communication_With_PSC_Module_A_U013100: DemEventId=26, DemDTCClassRef=DTCClass_DtcClass_Lost_Communication_With_PSC_Module_A_U013100
          DemEventClass:
            DemAgingAllowed = true
            DemAgingCycleCounterThreshold = 40
            DemEventPriority = 2
            DemEventSignificance = DEM_EVENT_SIGNIFICANCE_FAULT
            DemEventFailureCycleCounterThreshold = 0
            DemConsiderPtoStatus = false
            DemFFPrestorageSupported = false
            DemAgingCycleRef = IgnitionCycle
            DemEnableConditionGroupRef = EnableConditionGroup_58fca5ad
            DemOperationCycleRef = IgnitionCycle
            DemDebounceAlgorithmClass
              DemDebounceCounterBased:
                DemDebounceCounterDecrementStepSize = 128
                DemDebounceCounterIncrementStepSize = 127
                DemDebounceCounterJumpDown = false
                DemDebounceCounterJumpUp = false
                DemDebounceBehavior = DEM_DEBOUNCE_FREEZE
                DemDebounceCounterFailedThreshold = 127
                DemDebounceCounterJumpDownValue = 0
                DemDebounceCounterJumpUpValue = 0
                DemDebounceCounterPassedThreshold = -128
                DemDebounceCounterStorage = false
                DemDebounceContinuous = false
        Lost_Communication_with_Front_Camera_U026500: DemEventId=28, DemDTCClassRef=DTCClass_DtcClass_Lost_Communication_with_Front_Camera_U026500
          DemEventClass:
            DemAgingAllowed = true
            DemAgingCycleCounterThreshold = 40
            DemEventPriority = 2
            DemEventSignificance = DEM_EVENT_SIGNIFICANCE_FAULT
            DemEventFailureCycleCounterThreshold = 0
            DemConsiderPtoStatus = false
            DemFFPrestorageSupported = false
            DemAgingCycleRef = IgnitionCycle
            DemEnableConditionGroupRef = EnableConditionGroup_a3268155
            DemOperationCycleRef = IgnitionCycle
            DemDebounceAlgorithmClass
              DemDebounceCounterBased:
                DemDebounceCounterDecrementStepSize = 128
                DemDebounceCounterIncrementStepSize = 127
                DemDebounceCounterJumpDown = false
                DemDebounceCounterJumpUp = false
                DemDebounceBehavior = DEM_DEBOUNCE_FREEZE
                DemDebounceCounterFailedThreshold = 127
                DemDebounceCounterJumpDownValue = 0
                DemDebounceCounterJumpUpValue = 0
                DemDebounceCounterPassedThreshold = -128
                DemDebounceCounterStorage = false
                DemDebounceContinuous = false
        PTS_Sensor_3_Performance_or_Incorrect_Operation_B129092: DemEventId=39, DemDTCClassRef=DTCClass_DtcClass_PTS_Sensor_3_Performance_or_Incorrect_Operation_B129092
          DemEventClass:
            DemAgingAllowed = true
            DemAgingCycleCounterThreshold = 40
            DemEventPriority = 2
            DemEventSignificance = DEM_EVENT_SIGNIFICANCE_FAULT
            DemEventFailureCycleCounterThreshold = 0
            DemConsiderPtoStatus = false
            DemFFPrestorageSupported = false
            DemAgingCycleRef = IgnitionCycle
            DemEnableConditionGroupRef = EnableConditionGroup_2b31122d
            DemOperationCycleRef = IgnitionCycle
            DemDebounceAlgorithmClass
              DemDebounceCounterBased:
                DemDebounceCounterDecrementStepSize = 128
                DemDebounceCounterIncrementStepSize = 127
                DemDebounceCounterJumpDown = false
                DemDebounceCounterJumpUp = false
                DemDebounceBehavior = DEM_DEBOUNCE_FREEZE
                DemDebounceCounterFailedThreshold = 127
                DemDebounceCounterJumpDownValue = 0
                DemDebounceCounterJumpUpValue = 0
                DemDebounceCounterPassedThreshold = -128
                DemDebounceCounterStorage = false
                DemDebounceContinuous = false
      DTCClass_DtcClass_PTS_Sensor_5_Performance_or_Incorrect_Operation_B129292 (DemDTCClass): DemDTCSeverity=DEM_DTC_SEV_NO_SEVERITY, DemUdsDTC=9605778, DemImmediateNvStorage=false, DemDTCAttributesRef=DtcAttributes_41914fb7
      PTS_Sensor_8_Performance_or_Incorrect_Operation_B129592 (DemEventParameter):
        DemEventKind = DEM_EVENT_KIND_SWC
        DemEventTimeSeries = DEM_TIMESERIES_SNAPSHOT_NONE
        DemEventAvailable = true
        DemEventId = 48
        DemEventAvailableInVariant = true
        DemEventLatchTestFailed = false
        DemEventCreateInfoPort = true
        DemDTCClassRef = DTCClass_DtcClass_PTS_Sensor_8_Performance_or_Incorrect_Operation_B129592
        DemExtendedDataClassRef = ExtendedDataClass_240799f9
        DemFreezeFrameClassRef = FreezeFrame_a2168519
        DemFreezeFrameRecNumClassRef = DemFreezeFrameRecNumClass
        DemEventClass:
          DemAgingAllowed = true
          DemAgingCycleCounterThreshold = 40
          DemEventPriority = 2
          DemEventSignificance = DEM_EVENT_SIGNIFICANCE_FAULT
          DemEventFailureCycleCounterThreshold = 0
          DemConsiderPtoStatus = false
          DemFFPrestorageSupported = false
          DemAgingCycleRef = IgnitionCycle
          DemEnableConditionGroupRef = EnableConditionGroup_2b31122d
          DemOperationCycleRef = IgnitionCycle
          DemDebounceAlgorithmClass
            DemDebounceCounterBased:
              DemDebounceCounterDecrementStepSize = 128
              DemDebounceCounterIncrementStepSize = 127
              DemDebounceCounterJumpDown = false
              DemDebounceCounterJumpUp = false
              DemDebounceBehavior = DEM_DEBOUNCE_FREEZE
              DemDebounceCounterFailedThreshold = 127
              DemDebounceCounterJumpDownValue = 0
              DemDebounceCounterJumpUpValue = 0
              DemDebounceCounterPassedThreshold = -128
              DemDebounceCounterStorage = false
              DemDebounceContinuous = false
      DTCClass_DtcClass_Invalid_Data_Received_From_Power_Steering_Control_Module_U042000 (DemDTCClass): DemDTCSeverity=DEM_DTC_SEV_NO_SEVERITY, DemUdsDTC=12853248, DemImmediateNvStorage=false, DemDTCAttributesRef=DtcAttributes_41914fb7
      DTCClass_DtcClass_Rear_Sensors_PS_VltgeBelowThreshold_B212B16 (DemDTCClass): DemDTCSeverity=DEM_DTC_SEV_NO_SEVERITY, DemUdsDTC=10562326, DemImmediateNvStorage=false, DemDTCAttributesRef=DtcAttributes_41914fb7
      PPP_Assist_Switch_Stuck_B12B22A (DemEventParameter):
        DemEventKind = DEM_EVENT_KIND_SWC
        DemEventTimeSeries = DEM_TIMESERIES_SNAPSHOT_NONE
        DemEventAvailable = true
        DemEventId = 33
        DemEventAvailableInVariant = true
        DemEventLatchTestFailed = false
        DemEventCreateInfoPort = true
        DemDTCClassRef = DTCClass_DtcClass_PPP_Assist_Switch_Stuck_B12B22A
        DemExtendedDataClassRef = ExtendedDataClass_240799f9
        DemFreezeFrameClassRef = FreezeFrame_a2168519
        DemFreezeFrameRecNumClassRef = DemFreezeFrameRecNumClass
        DemEventClass:
          DemAgingAllowed = true
          DemAgingCycleCounterThreshold = 40
          DemEventPriority = 2
          DemEventSignificance = DEM_EVENT_SIGNIFICANCE_FAULT
          DemEventFailureCycleCounterThreshold = 0
          DemConsiderPtoStatus = false
          DemFFPrestorageSupported = false
          DemAgingCycleRef = IgnitionCycle
          DemEnableConditionGroupRef = EnableConditionGroup_bf4488aa
          DemOperationCycleRef = IgnitionCycle
          DemDebounceAlgorithmClass
            DemDebounceCounterBased:
              DemDebounceCounterDecrementStepSize = 128
              DemDebounceCounterIncrementStepSize = 127
              DemDebounceCounterJumpDown = false
              DemDebounceCounterJumpUp = false
              DemDebounceBehavior = DEM_DEBOUNCE_FREEZE
              DemDebounceCounterFailedThreshold = 127
              DemDebounceCounterJumpDownValue = 0
              DemDebounceCounterJumpUpValue = 0
              DemDebounceCounterPassedThreshold = -128
              DemDebounceCounterStorage = false
              DemDebounceContinuous = false
      DTCClass_DtcClass_Calibration_Not_Learned_Lost_Calibration_B228600 (DemDTCClass): DemDTCSeverity=DEM_DTC_SEV_NO_SEVERITY, DemUdsDTC=10651136, DemImmediateNvStorage=false, DemDTCAttributesRef=DtcAttributes_41914fb7
      Implausible_data_received_from_ECM_U040100 (DemEventParameter):
        DemEventKind = DEM_EVENT_KIND_SWC
        DemEventTimeSeries = DEM_TIMESERIES_SNAPSHOT_NONE
        DemEventAvailable = true
        DemEventId = 18
        DemEventAvailableInVariant = true
        DemEventLatchTestFailed = false
        DemEventCreateInfoPort = true
        DemDTCClassRef = DTCClass_DtcClass_Implausible_data_received_from_ECM_U040100
        DemExtendedDataClassRef = ExtendedDataClass_240799f9
        DemFreezeFrameClassRef = FreezeFrame_a2168519
        DemFreezeFrameRecNumClassRef = DemFreezeFrameRecNumClass
        DemEventClass:
          DemAgingAllowed = true
          DemAgingCycleCounterThreshold = 40
          DemEventPriority = 2
          DemEventSignificance = DEM_EVENT_SIGNIFICANCE_FAULT
          DemEventFailureCycleCounterThreshold = 0
          DemConsiderPtoStatus = false
          DemFFPrestorageSupported = false
          DemAgingCycleRef = IgnitionCycle
          DemEnableConditionGroupRef = EnableConditionGroup_58fca5ad
          DemOperationCycleRef = IgnitionCycle
          DemDebounceAlgorithmClass
            DemDebounceCounterBased:
              DemDebounceCounterDecrementStepSize = 128
              DemDebounceCounterIncrementStepSize = 127
              DemDebounceCounterJumpDown = false
              DemDebounceCounterJumpUp = false
              DemDebounceBehavior = DEM_DEBOUNCE_FREEZE
              DemDebounceCounterFailedThreshold = 127
              DemDebounceCounterJumpDownValue = 0
              DemDebounceCounterJumpUpValue = 0
              DemDebounceCounterPassedThreshold = -128
              DemDebounceCounterStorage = false
              DemDebounceContinuous = false
      PTS_Sensor_10_Circuit_Open_B129713 (DemEventParameter):
        DemEventKind = DEM_EVENT_KIND_SWC
        DemEventTimeSeries = DEM_TIMESERIES_SNAPSHOT_NONE
        DemEventAvailable = true
        DemEventId = 51
        DemEventAvailableInVariant = true
        DemEventLatchTestFailed = false
        DemEventCreateInfoPort = true
        DemDTCClassRef = DTCClass_DtcClass_PTS_Sensor_10_Circuit_Open_B129713
        DemExtendedDataClassRef = ExtendedDataClass_240799f9
        DemFreezeFrameClassRef = FreezeFrame_a2168519
        DemFreezeFrameRecNumClassRef = DemFreezeFrameRecNumClass
        DemEventClass:
          DemAgingAllowed = true
          DemAgingCycleCounterThreshold = 40
          DemEventPriority = 2
          DemEventSignificance = DEM_EVENT_SIGNIFICANCE_FAULT
          DemEventFailureCycleCounterThreshold = 0
          DemConsiderPtoStatus = false
          DemFFPrestorageSupported = false
          DemAgingCycleRef = IgnitionCycle
          DemEnableConditionGroupRef = EnableConditionGroup_2b31122d
          DemOperationCycleRef = IgnitionCycle
          DemDebounceAlgorithmClass
            DemDebounceCounterBased:
              DemDebounceCounterDecrementStepSize = 128
              DemDebounceCounterIncrementStepSize = 127
              DemDebounceCounterJumpDown = false
              DemDebounceCounterJumpUp = false
              DemDebounceBehavior = DEM_DEBOUNCE_FREEZE
              DemDebounceCounterFailedThreshold = 127
              DemDebounceCounterJumpDownValue = 0
              DemDebounceCounterJumpUpValue = 0
              DemDebounceCounterPassedThreshold = -128
              DemDebounceCounterStorage = false
              DemDebounceContinuous = false
      DTCClass_DtcClass_PTS_Sensor_9_Performance_or_Incorrect_Operation_B129692 (DemDTCClass): DemDTCSeverity=DEM_DTC_SEV_NO_SEVERITY, DemUdsDTC=9606802, DemImmediateNvStorage=false, DemDTCAttributesRef=DtcAttributes_41914fb7
      4 x DemEventParameter, all with DemEventKind=DEM_EVENT_KIND_SWC, DemEventTimeSeries=DEM_TIMESERIES_SNAPSHOT_NONE, DemEventAvailable=true, DemEventAvailableInVariant=true, DemEventLatchTestFailed=false, DemEventCreateInfoPort=true, DemExtendedDataClassRef=ExtendedDataClass_240799f9, DemFreezeFrameClassRef=FreezeFrame_a2168519, DemFreezeFrameRecNumClassRef=DemFreezeFrameRecNumClass:
        Lost_Communication_With_BSC_module_1_U012900: DemEventId=25, DemDTCClassRef=DTCClass_DtcClass_Lost_Communication_With_BSC_module_1_U012900
          DemEventClass:
            DemAgingAllowed = true
            DemAgingCycleCounterThreshold = 40
            DemEventPriority = 2
            DemEventSignificance = DEM_EVENT_SIGNIFICANCE_FAULT
            DemEventFailureCycleCounterThreshold = 0
            DemConsiderPtoStatus = false
            DemFFPrestorageSupported = false
            DemAgingCycleRef = IgnitionCycle
            DemEnableConditionGroupRef = EnableConditionGroup_58fca5ad
            DemOperationCycleRef = IgnitionCycle
            DemDebounceAlgorithmClass
              DemDebounceCounterBased:
                DemDebounceCounterDecrementStepSize = 128
                DemDebounceCounterIncrementStepSize = 127
                DemDebounceCounterJumpDown = false
                DemDebounceCounterJumpUp = false
                DemDebounceBehavior = DEM_DEBOUNCE_FREEZE
                DemDebounceCounterFailedThreshold = 127
                DemDebounceCounterJumpDownValue = 0
                DemDebounceCounterJumpUpValue = 0
                DemDebounceCounterPassedThreshold = -128
                DemDebounceCounterStorage = false
                DemDebounceContinuous = false
        PTS_Sensor_7_Performance_or_Incorrect_Operation_B129492: DemEventId=46, DemDTCClassRef=DTCClass_DtcClass_PTS_Sensor_7_Performance_or_Incorrect_Operation_B129492
          DemEventClass:
            DemAgingAllowed = true
            DemAgingCycleCounterThreshold = 40
            DemEventPriority = 2
            DemEventSignificance = DEM_EVENT_SIGNIFICANCE_FAULT
            DemEventFailureCycleCounterThreshold = 0
            DemConsiderPtoStatus = false
            DemFFPrestorageSupported = false
            DemAgingCycleRef = IgnitionCycle
            DemEnableConditionGroupRef = EnableConditionGroup_2b31122d
            DemOperationCycleRef = IgnitionCycle
            DemDebounceAlgorithmClass
              DemDebounceCounterBased:
                DemDebounceCounterDecrementStepSize = 128
                DemDebounceCounterIncrementStepSize = 127
                DemDebounceCounterJumpDown = false
                DemDebounceCounterJumpUp = false
                DemDebounceBehavior = DEM_DEBOUNCE_FREEZE
                DemDebounceCounterFailedThreshold = 127
                DemDebounceCounterJumpDownValue = 0
                DemDebounceCounterJumpUpValue = 0
                DemDebounceCounterPassedThreshold = -128
                DemDebounceCounterStorage = false
                DemDebounceContinuous = false
        Left_Camera_Performance_or_Incorrect_Operation_B23C692: DemEventId=21, DemDTCClassRef=DTCClass_DtcClass_Left_Camera_Performance_or_Incorrect_Operation_B23C692
          DemEventClass:
            DemAgingAllowed = true
            DemAgingCycleCounterThreshold = 40
            DemEventPriority = 2
            DemEventSignificance = DEM_EVENT_SIGNIFICANCE_FAULT
            DemEventFailureCycleCounterThreshold = 0
            DemConsiderPtoStatus = false
            DemFFPrestorageSupported = false
            DemAgingCycleRef = IgnitionCycle
            DemEnableConditionGroupRef = EnableConditionGroup_a3268155
            DemOperationCycleRef = IgnitionCycle
            DemDebounceAlgorithmClass
              DemDebounceCounterBased:
                DemDebounceCounterDecrementStepSize = 128
                DemDebounceCounterIncrementStepSize = 127
                DemDebounceCounterJumpDown = false
                DemDebounceCounterJumpUp = false
                DemDebounceBehavior = DEM_DEBOUNCE_FREEZE
                DemDebounceCounterFailedThreshold = 127
                DemDebounceCounterJumpDownValue = 0
                DemDebounceCounterJumpUpValue = 0
                DemDebounceCounterPassedThreshold = -128
                DemDebounceCounterStorage = false
                DemDebounceContinuous = false
        Vehicle_Configuration_Mismatch_B223B00: DemEventId=65, DemDTCClassRef=DTCClass_DtcClass_Vehicle_Configuration_Mismatch_B223B00
          DemEventClass:
            DemAgingAllowed = true
            DemAgingCycleCounterThreshold = 40
            DemEventPriority = 2
            DemEventSignificance = DEM_EVENT_SIGNIFICANCE_FAULT
            DemEventFailureCycleCounterThreshold = 0
            DemConsiderPtoStatus = false
            DemFFPrestorageSupported = false
            DemAgingCycleRef = IgnitionCycle
            DemEnableConditionGroupRef = EnableConditionGroup_5090bf01
            DemOperationCycleRef = IgnitionCycle
            DemDebounceAlgorithmClass
              DemDebounceCounterBased:
                DemDebounceCounterDecrementStepSize = 128
                DemDebounceCounterIncrementStepSize = 127
                DemDebounceCounterJumpDown = false
                DemDebounceCounterJumpUp = false
                DemDebounceBehavior = DEM_DEBOUNCE_FREEZE
                DemDebounceCounterFailedThreshold = 127
                DemDebounceCounterJumpDownValue = 0
                DemDebounceCounterJumpUpValue = 0
                DemDebounceCounterPassedThreshold = -128
                DemDebounceCounterStorage = false
                DemDebounceContinuous = false
      DTCClass_DtcClass_PTS_Sensor_12_Performance_or_Incorrect_Operation_B129992 (DemDTCClass): DemDTCSeverity=DEM_DTC_SEV_NO_SEVERITY, DemUdsDTC=9607570, DemImmediateNvStorage=false, DemDTCAttributesRef=DtcAttributes_41914fb7
      3 x DemEventParameter, all with DemEventKind=DEM_EVENT_KIND_SWC, DemEventTimeSeries=DEM_TIMESERIES_SNAPSHOT_NONE, DemEventAvailable=true, DemEventAvailableInVariant=true, DemEventLatchTestFailed=false, DemEventCreateInfoPort=true, DemExtendedDataClassRef=ExtendedDataClass_240799f9, DemFreezeFrameClassRef=FreezeFrame_a2168519, DemFreezeFrameRecNumClassRef=DemFreezeFrameRecNumClass:
        PTS_Sensor_6_Circuit_Open_B129313: DemEventId=44, DemDTCClassRef=DTCClass_DtcClass_PTS_Sensor_6_Circuit_Open_B129313
          DemEventClass:
            DemAgingAllowed = true
            DemAgingCycleCounterThreshold = 40
            DemEventPriority = 2
            DemEventSignificance = DEM_EVENT_SIGNIFICANCE_FAULT
            DemEventFailureCycleCounterThreshold = 0
            DemConsiderPtoStatus = false
            DemFFPrestorageSupported = false
            DemAgingCycleRef = IgnitionCycle
            DemEnableConditionGroupRef = EnableConditionGroup_2b31122d
            DemOperationCycleRef = IgnitionCycle
            DemDebounceAlgorithmClass
              DemDebounceCounterBased:
                DemDebounceCounterDecrementStepSize = 128
                DemDebounceCounterIncrementStepSize = 127
                DemDebounceCounterJumpDown = false
                DemDebounceCounterJumpUp = false
                DemDebounceBehavior = DEM_DEBOUNCE_FREEZE
                DemDebounceCounterFailedThreshold = 127
                DemDebounceCounterJumpDownValue = 0
                DemDebounceCounterJumpUpValue = 0
                DemDebounceCounterPassedThreshold = -128
                DemDebounceCounterStorage = false
                DemDebounceContinuous = false
        Front_Camera_Circuit_Voltage_Out_of_Range_B23C51C: DemEventId=6, DemDTCClassRef=DTCClass_DtcClass_Front_Camera_Circuit_Voltage_Out_of_Range_B23C51C
          DemEventClass:
            DemAgingAllowed = true
            DemAgingCycleCounterThreshold = 40
            DemEventPriority = 2
            DemEventSignificance = DEM_EVENT_SIGNIFICANCE_FAULT
            DemEventFailureCycleCounterThreshold = 0
            DemConsiderPtoStatus = false
            DemFFPrestorageSupported = false
            DemAgingCycleRef = IgnitionCycle
            DemEnableConditionGroupRef = EnableConditionGroup_a3268155
            DemOperationCycleRef = IgnitionCycle
            DemDebounceAlgorithmClass
              DemDebounceCounterBased:
                DemDebounceCounterDecrementStepSize = 128
                DemDebounceCounterIncrementStepSize = 127
                DemDebounceCounterJumpDown = false
                DemDebounceCounterJumpUp = false
                DemDebounceBehavior = DEM_DEBOUNCE_FREEZE
                DemDebounceCounterFailedThreshold = 127
                DemDebounceCounterJumpDownValue = 0
                DemDebounceCounterJumpUpValue = 0
                DemDebounceCounterPassedThreshold = -128
                DemDebounceCounterStorage = false
                DemDebounceContinuous = false
        Implausible_Data_From_BSC_Module_1_U041800: DemEventId=13, DemDTCClassRef=DTCClass_DtcClass_Implausible_Data_From_BSC_Module_1_U041800
          DemEventClass:
            DemAgingAllowed = true
            DemAgingCycleCounterThreshold = 40
            DemEventPriority = 2
            DemEventSignificance = DEM_EVENT_SIGNIFICANCE_FAULT
            DemEventFailureCycleCounterThreshold = 0
            DemConsiderPtoStatus = false
            DemFFPrestorageSupported = false
            DemAgingCycleRef = IgnitionCycle
            DemEnableConditionGroupRef = EnableConditionGroup_58fca5ad
            DemOperationCycleRef = IgnitionCycle
            DemDebounceAlgorithmClass
              DemDebounceCounterBased:
                DemDebounceCounterDecrementStepSize = 128
                DemDebounceCounterIncrementStepSize = 127
                DemDebounceCounterJumpDown = false
                DemDebounceCounterJumpUp = false
                DemDebounceBehavior = DEM_DEBOUNCE_FREEZE
                DemDebounceCounterFailedThreshold = 127
                DemDebounceCounterJumpDownValue = 0
                DemDebounceCounterJumpUpValue = 0
                DemDebounceCounterPassedThreshold = -128
                DemDebounceCounterStorage = false
                DemDebounceContinuous = false
      DTCClass_DtcClass_Lost_Communication_with_Front_Camera_U026500 (DemDTCClass): DemDTCSeverity=DEM_DTC_SEV_NO_SEVERITY, DemUdsDTC=12739840, DemImmediateNvStorage=false, DemDTCAttributesRef=DtcAttributes_41914fb7
      DTCClass_DtcClass_Lost_Communication_With_BSC_module_1_U012900 (DemDTCClass): DemDTCSeverity=DEM_DTC_SEV_NO_SEVERITY, DemUdsDTC=12658944, DemImmediateNvStorage=false, DemDTCAttributesRef=DtcAttributes_41914fb7
      PTS_Sensor_10_Performance_or_Incorrect_Operation_B129792 (DemEventParameter):
        DemEventKind = DEM_EVENT_KIND_SWC
        DemEventTimeSeries = DEM_TIMESERIES_SNAPSHOT_NONE
        DemEventAvailable = true
        DemEventId = 52
        DemEventAvailableInVariant = true
        DemEventLatchTestFailed = false
        DemEventCreateInfoPort = true
        DemDTCClassRef = DTCClass_DtcClass_PTS_Sensor_10_Performance_or_Incorrect_Operation_B129792
        DemExtendedDataClassRef = ExtendedDataClass_240799f9
        DemFreezeFrameClassRef = FreezeFrame_a2168519
        DemFreezeFrameRecNumClassRef = DemFreezeFrameRecNumClass
        DemEventClass:
          DemAgingAllowed = true
          DemAgingCycleCounterThreshold = 40
          DemEventPriority = 2
          DemEventSignificance = DEM_EVENT_SIGNIFICANCE_FAULT
          DemEventFailureCycleCounterThreshold = 0
          DemConsiderPtoStatus = false
          DemFFPrestorageSupported = false
          DemAgingCycleRef = IgnitionCycle
          DemEnableConditionGroupRef = EnableConditionGroup_2b31122d
          DemOperationCycleRef = IgnitionCycle
          DemDebounceAlgorithmClass
            DemDebounceCounterBased:
              DemDebounceCounterDecrementStepSize = 128
              DemDebounceCounterIncrementStepSize = 127
              DemDebounceCounterJumpDown = false
              DemDebounceCounterJumpUp = false
              DemDebounceBehavior = DEM_DEBOUNCE_FREEZE
              DemDebounceCounterFailedThreshold = 127
              DemDebounceCounterJumpDownValue = 0
              DemDebounceCounterJumpUpValue = 0
              DemDebounceCounterPassedThreshold = -128
              DemDebounceCounterStorage = false
              DemDebounceContinuous = false
      PTS_Sensor_11_Circuit_Open_B129813 (DemEventParameter):
        DemEventKind = DEM_EVENT_KIND_SWC
        DemEventTimeSeries = DEM_TIMESERIES_SNAPSHOT_NONE
        DemEventAvailable = true
        DemEventId = 53
        DemEventAvailableInVariant = true
        DemEventLatchTestFailed = false
        DemEventCreateInfoPort = true
        DemDTCClassRef = DTCClass_DtcClass_PTS_Sensor_11_Circuit_Open_B129813
        DemExtendedDataClassRef = ExtendedDataClass_240799f9
        DemFreezeFrameClassRef = FreezeFrame_a2168519
        DemFreezeFrameRecNumClassRef = DemFreezeFrameRecNumClass
        DemEventClass:
          DemAgingAllowed = true
          DemAgingCycleCounterThreshold = 40
          DemEventPriority = 2
          DemEventSignificance = DEM_EVENT_SIGNIFICANCE_FAULT
          DemEventFailureCycleCounterThreshold = 0
          DemConsiderPtoStatus = false
          DemFFPrestorageSupported = false
          DemAgingCycleRef = IgnitionCycle
          DemEnableConditionGroupRef = EnableConditionGroup_2b31122d
          DemOperationCycleRef = IgnitionCycle
          DemDebounceAlgorithmClass
            DemDebounceCounterBased:
              DemDebounceCounterDecrementStepSize = 128
              DemDebounceCounterIncrementStepSize = 127
              DemDebounceCounterJumpDown = false
              DemDebounceCounterJumpUp = false
              DemDebounceBehavior = DEM_DEBOUNCE_FREEZE
              DemDebounceCounterFailedThreshold = 127
              DemDebounceCounterJumpDownValue = 0
              DemDebounceCounterJumpUpValue = 0
              DemDebounceCounterPassedThreshold = -128
              DemDebounceCounterStorage = false
              DemDebounceContinuous = false
      3 x DemDTCClass, all with DemDTCSeverity=DEM_DTC_SEV_NO_SEVERITY, DemImmediateNvStorage=false, DemDTCAttributesRef=DtcAttributes_41914fb7:
        DTCClass_DtcClass_PTS_Sensor_1_Circuit_Open_B128E13: DemUdsDTC=9604627
        DTCClass_DtcClass_Lost_Communication_with_Left_Camera_U026600: DemUdsDTC=12740096
        DTCClass_DtcClass_Battery_Voltage_Under_Voltage_B210C16: DemUdsDTC=10554390
      ECU_Internal_Performance_B22A900 (DemEventParameter):
        DemEventKind = DEM_EVENT_KIND_SWC
        DemEventTimeSeries = DEM_TIMESERIES_SNAPSHOT_NONE
        DemEventAvailable = true
        DemEventId = 5
        DemEventAvailableInVariant = true
        DemEventLatchTestFailed = false
        DemEventCreateInfoPort = true
        DemDTCClassRef = DTCClass_DtcClass_ECU_Internal_Performance_B22A900
        DemExtendedDataClassRef = ExtendedDataClass_240799f9
        DemFreezeFrameClassRef = FreezeFrame_a2168519
        DemFreezeFrameRecNumClassRef = DemFreezeFrameRecNumClass
        DemEventClass:
          DemAgingAllowed = true
          DemAgingCycleCounterThreshold = 40
          DemEventPriority = 2
          DemEventSignificance = DEM_EVENT_SIGNIFICANCE_FAULT
          DemEventFailureCycleCounterThreshold = 0
          DemConsiderPtoStatus = false
          DemFFPrestorageSupported = false
          DemAgingCycleRef = IgnitionCycle
          DemEnableConditionGroupRef = EnableConditionGroup_EC2
          DemOperationCycleRef = IgnitionCycle
          DemDebounceAlgorithmClass
            DemDebounceCounterBased:
              DemDebounceCounterDecrementStepSize = 128
              DemDebounceCounterIncrementStepSize = 127
              DemDebounceCounterJumpDown = false
              DemDebounceCounterJumpUp = false
              DemDebounceBehavior = DEM_DEBOUNCE_FREEZE
              DemDebounceCounterFailedThreshold = 127
              DemDebounceCounterJumpDownValue = 0
              DemDebounceCounterJumpUpValue = 0
              DemDebounceCounterPassedThreshold = -128
              DemDebounceCounterStorage = false
              DemDebounceContinuous = false
      3 x DemDTCClass, all with DemDTCSeverity=DEM_DTC_SEV_NO_SEVERITY, DemImmediateNvStorage=false, DemDTCAttributesRef=DtcAttributes_41914fb7:
        DTCClass_DtcClass_PTS_Sensor_4_Circuit_Open_B129113: DemUdsDTC=9605395
        DTCClass_DtcClass_Right_Camera_Circuit_Voltage_Out_of_Range_B23C71C: DemUdsDTC=10733340
        DTCClass_DtcClass_PTS_Sensor_10_Circuit_Open_B129713: DemUdsDTC=9606931
      PTS_Sensor_9_Performance_or_Incorrect_Operation_B129692 (DemEventParameter):
        DemEventKind = DEM_EVENT_KIND_SWC
        DemEventTimeSeries = DEM_TIMESERIES_SNAPSHOT_NONE
        DemEventAvailable = true
        DemEventId = 50
        DemEventAvailableInVariant = true
        DemEventLatchTestFailed = false
        DemEventCreateInfoPort = true
        DemDTCClassRef = DTCClass_DtcClass_PTS_Sensor_9_Performance_or_Incorrect_Operation_B129692
        DemExtendedDataClassRef = ExtendedDataClass_240799f9
        DemFreezeFrameClassRef = FreezeFrame_a2168519
        DemFreezeFrameRecNumClassRef = DemFreezeFrameRecNumClass
        DemEventClass:
          DemAgingAllowed = true
          DemAgingCycleCounterThreshold = 40
          DemEventPriority = 2
          DemEventSignificance = DEM_EVENT_SIGNIFICANCE_FAULT
          DemEventFailureCycleCounterThreshold = 0
          DemConsiderPtoStatus = false
          DemFFPrestorageSupported = false
          DemAgingCycleRef = IgnitionCycle
          DemEnableConditionGroupRef = EnableConditionGroup_2b31122d
          DemOperationCycleRef = IgnitionCycle
          DemDebounceAlgorithmClass
            DemDebounceCounterBased:
              DemDebounceCounterDecrementStepSize = 128
              DemDebounceCounterIncrementStepSize = 127
              DemDebounceCounterJumpDown = false
              DemDebounceCounterJumpUp = false
              DemDebounceBehavior = DEM_DEBOUNCE_FREEZE
              DemDebounceCounterFailedThreshold = 127
              DemDebounceCounterJumpDownValue = 0
              DemDebounceCounterJumpUpValue = 0
              DemDebounceCounterPassedThreshold = -128
              DemDebounceCounterStorage = false
              DemDebounceContinuous = false
      DTCClass_DtcClass_Lost_Communication_with_Rear_Camera_U026400 (DemDTCClass): DemDTCSeverity=DEM_DTC_SEV_NO_SEVERITY, DemUdsDTC=12739584, DemImmediateNvStorage=false, DemDTCAttributesRef=DtcAttributes_41914fb7
      DTCClass_DtcClass_Right_Camera_Performance_or_Incorrect_Operation_B23C792 (DemDTCClass): DemDTCSeverity=DEM_DTC_SEV_NO_SEVERITY, DemUdsDTC=10733458, DemImmediateNvStorage=false, DemDTCAttributesRef=DtcAttributes_41914fb7
      5 x DemEventParameter, all with DemEventKind=DEM_EVENT_KIND_SWC, DemEventTimeSeries=DEM_TIMESERIES_SNAPSHOT_NONE, DemEventAvailable=true, DemEventAvailableInVariant=true, DemEventLatchTestFailed=false, DemEventCreateInfoPort=true, DemExtendedDataClassRef=ExtendedDataClass_240799f9, DemFreezeFrameClassRef=FreezeFrame_a2168519, DemFreezeFrameRecNumClassRef=DemFreezeFrameRecNumClass:
        Calibration_Not_Learned_Lost_Calibration_B228600: DemEventId=3, DemDTCClassRef=DTCClass_DtcClass_Calibration_Not_Learned_Lost_Calibration_B228600
          DemEventClass:
            DemAgingAllowed = true
            DemAgingCycleCounterThreshold = 40
            DemEventPriority = 2
            DemEventSignificance = DEM_EVENT_SIGNIFICANCE_FAULT
            DemEventFailureCycleCounterThreshold = 0
            DemConsiderPtoStatus = false
            DemFFPrestorageSupported = false
            DemAgingCycleRef = IgnitionCycle
            DemEnableConditionGroupRef = EnableConditionGroup_dc41854c
            DemOperationCycleRef = IgnitionCycle
            DemDebounceAlgorithmClass
              DemDebounceCounterBased:
                DemDebounceCounterDecrementStepSize = 128
                DemDebounceCounterIncrementStepSize = 127
                DemDebounceCounterJumpDown = false
                DemDebounceCounterJumpUp = false
                DemDebounceBehavior = DEM_DEBOUNCE_FREEZE
                DemDebounceCounterFailedThreshold = 127
                DemDebounceCounterJumpDownValue = 0
                DemDebounceCounterJumpUpValue = 0
                DemDebounceCounterPassedThreshold = -128
                DemDebounceCounterStorage = false
                DemDebounceContinuous = false
        Lost_Communication_with_ORC_U015100: DemEventId=30, DemDTCClassRef=DTCClass_DtcClass_Lost_Communication_with_ORC_U015100
          DemEventClass:
            DemAgingAllowed = true
            DemAgingCycleCounterThreshold = 40
            DemEventPriority = 2
            DemEventSignificance = DEM_EVENT_SIGNIFICANCE_FAULT
            DemEventFailureCycleCounterThreshold = 0
            DemConsiderPtoStatus = false
            DemFFPrestorageSupported = false
            DemAgingCycleRef = IgnitionCycle
            DemEnableConditionGroupRef = EnableConditionGroup_58fca5ad
            DemOperationCycleRef = IgnitionCycle
            DemDebounceAlgorithmClass
              DemDebounceCounterBased:
                DemDebounceCounterDecrementStepSize = 128
                DemDebounceCounterIncrementStepSize = 127
                DemDebounceCounterJumpDown = false
                DemDebounceCounterJumpUp = false
                DemDebounceBehavior = DEM_DEBOUNCE_FREEZE
                DemDebounceCounterFailedThreshold = 127
                DemDebounceCounterJumpDownValue = 0
                DemDebounceCounterJumpUpValue = 0
                DemDebounceCounterPassedThreshold = -128
                DemDebounceCounterStorage = false
                DemDebounceContinuous = false
        PTS_Sensor_1_Circuit_Open_B128E13: DemEventId=34, DemDTCClassRef=DTCClass_DtcClass_PTS_Sensor_1_Circuit_Open_B128E13
          DemEventClass:
            DemAgingAllowed = true
            DemAgingCycleCounterThreshold = 40
            DemEventPriority = 2
            DemEventSignificance = DEM_EVENT_SIGNIFICANCE_FAULT
            DemEventFailureCycleCounterThreshold = 0
            DemConsiderPtoStatus = false
            DemFFPrestorageSupported = false
            DemAgingCycleRef = IgnitionCycle
            DemEnableConditionGroupRef = EnableConditionGroup_2b31122d
            DemOperationCycleRef = IgnitionCycle
            DemDebounceAlgorithmClass
              DemDebounceCounterBased:
                DemDebounceCounterDecrementStepSize = 128
                DemDebounceCounterIncrementStepSize = 127
                DemDebounceCounterJumpDown = false
                DemDebounceCounterJumpUp = false
                DemDebounceBehavior = DEM_DEBOUNCE_FREEZE
                DemDebounceCounterFailedThreshold = 127
                DemDebounceCounterJumpDownValue = 0
                DemDebounceCounterJumpUpValue = 0
                DemDebounceCounterPassedThreshold = -128
                DemDebounceCounterStorage = false
                DemDebounceContinuous = false
        Lost_Communication_with_Rear_Camera_U026400: DemEventId=31, DemDTCClassRef=DTCClass_DtcClass_Lost_Communication_with_Rear_Camera_U026400
          DemEventClass:
            DemAgingAllowed = true
            DemAgingCycleCounterThreshold = 40
            DemEventPriority = 2
            DemEventSignificance = DEM_EVENT_SIGNIFICANCE_FAULT
            DemEventFailureCycleCounterThreshold = 0
            DemConsiderPtoStatus = false
            DemFFPrestorageSupported = false
            DemAgingCycleRef = IgnitionCycle
            DemEnableConditionGroupRef = EnableConditionGroup_dc41854c
            DemOperationCycleRef = IgnitionCycle
            DemDebounceAlgorithmClass
              DemDebounceCounterBased:
                DemDebounceCounterDecrementStepSize = 128
                DemDebounceCounterIncrementStepSize = 127
                DemDebounceCounterJumpDown = false
                DemDebounceCounterJumpUp = false
                DemDebounceBehavior = DEM_DEBOUNCE_FREEZE
                DemDebounceCounterFailedThreshold = 127
                DemDebounceCounterJumpDownValue = 0
                DemDebounceCounterJumpUpValue = 0
                DemDebounceCounterPassedThreshold = -128
                DemDebounceCounterStorage = false
                DemDebounceContinuous = false
        HS_FD_CANR_Comm_Bus_Performance_U100B00: DemEventId=12, DemDTCClassRef=DTCClass_DtcClass_HS_FD_CANR_Comm_Bus_Performance_U100B00
          DemEventClass:
            DemAgingAllowed = true
            DemAgingCycleCounterThreshold = 40
            DemEventPriority = 2
            DemEventSignificance = DEM_EVENT_SIGNIFICANCE_FAULT
            DemEventFailureCycleCounterThreshold = 0
            DemConsiderPtoStatus = false
            DemFFPrestorageSupported = false
            DemAgingCycleRef = IgnitionCycle
            DemEnableConditionGroupRef = EnableConditionGroup_5926f32a
            DemOperationCycleRef = IgnitionCycle
            DemDebounceAlgorithmClass
              DemDebounceCounterBased:
                DemDebounceCounterDecrementStepSize = 128
                DemDebounceCounterIncrementStepSize = 127
                DemDebounceCounterJumpDown = false
                DemDebounceCounterJumpUp = false
                DemDebounceBehavior = DEM_DEBOUNCE_FREEZE
                DemDebounceCounterFailedThreshold = 127
                DemDebounceCounterJumpDownValue = 0
                DemDebounceCounterJumpUpValue = 0
                DemDebounceCounterPassedThreshold = -128
                DemDebounceCounterStorage = false
                DemDebounceContinuous = false
      DTCClass_DtcClass_Rear_Sensors_PS_VltgeAboveThreshold_B212B17 (DemDTCClass): DemDTCSeverity=DEM_DTC_SEV_NO_SEVERITY, DemUdsDTC=10562327, DemImmediateNvStorage=false, DemDTCAttributesRef=DtcAttributes_41914fb7
      Implausible_Data_Received_From_Body_Control_Module_U042200 (DemEventParameter):
        DemEventKind = DEM_EVENT_KIND_SWC
        DemEventTimeSeries = DEM_TIMESERIES_SNAPSHOT_NONE
        DemEventAvailable = true
        DemEventId = 14
        DemEventAvailableInVariant = true
        DemEventLatchTestFailed = false
        DemEventCreateInfoPort = true
        DemDTCClassRef = DTCClass_DtcClass_Implausible_Data_Received_From_Body_Control_Module_U042200
        DemExtendedDataClassRef = ExtendedDataClass_240799f9
        DemFreezeFrameClassRef = FreezeFrame_a2168519
        DemFreezeFrameRecNumClassRef = DemFreezeFrameRecNumClass
        DemEventClass:
          DemAgingAllowed = true
          DemAgingCycleCounterThreshold = 40
          DemEventPriority = 2
          DemEventSignificance = DEM_EVENT_SIGNIFICANCE_FAULT
          DemEventFailureCycleCounterThreshold = 0
          DemConsiderPtoStatus = false
          DemFFPrestorageSupported = false
          DemAgingCycleRef = IgnitionCycle
          DemEnableConditionGroupRef = EnableConditionGroup_9fd149a3
          DemOperationCycleRef = IgnitionCycle
          DemDebounceAlgorithmClass
            DemDebounceCounterBased:
              DemDebounceCounterDecrementStepSize = 128
              DemDebounceCounterIncrementStepSize = 127
              DemDebounceCounterJumpDown = false
              DemDebounceCounterJumpUp = false
              DemDebounceBehavior = DEM_DEBOUNCE_FREEZE
              DemDebounceCounterFailedThreshold = 127
              DemDebounceCounterJumpDownValue = 0
              DemDebounceCounterJumpUpValue = 0
              DemDebounceCounterPassedThreshold = -128
              DemDebounceCounterStorage = false
              DemDebounceContinuous = false
      3 x DemDTCClass, all with DemDTCSeverity=DEM_DTC_SEV_NO_SEVERITY, DemImmediateNvStorage=false, DemDTCAttributesRef=DtcAttributes_41914fb7:
        DTCClass_DtcClass_Front_Camera_Performance_or_Incorrect_Operation_B23C592: DemUdsDTC=10732946
        DTCClass_DtcClass_PTS_Sensor_3_Circuit_Open_B129013: DemUdsDTC=9605139
        DTCClass_DtcClass_Implausible_Data_received_from_TRSKM_module_U14A000: DemUdsDTC=13934592
      4 x DemEventParameter, all with DemEventKind=DEM_EVENT_KIND_SWC, DemEventTimeSeries=DEM_TIMESERIES_SNAPSHOT_NONE, DemEventAvailable=true, DemEventAvailableInVariant=true, DemEventLatchTestFailed=false, DemEventCreateInfoPort=true, DemExtendedDataClassRef=ExtendedDataClass_240799f9, DemFreezeFrameClassRef=FreezeFrame_a2168519, DemFreezeFrameRecNumClassRef=DemFreezeFrameRecNumClass:
        Lost_Communication_With_BCM_U014000: DemEventId=24, DemDTCClassRef=DTCClass_DtcClass_Lost_Communication_With_BCM_U014000
          DemEventClass:
            DemAgingAllowed = true
            DemAgingCycleCounterThreshold = 40
            DemEventPriority = 2
            DemEventSignificance = DEM_EVENT_SIGNIFICANCE_FAULT
            DemEventFailureCycleCounterThreshold = 0
            DemConsiderPtoStatus = false
            DemFFPrestorageSupported = false
            DemAgingCycleRef = IgnitionCycle
            DemEnableConditionGroupRef = EnableConditionGroup_eab14353
            DemOperationCycleRef = IgnitionCycle
            DemDebounceAlgorithmClass
              DemDebounceCounterBased:
                DemDebounceCounterDecrementStepSize = 128
                DemDebounceCounterIncrementStepSize = 127
                DemDebounceCounterJumpDown = false
                DemDebounceCounterJumpUp = false
                DemDebounceBehavior = DEM_DEBOUNCE_FREEZE
                DemDebounceCounterFailedThreshold = 127
                DemDebounceCounterJumpDownValue = 0
                DemDebounceCounterJumpUpValue = 0
                DemDebounceCounterPassedThreshold = -128
                DemDebounceCounterStorage = false
                DemDebounceContinuous = false
        PTS_Sensor_2_Circuit_Open_B128F13: DemEventId=36, DemDTCClassRef=DTCClass_DtcClass_PTS_Sensor_2_Circuit_Open_B128F13
          DemEventClass:
            DemAgingAllowed = true
            DemAgingCycleCounterThreshold = 40
            DemEventPriority = 2
            DemEventSignificance = DEM_EVENT_SIGNIFICANCE_FAULT
            DemEventFailureCycleCounterThreshold = 0
            DemConsiderPtoStatus = false
            DemFFPrestorageSupported = false
            DemAgingCycleRef = IgnitionCycle
            DemEnableConditionGroupRef = EnableConditionGroup_2b31122d
            DemOperationCycleRef = IgnitionCycle
            DemDebounceAlgorithmClass
              DemDebounceCounterBased:
                DemDebounceCounterDecrementStepSize = 128
                DemDebounceCounterIncrementStepSize = 127
                DemDebounceCounterJumpDown = false
                DemDebounceCounterJumpUp = false
                DemDebounceBehavior = DEM_DEBOUNCE_FREEZE
                DemDebounceCounterFailedThreshold = 127
                DemDebounceCounterJumpDownValue = 0
                DemDebounceCounterJumpUpValue = 0
                DemDebounceCounterPassedThreshold = -128
                DemDebounceCounterStorage = false
                DemDebounceContinuous = false
        PTS_Sensor_3_Circuit_Open_B129013: DemEventId=38, DemDTCClassRef=DTCClass_DtcClass_PTS_Sensor_3_Circuit_Open_B129013
          DemEventClass:
            DemAgingAllowed = true
            DemAgingCycleCounterThreshold = 40
            DemEventPriority = 2
            DemEventSignificance = DEM_EVENT_SIGNIFICANCE_FAULT
            DemEventFailureCycleCounterThreshold = 0
            DemConsiderPtoStatus = false
            DemFFPrestorageSupported = false
            DemAgingCycleRef = IgnitionCycle
            DemEnableConditionGroupRef = EnableConditionGroup_2b31122d
            DemOperationCycleRef = IgnitionCycle
            DemDebounceAlgorithmClass
              DemDebounceCounterBased:
                DemDebounceCounterDecrementStepSize = 128
                DemDebounceCounterIncrementStepSize = 127
                DemDebounceCounterJumpDown = false
                DemDebounceCounterJumpUp = false
                DemDebounceBehavior = DEM_DEBOUNCE_FREEZE
                DemDebounceCounterFailedThreshold = 127
                DemDebounceCounterJumpDownValue = 0
                DemDebounceCounterJumpUpValue = 0
                DemDebounceCounterPassedThreshold = -128
                DemDebounceCounterStorage = false
                DemDebounceContinuous = false
        ECU_In_Plant_Mode_C221200: DemEventId=4, DemDTCClassRef=DTCClass_DtcClass_ECU_In_Plant_Mode_C221200
          DemEventClass:
            DemAgingAllowed = true
            DemAgingCycleCounterThreshold = 40
            DemEventPriority = 2
            DemEventSignificance = DEM_EVENT_SIGNIFICANCE_FAULT
            DemEventFailureCycleCounterThreshold = 0
            DemConsiderPtoStatus = false
            DemFFPrestorageSupported = false
            DemAgingCycleRef = IgnitionCycle
            DemEnableConditionGroupRef = EnableConditionGroup_EC2
            DemOperationCycleRef = IgnitionCycle
            DemDebounceAlgorithmClass
              DemDebounceCounterBased:
                DemDebounceCounterDecrementStepSize = 128
                DemDebounceCounterIncrementStepSize = 127
                DemDebounceCounterJumpDown = false
                DemDebounceCounterJumpUp = false
                DemDebounceBehavior = DEM_DEBOUNCE_FREEZE
                DemDebounceCounterFailedThreshold = 127
                DemDebounceCounterJumpDownValue = 0
                DemDebounceCounterJumpUpValue = 0
                DemDebounceCounterPassedThreshold = -128
                DemDebounceCounterStorage = false
                DemDebounceContinuous = false
      3 x DemDTCClass, all with DemDTCSeverity=DEM_DTC_SEV_NO_SEVERITY, DemImmediateNvStorage=false, DemDTCAttributesRef=DtcAttributes_41914fb7:
        DTCClass_DtcClass_PTS_Sensor_12_Circuit_Open_B129913: DemUdsDTC=9607443
        DTCClass_DtcClass_Left_Camera_Performance_or_Incorrect_Operation_B23C692: DemUdsDTC=10733202
        DTCClass_DtcClass_Left_Camera_Circuit_Voltage_Out_of_Range_B23C61C: DemUdsDTC=10733084
      3 x DemEventParameter, all with DemEventKind=DEM_EVENT_KIND_SWC, DemEventTimeSeries=DEM_TIMESERIES_SNAPSHOT_NONE, DemEventAvailable=true, DemEventAvailableInVariant=true, DemEventLatchTestFailed=false, DemEventCreateInfoPort=true, DemExtendedDataClassRef=ExtendedDataClass_240799f9, DemFreezeFrameClassRef=FreezeFrame_a2168519, DemFreezeFrameRecNumClassRef=DemFreezeFrameRecNumClass:
        Implausible_Data_from_ORC_module_U045500: DemEventId=16, DemDTCClassRef=DTCClass_DtcClass_Implausible_Data_from_ORC_module_U045500
          DemEventClass:
            DemAgingAllowed = true
            DemAgingCycleCounterThreshold = 40
            DemEventPriority = 2
            DemEventSignificance = DEM_EVENT_SIGNIFICANCE_FAULT
            DemEventFailureCycleCounterThreshold = 0
            DemConsiderPtoStatus = false
            DemFFPrestorageSupported = false
            DemAgingCycleRef = IgnitionCycle
            DemEnableConditionGroupRef = EnableConditionGroup_58fca5ad
            DemOperationCycleRef = IgnitionCycle
            DemDebounceAlgorithmClass
              DemDebounceCounterBased:
                DemDebounceCounterDecrementStepSize = 128
                DemDebounceCounterIncrementStepSize = 127
                DemDebounceCounterJumpDown = false
                DemDebounceCounterJumpUp = false
                DemDebounceBehavior = DEM_DEBOUNCE_FREEZE
                DemDebounceCounterFailedThreshold = 127
                DemDebounceCounterJumpDownValue = 0
                DemDebounceCounterJumpUpValue = 0
                DemDebounceCounterPassedThreshold = -128
                DemDebounceCounterStorage = false
                DemDebounceContinuous = false
        Right_Camera_Performance_or_Incorrect_Operation_B23C792: DemEventId=64, DemDTCClassRef=DTCClass_DtcClass_Right_Camera_Performance_or_Incorrect_Operation_B23C792
          DemEventClass:
            DemAgingAllowed = true
            DemAgingCycleCounterThreshold = 40
            DemEventPriority = 2
            DemEventSignificance = DEM_EVENT_SIGNIFICANCE_FAULT
            DemEventFailureCycleCounterThreshold = 0
            DemConsiderPtoStatus = false
            DemFFPrestorageSupported = false
            DemAgingCycleRef = IgnitionCycle
            DemEnableConditionGroupRef = EnableConditionGroup_a3268155
            DemOperationCycleRef = IgnitionCycle
            DemDebounceAlgorithmClass
              DemDebounceCounterBased:
                DemDebounceCounterDecrementStepSize = 128
                DemDebounceCounterIncrementStepSize = 127
                DemDebounceCounterJumpDown = false
                DemDebounceCounterJumpUp = false
                DemDebounceBehavior = DEM_DEBOUNCE_FREEZE
                DemDebounceCounterFailedThreshold = 127
                DemDebounceCounterJumpDownValue = 0
                DemDebounceCounterJumpUpValue = 0
                DemDebounceCounterPassedThreshold = -128
                DemDebounceCounterStorage = false
                DemDebounceContinuous = false
        Rear_Sensors_PS_VltgeAboveThreshold_B212B17: DemEventId=61, DemDTCClassRef=DTCClass_DtcClass_Rear_Sensors_PS_VltgeAboveThreshold_B212B17
          DemEventClass:
            DemAgingAllowed = true
            DemAgingCycleCounterThreshold = 40
            DemEventPriority = 2
            DemEventSignificance = DEM_EVENT_SIGNIFICANCE_FAULT
            DemEventFailureCycleCounterThreshold = 0
            DemConsiderPtoStatus = false
            DemFFPrestorageSupported = false
            DemAgingCycleRef = IgnitionCycle
            DemEnableConditionGroupRef = EnableConditionGroup_f0773a88
            DemOperationCycleRef = IgnitionCycle
            DemDebounceAlgorithmClass
              DemDebounceCounterBased:
                DemDebounceCounterDecrementStepSize = 128
                DemDebounceCounterIncrementStepSize = 127
                DemDebounceCounterJumpDown = false
                DemDebounceCounterJumpUp = false
                DemDebounceBehavior = DEM_DEBOUNCE_FREEZE
                DemDebounceCounterFailedThreshold = 127
                DemDebounceCounterJumpDownValue = 0
                DemDebounceCounterJumpUpValue = 0
                DemDebounceCounterPassedThreshold = -128
                DemDebounceCounterStorage = false
                DemDebounceContinuous = false
      DTCClass_DtcClass_Rear_Camera_Circuit_Voltage_Out_of_Range_B217A1C (DemDTCClass): DemDTCSeverity=DEM_DTC_SEV_NO_SEVERITY, DemUdsDTC=10582556, DemImmediateNvStorage=false, DemDTCAttributesRef=DtcAttributes_41914fb7
      PTS_Sensor_6_Performance_or_Incorrect_Operation_B129392 (DemEventParameter):
        DemEventKind = DEM_EVENT_KIND_SWC
        DemEventTimeSeries = DEM_TIMESERIES_SNAPSHOT_NONE
        DemEventAvailable = true
        DemEventId = 66
        DemEventAvailableInVariant = true
        DemEventLatchTestFailed = false
        DemEventCreateInfoPort = true
        DemDTCClassRef = DTCClass_DtcClass_PTS_Sensor_6_Performance_or_Incorrect_Operation_B129392
        DemExtendedDataClassRef = ExtendedDataClass_240799f9
        DemFreezeFrameClassRef = FreezeFrame_a2168519
        DemFreezeFrameRecNumClassRef = DemFreezeFrameRecNumClass
        DemEventClass:
          DemAgingAllowed = true
          DemAgingCycleCounterThreshold = 40
          DemEventPriority = 2
          DemEventSignificance = DEM_EVENT_SIGNIFICANCE_FAULT
          DemEventFailureCycleCounterThreshold = 0
          DemConsiderPtoStatus = false
          DemFFPrestorageSupported = false
          DemAgingCycleRef = IgnitionCycle
          DemEnableConditionGroupRef = EnableConditionGroup_2b31122d
          DemOperationCycleRef = IgnitionCycle
          DemDebounceAlgorithmClass
            DemDebounceCounterBased:
              DemDebounceCounterDecrementStepSize = 128
              DemDebounceCounterIncrementStepSize = 127
              DemDebounceCounterJumpDown = false
              DemDebounceCounterJumpUp = false
              DemDebounceBehavior = DEM_DEBOUNCE_FREEZE
              DemDebounceCounterFailedThreshold = 127
              DemDebounceCounterJumpDownValue = 0
              DemDebounceCounterJumpUpValue = 0
              DemDebounceCounterPassedThreshold = -128
              DemDebounceCounterStorage = false
              DemDebounceContinuous = false
      DTCClass_DtcClass_PTS_Sensor_6_Performance_or_Incorrect_Operation_B129392 (DemDTCClass): DemDTCSeverity=DEM_DTC_SEV_NO_SEVERITY, DemUdsDTC=9606034, DemImmediateNvStorage=false, DemDTCAttributesRef=DtcAttributes_41914fb7
