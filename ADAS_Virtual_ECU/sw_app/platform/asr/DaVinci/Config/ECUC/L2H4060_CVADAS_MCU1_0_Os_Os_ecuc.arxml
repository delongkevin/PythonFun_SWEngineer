AUTOSAR XML (schema 00048)
package /ActiveEcuC
  module config Os: implementation-config-variant=VARIANT-PRE-COMPILE, module-description=Os_Impl
    CounterIsr_SystemTimer (OsIsr):
      OsIsrInterruptPriority = 1
      OsIsrCategory = CATEGORY_2
      OsIsrInterruptType = EXTERNAL
      OsIsrInterruptSource = 39
      OsIsrStackSize = 1024
      OsIsrEnableNesting = false
      OsIsrUsesFpu = false
      OsIsrInitialEnableInterruptSource = false
      OsIsrSpecialFunctionName = Os_TimerPfrtIsr
      OsIsrInterruptMapping = IRQ_LEVEL
    SystemTimer (OsCounter):
      OsCounterMaxAllowedValue = 2147483647
      OsCounterMinCycle = 1
      OsCounterType = HARDWARE
      OsSecondsPerTick = 0.001
      OsCounterTicksPerBase = 19200
      OsCounterAlgorithm = HEAP
      OsCounterAccessingApplication = SystemApplication_OsCore0
      OsCounterAccessingApplication = OsApplication_Trusted_Core0
      OsCounterAccessingApplication = OsApplication_QM
      OsCounterAccessingApplication = OsApplication_Safety
      OsDriver: OsDriverHighResolution=false, OsDriverHardwareTimerChannelRef=MCU_TIMER1_Ch0, OsDriverIsrRef=CounterIsr_SystemTimer
    OsMemoryProtection
      15 x OsMemoryRegion, all with OsMemoryRegionProtectionUnit=Core0_MPU, OsMemoryRegionAccessRights=SUPERVISOR_RWX:
        OsMemoryRegion_0: OsMemoryRegionStartAddress=0, OsMemoryRegionEndAddress=0x80000000, OsMemoryRegionProtectionUnitSlot=0, OsMemoryRegionAccessRights=USER_RWX, OsMemoryRegionFlags=TYPE_STRONGLY_ORDERED
        OsMemoryRegion_1: OsMemoryRegionStartAddress=0, OsMemoryRegionEndAddress=0x8000, OsMemoryRegionProtectionUnitSlot=1, OsMemoryRegionAccessRights=USER_RWX, OsMemoryRegionFlags=TYPE_CACHEABLE_WRITEBACK_ALLOCATE
        OsMemoryRegion_2: OsMemoryRegionStartAddress=0x41000000, OsMemoryRegionEndAddress=0x40000, OsMemoryRegionProtectionUnitSlot=2, OsMemoryRegionAccessRights=USER_RWX, OsMemoryRegionFlags=TYPE_CACHEABLE_WRITEBACK_ALLOCATE
        OsMemoryRegion_3: OsMemoryRegionStartAddress=0x41C00000, OsMemoryRegionEndAddress=0x100000, OsMemoryRegionProtectionUnitSlot=3, OsMemoryRegionAccessRights=USER_RWX, OsMemoryRegionFlags=TYPE_CACHEABLE_WRITEBACK_ALLOCATE
        OsMemoryRegion_4: OsMemoryRegionStartAddress=0x41C00000, OsMemoryRegionEndAddress=0x4000, OsMemoryRegionProtectionUnitSlot=4, OsMemoryRegionAccessRights=USER_RWX, OsMemoryRegionFlags=TYPE_NON_CACHEABLE, OsMemoryRegionFlags=SHAREABLE
        OsMemoryRegion_5: OsMemoryRegionStartAddress=0xD0000000, OsMemoryRegionEndAddress=0x80000, OsMemoryRegionProtectionUnitSlot=5, OsMemoryRegionAccessRights=USER_RWX, OsMemoryRegionFlags=TYPE_NON_CACHEABLE
        OsMemoryRegion_6: OsMemoryRegionStartAddress=0x80000000, OsMemoryRegionEndAddress=0x10000000, OsMemoryRegionProtectionUnitSlot=6, OsMemoryRegionAccessRights=USER_RWX, OsMemoryRegionFlags=TYPE_NON_CACHEABLE
        OsMemoryRegion_7: OsMemoryRegionStartAddress=0x9E000000, OsMemoryRegionEndAddress=0x2000000, OsMemoryRegionProtectionUnitSlot=7, OsMemoryRegionAccessRights=USER_RWX, OsMemoryRegionFlags=TYPE_STRONGLY_ORDERED
        OsMemoryRegion_8: OsMemoryRegionStartAddress=0x50000000, OsMemoryRegionEndAddress=0x8000000, OsMemoryRegionProtectionUnitSlot=8, OsMemoryRegionAccessRights=USER_RWX, OsMemoryRegionFlags=TYPE_CACHEABLE_WRITEBACK_ALLOCATE
        OsMemoryRegion_9: OsMemoryRegionStartAddress=0x57FE0000, OsMemoryRegionEndAddress=0x20000, OsMemoryRegionProtectionUnitSlot=9, OsMemoryRegionAccessRights=USER_RWX, OsMemoryRegionFlags=TYPE_STRONGLY_ORDERED
        OsMemoryRegion_10: OsMemoryRegionStartAddress=0x97800000, OsMemoryRegionEndAddress=0x400000, OsMemoryRegionProtectionUnitSlot=10, OsMemoryRegionAccessRights=USER_RWX, OsMemoryRegionFlags=TYPE_CACHEABLE_WRITEBACK_ALLOCATE
        OsMemoryRegion_11: OsMemoryRegionStartAddress=0xB6C00000, OsMemoryRegionEndAddress=0x80000, OsMemoryRegionProtectionUnitSlot=11, OsMemoryRegionAccessRights=USER_RWX, OsMemoryRegionFlags=TYPE_NON_CACHEABLE
        OsMemoryRegion_12: OsMemoryRegionStartAddress=0x546C0000, OsMemoryRegionEndAddress=0x80, OsMemoryRegionProtectionUnitSlot=12, OsMemoryRegionAccessRights=USER_RWX, OsMemoryRegionFlags=TYPE_NON_CACHEABLE
        OsMemoryRegion_13: OsMemoryRegionStartAddress=0x41C80000, OsMemoryRegionEndAddress=0x40000, OsMemoryRegionProtectionUnitSlot=13, OsMemoryRegionAccessRights=USER_RWX, OsMemoryRegionFlags=TYPE_CACHEABLE_WRITEBACK_ALLOCATE, OsMemoryRegionOwner=OsApplication_Safety
        OsMemoryRegion_14: OsMemoryRegionStartAddress=0x41C80000, OsMemoryRegionEndAddress=0x40000, OsMemoryRegionProtectionUnitSlot=14, OsMemoryRegionAccessRights=USER_RX, OsMemoryRegionFlags=TYPE_CACHEABLE_WRITEBACK_ALLOCATE, OsMemoryRegionOwner=OsApplication_QM
    OsOS:
      OsGenerateMemMapForNearAddressing = false
      OsStackMonitoring = true
      OsStatus = EXTENDED
      OsUseArti = false
      OsUseGetServiceId = false
      OsUseParameterAccess = false
      OsUseResScheduler = false
      OsForcibleTermination = true
      OsGenerateCalloutStubs = true
      OsGenerateMemMap = COMPLETE
      OsGenerateMemMapForThreads = false
      OsServiceProtection = true
      OsStackUsageMeasurement = true
      OsUseXSignalAsyncApiCalls = false
      OsFpuUsage = INDIVIDUAL
      OsUseCase = STANDARD
      OsScalabilityClass = SC3
      OsNumberOfCores = 1
      OsMasterCore = OsCore0
      OsSystemTimer = SystemTimer
      OsHooks: OsErrorHook=true, OsPostTaskHook=false, OsPreTaskHook=false, OsShutdownHook=true, OsStartupHook=false, OsPanicHook=true, OsProtectionHook=true
      OsStackSummary
        24 x OsStack, all with OsStackCore=OsCore0:
          OsCore0_Kernel: OsStackSize=1024, OsStackType=CORE_KERNEL_STACK, OsStackUser=OsCore0
          OsCore0_Init: OsStackSize=1024, OsStackType=CORE_INIT_STACK, OsStackUser=OsCore0
          OsCore0_Error: OsStackSize=1024, OsStackType=CORE_ERROR_STACK, OsStackUser=OsCore0
          OsCore0_Task_Prio4294967295: OsStackSize=1024, OsStackType=TASK_SHARED_PRIORITY_STACK, OsStackUser=IdleTask_OsCore0
          OsCore0_Isr_Core: OsStackSize=1024, OsStackType=ISR_SHARED_CORE_STACK, OsStackUser=CounterIsr_SystemTimer, OsStackUser=ADC0, OsStackUser=ADC1, OsStackUser=IPC_mailbox2, OsStackUser=SciServer_OsIsr_UserMsgHwiFxn4, OsStackUser=SciServer_OsIsr_UserMsgHwiFxn2, OsStackUser=SciServer_OsIsr_UserMsgHwiFxn3, OsStackUser=SciServer_OsIsr_UserMsgHwiFxn1, OsStackUser=I2c_IrqUnit1, OsStackUser=MCU_NAVSS0_UDMASS_INTA_0_INTAGGR_VINTR_PEND_78, OsStackUser=I2c_IrqUnit0, OsStackUser=IPC_mailbox1, OsStackUser=MCU_NAVSS0_UDMASS_INTA_0_INTAGGR_VINTR_PEND_79, OsStackUser=Can_30_McanIsr_0, OsStackUser=Can_30_McanIsr_1, OsStackUser=vHsmResponseIsr, OsStackUser=MCU_ESM0_ESM_INT_HI_LVL_0, OsStackUser=MCU_ESM0_ESM_INT_LOW_LVL_0, OsStackUser=MCU_ESM0_ESM_INT_CFG_LVL_0, OsStackUser=WKUP_ESM0_ESM_INT_HI_LVL_0, OsStackUser=WKUP_ESM0_ESM_INT_LOW_LVL_0, OsStackUser=WKUP_ESM0_ESM_INT_CFG_LVL_0, OsStackUser=MAIN_ESM0_ESM_INT_HI_LVL_0, OsStackUser=MAIN_ESM0_ESM_INT_LOW_LVL_0, OsStackUser=MAIN_ESM0_ESM_INT_CFG_LVL_0, OsStackUser=SDLR_MCU_R5FSS0_CORE0_INTR_GLUELOGIC_MAIN_PULSAR0_LBIST_GLUE_DFT_LBIST_BIST_DONE_0_297, OsStackUser=SDLR_MCU_R5FSS0_CORE0_INTR_GLUELOGIC_MAIN_PULSAR1_LBIST_GLUE_DFT_LBIST_BIST_DONE_0_298, OsStackUser=SDLR_MCU_R5FSS0_CORE0_INTR_COMPUTE_CLUSTER0_AC71_4_DFT_LBIST_DFT_LBIST_BIST_DONE_0_295, OsStackUser=SDLR_MCU_R5FSS0_CORE0_INTR_COMPUTE_CLUSTER0_AC71_5_DFT_LBIST_DFT_LBIST_BIST_DONE_0_296, OsStackUser=SDLR_MCU_R5FSS0_CORE0_INTR_COMPUTE_CLUSTER0_ARM0_DFT_LBIST_DFT_LBIST_BIST_DONE_0_291, OsStackUser=SDLR_MCU_R5FSS0_CORE0_INTR_GLUELOGIC_DMPAC_LBIST_GLUE_DFT_LBIST_BIST_DONE_0_299, OsStackUser=SDLR_MCU_R5FSS0_CORE0_INTR_GLUELOGIC_VPAC_LBIST_GLUE_DFT_LBIST_BIST_DONE_0_300, OsStackUser=SDLR_MCU_R5FSS0_CORE0_INTR_AEP_GPU_BXS464_WRAP0_DFT_EMBED_PBIST_0_DFT_PBIST_CPU_0_317, OsStackUser=SDLR_MCU_R5FSS0_CORE0_INTR_COMPUTE_CLUSTER0_PBIST_WRAP_0_DFT_PBIST_CPU_0_290, OsStackUser=SDLR_MCU_R5FSS0_CORE0_INTR_MCU_PBIST0_DFT_PBIST_CPU_0_47, OsStackUser=SDLR_MCU_R5FSS0_CORE0_INTR_MCU_PBIST1_DFT_PBIST_CPU_0_36, OsStackUser=SDLR_MCU_R5FSS0_CORE0_INTR_MCU_PBIST2_DFT_PBIST_CPU_0_37, OsStackUser=SDLR_MCU_R5FSS0_CORE0_INTR_PBIST0_DFT_PBIST_CPU_0_312, OsStackUser=SDLR_MCU_R5FSS0_CORE0_INTR_PBIST10_DFT_PBIST_CPU_0_310, OsStackUser=SDLR_MCU_R5FSS0_CORE0_INTR_PBIST11_DFT_PBIST_CPU_0_314, OsStackUser=SDLR_MCU_R5FSS0_CORE0_INTR_PBIST2_DFT_PBIST_CPU_0_309, OsStackUser=SDLR_MCU_R5FSS0_CORE0_INTR_PBIST3_DFT_PBIST_CPU_0_307, OsStackUser=SDLR_MCU_R5FSS0_CORE0_INTR_PBIST4_DFT_PBIST_CPU_0_308, OsStackUser=SDLR_MCU_R5FSS0_CORE0_INTR_PBIST5_DFT_PBIST_CPU_0_306, OsStackUser=SDLR_MCU_R5FSS0_CORE0_INTR_PBIST7_DFT_PBIST_CPU_0_304, OsStackUser=SDLR_MCU_R5FSS0_CORE0_INTR_PBIST8_DFT_PBIST_CPU_0_305, OsStackUser=SDLR_MCU_R5FSS0_CORE0_INTR_PBIST1_DFT_PBIST_CPU_0_313
          OsCore0_Task_Prio100: OsStackSize=2048, OsStackType=TASK_SHARED_PRIORITY_STACK, OsStackUser=StartUpTask, OsStackUser=ShutdownTask
          SciServerLowOsTask: OsStackSize=4096, OsStackType=TASK_EXTENDED_STACK, OsStackUser=Os/SciServerLowOsTask
          SciServerHighOsTask: OsStackSize=4096, OsStackType=TASK_EXTENDED_STACK, OsStackUser=Os/SciServerHighOsTask
          OsCore0_Protection: OsStackSize=1024, OsStackType=CORE_PROTECTION_STACK, OsStackUser=OsCore0
          OsCore0_Shutdown: OsStackSize=1024, OsStackType=CORE_SHUTDOWN_STACK, OsStackUser=OsCore0
          QM_Task_200ms: OsStackSize=2048, OsStackType=TASK_EXTENDED_STACK, OsStackUser=Os/QM_Task_200ms
          BootAppOsTask: OsStackSize=4096, OsStackType=TASK_EXTENDED_STACK, OsStackUser=Os/BootAppOsTask
          OsCore0_Task_Prio54: OsStackSize=4096, OsStackType=TASK_SHARED_PRIORITY_STACK, OsStackUser=QM_Task_00_10ms
          OsCore0_Task_Prio50: OsStackSize=16384, OsStackType=TASK_SHARED_PRIORITY_STACK, OsStackUser=QM_Task_01_10ms
          OsCore0_Task_Prio90: OsStackSize=8192, OsStackType=TASK_SHARED_PRIORITY_STACK, OsStackUser=Safety_Task_Init
          OsCore0_Task_Prio88: OsStackSize=2048, OsStackType=TASK_SHARED_PRIORITY_STACK, OsStackUser=QM_Task_Init
          OsCore0_Task_Prio79: OsStackSize=8192, OsStackType=TASK_SHARED_PRIORITY_STACK, OsStackUser=Safety_Task_00_10ms
          OsCore0_Task_Prio78: OsStackSize=32768, OsStackType=TASK_SHARED_PRIORITY_STACK, OsStackUser=Safety_Task_01_10ms
          Safety_WdgTask_10ms: OsStackSize=4096, OsStackType=TASK_EXTENDED_STACK, OsStackUser=Os/Safety_WdgTask_10ms
          Safety_Task_200ms: OsStackSize=1024, OsStackType=TASK_EXTENDED_STACK, OsStackUser=Os/Safety_Task_200ms
          QM_ComTask_10ms: OsStackSize=4096, OsStackType=TASK_EXTENDED_STACK, OsStackUser=Os/QM_ComTask_10ms
          QM_ComTask_5ms: OsStackSize=1024, OsStackType=TASK_EXTENDED_STACK, OsStackUser=Os/QM_ComTask_5ms
          QM_DiagTask_10ms: OsStackSize=4096, OsStackType=TASK_EXTENDED_STACK, OsStackUser=Os/QM_DiagTask_10ms
          QM_MemTask_10ms: OsStackSize=1024, OsStackType=TASK_EXTENDED_STACK, OsStackUser=Os/QM_MemTask_10ms
      OsDebug: OsAssertions=false, OsTimingHooksIncludeHeader=MeOsProfiling_ASR.h, OsORTIDebugSupport=ORTI_23_ADDITIONAL
    OsPublishedInformation: OsKernelVersion=7, OsPlatformName=Arm
      Jacinto7 (OsDerivativeInformation):
        OsMpuAlignment = SIZE
        OsMpuEndAddressAccessible = true
        OsStackAlignment = 0
        OsExceptionVectorTableAlignment = 0
        OsInterruptVectorTableAlignment = 0
        OsHardwareManuals = J721E DRA829/TDA4VM/AM752x Processors Technical Reference Manual, Silicon Revision 1.0, May 2019 - Revised November 2019 TDA4VM Jacinto Automotive Processors for ADAS and Autonomous Vehicles, Silicon Revision 1.0, February 2019 – Revised October 2019 Cortex-R5 and Cortex-R5F Technical Reference Manual Revision: r1p1, February 2011 J721S2 TDA4VE TDA4AL TDA4VL Processors Silicon Revision 1.0 February 2022 – Revised July 2022 J784S4, TDA4AP, TDA4VP, TDA4AH, TDA4VH Processors Technical Reference Manual, Silicon Revision 1.0, March 2022 – Revised August 2022
        OsMpuPrivilegedRegionsConfigurable = false
        OsMemoryRegionSpecifics
          10 x OsMemoryRegionAccess:
            SUPERVISOR_R: OsMemoryRegionAccessRights=R, OsMemoryRegionAccessType=SUPERVISOR
            SUPERVISOR_RW: OsMemoryRegionAccessRights=RW, OsMemoryRegionAccessType=SUPERVISOR
            USER_R: OsMemoryRegionAccessRights=R, OsMemoryRegionAccessType=USER
            USER_RW: OsMemoryRegionAccessRights=RW, OsMemoryRegionAccessType=USER
            SUPERVISOR_NONE: OsMemoryRegionAccessRights=NONE, OsMemoryRegionAccessType=SUPERVISOR
            USER_NONE: OsMemoryRegionAccessRights=NONE, OsMemoryRegionAccessType=USER
            SUPERVISOR_RX: OsMemoryRegionAccessRights=RX, OsMemoryRegionAccessType=SUPERVISOR
            SUPERVISOR_RWX: OsMemoryRegionAccessRights=RWX, OsMemoryRegionAccessType=SUPERVISOR
            USER_RX: OsMemoryRegionAccessRights=RX, OsMemoryRegionAccessType=USER
            USER_RWX: OsMemoryRegionAccessRights=RWX, OsMemoryRegionAccessType=USER
          32 x OsMemoryRegionFlag:
            SHAREABLE
            TYPE_STRONGLY_ORDERED
            TYPE_NON_CACHEABLE
            TYPE_CACHEABLE_WRITEBACK_ALLOCATE
            TYPE_SHAREABLE_DEVICE
            TYPE_NON_SHAREABLE_DEVICE
            TYPE_CACHEABLE_WRITETHROUGH_NO_ALLOCATE
            TYPE_CACHEABLE_WRITEBACK_NO_ALLOCATE
            SUBREGION_{0..7}_DISABLE
            TYPE_OUTER_NON_CACHEABLE_INNER_NON_CACHEABLE
            TYPE_OUTER_NON_CACHEABLE_INNER_WRITEBACK_ALLOCATE
            TYPE_OUTER_NON_CACHEABLE_INNER_WRITETHROUGH_NO_ALLOCATE
            TYPE_OUTER_NON_CACHEABLE_INNER_WRITEBACK_NO_ALLOCATE
            TYPE_OUTER_WRITEBACK_ALLOCATE_INNER_NON_CACHEABLE
            TYPE_OUTER_WRITEBACK_ALLOCATE_INNER_WRITEBACK_ALLOCATE
            TYPE_OUTER_WRITEBACK_ALLOCATE_INNER_WRITETHROUGH_NO_ALLOCATE
            TYPE_OUTER_WRITEBACK_ALLOCATE_INNER_WRITEBACK_NO_ALLOCATE
            TYPE_OUTER_WRITETHROUGH_NO_ALLOCATE_INNER_NON_CACHEABLE
            TYPE_OUTER_WRITETHROUGH_NO_ALLOCATE_INNER_WRITEBACK_ALLOCATE
            TYPE_OUTER_WRITETHROUGH_NO_ALLOCATE_INNER_WRITETHROUGH_NO_ALLOCATE
            TYPE_OUTER_WRITETHROUGH_NO_ALLOCATE_INNER_WRITEBACK_NO_ALLOCATE
            TYPE_OUTER_WRITEBACK_NO_ALLOCATE_INNER_NON_CACHEABLE
            TYPE_OUTER_WRITEBACK_NO_ALLOCATE_INNER_WRITEBACK_ALLOCATE
            TYPE_OUTER_WRITEBACK_NO_ALLOCATE_INNER_WRITETHROUGH_NO_ALLOCATE
            TYPE_OUTER_WRITEBACK_NO_ALLOCATE_INNER_WRITEBACK_NO_ALLOCATE
        OsMemoryRegionDefaults_AppNT (OsMemoryRegionDefaults):
          OsMemoryRegionDefIdentifier = 1
          OsMemoryRegionDefType = APPLICATION_NONPRIVILEGED
          OsMemoryRegionDefProtectionUnitSlot = 14
          OsMemoryRegionDefAccessRights = SUPERVISOR_RW
          OsMemoryRegionDefAccessRights = USER_RW
          OsMemoryRegionDefFlags = TYPE_CACHEABLE_WRITEBACK_ALLOCATE
        6 x OsPhysicalCore, all with OsPhysicalCoreType=Cortex-R_Jacinto7, OsPhysicalCoreExceptionSources=8, OsPhysicalCoreIsAutostart=true, OsPhysicalCoreMasterStartAllowed=false, OsPhysicalCorePrivelegedHwAccess=true:
          Core0: OsPhysicalCoreId=0, OsPhysicalCoreDefaultEntrySymbol=_start, OsPhysicalCoreStackProtectionUnit=Core0_MPU
            Core0_MPU (OsPhysicalCoreMpu): OsPhysicalCoreMpuMaxRegions=16, OsPhysicalCoreMpuId=0, OsPhysicalCoreMpuType=CoreMpu
            VIM_Jacinto7 (OsPhysicalCoreIntCtrl): OsPhysicalCoreIntCtrlMaxPrios=15, OsPhysicalCoreIntCtrlMaxSources=383, OsPhysicalCoreIntCtrlPrioOrder=DESC
              OsPhysicalCoreIntCtrlAddress: OsPhysicalCoreIntCtrlAddressValue=1089994752
            SPINLOCK (OsPhysicalCoreAddress): OsPhysicalCoreAddressValue=819986432
          Core1: OsPhysicalCoreId=1, OsPhysicalCoreDefaultEntrySymbol=_start_c1, OsPhysicalCoreStackProtectionUnit=Core1_MPU
            Core1_MPU (OsPhysicalCoreMpu): OsPhysicalCoreMpuMaxRegions=16, OsPhysicalCoreMpuId=0, OsPhysicalCoreMpuType=CoreMpu
            VIM_Jacinto7 (OsPhysicalCoreIntCtrl): OsPhysicalCoreIntCtrlMaxPrios=15, OsPhysicalCoreIntCtrlMaxSources=383, OsPhysicalCoreIntCtrlPrioOrder=DESC
              OsPhysicalCoreIntCtrlAddress: OsPhysicalCoreIntCtrlAddressValue=1089994752
          Core2: OsPhysicalCoreId=2, OsPhysicalCoreDefaultEntrySymbol=_start_c2, OsPhysicalCoreStackProtectionUnit=Core2_MPU
            Core2_MPU (OsPhysicalCoreMpu): OsPhysicalCoreMpuMaxRegions=16, OsPhysicalCoreMpuId=0, OsPhysicalCoreMpuType=CoreMpu
            VIM_Jacinto7 (OsPhysicalCoreIntCtrl): OsPhysicalCoreIntCtrlMaxPrios=15, OsPhysicalCoreIntCtrlMaxSources=511, OsPhysicalCoreIntCtrlPrioOrder=DESC
              OsPhysicalCoreIntCtrlAddress: OsPhysicalCoreIntCtrlAddressValue=267911168
          Core3: OsPhysicalCoreId=3, OsPhysicalCoreDefaultEntrySymbol=_start_c3, OsPhysicalCoreStackProtectionUnit=Core3_MPU
            Core3_MPU (OsPhysicalCoreMpu): OsPhysicalCoreMpuMaxRegions=16, OsPhysicalCoreMpuId=0, OsPhysicalCoreMpuType=CoreMpu
            VIM_Jacinto7 (OsPhysicalCoreIntCtrl): OsPhysicalCoreIntCtrlMaxPrios=15, OsPhysicalCoreIntCtrlMaxSources=511, OsPhysicalCoreIntCtrlPrioOrder=DESC
              OsPhysicalCoreIntCtrlAddress: OsPhysicalCoreIntCtrlAddressValue=267911168
          Core4: OsPhysicalCoreId=4, OsPhysicalCoreDefaultEntrySymbol=_start_c4, OsPhysicalCoreStackProtectionUnit=Core4_MPU
            Core4_MPU (OsPhysicalCoreMpu): OsPhysicalCoreMpuMaxRegions=16, OsPhysicalCoreMpuId=0, OsPhysicalCoreMpuType=CoreMpu
            VIM_Jacinto7 (OsPhysicalCoreIntCtrl): OsPhysicalCoreIntCtrlMaxPrios=15, OsPhysicalCoreIntCtrlMaxSources=511, OsPhysicalCoreIntCtrlPrioOrder=DESC
              OsPhysicalCoreIntCtrlAddress: OsPhysicalCoreIntCtrlAddressValue=267911168
          Core5: OsPhysicalCoreId=5, OsPhysicalCoreDefaultEntrySymbol=_start_c5, OsPhysicalCoreStackProtectionUnit=Core5_MPU
            Core5_MPU (OsPhysicalCoreMpu): OsPhysicalCoreMpuMaxRegions=16, OsPhysicalCoreMpuId=0, OsPhysicalCoreMpuType=CoreMpu
            VIM_Jacinto7 (OsPhysicalCoreIntCtrl): OsPhysicalCoreIntCtrlMaxPrios=15, OsPhysicalCoreIntCtrlMaxSources=511, OsPhysicalCoreIntCtrlPrioOrder=DESC
              OsPhysicalCoreIntCtrlAddress: OsPhysicalCoreIntCtrlAddressValue=267911168
        18 x OsHardwareTimer, all with OsHardwareTimerSize=32, OsHardwareTimerUnit=FRT, OsHardwareTimerType=TIMER_Jacinto7:
          MCU_TIMER0: OsHardwareTimerBaseAddress=1077936128, OsHardwareTimerId=0
            MCU_TIMER0_Ch0 (OsHardwareTimerChannel): OsHardwareTimerChannelOffset=0, OsHardwareTimerChannelIntSource=38, OsHardwareTimerChannelId=0
          MCU_TIMER1: OsHardwareTimerBaseAddress=1078001664, OsHardwareTimerId=1
            MCU_TIMER1_Ch0 (OsHardwareTimerChannel): OsHardwareTimerChannelOffset=0, OsHardwareTimerChannelIntSource=39, OsHardwareTimerChannelId=0
          MCU_TIMER2: OsHardwareTimerBaseAddress=1078067200, OsHardwareTimerId=2
            MCU_TIMER2_Ch0 (OsHardwareTimerChannel): OsHardwareTimerChannelOffset=0, OsHardwareTimerChannelIntSource=40, OsHardwareTimerChannelId=0
          MCU_TIMER3: OsHardwareTimerBaseAddress=1078132736, OsHardwareTimerId=3
            MCU_TIMER3_Ch0 (OsHardwareTimerChannel): OsHardwareTimerChannelOffset=0, OsHardwareTimerChannelIntSource=41, OsHardwareTimerChannelId=0
          MCU_TIMER4: OsHardwareTimerBaseAddress=1078198272, OsHardwareTimerId=4
            MCU_TIMER4_Ch0 (OsHardwareTimerChannel): OsHardwareTimerChannelOffset=0, OsHardwareTimerChannelIntSource=108, OsHardwareTimerChannelId=0
          MCU_TIMER5: OsHardwareTimerBaseAddress=1078263808, OsHardwareTimerId=5
            MCU_TIMER5_Ch0 (OsHardwareTimerChannel): OsHardwareTimerChannelOffset=0, OsHardwareTimerChannelIntSource=109, OsHardwareTimerChannelId=0
          MCU_TIMER6: OsHardwareTimerBaseAddress=1078329344, OsHardwareTimerId=6
            MCU_TIMER6_Ch0 (OsHardwareTimerChannel): OsHardwareTimerChannelOffset=0, OsHardwareTimerChannelIntSource=110, OsHardwareTimerChannelId=0
          MCU_TIMER7: OsHardwareTimerBaseAddress=1078394880, OsHardwareTimerId=7
            MCU_TIMER7_Ch0 (OsHardwareTimerChannel): OsHardwareTimerChannelOffset=0, OsHardwareTimerChannelIntSource=111, OsHardwareTimerChannelId=0
          MCU_TIMER8: OsHardwareTimerBaseAddress=1078460416, OsHardwareTimerId=8
            MCU_TIMER8_Ch0 (OsHardwareTimerChannel): OsHardwareTimerChannelOffset=0, OsHardwareTimerChannelIntSource=112, OsHardwareTimerChannelId=0
          MCU_TIMER9: OsHardwareTimerBaseAddress=1078525952, OsHardwareTimerId=9
            MCU_TIMER9_Ch0 (OsHardwareTimerChannel): OsHardwareTimerChannelOffset=0, OsHardwareTimerChannelIntSource=113, OsHardwareTimerChannelId=0
          MAIN_TIMER12: OsHardwareTimerBaseAddress=38535168, OsHardwareTimerId=22
            MAIN_TIMER12_Ch0 (OsHardwareTimerChannel): OsHardwareTimerChannelOffset=0, OsHardwareTimerChannelIntSource=168, OsHardwareTimerChannelId=0
          MAIN_TIMER13: OsHardwareTimerBaseAddress=38600704, OsHardwareTimerId=23
            MAIN_TIMER13_Ch0 (OsHardwareTimerChannel): OsHardwareTimerChannelOffset=0, OsHardwareTimerChannelIntSource=169, OsHardwareTimerChannelId=0
          MAIN_TIMER14: OsHardwareTimerBaseAddress=38666240, OsHardwareTimerId=24
            MAIN_TIMER14_Ch0 (OsHardwareTimerChannel): OsHardwareTimerChannelOffset=0, OsHardwareTimerChannelIntSource=170, OsHardwareTimerChannelId=0
          MAIN_TIMER15: OsHardwareTimerBaseAddress=38731776, OsHardwareTimerId=25
            MAIN_TIMER15_Ch0 (OsHardwareTimerChannel): OsHardwareTimerChannelOffset=0, OsHardwareTimerChannelIntSource=171, OsHardwareTimerChannelId=0
          MAIN_TIMER16: OsHardwareTimerBaseAddress=38797312, OsHardwareTimerId=26
            MAIN_TIMER16_Ch0 (OsHardwareTimerChannel): OsHardwareTimerChannelOffset=0, OsHardwareTimerChannelIntSource=172, OsHardwareTimerChannelId=0
          MAIN_TIMER17: OsHardwareTimerBaseAddress=38862848, OsHardwareTimerId=27
            MAIN_TIMER17_Ch0 (OsHardwareTimerChannel): OsHardwareTimerChannelOffset=0, OsHardwareTimerChannelIntSource=173, OsHardwareTimerChannelId=0
          MAIN_TIMER18: OsHardwareTimerBaseAddress=38928384, OsHardwareTimerId=28
            MAIN_TIMER18_Ch0 (OsHardwareTimerChannel): OsHardwareTimerChannelOffset=0, OsHardwareTimerChannelIntSource=174, OsHardwareTimerChannelId=0
          MAIN_TIMER19: OsHardwareTimerBaseAddress=38993920, OsHardwareTimerId=29
            MAIN_TIMER19_Ch0 (OsHardwareTimerChannel): OsHardwareTimerChannelOffset=0, OsHardwareTimerChannelIntSource=175, OsHardwareTimerChannelId=0
        4 x OsInterruptSupportedType, all with OsInterruptSupportedTypeSeparateSources=true, OsInterruptSupportedTypeSeparatePriority=false:
          FIQ_LEVEL: OsInterruptSupportedTypeIsMapped=true, OsInterruptSupportedTypePostActionRequired=true
          FIQ_PULSE: OsInterruptSupportedTypeIsMapped=true, OsInterruptSupportedTypePostActionRequired=false
          IRQ_LEVEL: OsInterruptSupportedTypeIsMapped=false, OsInterruptSupportedTypePostActionRequired=true
          IRQ_PULSE: OsInterruptSupportedTypeIsMapped=false, OsInterruptSupportedTypePostActionRequired=false
        Core6 (OsPhysicalCore):
          OsPhysicalCoreId = 6
          OsPhysicalCoreType = Cortex-R_Jacinto7
          OsPhysicalCoreExceptionSources = 8
          OsPhysicalCoreIsAutostart = true
          OsPhysicalCoreMasterStartAllowed = false
          OsPhysicalCorePrivelegedHwAccess = true
          OsPhysicalCoreDefaultEntrySymbol = _start_c6
          OsPhysicalCoreStackProtectionUnit = Core6_MPU
          Core6_MPU (OsPhysicalCoreMpu): OsPhysicalCoreMpuMaxRegions=16, OsPhysicalCoreMpuId=0, OsPhysicalCoreMpuType=CoreMpu
          VIM_Jacinto7 (OsPhysicalCoreIntCtrl): OsPhysicalCoreIntCtrlMaxPrios=15, OsPhysicalCoreIntCtrlMaxSources=511, OsPhysicalCoreIntCtrlPrioOrder=DESC
            OsPhysicalCoreIntCtrlAddress: OsPhysicalCoreIntCtrlAddressValue=267911168
        Core7 (OsPhysicalCore):
          OsPhysicalCoreId = 7
          OsPhysicalCoreType = Cortex-R_Jacinto7
          OsPhysicalCoreExceptionSources = 8
          OsPhysicalCoreIsAutostart = true
          OsPhysicalCoreMasterStartAllowed = false
          OsPhysicalCorePrivelegedHwAccess = true
          OsPhysicalCoreDefaultEntrySymbol = _start_c7
          OsPhysicalCoreStackProtectionUnit = Core7_MPU
          Core7_MPU (OsPhysicalCoreMpu): OsPhysicalCoreMpuMaxRegions=16, OsPhysicalCoreMpuId=0, OsPhysicalCoreMpuType=CoreMpu
          VIM_Jacinto7 (OsPhysicalCoreIntCtrl): OsPhysicalCoreIntCtrlMaxPrios=15, OsPhysicalCoreIntCtrlMaxSources=511, OsPhysicalCoreIntCtrlPrioOrder=DESC
            OsPhysicalCoreIntCtrlAddress: OsPhysicalCoreIntCtrlAddressValue=267911168
    OSDEFAULTAPPMODE (OsAppMode)
    OS_APPMODE_ANY (OsAppMode)
    OsCore0 (OsCore):
      OsCoreIsAutostart = true
      OsCoreIsAutosar = true
      OsCoreEntrySymbol = _c_int00
      OsCorePhysicalCoreRef = Core0
      OsCoreEcucCoreRef = EcucCoreDefinition
      OsCoreIdleTask = IdleTask_OsCore0
      OsCoreSystemApplication = SystemApplication_OsCore0
      OsCoreStacks:
        OsCoreKernelStackSize = 1024
        OsCoreStartupStackSize = 1024
        OsCoreShutdownStackSize = 1024
        OsCoreErrorStackSize = 1024
        OsCoreProtectionStackSize = 1024
        OsCoreInitStackSize = 1024
    IdleTask_OsCore0 (OsTask):
      OsTaskActivation = 1
      OsTaskPriority = 4294967295
      OsTaskSchedule = FULL
      OsTaskStackSharing = false
      OsTaskStackSize = 1024
      OsTaskType = AUTO
      OsTaskUsesFpu = false
      OsTaskAccessingApplication = SystemApplication_OsCore0
      OsTaskResourceRef = OsResource
      OsTaskAccessingApplication = OsApplication_Trusted_Core0
      OsTaskAccessingApplication = OsApplication_QM
      OsTaskAccessingApplication = OsApplication_Safety
      OsTaskAutostart: OsTaskAppModeRef=OS_APPMODE_ANY
    SystemApplication_OsCore0 (OsApplication):
      OsTrusted = true
      OsTrustedApplicationDelayTimingViolationCall = false
      OsTrustedApplicationWithProtection = false
      OsApplicationIsPrivileged = true
      OsAppUseTrustedFunctionStubs = false
      OsApplicationCoreRef = EcucCoreDefinition
      OsAppCounterRef = SystemTimer
      OsAppTaskRef = IdleTask_OsCore0
      OsAppIsrRef = CounterIsr_SystemTimer
      OsAppTaskRef = Os/BootAppOsTask
      OsAppTaskRef = Os/SciServerLowOsTask
      OsAppTaskRef = StartUpTask
      OsAppTaskRef = Os/SciServerHighOsTask
      OsAppIsrRef = ADC0
      OsAppIsrRef = ADC1
      OsAppIsrRef = IPC_mailbox2
      OsAppIsrRef = SciServer_OsIsr_UserMsgHwiFxn4
      OsAppIsrRef = SciServer_OsIsr_UserMsgHwiFxn2
      OsAppIsrRef = SciServer_OsIsr_UserMsgHwiFxn3
      OsAppIsrRef = SciServer_OsIsr_UserMsgHwiFxn1
      OsAppIsrRef = I2c_IrqUnit1
      OsAppIsrRef = MCU_NAVSS0_UDMASS_INTA_0_INTAGGR_VINTR_PEND_78
      OsAppIsrRef = I2c_IrqUnit0
      OsAppIsrRef = IPC_mailbox1
      OsAppIsrRef = MCU_NAVSS0_UDMASS_INTA_0_INTAGGR_VINTR_PEND_79
      OsAppIsrRef = Can_30_McanIsr_0
      OsAppIsrRef = Can_30_McanIsr_1
      OsAppEcucPartitionRef = EcucPartition
      OsAppIsrRef = vHsmResponseIsr
      OsAppTaskRef = ShutdownTask
      OsAppIsrRef = MCU_ESM0_ESM_INT_HI_LVL_0
      OsAppIsrRef = MCU_ESM0_ESM_INT_LOW_LVL_0
      OsAppIsrRef = MCU_ESM0_ESM_INT_CFG_LVL_0
      OsAppIsrRef = WKUP_ESM0_ESM_INT_HI_LVL_0
      OsAppIsrRef = WKUP_ESM0_ESM_INT_LOW_LVL_0
      OsAppIsrRef = WKUP_ESM0_ESM_INT_CFG_LVL_0
      OsAppIsrRef = MAIN_ESM0_ESM_INT_HI_LVL_0
      OsAppIsrRef = MAIN_ESM0_ESM_INT_LOW_LVL_0
      OsAppIsrRef = MAIN_ESM0_ESM_INT_CFG_LVL_0
      OsAppIsrRef = SDLR_MCU_R5FSS0_CORE0_INTR_GLUELOGIC_MAIN_PULSAR0_LBIST_GLUE_DFT_LBIST_BIST_DONE_0_297
      OsAppIsrRef = SDLR_MCU_R5FSS0_CORE0_INTR_GLUELOGIC_MAIN_PULSAR1_LBIST_GLUE_DFT_LBIST_BIST_DONE_0_298
      OsAppIsrRef = SDLR_MCU_R5FSS0_CORE0_INTR_COMPUTE_CLUSTER0_AC71_4_DFT_LBIST_DFT_LBIST_BIST_DONE_0_295
      OsAppIsrRef = SDLR_MCU_R5FSS0_CORE0_INTR_COMPUTE_CLUSTER0_AC71_5_DFT_LBIST_DFT_LBIST_BIST_DONE_0_296
      OsAppIsrRef = SDLR_MCU_R5FSS0_CORE0_INTR_COMPUTE_CLUSTER0_ARM0_DFT_LBIST_DFT_LBIST_BIST_DONE_0_291
      OsAppIsrRef = SDLR_MCU_R5FSS0_CORE0_INTR_GLUELOGIC_DMPAC_LBIST_GLUE_DFT_LBIST_BIST_DONE_0_299
      OsAppIsrRef = SDLR_MCU_R5FSS0_CORE0_INTR_GLUELOGIC_VPAC_LBIST_GLUE_DFT_LBIST_BIST_DONE_0_300
      OsAppIsrRef = SDLR_MCU_R5FSS0_CORE0_INTR_AEP_GPU_BXS464_WRAP0_DFT_EMBED_PBIST_0_DFT_PBIST_CPU_0_317
      OsAppIsrRef = SDLR_MCU_R5FSS0_CORE0_INTR_COMPUTE_CLUSTER0_PBIST_WRAP_0_DFT_PBIST_CPU_0_290
      OsAppIsrRef = SDLR_MCU_R5FSS0_CORE0_INTR_MCU_PBIST0_DFT_PBIST_CPU_0_47
      OsAppIsrRef = SDLR_MCU_R5FSS0_CORE0_INTR_MCU_PBIST1_DFT_PBIST_CPU_0_36
      OsAppIsrRef = SDLR_MCU_R5FSS0_CORE0_INTR_MCU_PBIST2_DFT_PBIST_CPU_0_37
      OsAppIsrRef = SDLR_MCU_R5FSS0_CORE0_INTR_PBIST0_DFT_PBIST_CPU_0_312
      OsAppIsrRef = SDLR_MCU_R5FSS0_CORE0_INTR_PBIST10_DFT_PBIST_CPU_0_310
      OsAppIsrRef = SDLR_MCU_R5FSS0_CORE0_INTR_PBIST11_DFT_PBIST_CPU_0_314
      OsAppIsrRef = SDLR_MCU_R5FSS0_CORE0_INTR_PBIST2_DFT_PBIST_CPU_0_309
      OsAppIsrRef = SDLR_MCU_R5FSS0_CORE0_INTR_PBIST3_DFT_PBIST_CPU_0_307
      OsAppIsrRef = SDLR_MCU_R5FSS0_CORE0_INTR_PBIST4_DFT_PBIST_CPU_0_308
      OsAppIsrRef = SDLR_MCU_R5FSS0_CORE0_INTR_PBIST5_DFT_PBIST_CPU_0_306
      OsAppIsrRef = SDLR_MCU_R5FSS0_CORE0_INTR_PBIST7_DFT_PBIST_CPU_0_304
      OsAppIsrRef = SDLR_MCU_R5FSS0_CORE0_INTR_PBIST8_DFT_PBIST_CPU_0_305
      OsAppIsrRef = SDLR_MCU_R5FSS0_CORE0_INTR_PBIST1_DFT_PBIST_CPU_0_313
      OsApplicationHooks: OsAppErrorHook=false, OsAppShutdownHook=false, OsAppStartupHook=false
    OsResource:
      OsResourceProperty = STANDARD
      OsResourceAccessingApplication = SystemApplication_OsCore0
      OsResourceAccessingApplication = OsApplication_Trusted_Core0
      OsResourceAccessingApplication = OsApplication_QM
      OsResourceAccessingApplication = OsApplication_Safety
    QM_Task_200ms (OsTask):
      OsTaskActivation = 1
      OsTaskPriority = 46
      OsTaskSchedule = FULL
      OsTaskStackSharing = false
      OsTaskStackSize = 2048
      OsTaskType = AUTO
      OsTaskUsesFpu = true
      OsTaskAccessingApplication = SystemApplication_OsCore0
      OsTaskEventRef = Rte_Ev_Cyclic2_QM_Task_200ms_0_200ms
      OsTaskAccessingApplication = OsApplication_Trusted_Core0
      OsTaskAccessingApplication = OsApplication_QM
      OsTaskAccessingApplication = OsApplication_Safety
      OsTaskEventRef = Rte_Ev_InternalEventHandling
      OsTaskEventRef = Rte_Ev_Cyclic_QM_Task_200ms_0_200ms
    OsApplication_Trusted_Core0 (OsApplication):
      OsTrusted = true
      OsTrustedApplicationDelayTimingViolationCall = false
      OsTrustedApplicationWithProtection = false
      OsApplicationIsPrivileged = true
      OsAppUseTrustedFunctionStubs = true
      OsAppCalloutStubsIncludeHeader = Trusted_Func_Api.h
      OsApplicationCoreRef = EcucCoreDefinition
      OsAppEcucPartitionRef = EcucPartition_Trusted
      12 x OsApplicationTrustedFunction:
        ShutdownOS: OsTrustedFunctionName=ShutdownOS, OsTrustedFunctionReturnType=void
          Error (OsTrustedFunctionParam): OsTrustedFunctionParamId=1, OsTrustedFunctionParamDataType=uint8, OsTrustedFunctionParamDirection=IN
        Det_UserReportError: OsTrustedFunctionName=Det_UserReportError, OsTrustedFunctionReturnType=uint8
          4 x OsTrustedFunctionParam, all with OsTrustedFunctionParamDirection=IN:
            ModuleId: OsTrustedFunctionParamId=1, OsTrustedFunctionParamDataType=uint16
            InstanceId: OsTrustedFunctionParamId=2, OsTrustedFunctionParamDataType=uint8
            ApiId: OsTrustedFunctionParamId=3, OsTrustedFunctionParamDataType=uint8
            ErrorId: OsTrustedFunctionParamId=4, OsTrustedFunctionParamDataType=uint8
        CanWUp_Val_StartWakeUpValidation: OsTrustedFunctionName=CanWUp_Val_StartWakeUpValidation, OsTrustedFunctionReturnType=void
        CanWUp_Val_StopWakeUpValidation: OsTrustedFunctionName=CanWUp_Val_StopWakeUpValidation, OsTrustedFunctionReturnType=void
        CanWUp_Val_CheckPN: OsTrustedFunctionName=CanWUp_Val_CheckPN, OsTrustedFunctionReturnType=void
          WakeupSource (OsTrustedFunctionParam): OsTrustedFunctionParamId=1, OsTrustedFunctionParamDataType=uint32, OsTrustedFunctionParamDirection=IN
        RE_IpcTxData: OsTrustedFunctionName=RE_IpcTxData, OsTrustedFunctionReturnType=void
          3 x OsTrustedFunctionParam, all with OsTrustedFunctionParamDirection=IN:
            b_TxData_pv: OsTrustedFunctionParamId=1, OsTrustedFunctionParamDataType=void *
            i_IpcMsgId_u16: OsTrustedFunctionParamId=2, OsTrustedFunctionParamDataType=uint16
            i_IpcMsgSize_u16: OsTrustedFunctionParamId=3, OsTrustedFunctionParamDataType=uint16
        RE_CalDataProvider_Nvm_SVSCamEOLCalibData_WriteBlock: OsTrustedFunctionName=RE_CalDataProvider_Nvm_SVSCamEOLCalibData_WriteBlock, OsTrustedFunctionReturnType=Std_ReturnType
          v_SVSCamEOLCalibData (OsTrustedFunctionParam): OsTrustedFunctionParamId=1, OsTrustedFunctionParamDataType=const TbSVS_S_SVSCamEOLCalibDataToNVM_t *, OsTrustedFunctionParamDirection=IN
        RE_CalDataProvider_Nvm_SVSCamOCCalibData_WriteBlock: OsTrustedFunctionName=RE_CalDataProvider_Nvm_SVSCamOCCalibData_WriteBlock, OsTrustedFunctionReturnType=Std_ReturnType
          v_SVSCamOCCalibData (OsTrustedFunctionParam): OsTrustedFunctionParamId=1, OsTrustedFunctionParamDataType=const TbSVS_S_SVSCamOCCalibDataToNVM_t *, OsTrustedFunctionParamDirection=IN
        RE_CalDataProvider_Nvm_SVSCamSCCalibData_WriteBlock: OsTrustedFunctionName=RE_CalDataProvider_Nvm_SVSCamSCCalibData_WriteBlock, OsTrustedFunctionReturnType=Std_ReturnType
          v_SVSCamSCCalibData (OsTrustedFunctionParam): OsTrustedFunctionParamId=1, OsTrustedFunctionParamDataType=const TbSVS_S_SVSCamSCCalibDataToNVM_t *, OsTrustedFunctionParamDirection=IN
        RE_DID2023_ProxiData: OsTrustedFunctionName=RE_DID2023_ProxiData, OsTrustedFunctionReturnType=void
          3 x OsTrustedFunctionParam, all with OsTrustedFunctionParamDirection=IN:
            Data: OsTrustedFunctionParamId=1, OsTrustedFunctionParamDataType=const uint8 *
            Datalength: OsTrustedFunctionParamId=2, OsTrustedFunctionParamDataType=uint16
            Errorcode: OsTrustedFunctionParamId=3, OsTrustedFunctionParamDataType=uint8 *
        RE_CalDataProvider_Nvm_SVSCamCalibReset: OsTrustedFunctionName=RE_CalDataProvider_Nvm_SVSCamCalibReset, OsTrustedFunctionReturnType=Std_ReturnType
          v_SVSCamCalibReset (OsTrustedFunctionParam): OsTrustedFunctionParamId=1, OsTrustedFunctionParamDataType=const TbSVS_S_SVSCamCalibReset_t *, OsTrustedFunctionParamDirection=IN
        PMIC_EnterLongWindow_DisableWdg: OsTrustedFunctionName=PMIC_EnterLongWindow_DisableWdg, OsTrustedFunctionReturnType=void
      OsApplicationHooks: OsAppErrorHook=false, OsAppShutdownHook=false, OsAppStartupHook=false
      27 x OsApplicationTrustedFunction:
        Update_Proxi_MirrorBlock: OsTrustedFunctionName=Update_Proxi_MirrorBlock, OsTrustedFunctionReturnType=void
          Proxi_Erase_block (OsTrustedFunctionParam): OsTrustedFunctionParamId=1, OsTrustedFunctionParamDataType=boolean, OsTrustedFunctionParamDirection=IN
        Update_CalDataProvider_MirrorBlock: OsTrustedFunctionName=Update_CalDataProvider_MirrorBlock, OsTrustedFunctionReturnType=void
          CalDataProvider_Erase_block (OsTrustedFunctionParam): OsTrustedFunctionParamId=1, OsTrustedFunctionParamDataType=boolean, OsTrustedFunctionParamDirection=IN
        CddIpcHandler_Main: OsTrustedFunctionName=CddIpcHandler_Main, OsTrustedFunctionReturnType=void
        CddIpcHandler_Init: OsTrustedFunctionName=CddIpcHandler_Init, OsTrustedFunctionReturnType=void
        Update_CDD_IPCHandler_MirrorBlock: OsTrustedFunctionName=Update_CDD_IPCHandler_MirrorBlock, OsTrustedFunctionReturnType=void
          CDD_IPCHandler_Erase_block (OsTrustedFunctionParam): OsTrustedFunctionParamId=1, OsTrustedFunctionParamDataType=boolean, OsTrustedFunctionParamDirection=IN
        RE_ReportErrorStatus1_0_B: OsTrustedFunctionName=RE_ReportErrorStatus1_0_B, OsTrustedFunctionReturnType=Std_ReturnType
          3 x OsTrustedFunctionParam, all with OsTrustedFunctionParamDirection=IN:
            err: OsTrustedFunctionParamId=1, OsTrustedFunctionParamDataType=uint32
            errStatus: OsTrustedFunctionParamId=2, OsTrustedFunctionParamDataType=uint32
            addData: OsTrustedFunctionParamId=3, OsTrustedFunctionParamDataType=const ErrorMgr_stAddData*
        DcmCalloutStub_CompareKey: OsTrustedFunctionName=DcmCalloutStub_CompareKey, OsTrustedFunctionReturnType=Std_ReturnType
          3 x OsTrustedFunctionParam, all with OsTrustedFunctionParamDirection=IN:
            Key: OsTrustedFunctionParamId=1, OsTrustedFunctionParamDataType=const uint8*
            OpStatus: OsTrustedFunctionParamId=2, OsTrustedFunctionParamDataType=uint8
            ErrorCode: OsTrustedFunctionParamId=3, OsTrustedFunctionParamDataType=uint8*
        DcmCalloutStub_GetSeed: OsTrustedFunctionName=DcmCalloutStub_GetSeed, OsTrustedFunctionReturnType=Std_ReturnType
          4 x OsTrustedFunctionParam, all with OsTrustedFunctionParamDirection=IN:
            SecurityAccessDataRecord: OsTrustedFunctionParamId=1, OsTrustedFunctionParamDataType=const uint8*
            OpStatus: OsTrustedFunctionParamId=2, OsTrustedFunctionParamDataType=uint8
            ErrorCode: OsTrustedFunctionParamId=4, OsTrustedFunctionParamDataType=uint8*
            Seed: OsTrustedFunctionParamId=3, OsTrustedFunctionParamDataType=uint8*
        DcmCalloutStub_SessionCallback: OsTrustedFunctionName=DcmCalloutStub_SessionCallback, OsTrustedFunctionReturnType=void
          FormerSession (OsTrustedFunctionParam): OsTrustedFunctionParamId=1, OsTrustedFunctionParamDataType=uint8, OsTrustedFunctionParamDirection=IN
          NewSession (OsTrustedFunctionParam): OsTrustedFunctionParamId=2, OsTrustedFunctionParamDataType=uint8, OsTrustedFunctionParamDirection=IN
        RE_MCUReadDeviceReg: OsTrustedFunctionName=RE_MCUReadDeviceReg, OsTrustedFunctionReturnType=uint8
          DeviceAdd (OsTrustedFunctionParam): OsTrustedFunctionParamId=1, OsTrustedFunctionParamDataType=uint8, OsTrustedFunctionParamDirection=IN
          RegAddress (OsTrustedFunctionParam): OsTrustedFunctionParamId=2, OsTrustedFunctionParamDataType=uint16, OsTrustedFunctionParamDirection=IN
        RE_MCUReadDeviceRegData: OsTrustedFunctionName=RE_MCUReadDeviceRegData, OsTrustedFunctionReturnType=uint8
          DeviceAddress (OsTrustedFunctionParam): OsTrustedFunctionParamId=1, OsTrustedFunctionParamDataType=uint8, OsTrustedFunctionParamDirection=IN
          RegAddress (OsTrustedFunctionParam): OsTrustedFunctionParamId=2, OsTrustedFunctionParamDataType=uint16 *, OsTrustedFunctionParamDirection=IN
        RE_MCUWriteDeviceReg: OsTrustedFunctionName=RE_MCUWriteDeviceReg, OsTrustedFunctionReturnType=uint8
          3 x OsTrustedFunctionParam, all with OsTrustedFunctionParamDirection=IN:
            DeviceAdd: OsTrustedFunctionParamId=1, OsTrustedFunctionParamDataType=uint8
            RegAddress: OsTrustedFunctionParamId=2, OsTrustedFunctionParamDataType=uint16
            RegData: OsTrustedFunctionParamId=3, OsTrustedFunctionParamDataType=uint16
        Appl_vDamRemapNrcCalloutFunc: OsTrustedFunctionName=Appl_vDamRemapNrcCalloutFunc, OsTrustedFunctionReturnType=void
          3 x OsTrustedFunctionParam, all with OsTrustedFunctionParamDirection=IN:
            SID: OsTrustedFunctionParamId=1, OsTrustedFunctionParamDataType=uint8
            intErrorCode: OsTrustedFunctionParamId=2, OsTrustedFunctionParamDataType=uint8
            errorCode: OsTrustedFunctionParamId=3, OsTrustedFunctionParamDataType=uint8*
        Update_SafetyGuard_MirrorBlock: OsTrustedFunctionName=Update_SafetyGuard_MirrorBlock, OsTrustedFunctionReturnType=void
          Reset_Reason_Erase_Block (OsTrustedFunctionParam): OsTrustedFunctionParamId=1, OsTrustedFunctionParamDataType=boolean, OsTrustedFunctionParamDirection=IN
        Update_Cdd_Safety_MirrorBlock: OsTrustedFunctionName=Update_Cdd_Safety_MirrorBlock, OsTrustedFunctionReturnType=void
          Cdd_Safety_Erase_block (OsTrustedFunctionParam): OsTrustedFunctionParamId=1, OsTrustedFunctionParamDataType=boolean, OsTrustedFunctionParamDirection=IN
        Update_ComCallout_FlagStatus: OsTrustedFunctionName=Update_ComCallout_FlagStatus, OsTrustedFunctionReturnType=void
          flagPtrU8 (OsTrustedFunctionParam): OsTrustedFunctionParamId=1, OsTrustedFunctionParamDataType=uint8, OsTrustedFunctionParamDirection=OUT
          data (OsTrustedFunctionParam): OsTrustedFunctionParamId=2, OsTrustedFunctionParamDataType=uint8, OsTrustedFunctionParamDirection=IN
        SafeVCANTx_ComIPduCallout_CVPAM_FD_Control_oFDCAN2_2dc7d8b6_Tx: OsTrustedFunctionName=SafeVCANTx_ComIPduCallout_CVPAM_FD_Control_oFDCAN2_2dc7d8b6_Tx, OsTrustedFunctionReturnType=void
          PduId (OsTrustedFunctionParam): OsTrustedFunctionParamId=1, OsTrustedFunctionParamDataType=PduIdType, OsTrustedFunctionParamDirection=IN
          PduInfoPtr (OsTrustedFunctionParam): OsTrustedFunctionParamId=2, OsTrustedFunctionParamDataType=PduInfoType, OsTrustedFunctionParamDirection=OUT
        SafeVCANTx_ComIPduCallout_CVPAM_FD_Info_oFDCAN2_a36629be_Tx: OsTrustedFunctionName=SafeVCANTx_ComIPduCallout_CVPAM_FD_Info_oFDCAN2_a36629be_Tx, OsTrustedFunctionReturnType=void
          PduId (OsTrustedFunctionParam): OsTrustedFunctionParamId=1, OsTrustedFunctionParamDataType=PduIdType, OsTrustedFunctionParamDirection=IN
          PduInfoPtr (OsTrustedFunctionParam): OsTrustedFunctionParamId=2, OsTrustedFunctionParamDataType=PduInfoType, OsTrustedFunctionParamDirection=OUT
        SafeVCANTx_ComIPduCallout_CVPAM_FD_Control_oFDCAN14_fab4999a_Tx: OsTrustedFunctionName=SafeVCANTx_ComIPduCallout_CVPAM_FD_Control_oFDCAN14_fab4999a_Tx, OsTrustedFunctionReturnType=void
          PduId (OsTrustedFunctionParam): OsTrustedFunctionParamId=1, OsTrustedFunctionParamDataType=PduIdType, OsTrustedFunctionParamDirection=IN
          PduInfoPtr (OsTrustedFunctionParam): OsTrustedFunctionParamId=2, OsTrustedFunctionParamDataType=PduInfoType, OsTrustedFunctionParamDirection=OUT
        SafeVCANTx_ComIPduCallout_ADAS_FD_LANES_1_oFDCAN14_7b05104b_Tx: OsTrustedFunctionName=SafeVCANTx_ComIPduCallout_ADAS_FD_LANES_1_oFDCAN14_7b05104b_Tx, OsTrustedFunctionReturnType=void
          PduId (OsTrustedFunctionParam): OsTrustedFunctionParamId=1, OsTrustedFunctionParamDataType=PduIdType, OsTrustedFunctionParamDirection=IN
          PduInfoPtr (OsTrustedFunctionParam): OsTrustedFunctionParamId=2, OsTrustedFunctionParamDataType=PduInfoType, OsTrustedFunctionParamDirection=OUT
        SafeVCANTx_ComIPduCallout_ADAS_FD_LANES_2_oFDCAN14_9032ab48_Tx: OsTrustedFunctionName=SafeVCANTx_ComIPduCallout_ADAS_FD_LANES_2_oFDCAN14_9032ab48_Tx, OsTrustedFunctionReturnType=void
          PduId (OsTrustedFunctionParam): OsTrustedFunctionParamId=1, OsTrustedFunctionParamDataType=PduIdType, OsTrustedFunctionParamDirection=IN
          PduInfoPtr (OsTrustedFunctionParam): OsTrustedFunctionParamId=2, OsTrustedFunctionParamDataType=PduInfoType, OsTrustedFunctionParamDirection=OUT
        RE_IntrinsicCameraSN_Readblock: OsTrustedFunctionName=RE_IntrinsicCameraSN_Readblock, OsTrustedFunctionReturnType=Std_ReturnType
          CamNvmData (OsTrustedFunctionParam): OsTrustedFunctionParamId=1, OsTrustedFunctionParamDataType=IntrinsicCamID, OsTrustedFunctionParamDirection=OUT
          NvmCamSts (OsTrustedFunctionParam): OsTrustedFunctionParamId=2, OsTrustedFunctionParamDataType=CamNvmReadSts, OsTrustedFunctionParamDirection=OUT
        Pmic_F_SafeState2_v: OsTrustedFunctionName=Pmic_F_SafeState2_v, OsTrustedFunctionReturnType=void
          SafeStateReason (OsTrustedFunctionParam): OsTrustedFunctionParamId=1, OsTrustedFunctionParamDataType=uint8, OsTrustedFunctionParamDirection=IN
        Pmic_AppEnterInLongWindow: OsTrustedFunctionName=Pmic_AppEnterInLongWindow, OsTrustedFunctionReturnType=sint32
        f_Send_Dbg_SSMFault_CanTx: OsTrustedFunctionName=f_Send_Dbg_SSMFault_CanTx, OsTrustedFunctionReturnType=void
          SSMFault (OsTrustedFunctionParam): OsTrustedFunctionParamId=1, OsTrustedFunctionParamDataType=uint8, OsTrustedFunctionParamDirection=IN_OUT
        f_Send_Dbg_SDLFault_CanTx: OsTrustedFunctionName=f_Send_Dbg_SDLFault_CanTx, OsTrustedFunctionReturnType=void
          SDLFault (OsTrustedFunctionParam): OsTrustedFunctionParamId=1, OsTrustedFunctionParamDataType=uint16, OsTrustedFunctionParamDirection=IN
        Cdd_Safety_NVM_Write_PMICLastResetReason_BISTStatus: OsTrustedFunctionName=Cdd_Safety_NVM_Write_PMICLastResetReason_BISTStatus, OsTrustedFunctionReturnType=void
          3 x OsTrustedFunctionParam, all with OsTrustedFunctionParamDataType=uint8, OsTrustedFunctionParamDirection=IN:
            index: OsTrustedFunctionParamId=1
            Data: OsTrustedFunctionParamId=2
            storeAtShut: OsTrustedFunctionParamId=3
    11 x OsTask, all with OsTaskActivation=1, OsTaskSchedule=FULL, OsTaskStackSharing=false, OsTaskType=AUTO, OsTaskUsesFpu=true, OsTaskAccessingApplication=SystemApplication_OsCore0, OsTaskAccessingApplication=OsApplication_Trusted_Core0, OsTaskAccessingApplication=OsApplication_QM, OsTaskAccessingApplication=OsApplication_Safety:
      QM_Task_01_10ms: OsTaskPriority=50, OsTaskStackSize=16384
      QM_Task_00_10ms: OsTaskPriority=54, OsTaskStackSize=4096
      QM_MemTask_10ms: OsTaskPriority=76, OsTaskStackSize=1024, OsTaskEventRef=Rte_Ev_Cyclic2_QM_MemTask_10ms_0_10ms, OsTaskEventRef=Rte_Ev_Cyclic_QM_MemTask_10ms_0_10ms
      QM_DiagTask_10ms: OsTaskPriority=77, OsTaskStackSize=4096, OsTaskEventRef=Rte_Ev_Cyclic2_QM_DiagTask_10ms_0_10ms, OsTaskEventRef=Rte_Ev_Cyclic_QM_DiagTask_10ms_0_10ms
      QM_ComTask_5ms: OsTaskPriority=86, OsTaskStackSize=1024, OsTaskEventRef=Rte_Ev_Cyclic2_QM_ComTask_5ms_5_5ms, OsTaskEventRef=Rte_Ev_Cyclic_QM_ComTask_5ms_0_5ms
      QM_ComTask_10ms: OsTaskPriority=82, OsTaskStackSize=4096, OsTaskEventRef=Rte_Ev_Cyclic2_QM_ComTask_10ms_0_10ms, OsTaskEventRef=Rte_Ev_Cyclic_QM_ComTask_10ms_0_10ms
      QM_Task_Init: OsTaskPriority=88, OsTaskStackSize=2048
      BootAppOsTask: OsTaskPriority=94, OsTaskStackSize=4096, OsTaskResourceRef=OsResource, OsTaskEventRef=ospi_dma_event
      SciServerLowOsTask: OsTaskPriority=96, OsTaskStackSize=4096, OsTaskEventRef=SciServerTrigger_UserMcuLo, OsTaskEventRef=SciServerTrigger_UserMainLo, OsTaskResourceRef=OsResource_SciSecureproxy, OsTaskResourceRef=OsResource_SciServerSync
      SciServerHighOsTask: OsTaskPriority=98, OsTaskStackSize=4096, OsTaskEventRef=SciServerTrigger_UserMainHi, OsTaskEventRef=SciServerTrigger_UserMcuHi, OsTaskResourceRef=OsResource_SciSecureproxy, OsTaskResourceRef=OsResource_SciServerSync
      StartUpTask: OsTaskPriority=100, OsTaskStackSize=512
        OsTaskAutostart: OsTaskAppModeRef=OSDEFAULTAPPMODE
    OsResource_SciServerSync (OsResource):
      OsResourceProperty = STANDARD
      OsResourceAccessingApplication = SystemApplication_OsCore0
      OsResourceAccessingApplication = OsApplication_Trusted_Core0
      OsResourceAccessingApplication = OsApplication_QM
      OsResourceAccessingApplication = OsApplication_Safety
    OsResource_SciSecureproxy (OsResource):
      OsResourceProperty = STANDARD
      OsResourceAccessingApplication = SystemApplication_OsCore0
      OsResourceAccessingApplication = OsApplication_Trusted_Core0
      OsResourceAccessingApplication = OsApplication_QM
      OsResourceAccessingApplication = OsApplication_Safety
    4 x OsEvent:
      SciServerTrigger_UserMainHi
      SciServerTrigger_UserMainLo
      SciServerTrigger_UserMcuHi
      SciServerTrigger_UserMcuLo
    14 x OsIsr, all with OsIsrCategory=CATEGORY_2, OsIsrInterruptType=EXTERNAL, OsIsrStackSize=1024, OsIsrEnableNesting=false, OsIsrUsesFpu=false, OsIsrInitialEnableInterruptSource=true, OsIsrInterruptMapping=IRQ_LEVEL:
      ADC0: OsIsrInterruptSource=6, OsIsrInterruptPriority=13, OsIsrSpecialFunctionName=Adc_IrqUnit0, OsIsrResourceRef=OsResource
      ADC1: OsIsrInterruptSource=7, OsIsrInterruptPriority=14, OsIsrSpecialFunctionName=Adc_IrqUnit1, OsIsrResourceRef=OsResource
      I2c_IrqUnit0: OsIsrInterruptSource=18, OsIsrInterruptPriority=15, OsIsrSpecialFunctionName=I2c_IrqUnit0
      I2c_IrqUnit1: OsIsrInterruptSource=96, OsIsrInterruptPriority=15, OsIsrSpecialFunctionName=I2c_IrqUnit1
      IPC_mailbox1: OsIsrInterruptSource=376, OsIsrInterruptPriority=14
      IPC_mailbox2: OsIsrInterruptSource=377, OsIsrInterruptPriority=14
      MCU_NAVSS0_UDMASS_INTA_0_INTAGGR_VINTR_PEND_78: OsIsrInterruptSource=78, OsIsrInterruptPriority=4
      MCU_NAVSS0_UDMASS_INTA_0_INTAGGR_VINTR_PEND_79: OsIsrInterruptSource=79, OsIsrInterruptPriority=4
      SciServer_OsIsr_UserMsgHwiFxn1: OsIsrInterruptSource=70, OsIsrInterruptPriority=5
      SciServer_OsIsr_UserMsgHwiFxn2: OsIsrInterruptSource=71, OsIsrInterruptPriority=5
      SciServer_OsIsr_UserMsgHwiFxn3: OsIsrInterruptSource=72, OsIsrInterruptPriority=6
      SciServer_OsIsr_UserMsgHwiFxn4: OsIsrInterruptSource=73, OsIsrInterruptPriority=6
      Can_30_McanIsr_0: OsIsrInterruptSource=0, OsIsrInterruptPriority=10  # /ActiveEcuC/Can PLAIN_TEXT Can messages event (for a specific controllers)
      Can_30_McanIsr_1: OsIsrInterruptSource=2, OsIsrInterruptPriority=12  # /ActiveEcuC/Can PLAIN_TEXT Can messages event (for a specific controllers)
    Rte_Ev_InternalEventHandling (OsEvent)
    ospi_dma_event (OsEvent)
    vHsmResponseIsr (OsIsr):
      OsIsrCategory = CATEGORY_2
      OsIsrInterruptType = EXTERNAL
      OsIsrInterruptSource = 44
      OsIsrInterruptPriority = 7
      OsIsrStackSize = 1024
      OsIsrEnableNesting = false
      OsIsrUsesFpu = false
      OsIsrInitialEnableInterruptSource = true
      OsIsrSpecialFunctionName = vHsmResponseIsr
      OsIsrInterruptMapping = IRQ_LEVEL
    5 x OsTask, all with OsTaskActivation=1, OsTaskSchedule=FULL, OsTaskStackSharing=false, OsTaskType=AUTO, OsTaskUsesFpu=true, OsTaskAccessingApplication=SystemApplication_OsCore0, OsTaskAccessingApplication=OsApplication_Trusted_Core0, OsTaskAccessingApplication=OsApplication_QM, OsTaskAccessingApplication=OsApplication_Safety:
      Safety_Task_Init: OsTaskPriority=90, OsTaskStackSize=8192
      Safety_Task_00_10ms: OsTaskPriority=79, OsTaskStackSize=8192
      Safety_Task_01_10ms: OsTaskPriority=78, OsTaskStackSize=32768
      Safety_Task_200ms: OsTaskPriority=44, OsTaskStackSize=1024, OsTaskEventRef=Rte_Ev_Run_SWC_ProxiConfigMgr_RE_ProxiMgr_ConfigDataRSP, OsTaskEventRef=Rte_Ev_Cyclic_Safety_Task_200ms_0_200ms
      Safety_WdgTask_10ms: OsTaskPriority=84, OsTaskStackSize=4096, OsTaskResourceRef=OsResource_PMIC, OsTaskEventRef=Rte_Ev_Cyclic2_Safety_WdgTask_10ms_0_10ms, OsTaskEventRef=Rte_Ev_Cyclic_Safety_WdgTask_10ms_0_10ms
    9 x OsAlarm, all with OsAlarmCounterRef=SystemTimer, OsAlarmAccessingApplication=SystemApplication_OsCore0, OsAlarmAccessingApplication=OsApplication_Trusted_Core0, OsAlarmAccessingApplication=OsApplication_QM, OsAlarmAccessingApplication=OsApplication_Safety:
      Rte_Al_TE2_QM_ComTask_10ms_0_10ms
        OsAlarmAction
          OsAlarmSetEvent: OsAlarmSetEventRef=Rte_Ev_Cyclic2_QM_ComTask_10ms_0_10ms, OsAlarmSetEventTaskRef=Os/QM_ComTask_10ms
      Rte_Al_TE2_QM_ComTask_5ms_5_5ms
        OsAlarmAction
          OsAlarmSetEvent: OsAlarmSetEventRef=Rte_Ev_Cyclic2_QM_ComTask_5ms_5_5ms, OsAlarmSetEventTaskRef=Os/QM_ComTask_5ms
      Rte_Al_TE2_QM_DiagTask_10ms_0_10ms
        OsAlarmAction
          OsAlarmSetEvent: OsAlarmSetEventRef=Rte_Ev_Cyclic2_QM_DiagTask_10ms_0_10ms, OsAlarmSetEventTaskRef=Os/QM_DiagTask_10ms
      Rte_Al_TE2_QM_MemTask_10ms_0_10ms
        OsAlarmAction
          OsAlarmSetEvent: OsAlarmSetEventRef=Rte_Ev_Cyclic2_QM_MemTask_10ms_0_10ms, OsAlarmSetEventTaskRef=Os/QM_MemTask_10ms
      Rte_Al_TE_QM_Task_00_10ms_0_10ms
        OsAlarmAction
          OsAlarmActivateTask: OsAlarmActivateTaskRef=QM_Task_00_10ms
      Rte_Al_TE_QM_Task_01_10ms_0_10ms
        OsAlarmAction
          OsAlarmActivateTask: OsAlarmActivateTaskRef=QM_Task_01_10ms
      Rte_Al_TE2_QM_Task_200ms_0_200ms
        OsAlarmAction
          OsAlarmSetEvent: OsAlarmSetEventRef=Rte_Ev_Cyclic2_QM_Task_200ms_0_200ms, OsAlarmSetEventTaskRef=Os/QM_Task_200ms
      Rte_Al_TE_Safety_Task_00_10ms_0_10ms
        OsAlarmAction
          OsAlarmActivateTask: OsAlarmActivateTaskRef=Safety_Task_00_10ms
      Rte_Al_TE_Safety_Task_01_10ms_0_10ms
        OsAlarmAction
          OsAlarmActivateTask: OsAlarmActivateTaskRef=Safety_Task_01_10ms
    Rte_Ev_Cyclic2_QM_Task_200ms_0_200ms (OsEvent)
    ShutdownTask (OsTask):
      OsTaskActivation = 1
      OsTaskPriority = 100
      OsTaskSchedule = FULL
      OsTaskStackSharing = false
      OsTaskStackSize = 2048
      OsTaskType = AUTO
      OsTaskUsesFpu = true
      OsTaskAccessingApplication = SystemApplication_OsCore0
      OsTaskAccessingApplication = OsApplication_Trusted_Core0
      OsTaskAccessingApplication = OsApplication_QM
      OsTaskAccessingApplication = OsApplication_Safety
      OsTaskResourceRef = OsResource_SciSecureproxy
      OsTaskResourceRef = OsResource_PMIC
    30 x OsIsr, all with OsIsrCategory=CATEGORY_2, OsIsrInterruptType=EXTERNAL, OsIsrInterruptPriority=15, OsIsrStackSize=1024, OsIsrEnableNesting=false, OsIsrUsesFpu=false, OsIsrInitialEnableInterruptSource=true, OsIsrInterruptMapping=IRQ_LEVEL:
      MCU_ESM0_ESM_INT_HI_LVL_0: OsIsrInterruptSource=49
      MCU_ESM0_ESM_INT_LOW_LVL_0: OsIsrInterruptSource=48
      MCU_ESM0_ESM_INT_CFG_LVL_0: OsIsrInterruptSource=53
      WKUP_ESM0_ESM_INT_HI_LVL_0: OsIsrInterruptSource=99
      WKUP_ESM0_ESM_INT_LOW_LVL_0: OsIsrInterruptSource=98
      WKUP_ESM0_ESM_INT_CFG_LVL_0: OsIsrInterruptSource=100
      MAIN_ESM0_ESM_INT_HI_LVL_0: OsIsrInterruptSource=141
      MAIN_ESM0_ESM_INT_LOW_LVL_0: OsIsrInterruptSource=140
      MAIN_ESM0_ESM_INT_CFG_LVL_0: OsIsrInterruptSource=142
      SDLR_MCU_R5FSS0_CORE0_INTR_GLUELOGIC_MAIN_PULSAR0_LBIST_GLUE_DFT_LBIST_BIST_DONE_0_297: OsIsrInterruptSource=297
      SDLR_MCU_R5FSS0_CORE0_INTR_GLUELOGIC_MAIN_PULSAR1_LBIST_GLUE_DFT_LBIST_BIST_DONE_0_298: OsIsrInterruptSource=298
      SDLR_MCU_R5FSS0_CORE0_INTR_COMPUTE_CLUSTER0_AC71_4_DFT_LBIST_DFT_LBIST_BIST_DONE_0_295: OsIsrInterruptSource=295
      SDLR_MCU_R5FSS0_CORE0_INTR_COMPUTE_CLUSTER0_AC71_5_DFT_LBIST_DFT_LBIST_BIST_DONE_0_296: OsIsrInterruptSource=296
      SDLR_MCU_R5FSS0_CORE0_INTR_COMPUTE_CLUSTER0_ARM0_DFT_LBIST_DFT_LBIST_BIST_DONE_0_291: OsIsrInterruptSource=291
      SDLR_MCU_R5FSS0_CORE0_INTR_GLUELOGIC_DMPAC_LBIST_GLUE_DFT_LBIST_BIST_DONE_0_299: OsIsrInterruptSource=299
      SDLR_MCU_R5FSS0_CORE0_INTR_GLUELOGIC_VPAC_LBIST_GLUE_DFT_LBIST_BIST_DONE_0_300: OsIsrInterruptSource=300
      SDLR_MCU_R5FSS0_CORE0_INTR_AEP_GPU_BXS464_WRAP0_DFT_EMBED_PBIST_0_DFT_PBIST_CPU_0_317: OsIsrInterruptSource=317
      SDLR_MCU_R5FSS0_CORE0_INTR_COMPUTE_CLUSTER0_PBIST_WRAP_0_DFT_PBIST_CPU_0_290: OsIsrInterruptSource=290
      SDLR_MCU_R5FSS0_CORE0_INTR_MCU_PBIST0_DFT_PBIST_CPU_0_47: OsIsrInterruptSource=47
      SDLR_MCU_R5FSS0_CORE0_INTR_MCU_PBIST1_DFT_PBIST_CPU_0_36: OsIsrInterruptSource=36
      SDLR_MCU_R5FSS0_CORE0_INTR_MCU_PBIST2_DFT_PBIST_CPU_0_37: OsIsrInterruptSource=37
      SDLR_MCU_R5FSS0_CORE0_INTR_PBIST0_DFT_PBIST_CPU_0_312: OsIsrInterruptSource=312
      SDLR_MCU_R5FSS0_CORE0_INTR_PBIST10_DFT_PBIST_CPU_0_310: OsIsrInterruptSource=310
      SDLR_MCU_R5FSS0_CORE0_INTR_PBIST11_DFT_PBIST_CPU_0_314: OsIsrInterruptSource=314
      SDLR_MCU_R5FSS0_CORE0_INTR_PBIST2_DFT_PBIST_CPU_0_309: OsIsrInterruptSource=309
      SDLR_MCU_R5FSS0_CORE0_INTR_PBIST3_DFT_PBIST_CPU_0_307: OsIsrInterruptSource=307
      SDLR_MCU_R5FSS0_CORE0_INTR_PBIST4_DFT_PBIST_CPU_0_308: OsIsrInterruptSource=308
      SDLR_MCU_R5FSS0_CORE0_INTR_PBIST5_DFT_PBIST_CPU_0_306: OsIsrInterruptSource=306
      SDLR_MCU_R5FSS0_CORE0_INTR_PBIST7_DFT_PBIST_CPU_0_304: OsIsrInterruptSource=304
      SDLR_MCU_R5FSS0_CORE0_INTR_PBIST8_DFT_PBIST_CPU_0_305: OsIsrInterruptSource=305
    Rte_Al_TE_Safety_WdgTask_10ms_0_10ms (OsAlarm):
      OsAlarmCounterRef = SystemTimer
      OsAlarmAccessingApplication = SystemApplication_OsCore0
      OsAlarmAccessingApplication = OsApplication_Trusted_Core0
      OsAlarmAccessingApplication = OsApplication_QM
      OsAlarmAccessingApplication = OsApplication_Safety
      OsAlarmAction
        OsAlarmSetEvent: OsAlarmSetEventRef=Rte_Ev_Cyclic_Safety_WdgTask_10ms_0_10ms, OsAlarmSetEventTaskRef=Os/Safety_WdgTask_10ms
    OsApplication_Safety (OsApplication):
      OsTrusted = false
      OsTrustedApplicationDelayTimingViolationCall = false
      OsTrustedApplicationWithProtection = false
      OsApplicationIsPrivileged = false
      OsAppUseTrustedFunctionStubs = false
      OsApplicationCoreRef = EcucCoreDefinition
      OsAppEcucPartitionRef = EcucPartition_Safety
      OsAppTaskRef = Safety_Task_00_10ms
      OsAppTaskRef = Safety_Task_01_10ms
      OsAppTaskRef = Os/Safety_Task_200ms
      OsAppTaskRef = Safety_Task_Init
      OsAppTaskRef = Os/Safety_WdgTask_10ms
      OsAppAlarmRef = Rte_Al_TE_Safety_Task_00_10ms_0_10ms
      OsAppAlarmRef = Rte_Al_TE_Safety_Task_01_10ms_0_10ms
      OsAppAlarmRef = Rte_Al_TE_Safety_WdgTask_10ms_0_10ms
      OsAppAlarmRef = Rte_Al_TE2_Safety_WdgTask_10ms_0_10ms
      OsAppAlarmRef = Rte_Al_TE_Safety_Task_200ms_0_200ms
      OsApplicationHooks: OsAppErrorHook=false, OsAppShutdownHook=false, OsAppStartupHook=false
    OsApplication_QM (OsApplication):
      OsTrusted = false
      OsTrustedApplicationDelayTimingViolationCall = false
      OsTrustedApplicationWithProtection = false
      OsApplicationIsPrivileged = false
      OsAppUseTrustedFunctionStubs = false
      OsApplicationCoreRef = EcucCoreDefinition
      OsAppEcucPartitionRef = EcucPartition_QM
      OsAppTaskRef = Os/QM_ComTask_5ms
      OsAppTaskRef = Os/QM_ComTask_10ms
      OsAppTaskRef = Os/QM_DiagTask_10ms
      OsAppTaskRef = Os/QM_MemTask_10ms
      OsAppTaskRef = QM_Task_00_10ms
      OsAppTaskRef = QM_Task_01_10ms
      OsAppTaskRef = Os/QM_Task_200ms
      OsAppTaskRef = QM_Task_Init
      OsAppAlarmRef = Rte_Al_TE2_QM_ComTask_10ms_0_10ms
      OsAppAlarmRef = Rte_Al_TE2_QM_ComTask_5ms_5_5ms
      OsAppAlarmRef = Rte_Al_TE2_QM_DiagTask_10ms_0_10ms
      OsAppAlarmRef = Rte_Al_TE2_QM_MemTask_10ms_0_10ms
      OsAppAlarmRef = Rte_Al_TE_QM_Task_00_10ms_0_10ms
      OsAppAlarmRef = Rte_Al_TE_QM_Task_01_10ms_0_10ms
      OsAppAlarmRef = Rte_Al_TE2_QM_Task_200ms_0_200ms
      OsAppAlarmRef = Rte_Al_TE_QM_ComTask_10ms_0_10ms
      OsAppAlarmRef = Rte_Al_TE_QM_ComTask_5ms_0_5ms
      OsAppAlarmRef = Rte_Al_TE_QM_DiagTask_10ms_0_10ms
      OsAppAlarmRef = Rte_Al_TE_QM_MemTask_10ms_0_10ms
      OsAppAlarmRef = Rte_Al_TE_QM_Task_200ms_0_200ms
      OsApplicationHooks: OsAppErrorHook=false, OsAppShutdownHook=false, OsAppStartupHook=false
    OsIoc: OsIocIncludeHeader=usrostyp.h, OsIocIncludeHeader=Rte.h
      Rte_ErrorMgrAgg_1_0_QM_R_SatError_Data_ErrorMgr_ErrorCommPack_1_0_QM (OsIocCommunication)
        OsIocReceiverProperties: OsIocReceivingOsApplicationRef=OsApplication_QM
        OsIocDataProperties0 (OsIocDataProperties):
          OsIocDataTypeIsAtomic = false
          OsIocDataType = ErrorMgr_ErrorCommPack_1_0_QM
          OsIocInitValue = Rte_IocInitValue_ErrorMgrAgg_1_0_QM_R_SatError_Data_ErrorMgr_ErrorCommPack_1_0_QM
          OsIocDataPropertyIndex = 0
          OsIocDataTypeRef = ErrorMgr_ErrorCommPack_1_0_QM
        OsIocSenderProperties0 (OsIocSenderProperties): OsIocSenderId=0, OsIocSendingOsApplicationRef=OsApplication_Safety
        OsIocSenderProperties1 (OsIocSenderProperties): OsIocSenderId=1, OsIocSendingOsApplicationRef=OsApplication_QM
    SDLR_MCU_R5FSS0_CORE0_INTR_PBIST1_DFT_PBIST_CPU_0_313 (OsIsr):
      OsIsrCategory = CATEGORY_2
      OsIsrInterruptType = EXTERNAL
      OsIsrInterruptSource = 313
      OsIsrInterruptPriority = 15
      OsIsrStackSize = 1024
      OsIsrEnableNesting = false
      OsIsrUsesFpu = false
      OsIsrInitialEnableInterruptSource = true
      OsIsrInterruptMapping = IRQ_LEVEL
    OsResource_PMIC (OsResource):
      OsResourceProperty = STANDARD
      OsResourceAccessingApplication = SystemApplication_OsCore0
      OsResourceAccessingApplication = OsApplication_Trusted_Core0
      OsResourceAccessingApplication = OsApplication_QM
      OsResourceAccessingApplication = OsApplication_Safety
    Rte_Al_TE2_Safety_WdgTask_10ms_0_10ms (OsAlarm): OsAlarmCounterRef=SystemTimer, OsAlarmAccessingApplication=OsApplication_QM, OsAlarmAccessingApplication=SystemApplication_OsCore0
      OsAlarmAction
        OsAlarmSetEvent: OsAlarmSetEventRef=Rte_Ev_Cyclic2_Safety_WdgTask_10ms_0_10ms, OsAlarmSetEventTaskRef=Os/Safety_WdgTask_10ms
    3 x OsEvent:
      Rte_Ev_Cyclic2_Safety_WdgTask_10ms_0_10ms
      Rte_Ev_Cyclic_Safety_WdgTask_10ms_0_10ms
      Rte_Ev_Run_SWC_ProxiConfigMgr_RE_ProxiMgr_ConfigDataRSP
    6 x OsAlarm, all with OsAlarmCounterRef=SystemTimer, OsAlarmAccessingApplication=SystemApplication_OsCore0:
      Rte_Al_TE_QM_ComTask_10ms_0_10ms
        OsAlarmAction
          OsAlarmSetEvent: OsAlarmSetEventRef=Rte_Ev_Cyclic_QM_ComTask_10ms_0_10ms, OsAlarmSetEventTaskRef=Os/QM_ComTask_10ms
      Rte_Al_TE_QM_ComTask_5ms_0_5ms
        OsAlarmAction
          OsAlarmSetEvent: OsAlarmSetEventRef=Rte_Ev_Cyclic_QM_ComTask_5ms_0_5ms, OsAlarmSetEventTaskRef=Os/QM_ComTask_5ms
      Rte_Al_TE_QM_DiagTask_10ms_0_10ms
        OsAlarmAction
          OsAlarmSetEvent: OsAlarmSetEventRef=Rte_Ev_Cyclic_QM_DiagTask_10ms_0_10ms, OsAlarmSetEventTaskRef=Os/QM_DiagTask_10ms
      Rte_Al_TE_QM_MemTask_10ms_0_10ms
        OsAlarmAction
          OsAlarmSetEvent: OsAlarmSetEventRef=Rte_Ev_Cyclic_QM_MemTask_10ms_0_10ms, OsAlarmSetEventTaskRef=Os/QM_MemTask_10ms
      Rte_Al_TE_QM_Task_200ms_0_200ms
        OsAlarmAction
          OsAlarmSetEvent: OsAlarmSetEventRef=Rte_Ev_Cyclic_QM_Task_200ms_0_200ms, OsAlarmSetEventTaskRef=Os/QM_Task_200ms
      Rte_Al_TE_Safety_Task_200ms_0_200ms: OsAlarmAccessingApplication=OsApplication_QM
        OsAlarmAction
          OsAlarmSetEvent: OsAlarmSetEventRef=Rte_Ev_Cyclic_Safety_Task_200ms_0_200ms, OsAlarmSetEventTaskRef=Os/Safety_Task_200ms
    10 x OsEvent:
      Rte_Ev_Cyclic2_QM_ComTask_10ms_0_10ms
      Rte_Ev_Cyclic2_QM_ComTask_5ms_5_5ms
      Rte_Ev_Cyclic2_QM_DiagTask_10ms_0_10ms
      Rte_Ev_Cyclic2_QM_MemTask_10ms_0_10ms
      Rte_Ev_Cyclic_QM_ComTask_10ms_0_10ms
      Rte_Ev_Cyclic_QM_ComTask_5ms_0_5ms
      Rte_Ev_Cyclic_QM_DiagTask_10ms_0_10ms
      Rte_Ev_Cyclic_QM_MemTask_10ms_0_10ms
      Rte_Ev_Cyclic_QM_Task_200ms_0_200ms
      Rte_Ev_Cyclic_Safety_Task_200ms_0_200ms
