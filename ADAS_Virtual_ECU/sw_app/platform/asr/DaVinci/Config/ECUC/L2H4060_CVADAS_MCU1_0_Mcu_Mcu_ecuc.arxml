AUTOSAR XML (schema 00048)
package /ActiveEcuC
  module config Mcu: implementation-config-variant=VARIANT-PRE-COMPILE
    McuGeneralConfiguration: McuDevErrorDetect=false, McuGetRamStateApi=false, McuInitClock=true, McuNoPll=true, McuVersionInfoApi=false, McuPerformResetApi=false
    McuModuleConfiguration: McuClockSrcFailureNotification=ENABLED, McuNumberOfMcuModes=1, McuRamSectors=1
      McuClockSettingConfig: McuClockSettingId=1
        McuClockReferencePoint: McuClockReferencePointFrequency=80000000
      McuModeSettingConf: McuMode=1
    McuPublishedInformation
      McuResetReasonConf: McuResetReason=0
