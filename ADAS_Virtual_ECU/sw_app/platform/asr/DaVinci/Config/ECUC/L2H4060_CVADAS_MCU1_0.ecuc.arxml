AUTOSAR XML (schema 00048)
package /ActiveEcuC
  ecuc value collection ActiveEcuC: ecu-extract=SYSTEM
    ecuc-values:
      vSet
      vBaseEnv
      EcuC
      MemMap
      Adc
      Mcu
      Dio
      EcuM
      BswM
      IoHwAb
      Rte
      Os
      vLinkGen
      Det
      I2c
      MemIf
      Ea
      Eep
      NvM
      Cdd
      Dcm
      Dem
      PduR
      CanIf
      CanTp
      Com
      ComM
      CanNm
      Nm
      CanSM
      Crc
      CanTrcv
      Xcp
      Csm
      CryIf
      vDiagSecAcc
      WdgM
      Wdg
      WdgIf
      Crypto
      Cdd_UssLog
      vDam
      Can
