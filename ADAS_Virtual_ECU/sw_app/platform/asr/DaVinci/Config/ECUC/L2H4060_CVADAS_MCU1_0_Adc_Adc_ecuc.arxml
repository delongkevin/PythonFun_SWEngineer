AUTOSAR XML (schema 00048)
package /ActiveEcuC
  module config Adc: implementation-config-variant=VARIANT-PRE-COMPILE, module-description=Adc_Impl
    AdcConfigSet
      AdcHwUnit_0 (AdcHwUnit): AdcHwUnitId=ADC_UNIT_0, AdcClockSource=undefined
        AdcChannel_MCU_ADC0_AN0 (AdcChannel):
          AdcChannelId = 0
          AdcChannelOpenDelay = 0
          AdcChannelSampleDelay = 0
          AdcChannelRangeCheckEnable = false
          AdcChannelAveragingMode = ADC_AVERAGING_MODE_2_SAMPLES
        AdcGroup_0 (AdcGroup):
          AdcGroupAccessMode = ADC_ACCESS_MODE_SINGLE
          AdcGroupConversionMode = ADC_CONV_MODE_ONESHOT
          AdcGroupId = 0
          AdcGroupTriggSrc = ADC_TRIGG_SRC_SW
          AdcStreamingBufferMode = ADC_STREAM_BUFFER_LINEAR
          AdcStreamingNumSamples = 1
          AdcGroupHighRange = 4095
          AdcGroupLowRange = 1
          AdcGroupReplacement = ADC_GROUP_REPL_SUSPEND_RESUME
          AdcGroupPriority = 0
          AdcHwTrigSignal = ADC_HW_TRIG_FALLING_EDGE
          AdcHwTrigTimer = 0
          AdcNotification = AdcApp_HwUnit0_Group0EndNotification
          AdcGroupDefinition = AdcChannel_MCU_ADC0_AN{0..7}
        7 x AdcChannel, all with AdcChannelOpenDelay=0, AdcChannelSampleDelay=0, AdcChannelRangeCheckEnable=false, AdcChannelAveragingMode=ADC_AVERAGING_MODE_2_SAMPLES:
          AdcChannel_MCU_ADC0_AN{1..7}: AdcChannelId={1..7}
      AdcHwUnit_1 (AdcHwUnit): AdcHwUnitId=ADC_UNIT_1, AdcClockSource=undefined
        AdcChannel_MCU_ADC1_AN0 (AdcChannel):
          AdcChannelId = 0
          AdcChannelOpenDelay = 0
          AdcChannelSampleDelay = 0
          AdcChannelRangeCheckEnable = false
          AdcChannelAveragingMode = ADC_AVERAGING_MODE_2_SAMPLES
        AdcGroup_1 (AdcGroup):
          AdcGroupAccessMode = ADC_ACCESS_MODE_SINGLE
          AdcGroupConversionMode = ADC_CONV_MODE_ONESHOT
          AdcGroupId = 1
          AdcGroupTriggSrc = ADC_TRIGG_SRC_SW
          AdcStreamingBufferMode = ADC_STREAM_BUFFER_LINEAR
          AdcStreamingNumSamples = 1
          AdcGroupHighRange = 4095
          AdcGroupLowRange = 1
          AdcGroupReplacement = ADC_GROUP_REPL_SUSPEND_RESUME
          AdcGroupPriority = 1
          AdcHwTrigSignal = ADC_HW_TRIG_FALLING_EDGE
          AdcHwTrigTimer = 0
          AdcNotification = AdcApp_HwUnit1_Group1EndNotification
          AdcGroupDefinition = AdcChannel_MCU_ADC1_AN0
          AdcGroupDefinition = AdcChannel_MCU_ADC1_AN2
          AdcGroupDefinition = AdcChannel_MCU_ADC1_AN3
        AdcChannel_MCU_ADC1_AN2 (AdcChannel):
          AdcChannelId = 2
          AdcChannelOpenDelay = 0
          AdcChannelSampleDelay = 0
          AdcChannelRangeCheckEnable = false
          AdcChannelAveragingMode = ADC_AVERAGING_MODE_2_SAMPLES
        AdcChannel_MCU_ADC1_AN3 (AdcChannel):
          AdcChannelId = 3
          AdcChannelOpenDelay = 0
          AdcChannelSampleDelay = 0
          AdcChannelRangeCheckEnable = false
          AdcChannelAveragingMode = ADC_AVERAGING_MODE_2_SAMPLES
    AdcGeneral:
      AdcDeInitApi = true
      AdcDevErrorDetect = true
      AdcEnableQueuing = true
      AdcEnableStartStopGroupApi = true
      AdcGrpNotifCapability = true
      AdcPriorityImplementation = ADC_PRIORITY_HW_SW
      AdcReadGroupApi = true
      AdcResultAlignment = ADC_ALIGN_RIGHT
      AdcVersionInfoApi = true
      AdcGroupLog = true
      AdcGroupLogMaxLen = 100
      AdcFifoErrLog = true
      AdcFifoErrLogMaxLen = 100
      AdcMaxGroupCount = 2
      AdcMaxHwUnitCount = 2
      AdcEnableRegisterReadbackApi = true
      AdcTypeofInterruptFunction = ADC_ISR_CAT2
      AdcDefaultOSCounterId = 0
      AdcTimeoutDuration = 10000
      AdcDeviceVariant = J721S2
      AdcOwnProcId = MCU1_0
      AdcOsCounterRef = SystemTimer
    AdcPublishedInformation:
      AdcChannelValueSigned = false
      AdcGroupFirstChannelFixed = false
      AdcMaxChannelResolution = 12
      AdcMaxRange = 4095
      AdcMinRange = 0
      AdcMaxNumChannels = 10
      AdcMaxHwChannelId = 9
      AdcMinHwChannelId = 0
      AdcMaxOpenDelay = 262143
      AdcMinOpenDelay = 0
      AdcMaxSampleDelay = 255
      AdcMinSampleDelay = 0
