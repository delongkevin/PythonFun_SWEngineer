AUTOSAR XML (schema 00048)
package /ActiveEcuC
  module config vLinkGen: implementation-config-variant=VARIANT-PRE-COMPILE, module-description=vLinkGen_Impl
    vLinkGenMemLayout
      vLinkGenLinkerSections
        MSR_CODE (vLinkGenLinkerCodeSection): vLinkGenLinkerCodeSectionName=MSR_CODE, vLinkGenLinkerCodeSectionFast=false
        MSR_CONST (vLinkGenLinkerConstSection): vLinkGenLinkerConstSectionName=MSR_CONST, vLinkGenLinkerConstSectionFast=false
        MSR_PBCFG_CONST (vLinkGenLinkerConstSection): vLinkGenLinkerConstSectionName=MSR_PBCFG_CONST, vLinkGenLinkerConstSectionFast=false
        4 x vLinkGenLinkerVarSection, all with vLinkGenLinkerVarSectionFast=false:
          MSR_PBCFG_VAR: vLinkGenLinkerVarSectionName=MSR_PBCFG_VAR
          MSR_VAR_CLEARED: vLinkGenLinkerVarSectionName=MSR_VAR_CLEARED
          MSR_VAR_INIT: vLinkGenLinkerVarSectionName=MSR_VAR_INIT
          MSR_VAR_NO_INIT: vLinkGenLinkerVarSectionName=MSR_VAR_NO_INIT
        MSR_CONST_FAST (vLinkGenLinkerConstSection): vLinkGenLinkerConstSectionFast=true, vLinkGenLinkerConstSectionName=MSR_CONST_FAST
        3 x vLinkGenLinkerVarSection, all with vLinkGenLinkerVarSectionFast=true:
          MSR_VAR_FAST_CLEARED: vLinkGenLinkerVarSectionName=MSR_VAR_FAST_CLEARED
          MSR_VAR_FAST_INIT: vLinkGenLinkerVarSectionName=MSR_VAR_FAST_INIT
          MSR_VAR_FAST_NO_INIT: vLinkGenLinkerVarSectionName=MSR_VAR_FAST_NO_INIT
        MSR_PBCFG_CONST_FAST (vLinkGenLinkerConstSection): vLinkGenLinkerConstSectionFast=true, vLinkGenLinkerConstSectionName=MSR_PBCFG_CONST_FAST
        7 x vLinkGenLinkerVarSection:
          MSR_PBCFG_VAR_FAST: vLinkGenLinkerVarSectionFast=true, vLinkGenLinkerVarSectionName=MSR_PBCFG_VAR_FAST
          MSR_PBCFG_VAR_FAST_NO_INIT: vLinkGenLinkerVarSectionFast=true, vLinkGenLinkerVarSectionName=MSR_PBCFG_VAR_FAST_NO_INIT
          MSR_PBCFG_VAR_NO_INIT: vLinkGenLinkerVarSectionName=MSR_PBCFG_VAR_NO_INIT, vLinkGenLinkerVarSectionFast=false
          MSR_VAR_SAVED_ZONE_INIT: vLinkGenLinkerVarSectionName=MSR_VAR_SAVED_ZONE_INIT, vLinkGenLinkerVarSectionFast=false
          MSR_VAR_SAVED_ZONE_NO_INIT: vLinkGenLinkerVarSectionName=MSR_VAR_SAVED_ZONE_NO_INIT, vLinkGenLinkerVarSectionFast=false
          MSR_VAR_SAVED_ZONE_FAST_INIT: vLinkGenLinkerVarSectionFast=true, vLinkGenLinkerVarSectionName=MSR_VAR_SAVED_ZONE_FAST_INIT
          MSR_VAR_SAVED_ZONE_FAST_NO_INIT: vLinkGenLinkerVarSectionFast=true, vLinkGenLinkerVarSectionName=MSR_VAR_SAVED_ZONE_FAST_NO_INIT
        brsStartup (vLinkGenLinkerCodeSection): vLinkGenLinkerCodeSectionName=brsStartup, vLinkGenLinkerCodeSectionFast=false
        startupCode (vLinkGenLinkerCodeSection): vLinkGenLinkerCodeSectionName=startupCode, vLinkGenLinkerCodeSectionFast=false
        4 x vLinkGenLinkerConstSection, all with vLinkGenLinkerConstSectionFast=false:
          startupData: vLinkGenLinkerConstSectionName=startupData
          DMSC_INTERNAL_const: vLinkGenLinkerConstSectionName=const.devgroup.DMSC_INTERNAL
          MAIN_const: vLinkGenLinkerConstSectionName=const.devgroup.MAIN
          MCU_WAKEUP_const: vLinkGenLinkerConstSectionName=const.devgroup.MCU_WAKEUP
        5 x vLinkGenLinkerVarSection, all with vLinkGenLinkerVarSectionFast=false:
          BOARDCFG_DATA: vLinkGenLinkerVarSectionName=boardcfg_data
          DATA_USER: vLinkGenLinkerVarSectionName=data_user
          DMSC_INTERNAL_var: vLinkGenLinkerVarSectionName=bss.devgroup.DMSC_INTERNAL
          MAIN_var: vLinkGenLinkerVarSectionName=bss.devgroup.MAIN
          MCU_WAKEUP_var: vLinkGenLinkerVarSectionName=bss.devgroup.MCU_WAKEUP
        text (vLinkGenLinkerCodeSection): vLinkGenLinkerCodeSectionName=text, vLinkGenLinkerCodeSectionFast=false
        rodata (vLinkGenLinkerConstSection): vLinkGenLinkerConstSectionName=rodata, vLinkGenLinkerConstSectionFast=false
        rodata_const (vLinkGenLinkerSpecSection): vLinkGenLinkerSpecSectionValue=.const, vLinkGenLinkerSpecSectionPad=0
        4 x vLinkGenLinkerVarSection, all with vLinkGenLinkerVarSectionFast=false:
          data: vLinkGenLinkerVarSectionName=data
          bss: vLinkGenLinkerVarSectionName=bss
          stack: vLinkGenLinkerVarSectionName=stack
          heap: vLinkGenLinkerVarSectionName=heap
        6 x vLinkGenLinkerCodeSection, all with vLinkGenLinkerCodeSectionFast=false, vLinkGenLinkerCodeSectionModule=Os:
          OS_CODE: vLinkGenLinkerCodeSectionName=OS_CODE
          OS_OS_COREINITHOOK_CODE: vLinkGenLinkerCodeSectionName=OS_OS_COREINITHOOK_CODE
          OS_INTVEC_CODE: vLinkGenLinkerCodeSectionName=OS_INTVEC_CODE, vLinkGenLinkerCodeSectionAlignment=0
          OS_EXCVEC_CORE0_CODE: vLinkGenLinkerCodeSectionName=OS_EXCVEC_CORE0_CODE, vLinkGenLinkerCodeSectionAlignment=0
          OS_INTVEC_CORE0_CODE: vLinkGenLinkerCodeSectionName=OS_INTVEC_CORE0_CODE, vLinkGenLinkerCodeSectionAlignment=0
          OS_ERRORHOOK_CODE: vLinkGenLinkerCodeSectionName=OS_ERRORHOOK_CODE
        7 x vLinkGenLinkerConstSection, all with vLinkGenLinkerConstSectionFast=false, vLinkGenLinkerConstSectionModule=Os:
          OS_CONST: vLinkGenLinkerConstSectionName=OS_CONST
          OS_INTVEC_CONST: vLinkGenLinkerConstSectionName=OS_INTVEC_CONST
          OS_GLOBALSHARED_CONST: vLinkGenLinkerConstSectionName=OS_GLOBALSHARED_CONST
          OS_CORE0_CONST: vLinkGenLinkerConstSectionName=OS_CORE0_CONST
          OS_EXCVEC_CORE0_CONST: vLinkGenLinkerConstSectionName=OS_EXCVEC_CORE0_CONST, vLinkGenLinkerConstSectionAlignment=0
          OS_INTVEC_CORE0_CONST: vLinkGenLinkerConstSectionName=OS_INTVEC_CORE0_CONST, vLinkGenLinkerConstSectionAlignment=0
          OS_SystemApplication_OsCore0_CONST: vLinkGenLinkerConstSectionName=OS_SystemApplication_OsCore0_CONST
        5 x vLinkGenLinkerStackSection, all with vLinkGenLinkerStackSectionModule=Os:
          OS_STACK_OSCORE0_KERNEL_VAR_NOINIT: vLinkGenLinkerStackSectionName=OS_STACK_OSCORE0_KERNEL_VAR_NOINIT
          OS_STACK_OSCORE0_INIT_VAR_NOINIT: vLinkGenLinkerStackSectionName=OS_STACK_OSCORE0_INIT_VAR_NOINIT
          OS_STACK_OSCORE0_ERROR_VAR_NOINIT: vLinkGenLinkerStackSectionName=OS_STACK_OSCORE0_ERROR_VAR_NOINIT
          OS_STACK_OSCORE0_TASK_PRIO4294967295_VAR_NOINIT: vLinkGenLinkerStackSectionName=OS_STACK_OSCORE0_TASK_PRIO4294967295_VAR_NOINIT
          OS_STACK_OSCORE0_ISR_CORE_VAR_NOINIT: vLinkGenLinkerStackSectionName=OS_STACK_OSCORE0_ISR_CORE_VAR_NOINIT
        29 x vLinkGenLinkerVarSection, all with vLinkGenLinkerVarSectionFast=false, vLinkGenLinkerVarSectionModule=Os:
          OS_VAR_NOCACHE: vLinkGenLinkerVarSectionName=OS_VAR_NOCACHE
          OS_VAR_NOCACHE_NOINIT: vLinkGenLinkerVarSectionName=OS_VAR_NOCACHE_NOINIT
          OS_GLOBALSHARED_VAR_NOINIT: vLinkGenLinkerVarSectionName=OS_GLOBALSHARED_VAR_NOINIT
          OS_GLOBALSHARED_VAR: vLinkGenLinkerVarSectionName=OS_GLOBALSHARED_VAR
          OS_GLOBALSHARED_VAR_ZERO_INIT: vLinkGenLinkerVarSectionName=OS_GLOBALSHARED_VAR_ZERO_INIT
          OS_GLOBALSHARED_VAR_NOCACHE_NOINIT: vLinkGenLinkerVarSectionName=OS_GLOBALSHARED_VAR_NOCACHE_NOINIT
          OS_GLOBALSHARED_VAR_NOCACHE: vLinkGenLinkerVarSectionName=OS_GLOBALSHARED_VAR_NOCACHE
          OS_GLOBALSHARED_VAR_NOCACHE_ZERO_INIT: vLinkGenLinkerVarSectionName=OS_GLOBALSHARED_VAR_NOCACHE_ZERO_INIT
          OS_GLOBALSHARED_VAR_ZERO_INIT_bss: vLinkGenLinkerVarSectionName=OS_GLOBALSHARED_VAR_ZERO_INIT_bss
          OS_GLOBALSHARED_VAR_NOCACHE_ZERO_INIT_bss: vLinkGenLinkerVarSectionName=OS_GLOBALSHARED_VAR_NOCACHE_ZERO_INIT_bss
          OS_GLOBALSHARED_VAR_SAVED_ZONE: vLinkGenLinkerVarSectionName=OS_GLOBALSHARED_VAR_SAVED_ZONE
          OS_GLOBALSHARED_VAR_SAVED_ZONE_NOINIT: vLinkGenLinkerVarSectionName=OS_GLOBALSHARED_VAR_SAVED_ZONE_NOINIT
          OS_CORESTATUS_CORE0_VAR_NOCACHE_NOINIT: vLinkGenLinkerVarSectionName=OS_CORESTATUS_CORE0_VAR_NOCACHE_NOINIT
          OS_CORE0_VAR: vLinkGenLinkerVarSectionName=OS_CORE0_VAR
          OS_CORE0_VAR_NOCACHE: vLinkGenLinkerVarSectionName=OS_CORE0_VAR_NOCACHE
          OS_CORE0_VAR_NOINIT: vLinkGenLinkerVarSectionName=OS_CORE0_VAR_NOINIT
          OS_CORE0_VAR_NOCACHE_NOINIT: vLinkGenLinkerVarSectionName=OS_CORE0_VAR_NOCACHE_NOINIT
          OS_PUBLIC_CORE0_VAR_NOINIT: vLinkGenLinkerVarSectionName=OS_PUBLIC_CORE0_VAR_NOINIT
          OS_BARRIER_CORE0_VAR_NOCACHE_NOINIT: vLinkGenLinkerVarSectionName=OS_BARRIER_CORE0_VAR_NOCACHE_NOINIT
          OS_SystemApplication_OsCore0_VAR_NOINIT: vLinkGenLinkerVarSectionName=OS_SystemApplication_OsCore0_VAR_NOINIT
          OS_SystemApplication_OsCore0_VAR: vLinkGenLinkerVarSectionName=OS_SystemApplication_OsCore0_VAR
          OS_SystemApplication_OsCore0_VAR_ZERO_INIT: vLinkGenLinkerVarSectionName=OS_SystemApplication_OsCore0_VAR_ZERO_INIT
          OS_SystemApplication_OsCore0_VAR_NOCACHE_NOINIT: vLinkGenLinkerVarSectionName=OS_SystemApplication_OsCore0_VAR_NOCACHE_NOINIT
          OS_SystemApplication_OsCore0_VAR_NOCACHE: vLinkGenLinkerVarSectionName=OS_SystemApplication_OsCore0_VAR_NOCACHE
          OS_SystemApplication_OsCore0_VAR_NOCACHE_ZERO_INIT: vLinkGenLinkerVarSectionName=OS_SystemApplication_OsCore0_VAR_NOCACHE_ZERO_INIT
          OS_SystemApplication_OsCore0_VAR_ZERO_INIT_bss: vLinkGenLinkerVarSectionName=OS_SystemApplication_OsCore0_VAR_ZERO_INIT_bss
          OS_SystemApplication_OsCore0_VAR_NOCACHE_ZERO_INIT_bss: vLinkGenLinkerVarSectionName=OS_SystemApplication_OsCore0_VAR_NOCACHE_ZERO_INIT_bss
          OS_SystemApplication_OsCore0_VAR_SAVED_ZONE: vLinkGenLinkerVarSectionName=OS_SystemApplication_OsCore0_VAR_SAVED_ZONE
          OS_SystemApplication_OsCore0_VAR_SAVED_ZONE_NOINIT: vLinkGenLinkerVarSectionName=OS_SystemApplication_OsCore0_VAR_SAVED_ZONE_NOINIT
        OS_OsApplication_Trusted_Core0_CONST (vLinkGenLinkerConstSection): vLinkGenLinkerConstSectionName=OS_OsApplication_Trusted_Core0_CONST, vLinkGenLinkerConstSectionFast=false, vLinkGenLinkerConstSectionModule=Os
        10 x vLinkGenLinkerVarSection, all with vLinkGenLinkerVarSectionFast=false, vLinkGenLinkerVarSectionModule=Os:
          OS_OsApplication_Trusted_Core0_VAR_NOINIT: vLinkGenLinkerVarSectionName=OS_OsApplication_Trusted_Core0_VAR_NOINIT
          OS_OsApplication_Trusted_Core0_VAR: vLinkGenLinkerVarSectionName=OS_OsApplication_Trusted_Core0_VAR
          OS_OsApplication_Trusted_Core0_VAR_ZERO_INIT: vLinkGenLinkerVarSectionName=OS_OsApplication_Trusted_Core0_VAR_ZERO_INIT
          OS_OsApplication_Trusted_Core0_VAR_NOCACHE_NOINIT: vLinkGenLinkerVarSectionName=OS_OsApplication_Trusted_Core0_VAR_NOCACHE_NOINIT
          OS_OsApplication_Trusted_Core0_VAR_NOCACHE: vLinkGenLinkerVarSectionName=OS_OsApplication_Trusted_Core0_VAR_NOCACHE
          OS_OsApplication_Trusted_Core0_VAR_NOCACHE_ZERO_INIT: vLinkGenLinkerVarSectionName=OS_OsApplication_Trusted_Core0_VAR_NOCACHE_ZERO_INIT
          OS_OsApplication_Trusted_Core0_VAR_ZERO_INIT_bss: vLinkGenLinkerVarSectionName=OS_OsApplication_Trusted_Core0_VAR_ZERO_INIT_bss
          OS_OsApplication_Trusted_Core0_VAR_NOCACHE_ZERO_INIT_bss: vLinkGenLinkerVarSectionName=OS_OsApplication_Trusted_Core0_VAR_NOCACHE_ZERO_INIT_bss
          OS_OsApplication_Trusted_Core0_VAR_SAVED_ZONE: vLinkGenLinkerVarSectionName=OS_OsApplication_Trusted_Core0_VAR_SAVED_ZONE
          OS_OsApplication_Trusted_Core0_VAR_SAVED_ZONE_NOINIT: vLinkGenLinkerVarSectionName=OS_OsApplication_Trusted_Core0_VAR_SAVED_ZONE_NOINIT
        4 x vLinkGenLinkerCodeSection, all with vLinkGenLinkerCodeSectionFast=false, vLinkGenLinkerCodeSectionModule=Os:
          OS_BootAppOsTask_CODE: vLinkGenLinkerCodeSectionName=OS_BootAppOsTask_CODE
          OS_SciServerLowOsTask_CODE: vLinkGenLinkerCodeSectionName=OS_SciServerLowOsTask_CODE
          OS_StartUpTask_CODE: vLinkGenLinkerCodeSectionName=OS_StartUpTask_CODE
          OS_SciServerHighOsTask_CODE: vLinkGenLinkerCodeSectionName=OS_SciServerHighOsTask_CODE
        3 x vLinkGenLinkerStackSection, all with vLinkGenLinkerStackSectionModule=Os:
          OS_STACK_OSCORE0_TASK_PRIO100_VAR_NOINIT: vLinkGenLinkerStackSectionName=OS_STACK_OSCORE0_TASK_PRIO100_VAR_NOINIT, vLinkGenLinkerStackSectionAlignment=512
          OS_STACK_SCISERVERLOWOSTASK_VAR_NOINIT: vLinkGenLinkerStackSectionName=OS_STACK_SCISERVERLOWOSTASK_VAR_NOINIT, vLinkGenLinkerStackSectionAlignment=4096
          OS_STACK_SCISERVERHIGHOSTASK_VAR_NOINIT: vLinkGenLinkerStackSectionName=OS_STACK_SCISERVERHIGHOSTASK_VAR_NOINIT, vLinkGenLinkerStackSectionAlignment=4096
        9 x vLinkGenLinkerCodeSection, all with vLinkGenLinkerCodeSectionFast=false, vLinkGenLinkerCodeSectionModule=Os:
          OS_Adc_IrqUnit0_CODE: vLinkGenLinkerCodeSectionName=OS_Adc_IrqUnit0_CODE
          OS_Adc_IrqUnit1_CODE: vLinkGenLinkerCodeSectionName=OS_Adc_IrqUnit1_CODE
          OS_I2c_IrqUnit0_CODE: vLinkGenLinkerCodeSectionName=OS_I2c_IrqUnit0_CODE
          OS_IPC_mailbox1_CODE: vLinkGenLinkerCodeSectionName=OS_IPC_mailbox1_CODE
          OS_IPC_mailbox2_CODE: vLinkGenLinkerCodeSectionName=OS_IPC_mailbox2_CODE
          OS_MCU_NAVSS0_UDMASS_INTA_0_INTAGGR_VINTR_PEND_78_CODE: vLinkGenLinkerCodeSectionName=OS_MCU_NAVSS0_UDMASS_INTA_0_INTAGGR_VINTR_PEND_78_CODE
          OS_MCU_NAVSS0_UDMASS_INTA_0_INTAGGR_VINTR_PEND_79_CODE: vLinkGenLinkerCodeSectionName=OS_MCU_NAVSS0_UDMASS_INTA_0_INTAGGR_VINTR_PEND_79_CODE
          OS_PANICHOOK_CODE: vLinkGenLinkerCodeSectionName=OS_PANICHOOK_CODE
          OS_PROTECTIONHOOK_CODE: vLinkGenLinkerCodeSectionName=OS_PROTECTIONHOOK_CODE
        OS_STACK_OSCORE0_PROTECTION_VAR_NOINIT (vLinkGenLinkerStackSection):
          vLinkGenLinkerStackSectionName = OS_STACK_OSCORE0_PROTECTION_VAR_NOINIT
          vLinkGenLinkerStackSectionAlignment = 1024
          vLinkGenLinkerStackSectionModule = Os
        5 x vLinkGenLinkerCodeSection, all with vLinkGenLinkerCodeSectionFast=false, vLinkGenLinkerCodeSectionModule=Os:
          OS_SciServer_OsIsr_UserMsgHwiFxn{1..4}_CODE: vLinkGenLinkerCodeSectionName=OS_SciServer_OsIsr_UserMsgHwiFxn{1..4}_CODE
          OS_SHUTDOWNHOOK_CODE: vLinkGenLinkerCodeSectionName=OS_SHUTDOWNHOOK_CODE
        OS_STACK_OSCORE0_SHUTDOWN_VAR_NOINIT (vLinkGenLinkerStackSection):
          vLinkGenLinkerStackSectionName = OS_STACK_OSCORE0_SHUTDOWN_VAR_NOINIT
          vLinkGenLinkerStackSectionAlignment = 1024
          vLinkGenLinkerStackSectionModule = Os
        OS_Can_30_McanIsr_0_CODE (vLinkGenLinkerCodeSection): vLinkGenLinkerCodeSectionName=OS_Can_30_McanIsr_0_CODE, vLinkGenLinkerCodeSectionFast=false, vLinkGenLinkerCodeSectionModule=Os
        OS_Can_30_McanIsr_1_CODE (vLinkGenLinkerCodeSection): vLinkGenLinkerCodeSectionName=OS_Can_30_McanIsr_1_CODE, vLinkGenLinkerCodeSectionFast=false, vLinkGenLinkerCodeSectionModule=Os
        OS_STACK_BOOTAPPOSTASK_VAR_NOINIT (vLinkGenLinkerStackSection): vLinkGenLinkerStackSectionName=OS_STACK_BOOTAPPOSTASK_VAR_NOINIT, vLinkGenLinkerStackSectionAlignment=4096, vLinkGenLinkerStackSectionModule=Os
        8 x vLinkGenLinkerCodeSection, all with vLinkGenLinkerCodeSectionFast=false, vLinkGenLinkerCodeSectionModule=Os:
          OS_vHsmResponseIsr_CODE: vLinkGenLinkerCodeSectionName=OS_vHsmResponseIsr_CODE
          OS_QM_Task_Init_CODE: vLinkGenLinkerCodeSectionName=OS_QM_Task_Init_CODE
          OS_Safety_Task_Init_CODE: vLinkGenLinkerCodeSectionName=OS_Safety_Task_Init_CODE
          OS_QM_Task_00_10ms_CODE: vLinkGenLinkerCodeSectionName=OS_QM_Task_00_10ms_CODE
          OS_Safety_Task_00_10ms_CODE: vLinkGenLinkerCodeSectionName=OS_Safety_Task_00_10ms_CODE
          OS_QM_Task_01_10ms_CODE: vLinkGenLinkerCodeSectionName=OS_QM_Task_01_10ms_CODE
          OS_Safety_Task_01_10ms_CODE: vLinkGenLinkerCodeSectionName=OS_Safety_Task_01_10ms_CODE
          OS_QM_Task_200ms_CODE: vLinkGenLinkerCodeSectionName=OS_QM_Task_200ms_CODE
        3 x vLinkGenLinkerStackSection, all with vLinkGenLinkerStackSectionModule=Os:
          OS_STACK_QM_TASK_200MS_VAR_NOINIT: vLinkGenLinkerStackSectionName=OS_STACK_QM_TASK_200MS_VAR_NOINIT, vLinkGenLinkerStackSectionAlignment=512
          OS_STACK_OSCORE0_TASK_PRIO54_VAR_NOINIT: vLinkGenLinkerStackSectionName=OS_STACK_OSCORE0_TASK_PRIO54_VAR_NOINIT, vLinkGenLinkerStackSectionAlignment=4096
          OS_STACK_OSCORE0_TASK_PRIO50_VAR_NOINIT: vLinkGenLinkerStackSectionName=OS_STACK_OSCORE0_TASK_PRIO50_VAR_NOINIT, vLinkGenLinkerStackSectionAlignment=32768
        5 x vLinkGenLinkerCodeSection, all with vLinkGenLinkerCodeSectionFast=false, vLinkGenLinkerCodeSectionModule=Os:
          OS_Safety_Task_200ms_CODE: vLinkGenLinkerCodeSectionName=OS_Safety_Task_200ms_CODE
          OS_QM_ComTask_10ms_CODE: vLinkGenLinkerCodeSectionName=OS_QM_ComTask_10ms_CODE
          OS_QM_DiagTask_10ms_CODE: vLinkGenLinkerCodeSectionName=OS_QM_DiagTask_10ms_CODE
          OS_QM_MemTask_10ms_CODE: vLinkGenLinkerCodeSectionName=OS_QM_MemTask_10ms_CODE
          OS_QM_ComTask_5ms_CODE: vLinkGenLinkerCodeSectionName=OS_QM_ComTask_5ms_CODE
        OS_STACK_OSCORE0_TASK_PRIO90_VAR_NOINIT (vLinkGenLinkerStackSection):
          vLinkGenLinkerStackSectionName = OS_STACK_OSCORE0_TASK_PRIO90_VAR_NOINIT
          vLinkGenLinkerStackSectionAlignment = 2048
          vLinkGenLinkerStackSectionModule = Os
        OS_STACK_OSCORE0_TASK_PRIO88_VAR_NOINIT (vLinkGenLinkerStackSection):
          vLinkGenLinkerStackSectionName = OS_STACK_OSCORE0_TASK_PRIO88_VAR_NOINIT
          vLinkGenLinkerStackSectionAlignment = 2048
          vLinkGenLinkerStackSectionModule = Os
        32 x vLinkGenLinkerCodeSection, all with vLinkGenLinkerCodeSectionFast=false, vLinkGenLinkerCodeSectionModule=Os:
          OS_ShutdownTask_CODE: vLinkGenLinkerCodeSectionName=OS_ShutdownTask_CODE
          OS_MCU_ESM0_ESM_INT_HI_LVL_0_CODE: vLinkGenLinkerCodeSectionName=OS_MCU_ESM0_ESM_INT_HI_LVL_0_CODE
          OS_MCU_ESM0_ESM_INT_LOW_LVL_0_CODE: vLinkGenLinkerCodeSectionName=OS_MCU_ESM0_ESM_INT_LOW_LVL_0_CODE
          OS_MCU_ESM0_ESM_INT_CFG_LVL_0_CODE: vLinkGenLinkerCodeSectionName=OS_MCU_ESM0_ESM_INT_CFG_LVL_0_CODE
          OS_WKUP_ESM0_ESM_INT_HI_LVL_0_CODE: vLinkGenLinkerCodeSectionName=OS_WKUP_ESM0_ESM_INT_HI_LVL_0_CODE
          OS_WKUP_ESM0_ESM_INT_LOW_LVL_0_CODE: vLinkGenLinkerCodeSectionName=OS_WKUP_ESM0_ESM_INT_LOW_LVL_0_CODE
          OS_WKUP_ESM0_ESM_INT_CFG_LVL_0_CODE: vLinkGenLinkerCodeSectionName=OS_WKUP_ESM0_ESM_INT_CFG_LVL_0_CODE
          OS_MAIN_ESM0_ESM_INT_HI_LVL_0_CODE: vLinkGenLinkerCodeSectionName=OS_MAIN_ESM0_ESM_INT_HI_LVL_0_CODE
          OS_MAIN_ESM0_ESM_INT_LOW_LVL_0_CODE: vLinkGenLinkerCodeSectionName=OS_MAIN_ESM0_ESM_INT_LOW_LVL_0_CODE
          OS_MAIN_ESM0_ESM_INT_CFG_LVL_0_CODE: vLinkGenLinkerCodeSectionName=OS_MAIN_ESM0_ESM_INT_CFG_LVL_0_CODE
          OS_SDLR_MCU_R5FSS0_CORE0_INTR_GLUELOGIC_MAIN_PULSAR0_LBIST_GLUE_DFT_LBIST_BIST_DONE_0_297_CODE: vLinkGenLinkerCodeSectionName=OS_SDLR_MCU_R5FSS0_CORE0_INTR_GLUELOGIC_MAIN_PULSAR0_LBIST_GLUE_DFT_LBIST_BIST_DONE_0_297_CODE
          OS_SDLR_MCU_R5FSS0_CORE0_INTR_GLUELOGIC_MAIN_PULSAR1_LBIST_GLUE_DFT_LBIST_BIST_DONE_0_298_CODE: vLinkGenLinkerCodeSectionName=OS_SDLR_MCU_R5FSS0_CORE0_INTR_GLUELOGIC_MAIN_PULSAR1_LBIST_GLUE_DFT_LBIST_BIST_DONE_0_298_CODE
          OS_SDLR_MCU_R5FSS0_CORE0_INTR_COMPUTE_CLUSTER0_AC71_4_DFT_LBIST_DFT_LBIST_BIST_DONE_0_295_CODE: vLinkGenLinkerCodeSectionName=OS_SDLR_MCU_R5FSS0_CORE0_INTR_COMPUTE_CLUSTER0_AC71_4_DFT_LBIST_DFT_LBIST_BIST_DONE_0_295_CODE
          OS_SDLR_MCU_R5FSS0_CORE0_INTR_COMPUTE_CLUSTER0_AC71_5_DFT_LBIST_DFT_LBIST_BIST_DONE_0_296_CODE: vLinkGenLinkerCodeSectionName=OS_SDLR_MCU_R5FSS0_CORE0_INTR_COMPUTE_CLUSTER0_AC71_5_DFT_LBIST_DFT_LBIST_BIST_DONE_0_296_CODE
          OS_SDLR_MCU_R5FSS0_CORE0_INTR_COMPUTE_CLUSTER0_ARM0_DFT_LBIST_DFT_LBIST_BIST_DONE_0_291_CODE: vLinkGenLinkerCodeSectionName=OS_SDLR_MCU_R5FSS0_CORE0_INTR_COMPUTE_CLUSTER0_ARM0_DFT_LBIST_DFT_LBIST_BIST_DONE_0_291_CODE
          OS_SDLR_MCU_R5FSS0_CORE0_INTR_GLUELOGIC_DMPAC_LBIST_GLUE_DFT_LBIST_BIST_DONE_0_299_CODE: vLinkGenLinkerCodeSectionName=OS_SDLR_MCU_R5FSS0_CORE0_INTR_GLUELOGIC_DMPAC_LBIST_GLUE_DFT_LBIST_BIST_DONE_0_299_CODE
          OS_SDLR_MCU_R5FSS0_CORE0_INTR_GLUELOGIC_VPAC_LBIST_GLUE_DFT_LBIST_BIST_DONE_0_300_CODE: vLinkGenLinkerCodeSectionName=OS_SDLR_MCU_R5FSS0_CORE0_INTR_GLUELOGIC_VPAC_LBIST_GLUE_DFT_LBIST_BIST_DONE_0_300_CODE
          OS_SDLR_MCU_R5FSS0_CORE0_INTR_AEP_GPU_BXS464_WRAP0_DFT_EMBED_PBIST_0_DFT_PBIST_CPU_0_317_CODE: vLinkGenLinkerCodeSectionName=OS_SDLR_MCU_R5FSS0_CORE0_INTR_AEP_GPU_BXS464_WRAP0_DFT_EMBED_PBIST_0_DFT_PBIST_CPU_0_317_CODE
          OS_SDLR_MCU_R5FSS0_CORE0_INTR_COMPUTE_CLUSTER0_PBIST_WRAP_0_DFT_PBIST_CPU_0_290_CODE: vLinkGenLinkerCodeSectionName=OS_SDLR_MCU_R5FSS0_CORE0_INTR_COMPUTE_CLUSTER0_PBIST_WRAP_0_DFT_PBIST_CPU_0_290_CODE
          OS_SDLR_MCU_R5FSS0_CORE0_INTR_MCU_PBIST0_DFT_PBIST_CPU_0_47_CODE: vLinkGenLinkerCodeSectionName=OS_SDLR_MCU_R5FSS0_CORE0_INTR_MCU_PBIST0_DFT_PBIST_CPU_0_47_CODE
          OS_SDLR_MCU_R5FSS0_CORE0_INTR_MCU_PBIST1_DFT_PBIST_CPU_0_36_CODE: vLinkGenLinkerCodeSectionName=OS_SDLR_MCU_R5FSS0_CORE0_INTR_MCU_PBIST1_DFT_PBIST_CPU_0_36_CODE
          OS_SDLR_MCU_R5FSS0_CORE0_INTR_MCU_PBIST2_DFT_PBIST_CPU_0_37_CODE: vLinkGenLinkerCodeSectionName=OS_SDLR_MCU_R5FSS0_CORE0_INTR_MCU_PBIST2_DFT_PBIST_CPU_0_37_CODE
          OS_SDLR_MCU_R5FSS0_CORE0_INTR_PBIST0_DFT_PBIST_CPU_0_312_CODE: vLinkGenLinkerCodeSectionName=OS_SDLR_MCU_R5FSS0_CORE0_INTR_PBIST0_DFT_PBIST_CPU_0_312_CODE
          OS_SDLR_MCU_R5FSS0_CORE0_INTR_PBIST10_DFT_PBIST_CPU_0_310_CODE: vLinkGenLinkerCodeSectionName=OS_SDLR_MCU_R5FSS0_CORE0_INTR_PBIST10_DFT_PBIST_CPU_0_310_CODE
          OS_SDLR_MCU_R5FSS0_CORE0_INTR_PBIST11_DFT_PBIST_CPU_0_314_CODE: vLinkGenLinkerCodeSectionName=OS_SDLR_MCU_R5FSS0_CORE0_INTR_PBIST11_DFT_PBIST_CPU_0_314_CODE
          OS_SDLR_MCU_R5FSS0_CORE0_INTR_PBIST2_DFT_PBIST_CPU_0_309_CODE: vLinkGenLinkerCodeSectionName=OS_SDLR_MCU_R5FSS0_CORE0_INTR_PBIST2_DFT_PBIST_CPU_0_309_CODE
          OS_SDLR_MCU_R5FSS0_CORE0_INTR_PBIST3_DFT_PBIST_CPU_0_307_CODE: vLinkGenLinkerCodeSectionName=OS_SDLR_MCU_R5FSS0_CORE0_INTR_PBIST3_DFT_PBIST_CPU_0_307_CODE
          OS_SDLR_MCU_R5FSS0_CORE0_INTR_PBIST4_DFT_PBIST_CPU_0_308_CODE: vLinkGenLinkerCodeSectionName=OS_SDLR_MCU_R5FSS0_CORE0_INTR_PBIST4_DFT_PBIST_CPU_0_308_CODE
          OS_SDLR_MCU_R5FSS0_CORE0_INTR_PBIST5_DFT_PBIST_CPU_0_306_CODE: vLinkGenLinkerCodeSectionName=OS_SDLR_MCU_R5FSS0_CORE0_INTR_PBIST5_DFT_PBIST_CPU_0_306_CODE
          OS_SDLR_MCU_R5FSS0_CORE0_INTR_PBIST7_DFT_PBIST_CPU_0_304_CODE: vLinkGenLinkerCodeSectionName=OS_SDLR_MCU_R5FSS0_CORE0_INTR_PBIST7_DFT_PBIST_CPU_0_304_CODE
          OS_SDLR_MCU_R5FSS0_CORE0_INTR_PBIST8_DFT_PBIST_CPU_0_305_CODE: vLinkGenLinkerCodeSectionName=OS_SDLR_MCU_R5FSS0_CORE0_INTR_PBIST8_DFT_PBIST_CPU_0_305_CODE
          OS_Safety_WdgTask_10ms_CODE: vLinkGenLinkerCodeSectionName=OS_Safety_WdgTask_10ms_CODE
        OS_OsApplication_Safety_CONST (vLinkGenLinkerConstSection): vLinkGenLinkerConstSectionName=OS_OsApplication_Safety_CONST, vLinkGenLinkerConstSectionFast=false, vLinkGenLinkerConstSectionModule=Os
        10 x vLinkGenLinkerVarSection, all with vLinkGenLinkerVarSectionFast=false, vLinkGenLinkerVarSectionModule=Os:
          OS_OsApplication_Safety_VAR_NOINIT: vLinkGenLinkerVarSectionName=OS_OsApplication_Safety_VAR_NOINIT
          OS_OsApplication_Safety_VAR: vLinkGenLinkerVarSectionName=OS_OsApplication_Safety_VAR
          OS_OsApplication_Safety_VAR_ZERO_INIT: vLinkGenLinkerVarSectionName=OS_OsApplication_Safety_VAR_ZERO_INIT
          OS_OsApplication_Safety_VAR_NOCACHE_NOINIT: vLinkGenLinkerVarSectionName=OS_OsApplication_Safety_VAR_NOCACHE_NOINIT
          OS_OsApplication_Safety_VAR_NOCACHE: vLinkGenLinkerVarSectionName=OS_OsApplication_Safety_VAR_NOCACHE
          OS_OsApplication_Safety_VAR_NOCACHE_ZERO_INIT: vLinkGenLinkerVarSectionName=OS_OsApplication_Safety_VAR_NOCACHE_ZERO_INIT
          OS_OsApplication_Safety_VAR_ZERO_INIT_bss: vLinkGenLinkerVarSectionName=OS_OsApplication_Safety_VAR_ZERO_INIT_bss
          OS_OsApplication_Safety_VAR_NOCACHE_ZERO_INIT_bss: vLinkGenLinkerVarSectionName=OS_OsApplication_Safety_VAR_NOCACHE_ZERO_INIT_bss
          OS_OsApplication_Safety_VAR_SAVED_ZONE: vLinkGenLinkerVarSectionName=OS_OsApplication_Safety_VAR_SAVED_ZONE
          OS_OsApplication_Safety_VAR_SAVED_ZONE_NOINIT: vLinkGenLinkerVarSectionName=OS_OsApplication_Safety_VAR_SAVED_ZONE_NOINIT
        OS_OsApplication_QM_CONST (vLinkGenLinkerConstSection): vLinkGenLinkerConstSectionName=OS_OsApplication_QM_CONST, vLinkGenLinkerConstSectionFast=false, vLinkGenLinkerConstSectionModule=Os
        10 x vLinkGenLinkerVarSection, all with vLinkGenLinkerVarSectionFast=false, vLinkGenLinkerVarSectionModule=Os:
          OS_OsApplication_QM_VAR_NOINIT: vLinkGenLinkerVarSectionName=OS_OsApplication_QM_VAR_NOINIT
          OS_OsApplication_QM_VAR: vLinkGenLinkerVarSectionName=OS_OsApplication_QM_VAR
          OS_OsApplication_QM_VAR_ZERO_INIT: vLinkGenLinkerVarSectionName=OS_OsApplication_QM_VAR_ZERO_INIT
          OS_OsApplication_QM_VAR_NOCACHE_NOINIT: vLinkGenLinkerVarSectionName=OS_OsApplication_QM_VAR_NOCACHE_NOINIT
          OS_OsApplication_QM_VAR_NOCACHE: vLinkGenLinkerVarSectionName=OS_OsApplication_QM_VAR_NOCACHE
          OS_OsApplication_QM_VAR_NOCACHE_ZERO_INIT: vLinkGenLinkerVarSectionName=OS_OsApplication_QM_VAR_NOCACHE_ZERO_INIT
          OS_OsApplication_QM_VAR_ZERO_INIT_bss: vLinkGenLinkerVarSectionName=OS_OsApplication_QM_VAR_ZERO_INIT_bss
          OS_OsApplication_QM_VAR_NOCACHE_ZERO_INIT_bss: vLinkGenLinkerVarSectionName=OS_OsApplication_QM_VAR_NOCACHE_ZERO_INIT_bss
          OS_OsApplication_QM_VAR_SAVED_ZONE: vLinkGenLinkerVarSectionName=OS_OsApplication_QM_VAR_SAVED_ZONE
          OS_OsApplication_QM_VAR_SAVED_ZONE_NOINIT: vLinkGenLinkerVarSectionName=OS_OsApplication_QM_VAR_SAVED_ZONE_NOINIT
        OS_SDLR_MCU_R5FSS0_CORE0_INTR_PBIST1_DFT_PBIST_CPU_0_313_CODE (vLinkGenLinkerCodeSection):
          vLinkGenLinkerCodeSectionName = OS_SDLR_MCU_R5FSS0_CORE0_INTR_PBIST1_DFT_PBIST_CPU_0_313_CODE
          vLinkGenLinkerCodeSectionFast = false
          vLinkGenLinkerCodeSectionModule = Os
        OS_I2c_IrqUnit1_CODE (vLinkGenLinkerCodeSection): vLinkGenLinkerCodeSectionName=OS_I2c_IrqUnit1_CODE, vLinkGenLinkerCodeSectionFast=false, vLinkGenLinkerCodeSectionModule=Os
        8 x vLinkGenLinkerStackSection, all with vLinkGenLinkerStackSectionModule=Os:
          OS_STACK_OSCORE0_TASK_PRIO79_VAR_NOINIT: vLinkGenLinkerStackSectionName=OS_STACK_OSCORE0_TASK_PRIO79_VAR_NOINIT, vLinkGenLinkerStackSectionAlignment=8192
          OS_STACK_OSCORE0_TASK_PRIO78_VAR_NOINIT: vLinkGenLinkerStackSectionName=OS_STACK_OSCORE0_TASK_PRIO78_VAR_NOINIT, vLinkGenLinkerStackSectionAlignment=16384
          OS_STACK_SAFETY_WDGTASK_10MS_VAR_NOINIT: vLinkGenLinkerStackSectionName=OS_STACK_SAFETY_WDGTASK_10MS_VAR_NOINIT, vLinkGenLinkerStackSectionAlignment=1024
          OS_STACK_SAFETY_TASK_200MS_VAR_NOINIT: vLinkGenLinkerStackSectionName=OS_STACK_SAFETY_TASK_200MS_VAR_NOINIT, vLinkGenLinkerStackSectionAlignment=1024
          OS_STACK_QM_COMTASK_10MS_VAR_NOINIT: vLinkGenLinkerStackSectionName=OS_STACK_QM_COMTASK_10MS_VAR_NOINIT, vLinkGenLinkerStackSectionAlignment=4096
          OS_STACK_QM_COMTASK_5MS_VAR_NOINIT: vLinkGenLinkerStackSectionName=OS_STACK_QM_COMTASK_5MS_VAR_NOINIT, vLinkGenLinkerStackSectionAlignment=1024
          OS_STACK_QM_DIAGTASK_10MS_VAR_NOINIT: vLinkGenLinkerStackSectionName=OS_STACK_QM_DIAGTASK_10MS_VAR_NOINIT, vLinkGenLinkerStackSectionAlignment=4096
          OS_STACK_QM_MEMTASK_10MS_VAR_NOINIT: vLinkGenLinkerStackSectionName=OS_STACK_QM_MEMTASK_10MS_VAR_NOINIT, vLinkGenLinkerStackSectionAlignment=1024
      DDR0 (vLinkGenMemoryRegion):
        vLinkGenMemoryRegionAddrOffset = 0
        vLinkGenMemoryRegionSize = 16777216
        vLinkGenMemoryRegionAddress = 2533359616
        vLinkGenMemoryRegionAvailable = true
        vLinkGenMemoryRegionHwRegion = DDR0
        DDR0 (vLinkGenMemoryRegionBlock):
          vLinkGenMemoryRegionBlockPosition = 0
          vLinkGenMemoryRegionBlockSize = 16777216
          vLinkGenMemoryRegionBlockAddress = 2533359616
          vLinkGenMemoryRegionBlockBoundary = LOWER
          vLinkGenMemoryRegionBlockInitStage = NONE
      MCU_MSRAM (vLinkGenMemoryRegion):
        vLinkGenMemoryRegionAddrOffset = 0
        vLinkGenMemoryRegionSize = 241408
        vLinkGenMemoryRegionAddress = 1103360000
        vLinkGenMemoryRegionAvailable = true
        vLinkGenMemoryRegionHwRegion = MCU_MSRAM
        8 x vLinkGenMemoryRegionBlock, all with vLinkGenMemoryRegionBlockBoundary=LOWER, vLinkGenMemoryRegionBlockInitStage=NONE:
          MCU_MSRAM_Common: vLinkGenMemoryRegionBlockSize=49152, vLinkGenMemoryRegionBlockPosition=0, vLinkGenMemoryRegionBlockAddress=1103360000
          MCU_MSRAM_Common_NonCache: vLinkGenMemoryRegionBlockPosition=1, vLinkGenMemoryRegionBlockSize=1024, vLinkGenMemoryRegionBlockAddress=1103409152
          MCU_MSRAM_Core0: vLinkGenMemoryRegionBlockPosition=2, vLinkGenMemoryRegionBlockSize=1024, vLinkGenMemoryRegionBlockAddress=1103410176
          MCU_MSRAM_Core1: vLinkGenMemoryRegionBlockPosition=3, vLinkGenMemoryRegionBlockSize=1024, vLinkGenMemoryRegionBlockAddress=1103411200
          MCU_MSRAM_Core2: vLinkGenMemoryRegionBlockPosition=4, vLinkGenMemoryRegionBlockSize=1024, vLinkGenMemoryRegionBlockAddress=1103412224
          MCU_MSRAM_Core3: vLinkGenMemoryRegionBlockPosition=5, vLinkGenMemoryRegionBlockSize=1024, vLinkGenMemoryRegionBlockAddress=1103413248
          MCU_MSRAM_Core4: vLinkGenMemoryRegionBlockPosition=6, vLinkGenMemoryRegionBlockSize=1024, vLinkGenMemoryRegionBlockAddress=1103414272
          MCU_MSRAM_Core5: vLinkGenMemoryRegionBlockPosition=7, vLinkGenMemoryRegionBlockSize=1024, vLinkGenMemoryRegionBlockAddress=1103415296
      36 x vLinkGenLogicalConstGroup:
        OS_CODE: vLinkGenConstGroupPosition=5, vLinkGenConstGroupRegion=DDR0/DDR0, vLinkGenConstGroupModule=Os, vLinkGenConstGroupContentType=GLOBAL_CODE
          OS_CODE (vLinkGenConstSectionGroup):
            vLinkGenConstSectionGroupPosition = 0
            vLinkGenConstSectionGroupInit = NONE
            vLinkGenConstSectionGroupInitStage = ONE
            vLinkGenConstSectionGroupRef = vLinkGenLinkerSections/OS_CODE
            vLinkGenConstSectionGroupRef = OS_OS_COREINITHOOK_CODE
        OS_CONST: vLinkGenConstGroupPosition=5, vLinkGenConstGroupRegion=DDR0/DDR0, vLinkGenConstGroupModule=Os, vLinkGenConstGroupContentType=GLOBAL_CONST
          OS_CONST (vLinkGenConstSectionGroup):
            vLinkGenConstSectionGroupPosition = 0
            vLinkGenConstSectionGroupInit = NONE
            vLinkGenConstSectionGroupInitStage = ONE
            vLinkGenConstSectionGroupRef = vLinkGenLinkerSections/OS_CONST
            vLinkGenConstSectionGroupRef = OS_CORE0_CONST
            vLinkGenConstSectionGroupRef = OS_SystemApplication_OsCore0_CONST
        OS_EXCVEC_CORE0_CODE: vLinkGenConstGroupPosition=5, vLinkGenConstGroupCore=0, vLinkGenConstGroupRegion=MCU_MSRAM_Core0, vLinkGenConstGroupModule=Os, vLinkGenConstGroupContentType=LOCAL_EXCVEC_CODE
          OS_EXCVEC_CORE0_CODE (vLinkGenConstSectionGroup):
            vLinkGenConstSectionGroupPosition = 0
            vLinkGenConstSectionGroupInit = NONE
            vLinkGenConstSectionGroupInitStage = ONE
            vLinkGenConstSectionGroupAlignment = 0
            vLinkGenConstSectionGroupRef = vLinkGenLinkerSections/OS_EXCVEC_CORE0_CODE
        OS_EXCVEC_CORE0_CONST: vLinkGenConstGroupPosition=5, vLinkGenConstGroupCore=0, vLinkGenConstGroupRegion=MCU_MSRAM_Common, vLinkGenConstGroupModule=Os, vLinkGenConstGroupContentType=LOCAL_EXCVEC_CONST
          OS_EXCVEC_CORE0_CONST (vLinkGenConstSectionGroup):
            vLinkGenConstSectionGroupPosition = 0
            vLinkGenConstSectionGroupInit = NONE
            vLinkGenConstSectionGroupInitStage = ONE
            vLinkGenConstSectionGroupAlignment = 0
            vLinkGenConstSectionGroupRef = vLinkGenLinkerSections/OS_EXCVEC_CORE0_CONST
        OS_INTVEC_CORE0_CODE: vLinkGenConstGroupPosition=5, vLinkGenConstGroupCore=0, vLinkGenConstGroupRegion=DDR0/DDR0, vLinkGenConstGroupModule=Os, vLinkGenConstGroupContentType=LOCAL_INTVEC_CODE
          OS_INTVEC_CORE0_CODE (vLinkGenConstSectionGroup):
            vLinkGenConstSectionGroupPosition = 0
            vLinkGenConstSectionGroupInit = NONE
            vLinkGenConstSectionGroupInitStage = ONE
            vLinkGenConstSectionGroupAlignment = 0
            vLinkGenConstSectionGroupRef = vLinkGenLinkerSections/OS_INTVEC_CORE0_CODE
        OS_INTVEC_CORE0_CONST: vLinkGenConstGroupPosition=5, vLinkGenConstGroupCore=0, vLinkGenConstGroupRegion=DDR0/DDR0, vLinkGenConstGroupModule=Os, vLinkGenConstGroupContentType=LOCAL_INTVEC_CONST
          OS_INTVEC_CORE0_CONST (vLinkGenConstSectionGroup):
            vLinkGenConstSectionGroupPosition = 0
            vLinkGenConstSectionGroupInit = NONE
            vLinkGenConstSectionGroupInitStage = ONE
            vLinkGenConstSectionGroupAlignment = 0
            vLinkGenConstSectionGroupRef = vLinkGenLinkerSections/OS_INTVEC_CORE0_CONST
        OS_EXCVEC_CORE1_CODE: vLinkGenConstGroupPosition=5, vLinkGenConstGroupRegion=MCU_MSRAM_Core1
        OS_EXCVEC_CORE1_CONST: vLinkGenConstGroupPosition=5, vLinkGenConstGroupRegion=MCU_MSRAM_Common
        OS_INTVEC_CORE1_CODE: vLinkGenConstGroupPosition=5, vLinkGenConstGroupRegion=DDR0/DDR0
        OS_INTVEC_CORE1_CONST: vLinkGenConstGroupPosition=5, vLinkGenConstGroupRegion=DDR0/DDR0
        OS_EXCVEC_CORE2_CODE: vLinkGenConstGroupPosition=5, vLinkGenConstGroupRegion=MCU_MSRAM_Core2
        OS_EXCVEC_CORE2_CONST: vLinkGenConstGroupPosition=5, vLinkGenConstGroupRegion=MCU_MSRAM_Common
        OS_INTVEC_CORE2_CODE: vLinkGenConstGroupPosition=5, vLinkGenConstGroupRegion=DDR0/DDR0
        OS_INTVEC_CORE2_CONST: vLinkGenConstGroupPosition=5, vLinkGenConstGroupRegion=DDR0/DDR0
        OS_EXCVEC_CORE3_CODE: vLinkGenConstGroupPosition=5, vLinkGenConstGroupRegion=MCU_MSRAM_Core3
        OS_EXCVEC_CORE3_CONST: vLinkGenConstGroupPosition=5, vLinkGenConstGroupRegion=MCU_MSRAM_Common
        OS_INTVEC_CORE3_CODE: vLinkGenConstGroupPosition=5, vLinkGenConstGroupRegion=DDR0/DDR0
        OS_INTVEC_CORE3_CONST: vLinkGenConstGroupPosition=5, vLinkGenConstGroupRegion=DDR0/DDR0
        OS_EXCVEC_CORE4_CODE: vLinkGenConstGroupPosition=5, vLinkGenConstGroupRegion=MCU_MSRAM_Core4
        OS_EXCVEC_CORE4_CONST: vLinkGenConstGroupPosition=5, vLinkGenConstGroupRegion=MCU_MSRAM_Common
        OS_INTVEC_CORE4_CODE: vLinkGenConstGroupPosition=5, vLinkGenConstGroupRegion=DDR0/DDR0
        OS_INTVEC_CORE4_CONST: vLinkGenConstGroupPosition=5, vLinkGenConstGroupRegion=DDR0/DDR0
        OS_EXCVEC_CORE5_CODE: vLinkGenConstGroupPosition=5, vLinkGenConstGroupRegion=MCU_MSRAM_Core5
        OS_EXCVEC_CORE5_CONST: vLinkGenConstGroupPosition=5, vLinkGenConstGroupRegion=MCU_MSRAM_Common
        OS_INTVEC_CORE5_CODE: vLinkGenConstGroupPosition=5, vLinkGenConstGroupRegion=DDR0/DDR0
        OS_INTVEC_CORE5_CONST: vLinkGenConstGroupPosition=5, vLinkGenConstGroupRegion=DDR0/DDR0
        OS_INTVEC_CODE: vLinkGenConstGroupPosition=5, vLinkGenConstGroupRegion=DDR0/DDR0, vLinkGenConstGroupModule=Os, vLinkGenConstGroupContentType=GLOBAL_INTVEC_CODE
          OS_INTVEC_CODE (vLinkGenConstSectionGroup):
            vLinkGenConstSectionGroupPosition = 0
            vLinkGenConstSectionGroupInit = NONE
            vLinkGenConstSectionGroupInitStage = ONE
            vLinkGenConstSectionGroupAlignment = 0
            vLinkGenConstSectionGroupRef = vLinkGenLinkerSections/OS_INTVEC_CODE
        OS_INTVEC_CONST: vLinkGenConstGroupPosition=5, vLinkGenConstGroupRegion=DDR0/DDR0, vLinkGenConstGroupModule=Os, vLinkGenConstGroupContentType=GLOBAL_INTVEC_CONST
          OS_INTVEC_CONST (vLinkGenConstSectionGroup):
            vLinkGenConstSectionGroupPosition = 0
            vLinkGenConstSectionGroupInit = NONE
            vLinkGenConstSectionGroupInitStage = ONE
            vLinkGenConstSectionGroupAlignment = 0
            vLinkGenConstSectionGroupRef = vLinkGenLinkerSections/OS_INTVEC_CONST
        OS_GLOBALSHARED_CONST: vLinkGenConstGroupPosition=5, vLinkGenConstGroupRegion=DDR0/DDR0, vLinkGenConstGroupModule=Os, vLinkGenConstGroupContentType=GLOBAL_CONST
          OS_GLOBALSHARED_CONST (vLinkGenConstSectionGroup):
            vLinkGenConstSectionGroupPosition = 0
            vLinkGenConstSectionGroupInit = NONE
            vLinkGenConstSectionGroupInitStage = ONE
            vLinkGenConstSectionGroupRef = vLinkGenLinkerSections/OS_GLOBALSHARED_CONST
        OS_USER_CODE: vLinkGenConstGroupPosition=5, vLinkGenConstGroupRegion=DDR0/DDR0, vLinkGenConstGroupModule=Os, vLinkGenConstGroupContentType=GLOBAL_CODE
          OS_USER_CODE (vLinkGenConstSectionGroup):
            vLinkGenConstSectionGroupPosition = 0
            vLinkGenConstSectionGroupInit = NONE
            vLinkGenConstSectionGroupInitStage = ONE
            vLinkGenConstSectionGroupRef = OS_ERRORHOOK_CODE
            vLinkGenConstSectionGroupRef = OS_BootAppOsTask_CODE
            vLinkGenConstSectionGroupRef = OS_SciServerLowOsTask_CODE
            vLinkGenConstSectionGroupRef = OS_StartUpTask_CODE
            vLinkGenConstSectionGroupRef = OS_SciServerHighOsTask_CODE
            vLinkGenConstSectionGroupRef = OS_Adc_IrqUnit0_CODE
            vLinkGenConstSectionGroupRef = OS_Adc_IrqUnit1_CODE
            vLinkGenConstSectionGroupRef = OS_I2c_IrqUnit0_CODE
            vLinkGenConstSectionGroupRef = OS_IPC_mailbox1_CODE
            vLinkGenConstSectionGroupRef = OS_IPC_mailbox2_CODE
            vLinkGenConstSectionGroupRef = OS_MCU_NAVSS0_UDMASS_INTA_0_INTAGGR_VINTR_PEND_78_CODE
            vLinkGenConstSectionGroupRef = OS_MCU_NAVSS0_UDMASS_INTA_0_INTAGGR_VINTR_PEND_79_CODE
            vLinkGenConstSectionGroupRef = OS_PANICHOOK_CODE
            vLinkGenConstSectionGroupRef = OS_PROTECTIONHOOK_CODE
            vLinkGenConstSectionGroupRef = OS_SciServer_OsIsr_UserMsgHwiFxn{1..4}_CODE
            vLinkGenConstSectionGroupRef = OS_SHUTDOWNHOOK_CODE
            vLinkGenConstSectionGroupRef = OS_Can_30_McanIsr_0_CODE
            vLinkGenConstSectionGroupRef = OS_Can_30_McanIsr_1_CODE
            vLinkGenConstSectionGroupRef = OS_vHsmResponseIsr_CODE
            vLinkGenConstSectionGroupRef = OS_QM_Task_Init_CODE
            vLinkGenConstSectionGroupRef = OS_Safety_Task_Init_CODE
            vLinkGenConstSectionGroupRef = OS_QM_Task_00_10ms_CODE
            vLinkGenConstSectionGroupRef = OS_Safety_Task_00_10ms_CODE
            vLinkGenConstSectionGroupRef = OS_QM_Task_01_10ms_CODE
            vLinkGenConstSectionGroupRef = OS_Safety_Task_01_10ms_CODE
            vLinkGenConstSectionGroupRef = OS_QM_Task_200ms_CODE
            vLinkGenConstSectionGroupRef = OS_Safety_Task_200ms_CODE
            vLinkGenConstSectionGroupRef = OS_QM_ComTask_10ms_CODE
            vLinkGenConstSectionGroupRef = OS_QM_DiagTask_10ms_CODE
            vLinkGenConstSectionGroupRef = OS_QM_MemTask_10ms_CODE
            vLinkGenConstSectionGroupRef = OS_QM_ComTask_5ms_CODE
            vLinkGenConstSectionGroupRef = OS_ShutdownTask_CODE
            vLinkGenConstSectionGroupRef = OS_MCU_ESM0_ESM_INT_HI_LVL_0_CODE
            vLinkGenConstSectionGroupRef = OS_MCU_ESM0_ESM_INT_LOW_LVL_0_CODE
            vLinkGenConstSectionGroupRef = OS_MCU_ESM0_ESM_INT_CFG_LVL_0_CODE
            vLinkGenConstSectionGroupRef = OS_WKUP_ESM0_ESM_INT_HI_LVL_0_CODE
            vLinkGenConstSectionGroupRef = OS_WKUP_ESM0_ESM_INT_LOW_LVL_0_CODE
            vLinkGenConstSectionGroupRef = OS_WKUP_ESM0_ESM_INT_CFG_LVL_0_CODE
            vLinkGenConstSectionGroupRef = OS_MAIN_ESM0_ESM_INT_HI_LVL_0_CODE
            vLinkGenConstSectionGroupRef = OS_MAIN_ESM0_ESM_INT_LOW_LVL_0_CODE
            vLinkGenConstSectionGroupRef = OS_MAIN_ESM0_ESM_INT_CFG_LVL_0_CODE
            vLinkGenConstSectionGroupRef = OS_SDLR_MCU_R5FSS0_CORE0_INTR_GLUELOGIC_MAIN_PULSAR0_LBIST_GLUE_DFT_LBIST_BIST_DONE_0_297_CODE
            vLinkGenConstSectionGroupRef = OS_SDLR_MCU_R5FSS0_CORE0_INTR_GLUELOGIC_MAIN_PULSAR1_LBIST_GLUE_DFT_LBIST_BIST_DONE_0_298_CODE
            vLinkGenConstSectionGroupRef = OS_SDLR_MCU_R5FSS0_CORE0_INTR_COMPUTE_CLUSTER0_AC71_4_DFT_LBIST_DFT_LBIST_BIST_DONE_0_295_CODE
            vLinkGenConstSectionGroupRef = OS_SDLR_MCU_R5FSS0_CORE0_INTR_COMPUTE_CLUSTER0_AC71_5_DFT_LBIST_DFT_LBIST_BIST_DONE_0_296_CODE
            vLinkGenConstSectionGroupRef = OS_SDLR_MCU_R5FSS0_CORE0_INTR_COMPUTE_CLUSTER0_ARM0_DFT_LBIST_DFT_LBIST_BIST_DONE_0_291_CODE
            vLinkGenConstSectionGroupRef = OS_SDLR_MCU_R5FSS0_CORE0_INTR_GLUELOGIC_DMPAC_LBIST_GLUE_DFT_LBIST_BIST_DONE_0_299_CODE
            vLinkGenConstSectionGroupRef = OS_SDLR_MCU_R5FSS0_CORE0_INTR_GLUELOGIC_VPAC_LBIST_GLUE_DFT_LBIST_BIST_DONE_0_300_CODE
            vLinkGenConstSectionGroupRef = OS_SDLR_MCU_R5FSS0_CORE0_INTR_AEP_GPU_BXS464_WRAP0_DFT_EMBED_PBIST_0_DFT_PBIST_CPU_0_317_CODE
            vLinkGenConstSectionGroupRef = OS_SDLR_MCU_R5FSS0_CORE0_INTR_COMPUTE_CLUSTER0_PBIST_WRAP_0_DFT_PBIST_CPU_0_290_CODE
            vLinkGenConstSectionGroupRef = OS_SDLR_MCU_R5FSS0_CORE0_INTR_MCU_PBIST0_DFT_PBIST_CPU_0_47_CODE
            vLinkGenConstSectionGroupRef = OS_SDLR_MCU_R5FSS0_CORE0_INTR_MCU_PBIST1_DFT_PBIST_CPU_0_36_CODE
            vLinkGenConstSectionGroupRef = OS_SDLR_MCU_R5FSS0_CORE0_INTR_MCU_PBIST2_DFT_PBIST_CPU_0_37_CODE
            vLinkGenConstSectionGroupRef = OS_SDLR_MCU_R5FSS0_CORE0_INTR_PBIST0_DFT_PBIST_CPU_0_312_CODE
            vLinkGenConstSectionGroupRef = OS_SDLR_MCU_R5FSS0_CORE0_INTR_PBIST10_DFT_PBIST_CPU_0_310_CODE
            vLinkGenConstSectionGroupRef = OS_SDLR_MCU_R5FSS0_CORE0_INTR_PBIST11_DFT_PBIST_CPU_0_314_CODE
            vLinkGenConstSectionGroupRef = OS_SDLR_MCU_R5FSS0_CORE0_INTR_PBIST2_DFT_PBIST_CPU_0_309_CODE
            vLinkGenConstSectionGroupRef = OS_SDLR_MCU_R5FSS0_CORE0_INTR_PBIST3_DFT_PBIST_CPU_0_307_CODE
            vLinkGenConstSectionGroupRef = OS_SDLR_MCU_R5FSS0_CORE0_INTR_PBIST4_DFT_PBIST_CPU_0_308_CODE
            vLinkGenConstSectionGroupRef = OS_SDLR_MCU_R5FSS0_CORE0_INTR_PBIST5_DFT_PBIST_CPU_0_306_CODE
            vLinkGenConstSectionGroupRef = OS_SDLR_MCU_R5FSS0_CORE0_INTR_PBIST7_DFT_PBIST_CPU_0_304_CODE
            vLinkGenConstSectionGroupRef = OS_SDLR_MCU_R5FSS0_CORE0_INTR_PBIST8_DFT_PBIST_CPU_0_305_CODE
            vLinkGenConstSectionGroupRef = OS_Safety_WdgTask_10ms_CODE
            vLinkGenConstSectionGroupRef = OS_SDLR_MCU_R5FSS0_CORE0_INTR_PBIST1_DFT_PBIST_CPU_0_313_CODE
            vLinkGenConstSectionGroupRef = OS_I2c_IrqUnit1_CODE
        OS_USER_CONST: vLinkGenConstGroupPosition=5, vLinkGenConstGroupRegion=DDR0/DDR0, vLinkGenConstGroupModule=Os, vLinkGenConstGroupContentType=GLOBAL_CONST
          OS_USER_CONST (vLinkGenConstSectionGroup):
            vLinkGenConstSectionGroupPosition = 0
            vLinkGenConstSectionGroupInit = NONE
            vLinkGenConstSectionGroupInitStage = ONE
            vLinkGenConstSectionGroupRef = OS_OsApplication_Trusted_Core0_CONST
            vLinkGenConstSectionGroupRef = OS_OsApplication_Safety_CONST
            vLinkGenConstSectionGroupRef = OS_OsApplication_QM_CONST
        Const_Default: vLinkGenConstGroupPosition=1000, vLinkGenConstGroupRegion=DDR0/DDR0, vLinkGenConstGroupContentType=GLOBAL_CONST
          text (vLinkGenConstSectionGroup):
            vLinkGenConstSectionGroupPosition = 0
            vLinkGenConstSectionGroupInit = NONE
            vLinkGenConstSectionGroupInitStage = ONE
            vLinkGenConstSectionGroupRef = vLinkGenLinkerSections/text
          rodata (vLinkGenConstSectionGroup):
            vLinkGenConstSectionGroupPosition = 0
            vLinkGenConstSectionGroupInit = NONE
            vLinkGenConstSectionGroupInitStage = ONE
            vLinkGenConstSectionGroupRef = vLinkGenLinkerSections/rodata
            vLinkGenConstSectionGroupRef = rodata_const
        Startup_Code: vLinkGenConstGroupPosition=5, vLinkGenConstGroupRegion=MCU_MSRAM_Common
          Startup_Code (vLinkGenConstSectionGroup):
            vLinkGenConstSectionGroupPosition = 0
            vLinkGenConstSectionGroupInit = NONE
            vLinkGenConstSectionGroupInitStage = ONE
            vLinkGenConstSectionGroupRef = brsStartup
        R5F_Startup_Code: vLinkGenConstGroupPosition=5, vLinkGenConstGroupRegion=MCU_MSRAM_Common
          R5F_Startup_Code (vLinkGenConstSectionGroup):
            vLinkGenConstSectionGroupPosition = 0
            vLinkGenConstSectionGroupInit = NONE
            vLinkGenConstSectionGroupInitStage = ONE
            vLinkGenConstSectionGroupRef = startupCode
        R5F_Startup_Data: vLinkGenConstGroupPosition=5, vLinkGenConstGroupRegion=MCU_MSRAM_Common
          R5F_Startup_Data (vLinkGenConstSectionGroup):
            vLinkGenConstSectionGroupPosition = 0
            vLinkGenConstSectionGroupInit = NONE
            vLinkGenConstSectionGroupInitStage = ONE
            vLinkGenConstSectionGroupRef = startupData
        TI_sysfw_sections_const_devgroup: vLinkGenConstGroupPosition=5, vLinkGenConstGroupRegion=DDR0/DDR0
          TI_sysfw_sections_const_devgroup (vLinkGenConstSectionGroup):
            vLinkGenConstSectionGroupAlignment = 4
            vLinkGenConstSectionGroupEndAlignment = 4
            vLinkGenConstSectionGroupPosition = 0
            vLinkGenConstSectionGroupInit = NONE
            vLinkGenConstSectionGroupInitStage = ONE
            vLinkGenConstSectionGroupRef = DMSC_INTERNAL_const
            vLinkGenConstSectionGroupRef = MAIN_const
            vLinkGenConstSectionGroupRef = MCU_WAKEUP_const
      23 x vLinkGenLogicalVarGroup:
        OS_DATA_CORE0_VAR: vLinkGenVarGroupInitCore=0, vLinkGenVarGroupPosition=5, vLinkGenVarGroupCore=0, vLinkGenVarGroupRegion=DDR0/DDR0, vLinkGenVarGroupRomRegion=DDR0/DDR0, vLinkGenVarGroupModule=Os, vLinkGenVarGroupContentType=LOCAL_DATA
          4 x vLinkGenVarSectionGroup, all with vLinkGenVarSectionGroupPosition=0, vLinkGenVarSectionGroupInitStage=ONE:
            OS_DATA_CORE0_VAR_NOINIT: vLinkGenVarSectionGroupInit=NONE, vLinkGenVarSectionGroupRef=OS_CORE0_VAR_NOINIT, vLinkGenVarSectionGroupRef=OS_CORE0_VAR_NOCACHE_NOINIT, vLinkGenVarSectionGroupRef=OS_SystemApplication_OsCore0_VAR_NOINIT, vLinkGenVarSectionGroupRef=OS_SystemApplication_OsCore0_VAR_NOCACHE_NOINIT, vLinkGenVarSectionGroupRef=OS_SystemApplication_OsCore0_VAR_SAVED_ZONE_NOINIT
            OS_DATA_CORE0_VAR_INIT: vLinkGenVarSectionGroupInit=INIT, vLinkGenVarSectionGroupAlignment=4, vLinkGenVarSectionGroupEndAlignment=4, vLinkGenVarSectionGroupRef=OS_CORE0_VAR, vLinkGenVarSectionGroupRef=OS_CORE0_VAR_NOCACHE, vLinkGenVarSectionGroupRef=OS_SystemApplication_OsCore0_VAR, vLinkGenVarSectionGroupRef=OS_SystemApplication_OsCore0_VAR_NOCACHE, vLinkGenVarSectionGroupRef=OS_SystemApplication_OsCore0_VAR_SAVED_ZONE
            OS_DATA_CORE0_VAR_ZERO_INIT: vLinkGenVarSectionGroupInit=ZERO_INIT, vLinkGenVarSectionGroupAlignment=4, vLinkGenVarSectionGroupEndAlignment=4, vLinkGenVarSectionGroupRef=OS_SystemApplication_OsCore0_VAR_ZERO_INIT, vLinkGenVarSectionGroupRef=OS_SystemApplication_OsCore0_VAR_NOCACHE_ZERO_INIT
            OS_DATA_CORE0_VAR_ZERO_INIT_bss: vLinkGenVarSectionGroupInit=ZERO_INIT, vLinkGenVarSectionGroupAlignment=4, vLinkGenVarSectionGroupEndAlignment=4, vLinkGenVarSectionGroupRef=OS_SystemApplication_OsCore0_VAR_ZERO_INIT_bss, vLinkGenVarSectionGroupRef=OS_SystemApplication_OsCore0_VAR_NOCACHE_ZERO_INIT_bss
        OS_DATA_CORE{1..5}_VAR: vLinkGenVarGroupPosition=5, vLinkGenVarGroupRegion=DDR0/DDR0
        OS_DATA_SHARED_VAR: vLinkGenVarGroupInitCore=0, vLinkGenVarGroupPosition=5, vLinkGenVarGroupRegion=MCU_MSRAM_Common_NonCache, vLinkGenVarGroupRomRegion=DDR0/DDR0, vLinkGenVarGroupModule=Os, vLinkGenVarGroupContentType=GLOBAL_DATA
          OS_DATA_SHARED_VAR_NOINIT (vLinkGenVarSectionGroup):
            vLinkGenVarSectionGroupPosition = 0
            vLinkGenVarSectionGroupInit = NONE
            vLinkGenVarSectionGroupInitStage = ONE
            vLinkGenVarSectionGroupRef = OS_VAR_NOCACHE_NOINIT
            vLinkGenVarSectionGroupRef = OS_CORESTATUS_CORE0_VAR_NOCACHE_NOINIT
            vLinkGenVarSectionGroupRef = OS_PUBLIC_CORE0_VAR_NOINIT
            vLinkGenVarSectionGroupRef = OS_BARRIER_CORE0_VAR_NOCACHE_NOINIT
          OS_DATA_SHARED_VAR_INIT (vLinkGenVarSectionGroup):
            vLinkGenVarSectionGroupPosition = 0
            vLinkGenVarSectionGroupInit = INIT
            vLinkGenVarSectionGroupInitStage = ONE
            vLinkGenVarSectionGroupAlignment = 4
            vLinkGenVarSectionGroupEndAlignment = 4
            vLinkGenVarSectionGroupRef = OS_VAR_NOCACHE
        OS_GLOBALSHARED_VAR: vLinkGenVarGroupInitCore=0, vLinkGenVarGroupPosition=5, vLinkGenVarGroupRegion=MCU_MSRAM_Common_NonCache, vLinkGenVarGroupRomRegion=DDR0/DDR0, vLinkGenVarGroupModule=Os, vLinkGenVarGroupContentType=GLOBAL_DATA
          4 x vLinkGenVarSectionGroup, all with vLinkGenVarSectionGroupPosition=0, vLinkGenVarSectionGroupInitStage=ONE:
            OS_GLOBALSHARED_VAR_NOINIT: vLinkGenVarSectionGroupInit=NONE, vLinkGenVarSectionGroupRef=vLinkGenLinkerSections/OS_GLOBALSHARED_VAR_NOINIT, vLinkGenVarSectionGroupRef=OS_GLOBALSHARED_VAR_NOCACHE_NOINIT
            OS_GLOBALSHARED_VAR_INIT: vLinkGenVarSectionGroupInit=INIT, vLinkGenVarSectionGroupAlignment=4, vLinkGenVarSectionGroupEndAlignment=4, vLinkGenVarSectionGroupRef=vLinkGenLinkerSections/OS_GLOBALSHARED_VAR, vLinkGenVarSectionGroupRef=OS_GLOBALSHARED_VAR_NOCACHE
            OS_GLOBALSHARED_VAR_ZERO_INIT: vLinkGenVarSectionGroupInit=ZERO_INIT, vLinkGenVarSectionGroupAlignment=4, vLinkGenVarSectionGroupEndAlignment=4, vLinkGenVarSectionGroupRef=vLinkGenLinkerSections/OS_GLOBALSHARED_VAR_ZERO_INIT, vLinkGenVarSectionGroupRef=OS_GLOBALSHARED_VAR_NOCACHE_ZERO_INIT
            OS_GLOBALSHARED_VAR_ZERO_INIT_bss: vLinkGenVarSectionGroupInit=ZERO_INIT, vLinkGenVarSectionGroupAlignment=4, vLinkGenVarSectionGroupEndAlignment=4, vLinkGenVarSectionGroupRef=vLinkGenLinkerSections/OS_GLOBALSHARED_VAR_ZERO_INIT_bss, vLinkGenVarSectionGroupRef=OS_GLOBALSHARED_VAR_NOCACHE_ZERO_INIT_bss
        OS_GLOBALSHARED_VAR_SAVED_ZONE: vLinkGenVarGroupInitCore=0, vLinkGenVarGroupPosition=5, vLinkGenVarGroupRegion=MCU_MSRAM_Common_NonCache, vLinkGenVarGroupRomRegion=DDR0/DDR0, vLinkGenVarGroupModule=Os, vLinkGenVarGroupContentType=RETENTION_DATA
          OS_GLOBALSHARED_VAR_SAVED_ZONE_NOINIT (vLinkGenVarSectionGroup):
            vLinkGenVarSectionGroupPosition = 0
            vLinkGenVarSectionGroupInit = NONE
            vLinkGenVarSectionGroupInitStage = ONE
            vLinkGenVarSectionGroupRef = vLinkGenLinkerSections/OS_GLOBALSHARED_VAR_SAVED_ZONE_NOINIT
          OS_GLOBALSHARED_VAR_SAVED_ZONE_INIT (vLinkGenVarSectionGroup):
            vLinkGenVarSectionGroupPosition = 0
            vLinkGenVarSectionGroupInit = INIT
            vLinkGenVarSectionGroupInitStage = ONE
            vLinkGenVarSectionGroupAlignment = 4
            vLinkGenVarSectionGroupEndAlignment = 4
            vLinkGenVarSectionGroupRef = vLinkGenLinkerSections/OS_GLOBALSHARED_VAR_SAVED_ZONE
        OS_STACKS_CORE0_VAR: vLinkGenVarGroupPosition=0, vLinkGenVarGroupCore=0, vLinkGenVarGroupRegion=DDR0/DDR0, vLinkGenVarGroupModule=Os, vLinkGenVarGroupContentType=STACKS
          OS_STACKS_CORE0_VAR_NOINIT (vLinkGenVarSectionGroup):
            vLinkGenVarSectionGroupPosition = 0
            vLinkGenVarSectionGroupInit = NONE
            vLinkGenVarSectionGroupInitStage = ONE
            vLinkGenVarSectionGroupRef = OS_STACK_OSCORE0_KERNEL_VAR_NOINIT
            vLinkGenVarSectionGroupRef = OS_STACK_OSCORE0_INIT_VAR_NOINIT
            vLinkGenVarSectionGroupRef = OS_STACK_OSCORE0_ERROR_VAR_NOINIT
            vLinkGenVarSectionGroupRef = OS_STACK_OSCORE0_TASK_PRIO4294967295_VAR_NOINIT
            vLinkGenVarSectionGroupRef = OS_STACK_OSCORE0_ISR_CORE_VAR_NOINIT
            vLinkGenVarSectionGroupRef = OS_STACK_OSCORE0_TASK_PRIO100_VAR_NOINIT
            vLinkGenVarSectionGroupRef = OS_STACK_SCISERVERLOWOSTASK_VAR_NOINIT
            vLinkGenVarSectionGroupRef = OS_STACK_SCISERVERHIGHOSTASK_VAR_NOINIT
            vLinkGenVarSectionGroupRef = OS_STACK_OSCORE0_PROTECTION_VAR_NOINIT
            vLinkGenVarSectionGroupRef = OS_STACK_OSCORE0_SHUTDOWN_VAR_NOINIT
            vLinkGenVarSectionGroupRef = OS_STACK_BOOTAPPOSTASK_VAR_NOINIT
            vLinkGenVarSectionGroupRef = OS_STACK_QM_TASK_200MS_VAR_NOINIT
            vLinkGenVarSectionGroupRef = OS_STACK_OSCORE0_TASK_PRIO54_VAR_NOINIT
            vLinkGenVarSectionGroupRef = OS_STACK_OSCORE0_TASK_PRIO50_VAR_NOINIT
            vLinkGenVarSectionGroupRef = OS_STACK_OSCORE0_TASK_PRIO90_VAR_NOINIT
            vLinkGenVarSectionGroupRef = OS_STACK_OSCORE0_TASK_PRIO88_VAR_NOINIT
            vLinkGenVarSectionGroupRef = OS_STACK_OSCORE0_TASK_PRIO79_VAR_NOINIT
            vLinkGenVarSectionGroupRef = OS_STACK_OSCORE0_TASK_PRIO78_VAR_NOINIT
            vLinkGenVarSectionGroupRef = OS_STACK_SAFETY_WDGTASK_10MS_VAR_NOINIT
            vLinkGenVarSectionGroupRef = OS_STACK_SAFETY_TASK_200MS_VAR_NOINIT
            vLinkGenVarSectionGroupRef = OS_STACK_QM_COMTASK_10MS_VAR_NOINIT
            vLinkGenVarSectionGroupRef = OS_STACK_QM_COMTASK_5MS_VAR_NOINIT
            vLinkGenVarSectionGroupRef = OS_STACK_QM_DIAGTASK_10MS_VAR_NOINIT
            vLinkGenVarSectionGroupRef = OS_STACK_QM_MEMTASK_10MS_VAR_NOINIT
        OS_STACKS_CORE{1..5}_VAR: vLinkGenVarGroupPosition=5, vLinkGenVarGroupRegion=DDR0/DDR0
        Data_Default: vLinkGenVarGroupInitCore=0, vLinkGenVarGroupPosition=1000, vLinkGenVarGroupRegion=DDR0/DDR0, vLinkGenVarGroupRomRegion=DDR0/DDR0, vLinkGenVarGroupContentType=GLOBAL_DATA
          data (vLinkGenVarSectionGroup):
            vLinkGenVarSectionGroupInit = INIT
            vLinkGenVarSectionGroupPosition = 0
            vLinkGenVarSectionGroupInitStage = ONE
            vLinkGenVarSectionGroupAlignment = 4
            vLinkGenVarSectionGroupEndAlignment = 4
            vLinkGenVarSectionGroupRef = vLinkGenLinkerSections/data
          bss (vLinkGenVarSectionGroup):
            vLinkGenVarSectionGroupInit = ZERO_INIT
            vLinkGenVarSectionGroupPosition = 0
            vLinkGenVarSectionGroupInitStage = ONE
            vLinkGenVarSectionGroupAlignment = 4
            vLinkGenVarSectionGroupEndAlignment = 4
            vLinkGenVarSectionGroupRef = vLinkGenLinkerSections/bss
            vLinkGenVarSectionGroupRef = stack
            vLinkGenVarSectionGroupRef = heap
        STACK_C0: vLinkGenVarGroupInitCore=0, vLinkGenVarGroupPosition=0, vLinkGenVarGroupRegion=MCU_MSRAM_Common
          STACK_C0 (vLinkGenVarSectionGroup):
            vLinkGenVarSectionGroupAlignment = 4
            vLinkGenVarSectionGroupEndAlignment = 4
            vLinkGenVarSectionGroupSize = 1024
            vLinkGenVarSectionGroupInit = ZERO_INIT
            vLinkGenVarSectionGroupInitStage = EARLY
            vLinkGenVarSectionGroupPosition = 0
        STACK_C1: vLinkGenVarGroupInitCore=1, vLinkGenVarGroupPosition=5, vLinkGenVarGroupRegion=MCU_MSRAM_Common
          STACK_C1 (vLinkGenVarSectionGroup):
            vLinkGenVarSectionGroupAlignment = 4
            vLinkGenVarSectionGroupEndAlignment = 4
            vLinkGenVarSectionGroupSize = 1024
            vLinkGenVarSectionGroupInit = ZERO_INIT
            vLinkGenVarSectionGroupInitStage = EARLY
            vLinkGenVarSectionGroupPosition = 0
        STACK_C2: vLinkGenVarGroupInitCore=2, vLinkGenVarGroupPosition=5, vLinkGenVarGroupRegion=MCU_MSRAM_Common
          STACK_C2 (vLinkGenVarSectionGroup):
            vLinkGenVarSectionGroupAlignment = 4
            vLinkGenVarSectionGroupEndAlignment = 4
            vLinkGenVarSectionGroupSize = 1024
            vLinkGenVarSectionGroupInit = ZERO_INIT
            vLinkGenVarSectionGroupInitStage = EARLY
            vLinkGenVarSectionGroupPosition = 0
        STACK_C3: vLinkGenVarGroupInitCore=3, vLinkGenVarGroupPosition=5, vLinkGenVarGroupRegion=MCU_MSRAM_Common
          STACK_C3 (vLinkGenVarSectionGroup):
            vLinkGenVarSectionGroupAlignment = 4
            vLinkGenVarSectionGroupEndAlignment = 4
            vLinkGenVarSectionGroupSize = 1024
            vLinkGenVarSectionGroupInit = ZERO_INIT
            vLinkGenVarSectionGroupInitStage = EARLY
            vLinkGenVarSectionGroupPosition = 0
        STACK_C4: vLinkGenVarGroupInitCore=4, vLinkGenVarGroupPosition=5, vLinkGenVarGroupRegion=MCU_MSRAM_Common
          STACK_C4 (vLinkGenVarSectionGroup):
            vLinkGenVarSectionGroupAlignment = 4
            vLinkGenVarSectionGroupEndAlignment = 4
            vLinkGenVarSectionGroupSize = 1024
            vLinkGenVarSectionGroupInit = ZERO_INIT
            vLinkGenVarSectionGroupInitStage = EARLY
            vLinkGenVarSectionGroupPosition = 0
        STACK_C5: vLinkGenVarGroupInitCore=5, vLinkGenVarGroupPosition=5, vLinkGenVarGroupRegion=MCU_MSRAM_Common
          STACK_C5 (vLinkGenVarSectionGroup):
            vLinkGenVarSectionGroupAlignment = 4
            vLinkGenVarSectionGroupEndAlignment = 4
            vLinkGenVarSectionGroupSize = 1024
            vLinkGenVarSectionGroupInit = ZERO_INIT
            vLinkGenVarSectionGroupInitStage = EARLY
            vLinkGenVarSectionGroupPosition = 0
        TI_sysfw_sections_bss_devgroup: vLinkGenVarGroupPosition=5, vLinkGenVarGroupRegion=DDR0/DDR0
          TI_sysfw_sections_bss_devgroup (vLinkGenVarSectionGroup):
            vLinkGenVarSectionGroupAlignment = 4
            vLinkGenVarSectionGroupEndAlignment = 4
            vLinkGenVarSectionGroupPosition = 0
            vLinkGenVarSectionGroupInit = NONE
            vLinkGenVarSectionGroupInitStage = ONE
            vLinkGenVarSectionGroupRef = BOARDCFG_DATA
            vLinkGenVarSectionGroupRef = DATA_USER
            vLinkGenVarSectionGroupRef = DMSC_INTERNAL_var
            vLinkGenVarSectionGroupRef = MAIN_var
            vLinkGenVarSectionGroupRef = MCU_WAKEUP_var
      Startup_Stack_Symbols (vLinkGenLogicalSymbolGroup): vLinkGenSymbolGroupPosition=5
        6 x vLinkGenLinkerSymbol, all with vLinkGenLinkerSymbolPosition=0:
          Startup_Stack_c{0..5}: vLinkGenLinkerSymbolName=__section_stack_c{0..5}_end, vLinkGenLinkerSymbolValue=_STACK_C{0..5}_LIMIT
      Startup_Labels (vLinkGenLogicalSymbolGroup): vLinkGenSymbolGroupPosition=5
        8 x vLinkGenLinkerSymbol, all with vLinkGenLinkerSymbolValue=brsStartupEntry, vLinkGenLinkerSymbolPosition=0:
          Startup_Labels1: vLinkGenLinkerSymbolName=_RESET
          Startup_Labels2: vLinkGenLinkerSymbolName=_start
          Startup_Labels3: vLinkGenLinkerSymbolName=_start_c1
          Startup_Labels4: vLinkGenLinkerSymbolName=_start_c2
          Startup_Labels5: vLinkGenLinkerSymbolName=_start_c3
          Startup_Labels6: vLinkGenLinkerSymbolName=_start_c4
          Startup_Labels7: vLinkGenLinkerSymbolName=_start_c5
          Startup_Labels8: vLinkGenLinkerSymbolName=_brsStartupEntry
      6 x vLinkGenLogicalVarGroup, all with vLinkGenVarGroupPosition=5, vLinkGenVarGroupInitCore=0, vLinkGenVarGroupModule=Os:
        OS_OsApplication_Trusted_Core0_VAR: vLinkGenVarGroupCore=0, vLinkGenVarGroupRegion=MCU_MSRAM_Common, vLinkGenVarGroupContentType=LOCAL_DATA, vLinkGenVarGroupRomRegion=MCU_MSRAM_Common
          4 x vLinkGenVarSectionGroup, all with vLinkGenVarSectionGroupPosition=0, vLinkGenVarSectionGroupInitStage=ONE:
            OS_OsApplication_Trusted_Core0_VAR_NOINIT: vLinkGenVarSectionGroupInit=NONE, vLinkGenVarSectionGroupRef=vLinkGenLinkerSections/OS_OsApplication_Trusted_Core0_VAR_NOINIT, vLinkGenVarSectionGroupRef=OS_OsApplication_Trusted_Core0_VAR_NOCACHE_NOINIT
            OS_OsApplication_Trusted_Core0_VAR_INIT: vLinkGenVarSectionGroupInit=INIT, vLinkGenVarSectionGroupAlignment=4, vLinkGenVarSectionGroupEndAlignment=4, vLinkGenVarSectionGroupRef=vLinkGenLinkerSections/OS_OsApplication_Trusted_Core0_VAR, vLinkGenVarSectionGroupRef=OS_OsApplication_Trusted_Core0_VAR_NOCACHE
            OS_OsApplication_Trusted_Core0_VAR_ZERO_INIT: vLinkGenVarSectionGroupInit=ZERO_INIT, vLinkGenVarSectionGroupAlignment=4, vLinkGenVarSectionGroupEndAlignment=4, vLinkGenVarSectionGroupRef=vLinkGenLinkerSections/OS_OsApplication_Trusted_Core0_VAR_ZERO_INIT, vLinkGenVarSectionGroupRef=OS_OsApplication_Trusted_Core0_VAR_NOCACHE_ZERO_INIT
            OS_OsApplication_Trusted_Core0_VAR_ZERO_INIT_bss: vLinkGenVarSectionGroupInit=ZERO_INIT, vLinkGenVarSectionGroupAlignment=4, vLinkGenVarSectionGroupEndAlignment=4, vLinkGenVarSectionGroupRef=vLinkGenLinkerSections/OS_OsApplication_Trusted_Core0_VAR_ZERO_INIT_bss, vLinkGenVarSectionGroupRef=OS_OsApplication_Trusted_Core0_VAR_NOCACHE_ZERO_INIT_bss
        OS_OsApplication_Trusted_Core0_VAR_SAVED_ZONE: vLinkGenVarGroupRegion=MCU_MSRAM_Common, vLinkGenVarGroupContentType=RETENTION_DATA, vLinkGenVarGroupRomRegion=MCU_MSRAM_Common
          OS_OsApplication_Trusted_Core0_VAR_SAVED_ZONE_NOINIT (vLinkGenVarSectionGroup):
            vLinkGenVarSectionGroupPosition = 0
            vLinkGenVarSectionGroupInit = NONE
            vLinkGenVarSectionGroupInitStage = ONE
            vLinkGenVarSectionGroupRef = vLinkGenLinkerSections/OS_OsApplication_Trusted_Core0_VAR_SAVED_ZONE_NOINIT
          OS_OsApplication_Trusted_Core0_VAR_SAVED_ZONE_INIT (vLinkGenVarSectionGroup):
            vLinkGenVarSectionGroupPosition = 0
            vLinkGenVarSectionGroupInit = INIT
            vLinkGenVarSectionGroupInitStage = ONE
            vLinkGenVarSectionGroupAlignment = 4
            vLinkGenVarSectionGroupEndAlignment = 4
            vLinkGenVarSectionGroupRef = vLinkGenLinkerSections/OS_OsApplication_Trusted_Core0_VAR_SAVED_ZONE
        OS_OsApplication_Safety_VAR: vLinkGenVarGroupCore=0, vLinkGenVarGroupRegion=MCU_MSRAM_Common_NonCache, vLinkGenVarGroupContentType=LOCAL_DATA, vLinkGenVarGroupRomRegion=DDR0/DDR0
          4 x vLinkGenVarSectionGroup, all with vLinkGenVarSectionGroupPosition=0, vLinkGenVarSectionGroupInitStage=ONE:
            OS_OsApplication_Safety_VAR_NOINIT: vLinkGenVarSectionGroupInit=NONE, vLinkGenVarSectionGroupRef=vLinkGenLinkerSections/OS_OsApplication_Safety_VAR_NOINIT, vLinkGenVarSectionGroupRef=OS_OsApplication_Safety_VAR_NOCACHE_NOINIT
            OS_OsApplication_Safety_VAR_INIT: vLinkGenVarSectionGroupInit=INIT, vLinkGenVarSectionGroupAlignment=4, vLinkGenVarSectionGroupEndAlignment=4, vLinkGenVarSectionGroupRef=vLinkGenLinkerSections/OS_OsApplication_Safety_VAR, vLinkGenVarSectionGroupRef=OS_OsApplication_Safety_VAR_NOCACHE
            OS_OsApplication_Safety_VAR_ZERO_INIT: vLinkGenVarSectionGroupInit=ZERO_INIT, vLinkGenVarSectionGroupAlignment=4, vLinkGenVarSectionGroupEndAlignment=4, vLinkGenVarSectionGroupRef=vLinkGenLinkerSections/OS_OsApplication_Safety_VAR_ZERO_INIT, vLinkGenVarSectionGroupRef=OS_OsApplication_Safety_VAR_NOCACHE_ZERO_INIT
            OS_OsApplication_Safety_VAR_ZERO_INIT_bss: vLinkGenVarSectionGroupInit=ZERO_INIT, vLinkGenVarSectionGroupAlignment=4, vLinkGenVarSectionGroupEndAlignment=4, vLinkGenVarSectionGroupRef=vLinkGenLinkerSections/OS_OsApplication_Safety_VAR_ZERO_INIT_bss, vLinkGenVarSectionGroupRef=OS_OsApplication_Safety_VAR_NOCACHE_ZERO_INIT_bss
        OS_OsApplication_Safety_VAR_SAVED_ZONE: vLinkGenVarGroupRegion=MCU_MSRAM_Common_NonCache, vLinkGenVarGroupContentType=RETENTION_DATA, vLinkGenVarGroupRomRegion=DDR0/DDR0
          OS_OsApplication_Safety_VAR_SAVED_ZONE_NOINIT (vLinkGenVarSectionGroup):
            vLinkGenVarSectionGroupPosition = 0
            vLinkGenVarSectionGroupInit = NONE
            vLinkGenVarSectionGroupInitStage = ONE
            vLinkGenVarSectionGroupRef = vLinkGenLinkerSections/OS_OsApplication_Safety_VAR_SAVED_ZONE_NOINIT
          OS_OsApplication_Safety_VAR_SAVED_ZONE_INIT (vLinkGenVarSectionGroup):
            vLinkGenVarSectionGroupPosition = 0
            vLinkGenVarSectionGroupInit = INIT
            vLinkGenVarSectionGroupInitStage = ONE
            vLinkGenVarSectionGroupAlignment = 4
            vLinkGenVarSectionGroupEndAlignment = 4
            vLinkGenVarSectionGroupRef = vLinkGenLinkerSections/OS_OsApplication_Safety_VAR_SAVED_ZONE
        OS_OsApplication_QM_VAR: vLinkGenVarGroupCore=0, vLinkGenVarGroupRegion=MCU_MSRAM_Common_NonCache, vLinkGenVarGroupContentType=LOCAL_DATA, vLinkGenVarGroupRomRegion=DDR0/DDR0
          4 x vLinkGenVarSectionGroup, all with vLinkGenVarSectionGroupPosition=0, vLinkGenVarSectionGroupInitStage=ONE:
            OS_OsApplication_QM_VAR_NOINIT: vLinkGenVarSectionGroupInit=NONE, vLinkGenVarSectionGroupRef=vLinkGenLinkerSections/OS_OsApplication_QM_VAR_NOINIT, vLinkGenVarSectionGroupRef=OS_OsApplication_QM_VAR_NOCACHE_NOINIT
            OS_OsApplication_QM_VAR_INIT: vLinkGenVarSectionGroupInit=INIT, vLinkGenVarSectionGroupAlignment=4, vLinkGenVarSectionGroupEndAlignment=4, vLinkGenVarSectionGroupRef=vLinkGenLinkerSections/OS_OsApplication_QM_VAR, vLinkGenVarSectionGroupRef=OS_OsApplication_QM_VAR_NOCACHE
            OS_OsApplication_QM_VAR_ZERO_INIT: vLinkGenVarSectionGroupInit=ZERO_INIT, vLinkGenVarSectionGroupAlignment=4, vLinkGenVarSectionGroupEndAlignment=4, vLinkGenVarSectionGroupRef=vLinkGenLinkerSections/OS_OsApplication_QM_VAR_ZERO_INIT, vLinkGenVarSectionGroupRef=OS_OsApplication_QM_VAR_NOCACHE_ZERO_INIT
            OS_OsApplication_QM_VAR_ZERO_INIT_bss: vLinkGenVarSectionGroupInit=ZERO_INIT, vLinkGenVarSectionGroupAlignment=4, vLinkGenVarSectionGroupEndAlignment=4, vLinkGenVarSectionGroupRef=vLinkGenLinkerSections/OS_OsApplication_QM_VAR_ZERO_INIT_bss, vLinkGenVarSectionGroupRef=OS_OsApplication_QM_VAR_NOCACHE_ZERO_INIT_bss
        OS_OsApplication_QM_VAR_SAVED_ZONE: vLinkGenVarGroupRegion=MCU_MSRAM_Common_NonCache, vLinkGenVarGroupContentType=RETENTION_DATA, vLinkGenVarGroupRomRegion=DDR0/DDR0
          OS_OsApplication_QM_VAR_SAVED_ZONE_NOINIT (vLinkGenVarSectionGroup):
            vLinkGenVarSectionGroupPosition = 0
            vLinkGenVarSectionGroupInit = NONE
            vLinkGenVarSectionGroupInitStage = ONE
            vLinkGenVarSectionGroupRef = vLinkGenLinkerSections/OS_OsApplication_QM_VAR_SAVED_ZONE_NOINIT
          OS_OsApplication_QM_VAR_SAVED_ZONE_INIT (vLinkGenVarSectionGroup):
            vLinkGenVarSectionGroupPosition = 0
            vLinkGenVarSectionGroupInit = INIT
            vLinkGenVarSectionGroupInitStage = ONE
            vLinkGenVarSectionGroupAlignment = 4
            vLinkGenVarSectionGroupEndAlignment = 4
            vLinkGenVarSectionGroupRef = vLinkGenLinkerSections/OS_OsApplication_QM_VAR_SAVED_ZONE
    vLinkGenContentTypes
      RAM_CODE (vLinkGenConstContentType): vLinkGenConstContentTypeLocal=false, vLinkGenConstContentTypeCopyRef=RAM_CODE_COPY
      RAM_CONST (vLinkGenConstContentType): vLinkGenConstContentTypeLocal=false, vLinkGenConstContentTypeCopyRef=RAM_CONST_COPY
      3 x vLinkGenVarContentType:
        GLOBAL_DATA: vLinkGenVarContentTypeLocal=false, vLinkGenVarContentTypeCopyRef=GLOBAL_CONST
        LOCAL_DATA: vLinkGenVarContentTypeLocal=true, vLinkGenVarContentTypeCopyRef=LOCAL_CONST
        RETENTION_DATA: vLinkGenVarContentTypeLocal=false, vLinkGenVarContentTypeCopyRef=GLOBAL_CONST
      13 x vLinkGenConstContentType:
        GLOBAL_CODE: vLinkGenConstContentTypeLocal=false
        LOCAL_CODE: vLinkGenConstContentTypeLocal=true
        GLOBAL_CONST: vLinkGenConstContentTypeLocal=false
        LOCAL_CONST: vLinkGenConstContentTypeLocal=true
        GLOBAL_EXCVEC_CODE: vLinkGenConstContentTypeLocal=false
        LOCAL_EXCVEC_CODE: vLinkGenConstContentTypeLocal=true
        GLOBAL_EXCVEC_CONST: vLinkGenConstContentTypeLocal=true
        LOCAL_EXCVEC_CONST: vLinkGenConstContentTypeLocal=true
        GLOBAL_INTVEC_CODE: vLinkGenConstContentTypeLocal=false
        LOCAL_INTVEC_CODE: vLinkGenConstContentTypeLocal=true
        GLOBAL_INTVEC_CONST: vLinkGenConstContentTypeLocal=false
        LOCAL_INTVEC_CONST: vLinkGenConstContentTypeLocal=true
        STARTUP_CODE: vLinkGenConstContentTypeLocal=false
      5 x vLinkGenVarContentType:
        STARTUP_STACK: vLinkGenVarContentTypeLocal=true
        STACKS: vLinkGenVarContentTypeLocal=true
        RAM_CODE_COPY: vLinkGenVarContentTypeLocal=false
        RAM_CONST_COPY: vLinkGenVarContentTypeLocal=false
        SHARED_DATA: vLinkGenVarContentTypeLocal=false
    vLinkGenPublishedInformation: vLinkGenGeneration=2, vLinkGenDuplicatedLabels=false
      vLinkGenRegionBlockFlags
        4 x vLinkGenRegionBlockFlag:
          EXECUTE
          READ
          WRITE
          INIT
      vLinkGenConstGroupFlags
        NOLOAD (vLinkGenConstGroupFlag)
        PALIGN_BLOCK (vLinkGenConstGroupFlag)
      vLinkGenVarGroupFlags
        NOLOAD (vLinkGenVarGroupFlag)
        PALIGN_BLOCK (vLinkGenVarGroupFlag)
    vLinkGenGeneral: vLinkGenFileGeneration=STANDARD
