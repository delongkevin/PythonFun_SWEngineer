AUTOSAR XML (schema 00048)
package /ActiveEcuC
  module config Cdd_UssLog: definition=Cdd, implementation-config-variant=VARIANT-PRE-COMPILE, module-description=Cdd_Impl
    CddComStackContribution
      CddPduRUpperLayerContribution
        10 x CddPduRUpperLayerTxPdu:
          CddPduRUpperLayerTxPdu_LogSnr_01: CddPduRUpperLayerHandleId=3, CddPduRUpperLayerPduRef=Log_SnrMeasData_01_oFDCAN14_9bf3ad30_Tx
          CddPduRUpperLayerTxPdu_LogSnr_02: CddPduRUpperLayerHandleId=4, CddPduRUpperLayerPduRef=Log_SnrMeasData_02_oFDCAN14_70c41633_Tx
          CddPduRUpperLayerTxPdu_LogSnr_03: CddPduRUpperLayerHandleId=5, CddPduRUpperLayerPduRef=Log_SnrMeasData_03_oFDCAN14_9f067d0d_Tx
          CddPduRUpperLayerTxPdu_LogSnr_04: CddPduRUpperLayerHandleId=6, CddPduRUpperLayerPduRef=Log_SnrMeasData_04_oFDCAN14_7dda6674_Tx
          CddPduRUpperLayerTxPdu_LogSnr_05: CddPduRUpperLayerHandleId=7, CddPduRUpperLayerPduRef=Log_SnrMeasData_05_oFDCAN14_92180d4a_Tx
          CddPduRUpperLayerTxPdu_LogSnr_06: CddPduRUpperLayerHandleId=8, CddPduRUpperLayerPduRef=Log_SnrMeasData_06_oFDCAN14_792fb649_Tx
          CddPduRUpperLayerTxPdu_LogSnr_07: CddPduRUpperLayerHandleId=9, CddPduRUpperLayerPduRef=Log_SnrMeasData_07_oFDCAN14_96eddd77_Tx
          CddPduRUpperLayerTxPdu_LogPackedData1: CddPduRUpperLayerHandleId=1, CddPduRUpperLayerPduRef=Log_PackedDiagFlagData1_v_oFDCAN14_3f2e5ac7_Tx
          CddPduRUpperLayerTxPdu_LogPackedData2: CddPduRUpperLayerHandleId=2, CddPduRUpperLayerPduRef=Log_PackedDiagFlagData2_v_oFDCAN14_48b08837_Tx
          CddPduRUpperLayerTxPdu_LogPackedNoise: CddPduRUpperLayerHandleId=0, CddPduRUpperLayerPduRef=Log_PackedNoiseMeasData_oFDCAN14_b57e278e_Tx
