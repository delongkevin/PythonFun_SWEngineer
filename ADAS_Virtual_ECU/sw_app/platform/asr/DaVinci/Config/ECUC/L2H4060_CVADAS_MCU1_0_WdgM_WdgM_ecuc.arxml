AUTOSAR XML (schema 00048)
package /ActiveEcuC
  module config WdgM: implementation-config-variant=VARIANT-PRE-COMPILE, module-description=WdgM_Impl
    WdgMConfigSet: WdgMInitialMode=WdgMMode
      WdgMMode:
        WdgMExpiredSupervisionCycleTol = 0
        WdgMModeId = 0
        WdgMSupervisionCycle = 0.01
        WdgMInitialTriggerModeId = 0
        WdgMModeCoreAssignment = 0
        WdgMTicksPerSecond = 100
        WdgMReportStatusViaRte = false
        WdgMGlobalMemoryAppTaskRef = SystemApplication_OsCore0
        WdgMLocalStatusParams_Safety_Task_01_10ms (WdgMLocalStatusParams):
          WdgMFailedAliveSupervisionRefCycleTol = 0
          WdgMSupervisedEntityInitialMode = WDGM_LOCAL_STATUS_OK
          WdgMFailedDeadlineRefCycleTol = 0
          WdgMDeadlineReferenceCycle = 0
          WdgMFailedProgramFlowRefCycleTol = 0
          WdgMProgramFlowReferenceCycle = 0
          WdgMLocalStatusSupervisedEntityRef = WdgM_SE_Safety_Task_01_10ms
        WdgMLocalStatusParams_Safety_Task_00_10ms (WdgMLocalStatusParams):
          WdgMFailedAliveSupervisionRefCycleTol = 0
          WdgMSupervisedEntityInitialMode = WDGM_LOCAL_STATUS_OK
          WdgMFailedDeadlineRefCycleTol = 0
          WdgMDeadlineReferenceCycle = 0
          WdgMFailedProgramFlowRefCycleTol = 0
          WdgMProgramFlowReferenceCycle = 0
          WdgMLocalStatusSupervisedEntityRef = WdgM_SE_Safety_Task_00_10ms
        6 x WdgMAliveSupervision, all with WdgMExpectedAliveIndications=100, WdgMSupervisionReferenceCycle=100:
          WdgMAliveSupervision_Safety_Task_00_10ms: WdgMMaxMargin=80, WdgMMinMargin=80, WdgMAliveSupervisionCheckpointRef=WdgMAliveCP_Safety_Task_00_10ms
          WdgMAliveSupervision_Safety_Task_01_10ms: WdgMMaxMargin=80, WdgMMinMargin=80, WdgMAliveSupervisionCheckpointRef=WdgMAliveCP_Safety_Task_01_10ms
          WdgMAliveSupervision_MCU1_0: WdgMMaxMargin=40, WdgMMinMargin=40, WdgMAliveSupervisionCheckpointRef=WdgMAliveCP_MCU1_0
          WdgMAliveSupervision_MCU2_0: WdgMMaxMargin=40, WdgMMinMargin=40, WdgMAliveSupervisionCheckpointRef=WdgMAliveCP_MCU2_0
          WdgMAliveSupervision_MCU2_1: WdgMMaxMargin=40, WdgMMinMargin=40, WdgMAliveSupervisionCheckpointRef=WdgMAliveCP_MCU2_1
          WdgMAliveSupervision_MPU1_0: WdgMMaxMargin=40, WdgMMinMargin=40, WdgMAliveSupervisionCheckpointRef=WdgMAliveCP_MPU1_0
        4 x WdgMLocalStatusParams, all with WdgMFailedAliveSupervisionRefCycleTol=0, WdgMSupervisedEntityInitialMode=WDGM_LOCAL_STATUS_OK, WdgMFailedDeadlineRefCycleTol=0, WdgMDeadlineReferenceCycle=0, WdgMFailedProgramFlowRefCycleTol=0, WdgMProgramFlowReferenceCycle=0:
          WdgMLocalStatusParams_MCU1_0: WdgMLocalStatusSupervisedEntityRef=WdgM_SE_MCU1_0
          WdgMLocalStatusParams_MCU2_0: WdgMLocalStatusSupervisedEntityRef=WdgM_SE_MCU2_0
          WdgMLocalStatusParams_MCU2_1: WdgMLocalStatusSupervisedEntityRef=WdgM_SE_MCU2_1
          WdgMLocalStatusParams_MPU1_0: WdgMLocalStatusSupervisedEntityRef=WdgM_SE_MPU1_0
        WdgMTrigger: WdgMWatchdogMode=WDGIF_FAST_MODE, WdgMTriggerConditionValue=10, WdgMTriggerModeId=0, WdgMTriggerWatchdogRef=WdgMWatchdog
        WdgMAliveSupervision_Safety_Com_Task_10ms (WdgMAliveSupervision):
          WdgMExpectedAliveIndications = 100
          WdgMMaxMargin = 80
          WdgMMinMargin = 80
          WdgMSupervisionReferenceCycle = 100
          WdgMAliveSupervisionCheckpointRef = WdgMAliveCP_Safety_Com_Task_10ms
        WdgMLocalStatusParams_Safety_Com_Task_10ms (WdgMLocalStatusParams):
          WdgMFailedAliveSupervisionRefCycleTol = 0
          WdgMSupervisedEntityInitialMode = WDGM_LOCAL_STATUS_OK
          WdgMFailedDeadlineRefCycleTol = 0
          WdgMDeadlineReferenceCycle = 0
          WdgMFailedProgramFlowRefCycleTol = 0
          WdgMProgramFlowReferenceCycle = 0
          WdgMLocalStatusSupervisedEntityRef = WdgM_SE_Safety_Com_Task_10ms
        WdgMAliveSupervision_Safety_Task_200ms (WdgMAliveSupervision):
          WdgMExpectedAliveIndications = 25
          WdgMMaxMargin = 20
          WdgMMinMargin = 20
          WdgMSupervisionReferenceCycle = 500
          WdgMAliveSupervisionCheckpointRef = WdgMAliveCP_Safety_Task_200ms
        WdgMLocalStatusParams_Safety_Task_200ms (WdgMLocalStatusParams):
          WdgMFailedAliveSupervisionRefCycleTol = 0
          WdgMSupervisedEntityInitialMode = WDGM_LOCAL_STATUS_OK
          WdgMFailedDeadlineRefCycleTol = 0
          WdgMDeadlineReferenceCycle = 0
          WdgMFailedProgramFlowRefCycleTol = 0
          WdgMProgramFlowReferenceCycle = 0
          WdgMLocalStatusSupervisedEntityRef = WdgM_SE_Safety_Task_200ms
    WdgMGeneral:
      WdgMDevErrorDetect = false
      WdgMDemReport = false
      WdgMImmediateReset = false
      WdgMOffModeEnabled = false
      WdgMVersionInfoApi = false
      WdgMDefensiveBehavior = false
      WdgMUseRte = true
      WdgMDemSupervisionReport = false
      WdgMFirstCycleAliveCounterReset = false
      WdgMAutosarDebugging = false
      WdgMUseOsSuspendInterrupt = true
      WdgMTimebaseSource = WDGM_INTERNAL_SOFTWARE_TICK
      WdgMSecondResetPath = false
      WdgMTickOverrunCorrection = false
      WdgMEntityDeactivationEnabled = false
      WdgMGenerateCPIdAsPortDefinedArgument = false
      WdgMStatusReportingMechanism = WDGM_USE_NO_STATUS_REPORTING
      WdgMUseOsCoreIdentification = true
      WdgM_SE_Safety_Task_01_10ms (WdgMSupervisedEntity):
        WdgMSupervisedEntityId = 5
        WdgMEnableEntityDeactivation = false
        WdgMReportStatusViaRte = false
        WdgMInternalCheckpointInitialRef = WdgMAliveCP_Safety_Task_01_10ms
        WdgMAppTaskRef = SystemApplication_OsCore0
        WdgMAliveCP_Safety_Task_01_10ms (WdgMCheckpoint): WdgMCheckpointId=0
      WdgM_SE_Safety_Task_00_10ms (WdgMSupervisedEntity):
        WdgMSupervisedEntityId = 4
        WdgMEnableEntityDeactivation = false
        WdgMReportStatusViaRte = false
        WdgMInternalCheckpointInitialRef = WdgMAliveCP_Safety_Task_00_10ms
        WdgMAppTaskRef = SystemApplication_OsCore0
        WdgMAliveCP_Safety_Task_00_10ms (WdgMCheckpoint): WdgMCheckpointId=0
      WdgMCallerIds: WdgMCallerId=0
      WdgMWatchdog: WdgMWatchdogName=, WdgMWatchdogDeviceRef=WdgIfDevice
      6 x WdgMSupervisedEntity, all with WdgMEnableEntityDeactivation=false, WdgMReportStatusViaRte=false, WdgMAppTaskRef=SystemApplication_OsCore0:
        WdgM_SE_MCU1_0: WdgMSupervisedEntityId=0, WdgMInternalCheckpointInitialRef=WdgMAliveCP_MCU1_0
          WdgMAliveCP_MCU1_0 (WdgMCheckpoint): WdgMCheckpointId=0
        WdgM_SE_MCU2_0: WdgMSupervisedEntityId=1, WdgMInternalCheckpointInitialRef=WdgMAliveCP_MCU2_0
          WdgMAliveCP_MCU2_0 (WdgMCheckpoint): WdgMCheckpointId=0
        WdgM_SE_MCU2_1: WdgMSupervisedEntityId=2, WdgMInternalCheckpointInitialRef=WdgMAliveCP_MCU2_1
          WdgMAliveCP_MCU2_1 (WdgMCheckpoint): WdgMCheckpointId=0
        WdgM_SE_MPU1_0: WdgMSupervisedEntityId=3, WdgMInternalCheckpointInitialRef=WdgMAliveCP_MPU1_0
          WdgMAliveCP_MPU1_0 (WdgMCheckpoint): WdgMCheckpointId=0
        WdgM_SE_Safety_Com_Task_10ms: WdgMSupervisedEntityId=6, WdgMInternalCheckpointInitialRef=WdgMAliveCP_Safety_Com_Task_10ms
          WdgMAliveCP_Safety_Com_Task_10ms (WdgMCheckpoint): WdgMCheckpointId=0
        WdgM_SE_Safety_Task_200ms: WdgMSupervisedEntityId=7, WdgMInternalCheckpointInitialRef=WdgMAliveCP_Safety_Task_200ms
          WdgMAliveCP_Safety_Task_200ms (WdgMCheckpoint): WdgMCheckpointId=0
