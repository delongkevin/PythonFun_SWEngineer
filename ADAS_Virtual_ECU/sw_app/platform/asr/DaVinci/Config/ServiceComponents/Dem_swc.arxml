[part 2 of 3: package /MICROSAR/Dem_swc/ComponentTypes]
AUTOSAR XML (schema 00050)
package /MICROSAR/Dem_swc/ComponentTypes  (continued)
  service sw component type DemSatellite_0: category=SERVICE_COMPONENT  (continued)
    behavior DemSatellite_0InternalBehavior: handle-termination-and-restart=NO-SUPPORT, included-data-type-set=data-type=[Dem_EventIdType, Dem_RatioIdType, Dem_EventStatusType, Dem_UdsStatusByteType, Dem_DTCFormatType, Dem_InitMonitorReasonType, Dem_OperationCycleStateType, Dem_DTCStatusMaskType, Dem_IndicatorStatusType, Dem_MaxDataValueType, Dem_DTCKindType, Dem_DTCGroupType, Dem_IumprDenomCondIdType, Dem_IumprDenomCondStatusType, Dem_DebounceResetStatusType, Dem_DebouncingStateType, Dem_IumprReadinessGroupType, Dem_DTRControlType, Dem_DTCSeverityType, Dem_MonitorStatusType]  (continued)
      1485 x operation invoked event:  (continued)
        OpEventGetEventFailed_GetEventFailed_Event_PTS_Sensor_9_Performance_or_Incorrect_Operation_B129692: start-on-event=DemSatellite_0InternalBehavior/GetEventFailed, operation=Event_PTS_Sensor_9_Performance_or_Incorrect_Operation_B129692.GetEventFailed
        OpEventGetEventFailed_GetEventFailed_EvtInfo_Calibration_Not_Learned_Lost_Calibration_B228600: start-on-event=DemSatellite_0InternalBehavior/GetEventFailed, operation=EvtInfo_Calibration_Not_Learned_Lost_Calibration_B228600.GetEventFailed
        OpEventGetEventFailed_GetEventFailed_Event_Calibration_Not_Learned_Lost_Calibration_B228600: start-on-event=DemSatellite_0InternalBehavior/GetEventFailed, operation=Event_Calibration_Not_Learned_Lost_Calibration_B228600.GetEventFailed
        OpEventGetEventFailed_GetEventFailed_EvtInfo_Lost_Communication_with_ORC_U015100: start-on-event=DemSatellite_0InternalBehavior/GetEventFailed, operation=EvtInfo_Lost_Communication_with_ORC_U015100.GetEventFailed
        OpEventGetEventFailed_GetEventFailed_Event_Lost_Communication_with_ORC_U015100: start-on-event=DemSatellite_0InternalBehavior/GetEventFailed, operation=Event_Lost_Communication_with_ORC_U015100.GetEventFailed
        OpEventGetEventFailed_GetEventFailed_EvtInfo_PTS_Sensor_1_Circuit_Open_B128E13: start-on-event=DemSatellite_0InternalBehavior/GetEventFailed, operation=EvtInfo_PTS_Sensor_1_Circuit_Open_B128E13.GetEventFailed
        OpEventGetEventFailed_GetEventFailed_Event_PTS_Sensor_1_Circuit_Open_B128E13: start-on-event=DemSatellite_0InternalBehavior/GetEventFailed, operation=Event_PTS_Sensor_1_Circuit_Open_B128E13.GetEventFailed
        OpEventGetEventFailed_GetEventFailed_EvtInfo_Lost_Communication_with_Rear_Camera_U026400: start-on-event=DemSatellite_0InternalBehavior/GetEventFailed, operation=EvtInfo_Lost_Communication_with_Rear_Camera_U026400.GetEventFailed
        OpEventGetEventFailed_GetEventFailed_Event_Lost_Communication_with_Rear_Camera_U026400: start-on-event=DemSatellite_0InternalBehavior/GetEventFailed, operation=Event_Lost_Communication_with_Rear_Camera_U026400.GetEventFailed
        OpEventGetEventFailed_GetEventFailed_EvtInfo_HS_FD_CANR_Comm_Bus_Performance_U100B00: start-on-event=DemSatellite_0InternalBehavior/GetEventFailed, operation=EvtInfo_HS_FD_CANR_Comm_Bus_Performance_U100B00.GetEventFailed
        OpEventGetEventFailed_GetEventFailed_Event_HS_FD_CANR_Comm_Bus_Performance_U100B00: start-on-event=DemSatellite_0InternalBehavior/GetEventFailed, operation=Event_HS_FD_CANR_Comm_Bus_Performance_U100B00.GetEventFailed
        OpEventGetEventFailed_GetEventFailed_EvtInfo_Implausible_Data_Received_From_Body_Control_Module_U042200: start-on-event=DemSatellite_0InternalBehavior/GetEventFailed, operation=EvtInfo_Implausible_Data_Received_From_Body_Control_Module_U042200.GetEventFailed
        OpEventGetEventFailed_GetEventFailed_Event_Implausible_Data_Received_From_Body_Control_Module_U042200: start-on-event=DemSatellite_0InternalBehavior/GetEventFailed, operation=Event_Implausible_Data_Received_From_Body_Control_Module_U042200.GetEventFailed
        OpEventGetEventFailed_GetEventFailed_EvtInfo_Lost_Communication_With_BCM_U014000: start-on-event=DemSatellite_0InternalBehavior/GetEventFailed, operation=EvtInfo_Lost_Communication_With_BCM_U014000.GetEventFailed
        OpEventGetEventFailed_GetEventFailed_Event_Lost_Communication_With_BCM_U014000: start-on-event=DemSatellite_0InternalBehavior/GetEventFailed, operation=Event_Lost_Communication_With_BCM_U014000.GetEventFailed
        OpEventGetEventFailed_GetEventFailed_EvtInfo_PTS_Sensor_2_Circuit_Open_B128F13: start-on-event=DemSatellite_0InternalBehavior/GetEventFailed, operation=EvtInfo_PTS_Sensor_2_Circuit_Open_B128F13.GetEventFailed
        OpEventGetEventFailed_GetEventFailed_Event_PTS_Sensor_2_Circuit_Open_B128F13: start-on-event=DemSatellite_0InternalBehavior/GetEventFailed, operation=Event_PTS_Sensor_2_Circuit_Open_B128F13.GetEventFailed
        OpEventGetEventFailed_GetEventFailed_EvtInfo_PTS_Sensor_3_Circuit_Open_B129013: start-on-event=DemSatellite_0InternalBehavior/GetEventFailed, operation=EvtInfo_PTS_Sensor_3_Circuit_Open_B129013.GetEventFailed
        OpEventGetEventFailed_GetEventFailed_Event_PTS_Sensor_3_Circuit_Open_B129013: start-on-event=DemSatellite_0InternalBehavior/GetEventFailed, operation=Event_PTS_Sensor_3_Circuit_Open_B129013.GetEventFailed
        OpEventGetEventFailed_GetEventFailed_EvtInfo_ECU_In_Plant_Mode_C221200: start-on-event=DemSatellite_0InternalBehavior/GetEventFailed, operation=EvtInfo_ECU_In_Plant_Mode_C221200.GetEventFailed
        OpEventGetEventFailed_GetEventFailed_Event_ECU_In_Plant_Mode_C221200: start-on-event=DemSatellite_0InternalBehavior/GetEventFailed, operation=Event_ECU_In_Plant_Mode_C221200.GetEventFailed
        OpEventGetEventFailed_GetEventFailed_EvtInfo_Implausible_Data_from_ORC_module_U045500: start-on-event=DemSatellite_0InternalBehavior/GetEventFailed, operation=EvtInfo_Implausible_Data_from_ORC_module_U045500.GetEventFailed
        OpEventGetEventFailed_GetEventFailed_Event_Implausible_Data_from_ORC_module_U045500: start-on-event=DemSatellite_0InternalBehavior/GetEventFailed, operation=Event_Implausible_Data_from_ORC_module_U045500.GetEventFailed
        OpEventGetEventFailed_GetEventFailed_EvtInfo_Right_Camera_Performance_or_Incorrect_Operation_B23C792: start-on-event=DemSatellite_0InternalBehavior/GetEventFailed, operation=EvtInfo_Right_Camera_Performance_or_Incorrect_Operation_B23C792.GetEventFailed
        OpEventGetEventFailed_GetEventFailed_Event_Right_Camera_Performance_or_Incorrect_Operation_B23C792: start-on-event=DemSatellite_0InternalBehavior/GetEventFailed, operation=Event_Right_Camera_Performance_or_Incorrect_Operation_B23C792.GetEventFailed
        OpEventGetEventFailed_GetEventFailed_EvtInfo_Rear_Sensors_PS_VltgeAboveThreshold_B212B17: start-on-event=DemSatellite_0InternalBehavior/GetEventFailed, operation=EvtInfo_Rear_Sensors_PS_VltgeAboveThreshold_B212B17.GetEventFailed
        OpEventGetEventFailed_GetEventFailed_Event_Rear_Sensors_PS_VltgeAboveThreshold_B212B17: start-on-event=DemSatellite_0InternalBehavior/GetEventFailed, operation=Event_Rear_Sensors_PS_VltgeAboveThreshold_B212B17.GetEventFailed
        OpEventGetEventFailed_GetEventFailed_EvtInfo_PTS_Sensor_6_Performance_or_Incorrect_Operation_B129392: start-on-event=DemSatellite_0InternalBehavior/GetEventFailed, operation=EvtInfo_PTS_Sensor_6_Performance_or_Incorrect_Operation_B129392.GetEventFailed
        OpEventGetEventFailed_GetEventFailed_Event_PTS_Sensor_6_Performance_or_Incorrect_Operation_B129392: start-on-event=DemSatellite_0InternalBehavior/GetEventFailed, operation=Event_PTS_Sensor_6_Performance_or_Incorrect_Operation_B129392.GetEventFailed
        OpEventGetEventFailed_GetEventFailed_GeneralEvtInfo: start-on-event=DemSatellite_0InternalBehavior/GetEventFailed, operation=GeneralEvtInfo.GetEventFailed
        OpEventGetEventTested_GetEventTested_EvtInfo_Dem_SystemInternalFailure: start-on-event=DemSatellite_0InternalBehavior/GetEventTested, operation=EvtInfo_Dem_SystemInternalFailure.GetEventTested
        OpEventGetEventTested_GetEventTested_Event_Dem_SystemInternalFailure: start-on-event=DemSatellite_0InternalBehavior/GetEventTested, operation=Event_Dem_SystemInternalFailure.GetEventTested
        OpEventGetEventTested_GetEventTested_EvtInfo_Invalid_Data_Received_From_Power_Steering_Control_Module_U042000: start-on-event=DemSatellite_0InternalBehavior/GetEventTested, operation=EvtInfo_Invalid_Data_Received_From_Power_Steering_Control_Module_U042000.GetEventTested
        OpEventGetEventTested_GetEventTested_Event_Invalid_Data_Received_From_Power_Steering_Control_Module_U042000: start-on-event=DemSatellite_0InternalBehavior/GetEventTested, operation=Event_Invalid_Data_Received_From_Power_Steering_Control_Module_U042000.GetEventTested
        OpEventGetEventTested_GetEventTested_EvtInfo_Lost_Communication_with_Left_Camera_U026600: start-on-event=DemSatellite_0InternalBehavior/GetEventTested, operation=EvtInfo_Lost_Communication_with_Left_Camera_U026600.GetEventTested
        OpEventGetEventTested_GetEventTested_Event_Lost_Communication_with_Left_Camera_U026600: start-on-event=DemSatellite_0InternalBehavior/GetEventTested, operation=Event_Lost_Communication_with_Left_Camera_U026600.GetEventTested
        OpEventGetEventTested_GetEventTested_EvtInfo_Front_Sensors_PS_VltgeBelowThreshold_B212A16: start-on-event=DemSatellite_0InternalBehavior/GetEventTested, operation=EvtInfo_Front_Sensors_PS_VltgeBelowThreshold_B212A16.GetEventTested
        OpEventGetEventTested_GetEventTested_Event_Front_Sensors_PS_VltgeBelowThreshold_B212A16: start-on-event=DemSatellite_0InternalBehavior/GetEventTested, operation=Event_Front_Sensors_PS_VltgeBelowThreshold_B212A16.GetEventTested
        OpEventGetEventTested_GetEventTested_EvtInfo_Left_Camera_Circuit_Voltage_Out_of_Range_B23C61C: start-on-event=DemSatellite_0InternalBehavior/GetEventTested, operation=EvtInfo_Left_Camera_Circuit_Voltage_Out_of_Range_B23C61C.GetEventTested
        OpEventGetEventTested_GetEventTested_Event_Left_Camera_Circuit_Voltage_Out_of_Range_B23C61C: start-on-event=DemSatellite_0InternalBehavior/GetEventTested, operation=Event_Left_Camera_Circuit_Voltage_Out_of_Range_B23C61C.GetEventTested
        OpEventGetEventTested_GetEventTested_EvtInfo_Rear_Sensors_PS_VltgeBelowThreshold_B212B16: start-on-event=DemSatellite_0InternalBehavior/GetEventTested, operation=EvtInfo_Rear_Sensors_PS_VltgeBelowThreshold_B212B16.GetEventTested
        OpEventGetEventTested_GetEventTested_Event_Rear_Sensors_PS_VltgeBelowThreshold_B212B16: start-on-event=DemSatellite_0InternalBehavior/GetEventTested, operation=Event_Rear_Sensors_PS_VltgeBelowThreshold_B212B16.GetEventTested
        OpEventGetEventTested_GetEventTested_EvtInfo_Rear_Sensors_PS_Bus_Sig_Msg_Failures_B212B08: start-on-event=DemSatellite_0InternalBehavior/GetEventTested, operation=EvtInfo_Rear_Sensors_PS_Bus_Sig_Msg_Failures_B212B08.GetEventTested
        OpEventGetEventTested_GetEventTested_Event_Rear_Sensors_PS_Bus_Sig_Msg_Failures_B212B08: start-on-event=DemSatellite_0InternalBehavior/GetEventTested, operation=Event_Rear_Sensors_PS_Bus_Sig_Msg_Failures_B212B08.GetEventTested
        OpEventGetEventTested_GetEventTested_EvtInfo_Rear_Camera_Circuit_Voltage_Out_of_Range_B217A1C: start-on-event=DemSatellite_0InternalBehavior/GetEventTested, operation=EvtInfo_Rear_Camera_Circuit_Voltage_Out_of_Range_B217A1C.GetEventTested
        OpEventGetEventTested_GetEventTested_Event_Rear_Camera_Circuit_Voltage_Out_of_Range_B217A1C: start-on-event=DemSatellite_0InternalBehavior/GetEventTested, operation=Event_Rear_Camera_Circuit_Voltage_Out_of_Range_B217A1C.GetEventTested
        OpEventGetEventTested_GetEventTested_EvtInfo_PTS_Sensor_12_Performance_or_Incorrect_Operation_B129992: start-on-event=DemSatellite_0InternalBehavior/GetEventTested, operation=EvtInfo_PTS_Sensor_12_Performance_or_Incorrect_Operation_B129992.GetEventTested
        OpEventGetEventTested_GetEventTested_Event_PTS_Sensor_12_Performance_or_Incorrect_Operation_B129992: start-on-event=DemSatellite_0InternalBehavior/GetEventTested, operation=Event_PTS_Sensor_12_Performance_or_Incorrect_Operation_B129992.GetEventTested
        OpEventGetEventTested_GetEventTested_EvtInfo_Battery_Voltage_Over_Voltage_B210C17: start-on-event=DemSatellite_0InternalBehavior/GetEventTested, operation=EvtInfo_Battery_Voltage_Over_Voltage_B210C17.GetEventTested
        OpEventGetEventTested_GetEventTested_Event_Battery_Voltage_Over_Voltage_B210C17: start-on-event=DemSatellite_0InternalBehavior/GetEventTested, operation=Event_Battery_Voltage_Over_Voltage_B210C17.GetEventTested
        OpEventGetEventTested_GetEventTested_EvtInfo_Front_Sensors_PS_VltgeAboveThreshold_B212A17: start-on-event=DemSatellite_0InternalBehavior/GetEventTested, operation=EvtInfo_Front_Sensors_PS_VltgeAboveThreshold_B212A17.GetEventTested
        OpEventGetEventTested_GetEventTested_Event_Front_Sensors_PS_VltgeAboveThreshold_B212A17: start-on-event=DemSatellite_0InternalBehavior/GetEventTested, operation=Event_Front_Sensors_PS_VltgeAboveThreshold_B212A17.GetEventTested
        OpEventGetEventTested_GetEventTested_EvtInfo_PTS_Sensor_4_Circuit_Open_B129113: start-on-event=DemSatellite_0InternalBehavior/GetEventTested, operation=EvtInfo_PTS_Sensor_4_Circuit_Open_B129113.GetEventTested
        OpEventGetEventTested_GetEventTested_Event_PTS_Sensor_4_Circuit_Open_B129113: start-on-event=DemSatellite_0InternalBehavior/GetEventTested, operation=Event_PTS_Sensor_4_Circuit_Open_B129113.GetEventTested
        OpEventGetEventTested_GetEventTested_EvtInfo_PTS_Sensor_12_Circuit_Open_B129913: start-on-event=DemSatellite_0InternalBehavior/GetEventTested, operation=EvtInfo_PTS_Sensor_12_Circuit_Open_B129913.GetEventTested
        OpEventGetEventTested_GetEventTested_Event_PTS_Sensor_12_Circuit_Open_B129913: start-on-event=DemSatellite_0InternalBehavior/GetEventTested, operation=Event_PTS_Sensor_12_Circuit_Open_B129913.GetEventTested
        OpEventGetEventTested_GetEventTested_EvtInfo_PTS_Sensor_11_Performance_or_Incorrect_Operation_B129892: start-on-event=DemSatellite_0InternalBehavior/GetEventTested, operation=EvtInfo_PTS_Sensor_11_Performance_or_Incorrect_Operation_B129892.GetEventTested
        OpEventGetEventTested_GetEventTested_Event_PTS_Sensor_11_Performance_or_Incorrect_Operation_B129892: start-on-event=DemSatellite_0InternalBehavior/GetEventTested, operation=Event_PTS_Sensor_11_Performance_or_Incorrect_Operation_B129892.GetEventTested
        OpEventGetEventTested_GetEventTested_EvtInfo_Lost_Communication_With_Radio_U018400: start-on-event=DemSatellite_0InternalBehavior/GetEventTested, operation=EvtInfo_Lost_Communication_With_Radio_U018400.GetEventTested
        OpEventGetEventTested_GetEventTested_Event_Lost_Communication_With_Radio_U018400: start-on-event=DemSatellite_0InternalBehavior/GetEventTested, operation=Event_Lost_Communication_With_Radio_U018400.GetEventTested
        OpEventGetEventTested_GetEventTested_EvtInfo_Park_Assist_PTS_Switch_Stuck_B12852A: start-on-event=DemSatellite_0InternalBehavior/GetEventTested, operation=EvtInfo_Park_Assist_PTS_Switch_Stuck_B12852A.GetEventTested
        OpEventGetEventTested_GetEventTested_Event_Park_Assist_PTS_Switch_Stuck_B12852A: start-on-event=DemSatellite_0InternalBehavior/GetEventTested, operation=Event_Park_Assist_PTS_Switch_Stuck_B12852A.GetEventTested
        OpEventGetEventTested_GetEventTested_EvtInfo_PTS_Sensor_5_Circuit_Open_B129213: start-on-event=DemSatellite_0InternalBehavior/GetEventTested, operation=EvtInfo_PTS_Sensor_5_Circuit_Open_B129213.GetEventTested
        OpEventGetEventTested_GetEventTested_Event_PTS_Sensor_5_Circuit_Open_B129213: start-on-event=DemSatellite_0InternalBehavior/GetEventTested, operation=Event_PTS_Sensor_5_Circuit_Open_B129213.GetEventTested
        OpEventGetEventTested_GetEventTested_EvtInfo_PTS_Sensor_5_Performance_or_Incorrect_Operation_B129292: start-on-event=DemSatellite_0InternalBehavior/GetEventTested, operation=EvtInfo_PTS_Sensor_5_Performance_or_Incorrect_Operation_B129292.GetEventTested
        OpEventGetEventTested_GetEventTested_Event_PTS_Sensor_5_Performance_or_Incorrect_Operation_B129292: start-on-event=DemSatellite_0InternalBehavior/GetEventTested, operation=Event_PTS_Sensor_5_Performance_or_Incorrect_Operation_B129292.GetEventTested
        OpEventGetEventTested_GetEventTested_EvtInfo_Battery_Voltage_Under_Voltage_B210C16: start-on-event=DemSatellite_0InternalBehavior/GetEventTested, operation=EvtInfo_Battery_Voltage_Under_Voltage_B210C16.GetEventTested
        OpEventGetEventTested_GetEventTested_Event_Battery_Voltage_Under_Voltage_B210C16: start-on-event=DemSatellite_0InternalBehavior/GetEventTested, operation=Event_Battery_Voltage_Under_Voltage_B210C16.GetEventTested
        OpEventGetEventTested_GetEventTested_EvtInfo_PTS_Sensor_4_Performance_or_Incorrect_Operation_B129192: start-on-event=DemSatellite_0InternalBehavior/GetEventTested, operation=EvtInfo_PTS_Sensor_4_Performance_or_Incorrect_Operation_B129192.GetEventTested
        OpEventGetEventTested_GetEventTested_Event_PTS_Sensor_4_Performance_or_Incorrect_Operation_B129192: start-on-event=DemSatellite_0InternalBehavior/GetEventTested, operation=Event_PTS_Sensor_4_Performance_or_Incorrect_Operation_B129192.GetEventTested
        OpEventGetEventTested_GetEventTested_EvtInfo_HS_FD_CAN2_Comm_Bus_Performance_U104E00: start-on-event=DemSatellite_0InternalBehavior/GetEventTested, operation=EvtInfo_HS_FD_CAN2_Comm_Bus_Performance_U104E00.GetEventTested
        OpEventGetEventTested_GetEventTested_Event_HS_FD_CAN2_Comm_Bus_Performance_U104E00: start-on-event=DemSatellite_0InternalBehavior/GetEventTested, operation=Event_HS_FD_CAN2_Comm_Bus_Performance_U104E00.GetEventTested
        OpEventGetEventTested_GetEventTested_EvtInfo_PTS_Sensor_9_Circuit_Open_B129613: start-on-event=DemSatellite_0InternalBehavior/GetEventTested, operation=EvtInfo_PTS_Sensor_9_Circuit_Open_B129613.GetEventTested
        OpEventGetEventTested_GetEventTested_Event_PTS_Sensor_9_Circuit_Open_B129613: start-on-event=DemSatellite_0InternalBehavior/GetEventTested, operation=Event_PTS_Sensor_9_Circuit_Open_B129613.GetEventTested
        OpEventGetEventTested_GetEventTested_EvtInfo_Loss_of_Comm_With_Engine_Control_Module_U010000: start-on-event=DemSatellite_0InternalBehavior/GetEventTested, operation=EvtInfo_Loss_of_Comm_With_Engine_Control_Module_U010000.GetEventTested
        OpEventGetEventTested_GetEventTested_Event_Loss_of_Comm_With_Engine_Control_Module_U010000: start-on-event=DemSatellite_0InternalBehavior/GetEventTested, operation=Event_Loss_of_Comm_With_Engine_Control_Module_U010000.GetEventTested
        OpEventGetEventTested_GetEventTested_EvtInfo_Lost_Communication_with_Right_Camera_U026700: start-on-event=DemSatellite_0InternalBehavior/GetEventTested, operation=EvtInfo_Lost_Communication_with_Right_Camera_U026700.GetEventTested
        OpEventGetEventTested_GetEventTested_Event_Lost_Communication_with_Right_Camera_U026700: start-on-event=DemSatellite_0InternalBehavior/GetEventTested, operation=Event_Lost_Communication_with_Right_Camera_U026700.GetEventTested
        OpEventGetEventTested_GetEventTested_EvtInfo_PTS_Sensor_1_Performance_or_Incorrect_Operation_B128E92: start-on-event=DemSatellite_0InternalBehavior/GetEventTested, operation=EvtInfo_PTS_Sensor_1_Performance_or_Incorrect_Operation_B128E92.GetEventTested
        OpEventGetEventTested_GetEventTested_Event_PTS_Sensor_1_Performance_or_Incorrect_Operation_B128E92: start-on-event=DemSatellite_0InternalBehavior/GetEventTested, operation=Event_PTS_Sensor_1_Performance_or_Incorrect_Operation_B128E92.GetEventTested
        OpEventGetEventTested_GetEventTested_EvtInfo_Rear_Camera_Performance_or_Incorrect_Operation_B217A92: start-on-event=DemSatellite_0InternalBehavior/GetEventTested, operation=EvtInfo_Rear_Camera_Performance_or_Incorrect_Operation_B217A92.GetEventTested
        OpEventGetEventTested_GetEventTested_Event_Rear_Camera_Performance_or_Incorrect_Operation_B217A92: start-on-event=DemSatellite_0InternalBehavior/GetEventTested, operation=Event_Rear_Camera_Performance_or_Incorrect_Operation_B217A92.GetEventTested
        OpEventGetEventTested_GetEventTested_EvtInfo_PTS_Sensor_2_Performance_or_Incorrect_Operation_B128F92: start-on-event=DemSatellite_0InternalBehavior/GetEventTested, operation=EvtInfo_PTS_Sensor_2_Performance_or_Incorrect_Operation_B128F92.GetEventTested
        OpEventGetEventTested_GetEventTested_Event_PTS_Sensor_2_Performance_or_Incorrect_Operation_B128F92: start-on-event=DemSatellite_0InternalBehavior/GetEventTested, operation=Event_PTS_Sensor_2_Performance_or_Incorrect_Operation_B128F92.GetEventTested
        OpEventGetEventTested_GetEventTested_EvtInfo_Right_Camera_Circuit_Voltage_Out_of_Range_B23C71C: start-on-event=DemSatellite_0InternalBehavior/GetEventTested, operation=EvtInfo_Right_Camera_Circuit_Voltage_Out_of_Range_B23C71C.GetEventTested
        OpEventGetEventTested_GetEventTested_Event_Right_Camera_Circuit_Voltage_Out_of_Range_B23C71C: start-on-event=DemSatellite_0InternalBehavior/GetEventTested, operation=Event_Right_Camera_Circuit_Voltage_Out_of_Range_B23C71C.GetEventTested
        OpEventGetEventTested_GetEventTested_EvtInfo_PTS_Sensor_8_Circuit_Open_B129513: start-on-event=DemSatellite_0InternalBehavior/GetEventTested, operation=EvtInfo_PTS_Sensor_8_Circuit_Open_B129513.GetEventTested
        OpEventGetEventTested_GetEventTested_Event_PTS_Sensor_8_Circuit_Open_B129513: start-on-event=DemSatellite_0InternalBehavior/GetEventTested, operation=Event_PTS_Sensor_8_Circuit_Open_B129513.GetEventTested
        OpEventGetEventTested_GetEventTested_EvtInfo_Implausible_Data_Received_from_Radio_U048500: start-on-event=DemSatellite_0InternalBehavior/GetEventTested, operation=EvtInfo_Implausible_Data_Received_from_Radio_U048500.GetEventTested
        OpEventGetEventTested_GetEventTested_Event_Implausible_Data_Received_from_Radio_U048500: start-on-event=DemSatellite_0InternalBehavior/GetEventTested, operation=Event_Implausible_Data_Received_from_Radio_U048500.GetEventTested
        OpEventGetEventTested_GetEventTested_EvtInfo_Implausible_Data_received_from_TRSKM_module_U14A000: start-on-event=DemSatellite_0InternalBehavior/GetEventTested, operation=EvtInfo_Implausible_Data_received_from_TRSKM_module_U14A000.GetEventTested
        OpEventGetEventTested_GetEventTested_Event_Implausible_Data_received_from_TRSKM_module_U14A000: start-on-event=DemSatellite_0InternalBehavior/GetEventTested, operation=Event_Implausible_Data_received_from_TRSKM_module_U14A000.GetEventTested
        OpEventGetEventTested_GetEventTested_EvtInfo_Front_Camera_Performance_or_Incorrect_Operation_B23C592: start-on-event=DemSatellite_0InternalBehavior/GetEventTested, operation=EvtInfo_Front_Camera_Performance_or_Incorrect_Operation_B23C592.GetEventTested
        OpEventGetEventTested_GetEventTested_Event_Front_Camera_Performance_or_Incorrect_Operation_B23C592: start-on-event=DemSatellite_0InternalBehavior/GetEventTested, operation=Event_Front_Camera_Performance_or_Incorrect_Operation_B23C592.GetEventTested
        OpEventGetEventTested_GetEventTested_EvtInfo_Loss_Communication_with_TRS_Knob_Module_U12B900: start-on-event=DemSatellite_0InternalBehavior/GetEventTested, operation=EvtInfo_Loss_Communication_with_TRS_Knob_Module_U12B900.GetEventTested
        OpEventGetEventTested_GetEventTested_Event_Loss_Communication_with_TRS_Knob_Module_U12B900: start-on-event=DemSatellite_0InternalBehavior/GetEventTested, operation=Event_Loss_Communication_with_TRS_Knob_Module_U12B900.GetEventTested
        OpEventGetEventTested_GetEventTested_EvtInfo_PTS_Sensor_7_Circuit_Open_B129413: start-on-event=DemSatellite_0InternalBehavior/GetEventTested, operation=EvtInfo_PTS_Sensor_7_Circuit_Open_B129413.GetEventTested
        OpEventGetEventTested_GetEventTested_Event_PTS_Sensor_7_Circuit_Open_B129413: start-on-event=DemSatellite_0InternalBehavior/GetEventTested, operation=Event_PTS_Sensor_7_Circuit_Open_B129413.GetEventTested
        OpEventGetEventTested_GetEventTested_EvtInfo_Front_Sensors_PS_Bus_Sig_Msg_Failures_B212A08: start-on-event=DemSatellite_0InternalBehavior/GetEventTested, operation=EvtInfo_Front_Sensors_PS_Bus_Sig_Msg_Failures_B212A08.GetEventTested
        OpEventGetEventTested_GetEventTested_Event_Front_Sensors_PS_Bus_Sig_Msg_Failures_B212A08: start-on-event=DemSatellite_0InternalBehavior/GetEventTested, operation=Event_Front_Sensors_PS_Bus_Sig_Msg_Failures_B212A08.GetEventTested
        OpEventGetEventTested_GetEventTested_EvtInfo_Lost_Communication_With_PSC_Module_A_U013100: start-on-event=DemSatellite_0InternalBehavior/GetEventTested, operation=EvtInfo_Lost_Communication_With_PSC_Module_A_U013100.GetEventTested
        OpEventGetEventTested_GetEventTested_Event_Lost_Communication_With_PSC_Module_A_U013100: start-on-event=DemSatellite_0InternalBehavior/GetEventTested, operation=Event_Lost_Communication_With_PSC_Module_A_U013100.GetEventTested
        OpEventGetEventTested_GetEventTested_EvtInfo_Lost_Communication_with_Front_Camera_U026500: start-on-event=DemSatellite_0InternalBehavior/GetEventTested, operation=EvtInfo_Lost_Communication_with_Front_Camera_U026500.GetEventTested
        OpEventGetEventTested_GetEventTested_Event_Lost_Communication_with_Front_Camera_U026500: start-on-event=DemSatellite_0InternalBehavior/GetEventTested, operation=Event_Lost_Communication_with_Front_Camera_U026500.GetEventTested
        OpEventGetEventTested_GetEventTested_EvtInfo_PTS_Sensor_3_Performance_or_Incorrect_Operation_B129092: start-on-event=DemSatellite_0InternalBehavior/GetEventTested, operation=EvtInfo_PTS_Sensor_3_Performance_or_Incorrect_Operation_B129092.GetEventTested
        OpEventGetEventTested_GetEventTested_Event_PTS_Sensor_3_Performance_or_Incorrect_Operation_B129092: start-on-event=DemSatellite_0InternalBehavior/GetEventTested, operation=Event_PTS_Sensor_3_Performance_or_Incorrect_Operation_B129092.GetEventTested
        OpEventGetEventTested_GetEventTested_EvtInfo_PTS_Sensor_8_Performance_or_Incorrect_Operation_B129592: start-on-event=DemSatellite_0InternalBehavior/GetEventTested, operation=EvtInfo_PTS_Sensor_8_Performance_or_Incorrect_Operation_B129592.GetEventTested
        OpEventGetEventTested_GetEventTested_Event_PTS_Sensor_8_Performance_or_Incorrect_Operation_B129592: start-on-event=DemSatellite_0InternalBehavior/GetEventTested, operation=Event_PTS_Sensor_8_Performance_or_Incorrect_Operation_B129592.GetEventTested
        OpEventGetEventTested_GetEventTested_EvtInfo_PPP_Assist_Switch_Stuck_B12B22A: start-on-event=DemSatellite_0InternalBehavior/GetEventTested, operation=EvtInfo_PPP_Assist_Switch_Stuck_B12B22A.GetEventTested
        OpEventGetEventTested_GetEventTested_Event_PPP_Assist_Switch_Stuck_B12B22A: start-on-event=DemSatellite_0InternalBehavior/GetEventTested, operation=Event_PPP_Assist_Switch_Stuck_B12B22A.GetEventTested
        OpEventGetEventTested_GetEventTested_EvtInfo_Implausible_data_received_from_ECM_U040100: start-on-event=DemSatellite_0InternalBehavior/GetEventTested, operation=EvtInfo_Implausible_data_received_from_ECM_U040100.GetEventTested
        OpEventGetEventTested_GetEventTested_Event_Implausible_data_received_from_ECM_U040100: start-on-event=DemSatellite_0InternalBehavior/GetEventTested, operation=Event_Implausible_data_received_from_ECM_U040100.GetEventTested
        OpEventGetEventTested_GetEventTested_EvtInfo_PTS_Sensor_10_Circuit_Open_B129713: start-on-event=DemSatellite_0InternalBehavior/GetEventTested, operation=EvtInfo_PTS_Sensor_10_Circuit_Open_B129713.GetEventTested
        OpEventGetEventTested_GetEventTested_Event_PTS_Sensor_10_Circuit_Open_B129713: start-on-event=DemSatellite_0InternalBehavior/GetEventTested, operation=Event_PTS_Sensor_10_Circuit_Open_B129713.GetEventTested
        OpEventGetEventTested_GetEventTested_EvtInfo_Lost_Communication_With_BSC_module_1_U012900: start-on-event=DemSatellite_0InternalBehavior/GetEventTested, operation=EvtInfo_Lost_Communication_With_BSC_module_1_U012900.GetEventTested
        OpEventGetEventTested_GetEventTested_Event_Lost_Communication_With_BSC_module_1_U012900: start-on-event=DemSatellite_0InternalBehavior/GetEventTested, operation=Event_Lost_Communication_With_BSC_module_1_U012900.GetEventTested
        OpEventGetEventTested_GetEventTested_EvtInfo_PTS_Sensor_7_Performance_or_Incorrect_Operation_B129492: start-on-event=DemSatellite_0InternalBehavior/GetEventTested, operation=EvtInfo_PTS_Sensor_7_Performance_or_Incorrect_Operation_B129492.GetEventTested
        OpEventGetEventTested_GetEventTested_Event_PTS_Sensor_7_Performance_or_Incorrect_Operation_B129492: start-on-event=DemSatellite_0InternalBehavior/GetEventTested, operation=Event_PTS_Sensor_7_Performance_or_Incorrect_Operation_B129492.GetEventTested
        OpEventGetEventTested_GetEventTested_EvtInfo_Left_Camera_Performance_or_Incorrect_Operation_B23C692: start-on-event=DemSatellite_0InternalBehavior/GetEventTested, operation=EvtInfo_Left_Camera_Performance_or_Incorrect_Operation_B23C692.GetEventTested
        OpEventGetEventTested_GetEventTested_Event_Left_Camera_Performance_or_Incorrect_Operation_B23C692: start-on-event=DemSatellite_0InternalBehavior/GetEventTested, operation=Event_Left_Camera_Performance_or_Incorrect_Operation_B23C692.GetEventTested
        OpEventGetEventTested_GetEventTested_EvtInfo_Vehicle_Configuration_Mismatch_B223B00: start-on-event=DemSatellite_0InternalBehavior/GetEventTested, operation=EvtInfo_Vehicle_Configuration_Mismatch_B223B00.GetEventTested
        OpEventGetEventTested_GetEventTested_Event_Vehicle_Configuration_Mismatch_B223B00: start-on-event=DemSatellite_0InternalBehavior/GetEventTested, operation=Event_Vehicle_Configuration_Mismatch_B223B00.GetEventTested
        OpEventGetEventTested_GetEventTested_EvtInfo_PTS_Sensor_6_Circuit_Open_B129313: start-on-event=DemSatellite_0InternalBehavior/GetEventTested, operation=EvtInfo_PTS_Sensor_6_Circuit_Open_B129313.GetEventTested
        OpEventGetEventTested_GetEventTested_Event_PTS_Sensor_6_Circuit_Open_B129313: start-on-event=DemSatellite_0InternalBehavior/GetEventTested, operation=Event_PTS_Sensor_6_Circuit_Open_B129313.GetEventTested
        OpEventGetEventTested_GetEventTested_EvtInfo_Front_Camera_Circuit_Voltage_Out_of_Range_B23C51C: start-on-event=DemSatellite_0InternalBehavior/GetEventTested, operation=EvtInfo_Front_Camera_Circuit_Voltage_Out_of_Range_B23C51C.GetEventTested
        OpEventGetEventTested_GetEventTested_Event_Front_Camera_Circuit_Voltage_Out_of_Range_B23C51C: start-on-event=DemSatellite_0InternalBehavior/GetEventTested, operation=Event_Front_Camera_Circuit_Voltage_Out_of_Range_B23C51C.GetEventTested
        OpEventGetEventTested_GetEventTested_EvtInfo_Implausible_Data_From_BSC_Module_1_U041800: start-on-event=DemSatellite_0InternalBehavior/GetEventTested, operation=EvtInfo_Implausible_Data_From_BSC_Module_1_U041800.GetEventTested
        OpEventGetEventTested_GetEventTested_Event_Implausible_Data_From_BSC_Module_1_U041800: start-on-event=DemSatellite_0InternalBehavior/GetEventTested, operation=Event_Implausible_Data_From_BSC_Module_1_U041800.GetEventTested
        OpEventGetEventTested_GetEventTested_EvtInfo_PTS_Sensor_10_Performance_or_Incorrect_Operation_B129792: start-on-event=DemSatellite_0InternalBehavior/GetEventTested, operation=EvtInfo_PTS_Sensor_10_Performance_or_Incorrect_Operation_B129792.GetEventTested
        OpEventGetEventTested_GetEventTested_Event_PTS_Sensor_10_Performance_or_Incorrect_Operation_B129792: start-on-event=DemSatellite_0InternalBehavior/GetEventTested, operation=Event_PTS_Sensor_10_Performance_or_Incorrect_Operation_B129792.GetEventTested
        OpEventGetEventTested_GetEventTested_EvtInfo_PTS_Sensor_11_Circuit_Open_B129813: start-on-event=DemSatellite_0InternalBehavior/GetEventTested, operation=EvtInfo_PTS_Sensor_11_Circuit_Open_B129813.GetEventTested
        OpEventGetEventTested_GetEventTested_Event_PTS_Sensor_11_Circuit_Open_B129813: start-on-event=DemSatellite_0InternalBehavior/GetEventTested, operation=Event_PTS_Sensor_11_Circuit_Open_B129813.GetEventTested
        OpEventGetEventTested_GetEventTested_EvtInfo_ECU_Internal_Performance_B22A900: start-on-event=DemSatellite_0InternalBehavior/GetEventTested, operation=EvtInfo_ECU_Internal_Performance_B22A900.GetEventTested
        OpEventGetEventTested_GetEventTested_Event_ECU_Internal_Performance_B22A900: start-on-event=DemSatellite_0InternalBehavior/GetEventTested, operation=Event_ECU_Internal_Performance_B22A900.GetEventTested
        OpEventGetEventTested_GetEventTested_EvtInfo_PTS_Sensor_9_Performance_or_Incorrect_Operation_B129692: start-on-event=DemSatellite_0InternalBehavior/GetEventTested, operation=EvtInfo_PTS_Sensor_9_Performance_or_Incorrect_Operation_B129692.GetEventTested
        OpEventGetEventTested_GetEventTested_Event_PTS_Sensor_9_Performance_or_Incorrect_Operation_B129692: start-on-event=DemSatellite_0InternalBehavior/GetEventTested, operation=Event_PTS_Sensor_9_Performance_or_Incorrect_Operation_B129692.GetEventTested
        OpEventGetEventTested_GetEventTested_EvtInfo_Calibration_Not_Learned_Lost_Calibration_B228600: start-on-event=DemSatellite_0InternalBehavior/GetEventTested, operation=EvtInfo_Calibration_Not_Learned_Lost_Calibration_B228600.GetEventTested
        OpEventGetEventTested_GetEventTested_Event_Calibration_Not_Learned_Lost_Calibration_B228600: start-on-event=DemSatellite_0InternalBehavior/GetEventTested, operation=Event_Calibration_Not_Learned_Lost_Calibration_B228600.GetEventTested
        OpEventGetEventTested_GetEventTested_EvtInfo_Lost_Communication_with_ORC_U015100: start-on-event=DemSatellite_0InternalBehavior/GetEventTested, operation=EvtInfo_Lost_Communication_with_ORC_U015100.GetEventTested
        OpEventGetEventTested_GetEventTested_Event_Lost_Communication_with_ORC_U015100: start-on-event=DemSatellite_0InternalBehavior/GetEventTested, operation=Event_Lost_Communication_with_ORC_U015100.GetEventTested
        OpEventGetEventTested_GetEventTested_EvtInfo_PTS_Sensor_1_Circuit_Open_B128E13: start-on-event=DemSatellite_0InternalBehavior/GetEventTested, operation=EvtInfo_PTS_Sensor_1_Circuit_Open_B128E13.GetEventTested
        OpEventGetEventTested_GetEventTested_Event_PTS_Sensor_1_Circuit_Open_B128E13: start-on-event=DemSatellite_0InternalBehavior/GetEventTested, operation=Event_PTS_Sensor_1_Circuit_Open_B128E13.GetEventTested
        OpEventGetEventTested_GetEventTested_EvtInfo_Lost_Communication_with_Rear_Camera_U026400: start-on-event=DemSatellite_0InternalBehavior/GetEventTested, operation=EvtInfo_Lost_Communication_with_Rear_Camera_U026400.GetEventTested
        OpEventGetEventTested_GetEventTested_Event_Lost_Communication_with_Rear_Camera_U026400: start-on-event=DemSatellite_0InternalBehavior/GetEventTested, operation=Event_Lost_Communication_with_Rear_Camera_U026400.GetEventTested
        OpEventGetEventTested_GetEventTested_EvtInfo_HS_FD_CANR_Comm_Bus_Performance_U100B00: start-on-event=DemSatellite_0InternalBehavior/GetEventTested, operation=EvtInfo_HS_FD_CANR_Comm_Bus_Performance_U100B00.GetEventTested
        OpEventGetEventTested_GetEventTested_Event_HS_FD_CANR_Comm_Bus_Performance_U100B00: start-on-event=DemSatellite_0InternalBehavior/GetEventTested, operation=Event_HS_FD_CANR_Comm_Bus_Performance_U100B00.GetEventTested
        OpEventGetEventTested_GetEventTested_EvtInfo_Implausible_Data_Received_From_Body_Control_Module_U042200: start-on-event=DemSatellite_0InternalBehavior/GetEventTested, operation=EvtInfo_Implausible_Data_Received_From_Body_Control_Module_U042200.GetEventTested
        OpEventGetEventTested_GetEventTested_Event_Implausible_Data_Received_From_Body_Control_Module_U042200: start-on-event=DemSatellite_0InternalBehavior/GetEventTested, operation=Event_Implausible_Data_Received_From_Body_Control_Module_U042200.GetEventTested
        OpEventGetEventTested_GetEventTested_EvtInfo_Lost_Communication_With_BCM_U014000: start-on-event=DemSatellite_0InternalBehavior/GetEventTested, operation=EvtInfo_Lost_Communication_With_BCM_U014000.GetEventTested
        OpEventGetEventTested_GetEventTested_Event_Lost_Communication_With_BCM_U014000: start-on-event=DemSatellite_0InternalBehavior/GetEventTested, operation=Event_Lost_Communication_With_BCM_U014000.GetEventTested
        OpEventGetEventTested_GetEventTested_EvtInfo_PTS_Sensor_2_Circuit_Open_B128F13: start-on-event=DemSatellite_0InternalBehavior/GetEventTested, operation=EvtInfo_PTS_Sensor_2_Circuit_Open_B128F13.GetEventTested
        OpEventGetEventTested_GetEventTested_Event_PTS_Sensor_2_Circuit_Open_B128F13: start-on-event=DemSatellite_0InternalBehavior/GetEventTested, operation=Event_PTS_Sensor_2_Circuit_Open_B128F13.GetEventTested
        OpEventGetEventTested_GetEventTested_EvtInfo_PTS_Sensor_3_Circuit_Open_B129013: start-on-event=DemSatellite_0InternalBehavior/GetEventTested, operation=EvtInfo_PTS_Sensor_3_Circuit_Open_B129013.GetEventTested
        OpEventGetEventTested_GetEventTested_Event_PTS_Sensor_3_Circuit_Open_B129013: start-on-event=DemSatellite_0InternalBehavior/GetEventTested, operation=Event_PTS_Sensor_3_Circuit_Open_B129013.GetEventTested
        OpEventGetEventTested_GetEventTested_EvtInfo_ECU_In_Plant_Mode_C221200: start-on-event=DemSatellite_0InternalBehavior/GetEventTested, operation=EvtInfo_ECU_In_Plant_Mode_C221200.GetEventTested
        OpEventGetEventTested_GetEventTested_Event_ECU_In_Plant_Mode_C221200: start-on-event=DemSatellite_0InternalBehavior/GetEventTested, operation=Event_ECU_In_Plant_Mode_C221200.GetEventTested
        OpEventGetEventTested_GetEventTested_EvtInfo_Implausible_Data_from_ORC_module_U045500: start-on-event=DemSatellite_0InternalBehavior/GetEventTested, operation=EvtInfo_Implausible_Data_from_ORC_module_U045500.GetEventTested
        OpEventGetEventTested_GetEventTested_Event_Implausible_Data_from_ORC_module_U045500: start-on-event=DemSatellite_0InternalBehavior/GetEventTested, operation=Event_Implausible_Data_from_ORC_module_U045500.GetEventTested
        OpEventGetEventTested_GetEventTested_EvtInfo_Right_Camera_Performance_or_Incorrect_Operation_B23C792: start-on-event=DemSatellite_0InternalBehavior/GetEventTested, operation=EvtInfo_Right_Camera_Performance_or_Incorrect_Operation_B23C792.GetEventTested
        OpEventGetEventTested_GetEventTested_Event_Right_Camera_Performance_or_Incorrect_Operation_B23C792: start-on-event=DemSatellite_0InternalBehavior/GetEventTested, operation=Event_Right_Camera_Performance_or_Incorrect_Operation_B23C792.GetEventTested
        OpEventGetEventTested_GetEventTested_EvtInfo_Rear_Sensors_PS_VltgeAboveThreshold_B212B17: start-on-event=DemSatellite_0InternalBehavior/GetEventTested, operation=EvtInfo_Rear_Sensors_PS_VltgeAboveThreshold_B212B17.GetEventTested
        OpEventGetEventTested_GetEventTested_Event_Rear_Sensors_PS_VltgeAboveThreshold_B212B17: start-on-event=DemSatellite_0InternalBehavior/GetEventTested, operation=Event_Rear_Sensors_PS_VltgeAboveThreshold_B212B17.GetEventTested
        OpEventGetEventTested_GetEventTested_EvtInfo_PTS_Sensor_6_Performance_or_Incorrect_Operation_B129392: start-on-event=DemSatellite_0InternalBehavior/GetEventTested, operation=EvtInfo_PTS_Sensor_6_Performance_or_Incorrect_Operation_B129392.GetEventTested
        OpEventGetEventTested_GetEventTested_Event_PTS_Sensor_6_Performance_or_Incorrect_Operation_B129392: start-on-event=DemSatellite_0InternalBehavior/GetEventTested, operation=Event_PTS_Sensor_6_Performance_or_Incorrect_Operation_B129392.GetEventTested
        OpEventGetEventTested_GetEventTested_GeneralEvtInfo: start-on-event=DemSatellite_0InternalBehavior/GetEventTested, operation=GeneralEvtInfo.GetEventTested
        OpEventGetDTCOfEvent_GetDTCOfEvent_EvtInfo_Dem_SystemInternalFailure: start-on-event=DemSatellite_0InternalBehavior/GetDTCOfEvent, operation=EvtInfo_Dem_SystemInternalFailure.GetDTCOfEvent
        OpEventGetDTCOfEvent_GetDTCOfEvent_Event_Dem_SystemInternalFailure: start-on-event=DemSatellite_0InternalBehavior/GetDTCOfEvent, operation=Event_Dem_SystemInternalFailure.GetDTCOfEvent
        OpEventGetDTCOfEvent_GetDTCOfEvent_EvtInfo_Invalid_Data_Received_From_Power_Steering_Control_Module_U042000: start-on-event=DemSatellite_0InternalBehavior/GetDTCOfEvent, operation=EvtInfo_Invalid_Data_Received_From_Power_Steering_Control_Module_U042000.GetDTCOfEvent
        OpEventGetDTCOfEvent_GetDTCOfEvent_Event_Invalid_Data_Received_From_Power_Steering_Control_Module_U042000: start-on-event=DemSatellite_0InternalBehavior/GetDTCOfEvent, operation=Event_Invalid_Data_Received_From_Power_Steering_Control_Module_U042000.GetDTCOfEvent
        OpEventGetDTCOfEvent_GetDTCOfEvent_EvtInfo_Lost_Communication_with_Left_Camera_U026600: start-on-event=DemSatellite_0InternalBehavior/GetDTCOfEvent, operation=EvtInfo_Lost_Communication_with_Left_Camera_U026600.GetDTCOfEvent
        OpEventGetDTCOfEvent_GetDTCOfEvent_Event_Lost_Communication_with_Left_Camera_U026600: start-on-event=DemSatellite_0InternalBehavior/GetDTCOfEvent, operation=Event_Lost_Communication_with_Left_Camera_U026600.GetDTCOfEvent
        OpEventGetDTCOfEvent_GetDTCOfEvent_EvtInfo_Front_Sensors_PS_VltgeBelowThreshold_B212A16: start-on-event=DemSatellite_0InternalBehavior/GetDTCOfEvent, operation=EvtInfo_Front_Sensors_PS_VltgeBelowThreshold_B212A16.GetDTCOfEvent
        OpEventGetDTCOfEvent_GetDTCOfEvent_Event_Front_Sensors_PS_VltgeBelowThreshold_B212A16: start-on-event=DemSatellite_0InternalBehavior/GetDTCOfEvent, operation=Event_Front_Sensors_PS_VltgeBelowThreshold_B212A16.GetDTCOfEvent
        OpEventGetDTCOfEvent_GetDTCOfEvent_EvtInfo_Left_Camera_Circuit_Voltage_Out_of_Range_B23C61C: start-on-event=DemSatellite_0InternalBehavior/GetDTCOfEvent, operation=EvtInfo_Left_Camera_Circuit_Voltage_Out_of_Range_B23C61C.GetDTCOfEvent
        OpEventGetDTCOfEvent_GetDTCOfEvent_Event_Left_Camera_Circuit_Voltage_Out_of_Range_B23C61C: start-on-event=DemSatellite_0InternalBehavior/GetDTCOfEvent, operation=Event_Left_Camera_Circuit_Voltage_Out_of_Range_B23C61C.GetDTCOfEvent
        OpEventGetDTCOfEvent_GetDTCOfEvent_EvtInfo_Rear_Sensors_PS_VltgeBelowThreshold_B212B16: start-on-event=DemSatellite_0InternalBehavior/GetDTCOfEvent, operation=EvtInfo_Rear_Sensors_PS_VltgeBelowThreshold_B212B16.GetDTCOfEvent
        OpEventGetDTCOfEvent_GetDTCOfEvent_Event_Rear_Sensors_PS_VltgeBelowThreshold_B212B16: start-on-event=DemSatellite_0InternalBehavior/GetDTCOfEvent, operation=Event_Rear_Sensors_PS_VltgeBelowThreshold_B212B16.GetDTCOfEvent
        OpEventGetDTCOfEvent_GetDTCOfEvent_EvtInfo_Rear_Sensors_PS_Bus_Sig_Msg_Failures_B212B08: start-on-event=DemSatellite_0InternalBehavior/GetDTCOfEvent, operation=EvtInfo_Rear_Sensors_PS_Bus_Sig_Msg_Failures_B212B08.GetDTCOfEvent
        OpEventGetDTCOfEvent_GetDTCOfEvent_Event_Rear_Sensors_PS_Bus_Sig_Msg_Failures_B212B08: start-on-event=DemSatellite_0InternalBehavior/GetDTCOfEvent, operation=Event_Rear_Sensors_PS_Bus_Sig_Msg_Failures_B212B08.GetDTCOfEvent
        OpEventGetDTCOfEvent_GetDTCOfEvent_EvtInfo_Rear_Camera_Circuit_Voltage_Out_of_Range_B217A1C: start-on-event=DemSatellite_0InternalBehavior/GetDTCOfEvent, operation=EvtInfo_Rear_Camera_Circuit_Voltage_Out_of_Range_B217A1C.GetDTCOfEvent
        OpEventGetDTCOfEvent_GetDTCOfEvent_Event_Rear_Camera_Circuit_Voltage_Out_of_Range_B217A1C: start-on-event=DemSatellite_0InternalBehavior/GetDTCOfEvent, operation=Event_Rear_Camera_Circuit_Voltage_Out_of_Range_B217A1C.GetDTCOfEvent
        OpEventGetDTCOfEvent_GetDTCOfEvent_EvtInfo_PTS_Sensor_12_Performance_or_Incorrect_Operation_B129992: start-on-event=DemSatellite_0InternalBehavior/GetDTCOfEvent, operation=EvtInfo_PTS_Sensor_12_Performance_or_Incorrect_Operation_B129992.GetDTCOfEvent
        OpEventGetDTCOfEvent_GetDTCOfEvent_Event_PTS_Sensor_12_Performance_or_Incorrect_Operation_B129992: start-on-event=DemSatellite_0InternalBehavior/GetDTCOfEvent, operation=Event_PTS_Sensor_12_Performance_or_Incorrect_Operation_B129992.GetDTCOfEvent
        OpEventGetDTCOfEvent_GetDTCOfEvent_EvtInfo_Battery_Voltage_Over_Voltage_B210C17: start-on-event=DemSatellite_0InternalBehavior/GetDTCOfEvent, operation=EvtInfo_Battery_Voltage_Over_Voltage_B210C17.GetDTCOfEvent
        OpEventGetDTCOfEvent_GetDTCOfEvent_Event_Battery_Voltage_Over_Voltage_B210C17: start-on-event=DemSatellite_0InternalBehavior/GetDTCOfEvent, operation=Event_Battery_Voltage_Over_Voltage_B210C17.GetDTCOfEvent
        OpEventGetDTCOfEvent_GetDTCOfEvent_EvtInfo_Front_Sensors_PS_VltgeAboveThreshold_B212A17: start-on-event=DemSatellite_0InternalBehavior/GetDTCOfEvent, operation=EvtInfo_Front_Sensors_PS_VltgeAboveThreshold_B212A17.GetDTCOfEvent
        OpEventGetDTCOfEvent_GetDTCOfEvent_Event_Front_Sensors_PS_VltgeAboveThreshold_B212A17: start-on-event=DemSatellite_0InternalBehavior/GetDTCOfEvent, operation=Event_Front_Sensors_PS_VltgeAboveThreshold_B212A17.GetDTCOfEvent
        OpEventGetDTCOfEvent_GetDTCOfEvent_EvtInfo_PTS_Sensor_4_Circuit_Open_B129113: start-on-event=DemSatellite_0InternalBehavior/GetDTCOfEvent, operation=EvtInfo_PTS_Sensor_4_Circuit_Open_B129113.GetDTCOfEvent
        OpEventGetDTCOfEvent_GetDTCOfEvent_Event_PTS_Sensor_4_Circuit_Open_B129113: start-on-event=DemSatellite_0InternalBehavior/GetDTCOfEvent, operation=Event_PTS_Sensor_4_Circuit_Open_B129113.GetDTCOfEvent
        OpEventGetDTCOfEvent_GetDTCOfEvent_EvtInfo_PTS_Sensor_12_Circuit_Open_B129913: start-on-event=DemSatellite_0InternalBehavior/GetDTCOfEvent, operation=EvtInfo_PTS_Sensor_12_Circuit_Open_B129913.GetDTCOfEvent
        OpEventGetDTCOfEvent_GetDTCOfEvent_Event_PTS_Sensor_12_Circuit_Open_B129913: start-on-event=DemSatellite_0InternalBehavior/GetDTCOfEvent, operation=Event_PTS_Sensor_12_Circuit_Open_B129913.GetDTCOfEvent
        OpEventGetDTCOfEvent_GetDTCOfEvent_EvtInfo_PTS_Sensor_11_Performance_or_Incorrect_Operation_B129892: start-on-event=DemSatellite_0InternalBehavior/GetDTCOfEvent, operation=EvtInfo_PTS_Sensor_11_Performance_or_Incorrect_Operation_B129892.GetDTCOfEvent
        OpEventGetDTCOfEvent_GetDTCOfEvent_Event_PTS_Sensor_11_Performance_or_Incorrect_Operation_B129892: start-on-event=DemSatellite_0InternalBehavior/GetDTCOfEvent, operation=Event_PTS_Sensor_11_Performance_or_Incorrect_Operation_B129892.GetDTCOfEvent
        OpEventGetDTCOfEvent_GetDTCOfEvent_EvtInfo_Lost_Communication_With_Radio_U018400: start-on-event=DemSatellite_0InternalBehavior/GetDTCOfEvent, operation=EvtInfo_Lost_Communication_With_Radio_U018400.GetDTCOfEvent
        OpEventGetDTCOfEvent_GetDTCOfEvent_Event_Lost_Communication_With_Radio_U018400: start-on-event=DemSatellite_0InternalBehavior/GetDTCOfEvent, operation=Event_Lost_Communication_With_Radio_U018400.GetDTCOfEvent
        OpEventGetDTCOfEvent_GetDTCOfEvent_EvtInfo_Park_Assist_PTS_Switch_Stuck_B12852A: start-on-event=DemSatellite_0InternalBehavior/GetDTCOfEvent, operation=EvtInfo_Park_Assist_PTS_Switch_Stuck_B12852A.GetDTCOfEvent
        OpEventGetDTCOfEvent_GetDTCOfEvent_Event_Park_Assist_PTS_Switch_Stuck_B12852A: start-on-event=DemSatellite_0InternalBehavior/GetDTCOfEvent, operation=Event_Park_Assist_PTS_Switch_Stuck_B12852A.GetDTCOfEvent
        OpEventGetDTCOfEvent_GetDTCOfEvent_EvtInfo_PTS_Sensor_5_Circuit_Open_B129213: start-on-event=DemSatellite_0InternalBehavior/GetDTCOfEvent, operation=EvtInfo_PTS_Sensor_5_Circuit_Open_B129213.GetDTCOfEvent
        OpEventGetDTCOfEvent_GetDTCOfEvent_Event_PTS_Sensor_5_Circuit_Open_B129213: start-on-event=DemSatellite_0InternalBehavior/GetDTCOfEvent, operation=Event_PTS_Sensor_5_Circuit_Open_B129213.GetDTCOfEvent
        OpEventGetDTCOfEvent_GetDTCOfEvent_EvtInfo_PTS_Sensor_5_Performance_or_Incorrect_Operation_B129292: start-on-event=DemSatellite_0InternalBehavior/GetDTCOfEvent, operation=EvtInfo_PTS_Sensor_5_Performance_or_Incorrect_Operation_B129292.GetDTCOfEvent
        OpEventGetDTCOfEvent_GetDTCOfEvent_Event_PTS_Sensor_5_Performance_or_Incorrect_Operation_B129292: start-on-event=DemSatellite_0InternalBehavior/GetDTCOfEvent, operation=Event_PTS_Sensor_5_Performance_or_Incorrect_Operation_B129292.GetDTCOfEvent
        OpEventGetDTCOfEvent_GetDTCOfEvent_EvtInfo_Battery_Voltage_Under_Voltage_B210C16: start-on-event=DemSatellite_0InternalBehavior/GetDTCOfEvent, operation=EvtInfo_Battery_Voltage_Under_Voltage_B210C16.GetDTCOfEvent
        OpEventGetDTCOfEvent_GetDTCOfEvent_Event_Battery_Voltage_Under_Voltage_B210C16: start-on-event=DemSatellite_0InternalBehavior/GetDTCOfEvent, operation=Event_Battery_Voltage_Under_Voltage_B210C16.GetDTCOfEvent
        OpEventGetDTCOfEvent_GetDTCOfEvent_EvtInfo_PTS_Sensor_4_Performance_or_Incorrect_Operation_B129192: start-on-event=DemSatellite_0InternalBehavior/GetDTCOfEvent, operation=EvtInfo_PTS_Sensor_4_Performance_or_Incorrect_Operation_B129192.GetDTCOfEvent
        OpEventGetDTCOfEvent_GetDTCOfEvent_Event_PTS_Sensor_4_Performance_or_Incorrect_Operation_B129192: start-on-event=DemSatellite_0InternalBehavior/GetDTCOfEvent, operation=Event_PTS_Sensor_4_Performance_or_Incorrect_Operation_B129192.GetDTCOfEvent
        OpEventGetDTCOfEvent_GetDTCOfEvent_EvtInfo_HS_FD_CAN2_Comm_Bus_Performance_U104E00: start-on-event=DemSatellite_0InternalBehavior/GetDTCOfEvent, operation=EvtInfo_HS_FD_CAN2_Comm_Bus_Performance_U104E00.GetDTCOfEvent
        OpEventGetDTCOfEvent_GetDTCOfEvent_Event_HS_FD_CAN2_Comm_Bus_Performance_U104E00: start-on-event=DemSatellite_0InternalBehavior/GetDTCOfEvent, operation=Event_HS_FD_CAN2_Comm_Bus_Performance_U104E00.GetDTCOfEvent
        OpEventGetDTCOfEvent_GetDTCOfEvent_EvtInfo_PTS_Sensor_9_Circuit_Open_B129613: start-on-event=DemSatellite_0InternalBehavior/GetDTCOfEvent, operation=EvtInfo_PTS_Sensor_9_Circuit_Open_B129613.GetDTCOfEvent
        OpEventGetDTCOfEvent_GetDTCOfEvent_Event_PTS_Sensor_9_Circuit_Open_B129613: start-on-event=DemSatellite_0InternalBehavior/GetDTCOfEvent, operation=Event_PTS_Sensor_9_Circuit_Open_B129613.GetDTCOfEvent
        OpEventGetDTCOfEvent_GetDTCOfEvent_EvtInfo_Loss_of_Comm_With_Engine_Control_Module_U010000: start-on-event=DemSatellite_0InternalBehavior/GetDTCOfEvent, operation=EvtInfo_Loss_of_Comm_With_Engine_Control_Module_U010000.GetDTCOfEvent
        OpEventGetDTCOfEvent_GetDTCOfEvent_Event_Loss_of_Comm_With_Engine_Control_Module_U010000: start-on-event=DemSatellite_0InternalBehavior/GetDTCOfEvent, operation=Event_Loss_of_Comm_With_Engine_Control_Module_U010000.GetDTCOfEvent
        OpEventGetDTCOfEvent_GetDTCOfEvent_EvtInfo_Lost_Communication_with_Right_Camera_U026700: start-on-event=DemSatellite_0InternalBehavior/GetDTCOfEvent, operation=EvtInfo_Lost_Communication_with_Right_Camera_U026700.GetDTCOfEvent
        OpEventGetDTCOfEvent_GetDTCOfEvent_Event_Lost_Communication_with_Right_Camera_U026700: start-on-event=DemSatellite_0InternalBehavior/GetDTCOfEvent, operation=Event_Lost_Communication_with_Right_Camera_U026700.GetDTCOfEvent
        OpEventGetDTCOfEvent_GetDTCOfEvent_EvtInfo_PTS_Sensor_1_Performance_or_Incorrect_Operation_B128E92: start-on-event=DemSatellite_0InternalBehavior/GetDTCOfEvent, operation=EvtInfo_PTS_Sensor_1_Performance_or_Incorrect_Operation_B128E92.GetDTCOfEvent
        OpEventGetDTCOfEvent_GetDTCOfEvent_Event_PTS_Sensor_1_Performance_or_Incorrect_Operation_B128E92: start-on-event=DemSatellite_0InternalBehavior/GetDTCOfEvent, operation=Event_PTS_Sensor_1_Performance_or_Incorrect_Operation_B128E92.GetDTCOfEvent
        OpEventGetDTCOfEvent_GetDTCOfEvent_EvtInfo_Rear_Camera_Performance_or_Incorrect_Operation_B217A92: start-on-event=DemSatellite_0InternalBehavior/GetDTCOfEvent, operation=EvtInfo_Rear_Camera_Performance_or_Incorrect_Operation_B217A92.GetDTCOfEvent
        OpEventGetDTCOfEvent_GetDTCOfEvent_Event_Rear_Camera_Performance_or_Incorrect_Operation_B217A92: start-on-event=DemSatellite_0InternalBehavior/GetDTCOfEvent, operation=Event_Rear_Camera_Performance_or_Incorrect_Operation_B217A92.GetDTCOfEvent
        OpEventGetDTCOfEvent_GetDTCOfEvent_EvtInfo_PTS_Sensor_2_Performance_or_Incorrect_Operation_B128F92: start-on-event=DemSatellite_0InternalBehavior/GetDTCOfEvent, operation=EvtInfo_PTS_Sensor_2_Performance_or_Incorrect_Operation_B128F92.GetDTCOfEvent
        OpEventGetDTCOfEvent_GetDTCOfEvent_Event_PTS_Sensor_2_Performance_or_Incorrect_Operation_B128F92: start-on-event=DemSatellite_0InternalBehavior/GetDTCOfEvent, operation=Event_PTS_Sensor_2_Performance_or_Incorrect_Operation_B128F92.GetDTCOfEvent
        OpEventGetDTCOfEvent_GetDTCOfEvent_EvtInfo_Right_Camera_Circuit_Voltage_Out_of_Range_B23C71C: start-on-event=DemSatellite_0InternalBehavior/GetDTCOfEvent, operation=EvtInfo_Right_Camera_Circuit_Voltage_Out_of_Range_B23C71C.GetDTCOfEvent
        OpEventGetDTCOfEvent_GetDTCOfEvent_Event_Right_Camera_Circuit_Voltage_Out_of_Range_B23C71C: start-on-event=DemSatellite_0InternalBehavior/GetDTCOfEvent, operation=Event_Right_Camera_Circuit_Voltage_Out_of_Range_B23C71C.GetDTCOfEvent
        OpEventGetDTCOfEvent_GetDTCOfEvent_EvtInfo_PTS_Sensor_8_Circuit_Open_B129513: start-on-event=DemSatellite_0InternalBehavior/GetDTCOfEvent, operation=EvtInfo_PTS_Sensor_8_Circuit_Open_B129513.GetDTCOfEvent
        OpEventGetDTCOfEvent_GetDTCOfEvent_Event_PTS_Sensor_8_Circuit_Open_B129513: start-on-event=DemSatellite_0InternalBehavior/GetDTCOfEvent, operation=Event_PTS_Sensor_8_Circuit_Open_B129513.GetDTCOfEvent
        OpEventGetDTCOfEvent_GetDTCOfEvent_EvtInfo_Implausible_Data_Received_from_Radio_U048500: start-on-event=DemSatellite_0InternalBehavior/GetDTCOfEvent, operation=EvtInfo_Implausible_Data_Received_from_Radio_U048500.GetDTCOfEvent
        OpEventGetDTCOfEvent_GetDTCOfEvent_Event_Implausible_Data_Received_from_Radio_U048500: start-on-event=DemSatellite_0InternalBehavior/GetDTCOfEvent, operation=Event_Implausible_Data_Received_from_Radio_U048500.GetDTCOfEvent
        OpEventGetDTCOfEvent_GetDTCOfEvent_EvtInfo_Implausible_Data_received_from_TRSKM_module_U14A000: start-on-event=DemSatellite_0InternalBehavior/GetDTCOfEvent, operation=EvtInfo_Implausible_Data_received_from_TRSKM_module_U14A000.GetDTCOfEvent
        OpEventGetDTCOfEvent_GetDTCOfEvent_Event_Implausible_Data_received_from_TRSKM_module_U14A000: start-on-event=DemSatellite_0InternalBehavior/GetDTCOfEvent, operation=Event_Implausible_Data_received_from_TRSKM_module_U14A000.GetDTCOfEvent
        OpEventGetDTCOfEvent_GetDTCOfEvent_EvtInfo_Front_Camera_Performance_or_Incorrect_Operation_B23C592: start-on-event=DemSatellite_0InternalBehavior/GetDTCOfEvent, operation=EvtInfo_Front_Camera_Performance_or_Incorrect_Operation_B23C592.GetDTCOfEvent
        OpEventGetDTCOfEvent_GetDTCOfEvent_Event_Front_Camera_Performance_or_Incorrect_Operation_B23C592: start-on-event=DemSatellite_0InternalBehavior/GetDTCOfEvent, operation=Event_Front_Camera_Performance_or_Incorrect_Operation_B23C592.GetDTCOfEvent
        OpEventGetDTCOfEvent_GetDTCOfEvent_EvtInfo_Loss_Communication_with_TRS_Knob_Module_U12B900: start-on-event=DemSatellite_0InternalBehavior/GetDTCOfEvent, operation=EvtInfo_Loss_Communication_with_TRS_Knob_Module_U12B900.GetDTCOfEvent
        OpEventGetDTCOfEvent_GetDTCOfEvent_Event_Loss_Communication_with_TRS_Knob_Module_U12B900: start-on-event=DemSatellite_0InternalBehavior/GetDTCOfEvent, operation=Event_Loss_Communication_with_TRS_Knob_Module_U12B900.GetDTCOfEvent
        OpEventGetDTCOfEvent_GetDTCOfEvent_EvtInfo_PTS_Sensor_7_Circuit_Open_B129413: start-on-event=DemSatellite_0InternalBehavior/GetDTCOfEvent, operation=EvtInfo_PTS_Sensor_7_Circuit_Open_B129413.GetDTCOfEvent
        OpEventGetDTCOfEvent_GetDTCOfEvent_Event_PTS_Sensor_7_Circuit_Open_B129413: start-on-event=DemSatellite_0InternalBehavior/GetDTCOfEvent, operation=Event_PTS_Sensor_7_Circuit_Open_B129413.GetDTCOfEvent
        OpEventGetDTCOfEvent_GetDTCOfEvent_EvtInfo_Front_Sensors_PS_Bus_Sig_Msg_Failures_B212A08: start-on-event=DemSatellite_0InternalBehavior/GetDTCOfEvent, operation=EvtInfo_Front_Sensors_PS_Bus_Sig_Msg_Failures_B212A08.GetDTCOfEvent
        OpEventGetDTCOfEvent_GetDTCOfEvent_Event_Front_Sensors_PS_Bus_Sig_Msg_Failures_B212A08: start-on-event=DemSatellite_0InternalBehavior/GetDTCOfEvent, operation=Event_Front_Sensors_PS_Bus_Sig_Msg_Failures_B212A08.GetDTCOfEvent
        OpEventGetDTCOfEvent_GetDTCOfEvent_EvtInfo_Lost_Communication_With_PSC_Module_A_U013100: start-on-event=DemSatellite_0InternalBehavior/GetDTCOfEvent, operation=EvtInfo_Lost_Communication_With_PSC_Module_A_U013100.GetDTCOfEvent
        OpEventGetDTCOfEvent_GetDTCOfEvent_Event_Lost_Communication_With_PSC_Module_A_U013100: start-on-event=DemSatellite_0InternalBehavior/GetDTCOfEvent, operation=Event_Lost_Communication_With_PSC_Module_A_U013100.GetDTCOfEvent
        OpEventGetDTCOfEvent_GetDTCOfEvent_EvtInfo_Lost_Communication_with_Front_Camera_U026500: start-on-event=DemSatellite_0InternalBehavior/GetDTCOfEvent, operation=EvtInfo_Lost_Communication_with_Front_Camera_U026500.GetDTCOfEvent
        OpEventGetDTCOfEvent_GetDTCOfEvent_Event_Lost_Communication_with_Front_Camera_U026500: start-on-event=DemSatellite_0InternalBehavior/GetDTCOfEvent, operation=Event_Lost_Communication_with_Front_Camera_U026500.GetDTCOfEvent
        OpEventGetDTCOfEvent_GetDTCOfEvent_EvtInfo_PTS_Sensor_3_Performance_or_Incorrect_Operation_B129092: start-on-event=DemSatellite_0InternalBehavior/GetDTCOfEvent, operation=EvtInfo_PTS_Sensor_3_Performance_or_Incorrect_Operation_B129092.GetDTCOfEvent
        OpEventGetDTCOfEvent_GetDTCOfEvent_Event_PTS_Sensor_3_Performance_or_Incorrect_Operation_B129092: start-on-event=DemSatellite_0InternalBehavior/GetDTCOfEvent, operation=Event_PTS_Sensor_3_Performance_or_Incorrect_Operation_B129092.GetDTCOfEvent
        OpEventGetDTCOfEvent_GetDTCOfEvent_EvtInfo_PTS_Sensor_8_Performance_or_Incorrect_Operation_B129592: start-on-event=DemSatellite_0InternalBehavior/GetDTCOfEvent, operation=EvtInfo_PTS_Sensor_8_Performance_or_Incorrect_Operation_B129592.GetDTCOfEvent
        OpEventGetDTCOfEvent_GetDTCOfEvent_Event_PTS_Sensor_8_Performance_or_Incorrect_Operation_B129592: start-on-event=DemSatellite_0InternalBehavior/GetDTCOfEvent, operation=Event_PTS_Sensor_8_Performance_or_Incorrect_Operation_B129592.GetDTCOfEvent
        OpEventGetDTCOfEvent_GetDTCOfEvent_EvtInfo_PPP_Assist_Switch_Stuck_B12B22A: start-on-event=DemSatellite_0InternalBehavior/GetDTCOfEvent, operation=EvtInfo_PPP_Assist_Switch_Stuck_B12B22A.GetDTCOfEvent
        OpEventGetDTCOfEvent_GetDTCOfEvent_Event_PPP_Assist_Switch_Stuck_B12B22A: start-on-event=DemSatellite_0InternalBehavior/GetDTCOfEvent, operation=Event_PPP_Assist_Switch_Stuck_B12B22A.GetDTCOfEvent
        OpEventGetDTCOfEvent_GetDTCOfEvent_EvtInfo_Implausible_data_received_from_ECM_U040100: start-on-event=DemSatellite_0InternalBehavior/GetDTCOfEvent, operation=EvtInfo_Implausible_data_received_from_ECM_U040100.GetDTCOfEvent
        OpEventGetDTCOfEvent_GetDTCOfEvent_Event_Implausible_data_received_from_ECM_U040100: start-on-event=DemSatellite_0InternalBehavior/GetDTCOfEvent, operation=Event_Implausible_data_received_from_ECM_U040100.GetDTCOfEvent
        OpEventGetDTCOfEvent_GetDTCOfEvent_EvtInfo_PTS_Sensor_10_Circuit_Open_B129713: start-on-event=DemSatellite_0InternalBehavior/GetDTCOfEvent, operation=EvtInfo_PTS_Sensor_10_Circuit_Open_B129713.GetDTCOfEvent
        OpEventGetDTCOfEvent_GetDTCOfEvent_Event_PTS_Sensor_10_Circuit_Open_B129713: start-on-event=DemSatellite_0InternalBehavior/GetDTCOfEvent, operation=Event_PTS_Sensor_10_Circuit_Open_B129713.GetDTCOfEvent
        OpEventGetDTCOfEvent_GetDTCOfEvent_EvtInfo_Lost_Communication_With_BSC_module_1_U012900: start-on-event=DemSatellite_0InternalBehavior/GetDTCOfEvent, operation=EvtInfo_Lost_Communication_With_BSC_module_1_U012900.GetDTCOfEvent
        OpEventGetDTCOfEvent_GetDTCOfEvent_Event_Lost_Communication_With_BSC_module_1_U012900: start-on-event=DemSatellite_0InternalBehavior/GetDTCOfEvent, operation=Event_Lost_Communication_With_BSC_module_1_U012900.GetDTCOfEvent
        OpEventGetDTCOfEvent_GetDTCOfEvent_EvtInfo_PTS_Sensor_7_Performance_or_Incorrect_Operation_B129492: start-on-event=DemSatellite_0InternalBehavior/GetDTCOfEvent, operation=EvtInfo_PTS_Sensor_7_Performance_or_Incorrect_Operation_B129492.GetDTCOfEvent
        OpEventGetDTCOfEvent_GetDTCOfEvent_Event_PTS_Sensor_7_Performance_or_Incorrect_Operation_B129492: start-on-event=DemSatellite_0InternalBehavior/GetDTCOfEvent, operation=Event_PTS_Sensor_7_Performance_or_Incorrect_Operation_B129492.GetDTCOfEvent
        OpEventGetDTCOfEvent_GetDTCOfEvent_EvtInfo_Left_Camera_Performance_or_Incorrect_Operation_B23C692: start-on-event=DemSatellite_0InternalBehavior/GetDTCOfEvent, operation=EvtInfo_Left_Camera_Performance_or_Incorrect_Operation_B23C692.GetDTCOfEvent
        OpEventGetDTCOfEvent_GetDTCOfEvent_Event_Left_Camera_Performance_or_Incorrect_Operation_B23C692: start-on-event=DemSatellite_0InternalBehavior/GetDTCOfEvent, operation=Event_Left_Camera_Performance_or_Incorrect_Operation_B23C692.GetDTCOfEvent
        OpEventGetDTCOfEvent_GetDTCOfEvent_EvtInfo_Vehicle_Configuration_Mismatch_B223B00: start-on-event=DemSatellite_0InternalBehavior/GetDTCOfEvent, operation=EvtInfo_Vehicle_Configuration_Mismatch_B223B00.GetDTCOfEvent
        OpEventGetDTCOfEvent_GetDTCOfEvent_Event_Vehicle_Configuration_Mismatch_B223B00: start-on-event=DemSatellite_0InternalBehavior/GetDTCOfEvent, operation=Event_Vehicle_Configuration_Mismatch_B223B00.GetDTCOfEvent
        OpEventGetDTCOfEvent_GetDTCOfEvent_EvtInfo_PTS_Sensor_6_Circuit_Open_B129313: start-on-event=DemSatellite_0InternalBehavior/GetDTCOfEvent, operation=EvtInfo_PTS_Sensor_6_Circuit_Open_B129313.GetDTCOfEvent
        OpEventGetDTCOfEvent_GetDTCOfEvent_Event_PTS_Sensor_6_Circuit_Open_B129313: start-on-event=DemSatellite_0InternalBehavior/GetDTCOfEvent, operation=Event_PTS_Sensor_6_Circuit_Open_B129313.GetDTCOfEvent
        OpEventGetDTCOfEvent_GetDTCOfEvent_EvtInfo_Front_Camera_Circuit_Voltage_Out_of_Range_B23C51C: start-on-event=DemSatellite_0InternalBehavior/GetDTCOfEvent, operation=EvtInfo_Front_Camera_Circuit_Voltage_Out_of_Range_B23C51C.GetDTCOfEvent
        OpEventGetDTCOfEvent_GetDTCOfEvent_Event_Front_Camera_Circuit_Voltage_Out_of_Range_B23C51C: start-on-event=DemSatellite_0InternalBehavior/GetDTCOfEvent, operation=Event_Front_Camera_Circuit_Voltage_Out_of_Range_B23C51C.GetDTCOfEvent
        OpEventGetDTCOfEvent_GetDTCOfEvent_EvtInfo_Implausible_Data_From_BSC_Module_1_U041800: start-on-event=DemSatellite_0InternalBehavior/GetDTCOfEvent, operation=EvtInfo_Implausible_Data_From_BSC_Module_1_U041800.GetDTCOfEvent
        OpEventGetDTCOfEvent_GetDTCOfEvent_Event_Implausible_Data_From_BSC_Module_1_U041800: start-on-event=DemSatellite_0InternalBehavior/GetDTCOfEvent, operation=Event_Implausible_Data_From_BSC_Module_1_U041800.GetDTCOfEvent
        OpEventGetDTCOfEvent_GetDTCOfEvent_EvtInfo_PTS_Sensor_10_Performance_or_Incorrect_Operation_B129792: start-on-event=DemSatellite_0InternalBehavior/GetDTCOfEvent, operation=EvtInfo_PTS_Sensor_10_Performance_or_Incorrect_Operation_B129792.GetDTCOfEvent
        OpEventGetDTCOfEvent_GetDTCOfEvent_Event_PTS_Sensor_10_Performance_or_Incorrect_Operation_B129792: start-on-event=DemSatellite_0InternalBehavior/GetDTCOfEvent, operation=Event_PTS_Sensor_10_Performance_or_Incorrect_Operation_B129792.GetDTCOfEvent
        OpEventGetDTCOfEvent_GetDTCOfEvent_EvtInfo_PTS_Sensor_11_Circuit_Open_B129813: start-on-event=DemSatellite_0InternalBehavior/GetDTCOfEvent, operation=EvtInfo_PTS_Sensor_11_Circuit_Open_B129813.GetDTCOfEvent
        OpEventGetDTCOfEvent_GetDTCOfEvent_Event_PTS_Sensor_11_Circuit_Open_B129813: start-on-event=DemSatellite_0InternalBehavior/GetDTCOfEvent, operation=Event_PTS_Sensor_11_Circuit_Open_B129813.GetDTCOfEvent
        OpEventGetDTCOfEvent_GetDTCOfEvent_EvtInfo_ECU_Internal_Performance_B22A900: start-on-event=DemSatellite_0InternalBehavior/GetDTCOfEvent, operation=EvtInfo_ECU_Internal_Performance_B22A900.GetDTCOfEvent
        OpEventGetDTCOfEvent_GetDTCOfEvent_Event_ECU_Internal_Performance_B22A900: start-on-event=DemSatellite_0InternalBehavior/GetDTCOfEvent, operation=Event_ECU_Internal_Performance_B22A900.GetDTCOfEvent
        OpEventGetDTCOfEvent_GetDTCOfEvent_EvtInfo_PTS_Sensor_9_Performance_or_Incorrect_Operation_B129692: start-on-event=DemSatellite_0InternalBehavior/GetDTCOfEvent, operation=EvtInfo_PTS_Sensor_9_Performance_or_Incorrect_Operation_B129692.GetDTCOfEvent
        OpEventGetDTCOfEvent_GetDTCOfEvent_Event_PTS_Sensor_9_Performance_or_Incorrect_Operation_B129692: start-on-event=DemSatellite_0InternalBehavior/GetDTCOfEvent, operation=Event_PTS_Sensor_9_Performance_or_Incorrect_Operation_B129692.GetDTCOfEvent
        OpEventGetDTCOfEvent_GetDTCOfEvent_EvtInfo_Calibration_Not_Learned_Lost_Calibration_B228600: start-on-event=DemSatellite_0InternalBehavior/GetDTCOfEvent, operation=EvtInfo_Calibration_Not_Learned_Lost_Calibration_B228600.GetDTCOfEvent
        OpEventGetDTCOfEvent_GetDTCOfEvent_Event_Calibration_Not_Learned_Lost_Calibration_B228600: start-on-event=DemSatellite_0InternalBehavior/GetDTCOfEvent, operation=Event_Calibration_Not_Learned_Lost_Calibration_B228600.GetDTCOfEvent
        OpEventGetDTCOfEvent_GetDTCOfEvent_EvtInfo_Lost_Communication_with_ORC_U015100: start-on-event=DemSatellite_0InternalBehavior/GetDTCOfEvent, operation=EvtInfo_Lost_Communication_with_ORC_U015100.GetDTCOfEvent
        OpEventGetDTCOfEvent_GetDTCOfEvent_Event_Lost_Communication_with_ORC_U015100: start-on-event=DemSatellite_0InternalBehavior/GetDTCOfEvent, operation=Event_Lost_Communication_with_ORC_U015100.GetDTCOfEvent
        OpEventGetDTCOfEvent_GetDTCOfEvent_EvtInfo_PTS_Sensor_1_Circuit_Open_B128E13: start-on-event=DemSatellite_0InternalBehavior/GetDTCOfEvent, operation=EvtInfo_PTS_Sensor_1_Circuit_Open_B128E13.GetDTCOfEvent
        OpEventGetDTCOfEvent_GetDTCOfEvent_Event_PTS_Sensor_1_Circuit_Open_B128E13: start-on-event=DemSatellite_0InternalBehavior/GetDTCOfEvent, operation=Event_PTS_Sensor_1_Circuit_Open_B128E13.GetDTCOfEvent
        OpEventGetDTCOfEvent_GetDTCOfEvent_EvtInfo_Lost_Communication_with_Rear_Camera_U026400: start-on-event=DemSatellite_0InternalBehavior/GetDTCOfEvent, operation=EvtInfo_Lost_Communication_with_Rear_Camera_U026400.GetDTCOfEvent
        OpEventGetDTCOfEvent_GetDTCOfEvent_Event_Lost_Communication_with_Rear_Camera_U026400: start-on-event=DemSatellite_0InternalBehavior/GetDTCOfEvent, operation=Event_Lost_Communication_with_Rear_Camera_U026400.GetDTCOfEvent
        OpEventGetDTCOfEvent_GetDTCOfEvent_EvtInfo_HS_FD_CANR_Comm_Bus_Performance_U100B00: start-on-event=DemSatellite_0InternalBehavior/GetDTCOfEvent, operation=EvtInfo_HS_FD_CANR_Comm_Bus_Performance_U100B00.GetDTCOfEvent
        OpEventGetDTCOfEvent_GetDTCOfEvent_Event_HS_FD_CANR_Comm_Bus_Performance_U100B00: start-on-event=DemSatellite_0InternalBehavior/GetDTCOfEvent, operation=Event_HS_FD_CANR_Comm_Bus_Performance_U100B00.GetDTCOfEvent
        OpEventGetDTCOfEvent_GetDTCOfEvent_EvtInfo_Implausible_Data_Received_From_Body_Control_Module_U042200: start-on-event=DemSatellite_0InternalBehavior/GetDTCOfEvent, operation=EvtInfo_Implausible_Data_Received_From_Body_Control_Module_U042200.GetDTCOfEvent
        OpEventGetDTCOfEvent_GetDTCOfEvent_Event_Implausible_Data_Received_From_Body_Control_Module_U042200: start-on-event=DemSatellite_0InternalBehavior/GetDTCOfEvent, operation=Event_Implausible_Data_Received_From_Body_Control_Module_U042200.GetDTCOfEvent
        OpEventGetDTCOfEvent_GetDTCOfEvent_EvtInfo_Lost_Communication_With_BCM_U014000: start-on-event=DemSatellite_0InternalBehavior/GetDTCOfEvent, operation=EvtInfo_Lost_Communication_With_BCM_U014000.GetDTCOfEvent
        OpEventGetDTCOfEvent_GetDTCOfEvent_Event_Lost_Communication_With_BCM_U014000: start-on-event=DemSatellite_0InternalBehavior/GetDTCOfEvent, operation=Event_Lost_Communication_With_BCM_U014000.GetDTCOfEvent
        OpEventGetDTCOfEvent_GetDTCOfEvent_EvtInfo_PTS_Sensor_2_Circuit_Open_B128F13: start-on-event=DemSatellite_0InternalBehavior/GetDTCOfEvent, operation=EvtInfo_PTS_Sensor_2_Circuit_Open_B128F13.GetDTCOfEvent
        OpEventGetDTCOfEvent_GetDTCOfEvent_Event_PTS_Sensor_2_Circuit_Open_B128F13: start-on-event=DemSatellite_0InternalBehavior/GetDTCOfEvent, operation=Event_PTS_Sensor_2_Circuit_Open_B128F13.GetDTCOfEvent
        OpEventGetDTCOfEvent_GetDTCOfEvent_EvtInfo_PTS_Sensor_3_Circuit_Open_B129013: start-on-event=DemSatellite_0InternalBehavior/GetDTCOfEvent, operation=EvtInfo_PTS_Sensor_3_Circuit_Open_B129013.GetDTCOfEvent
        OpEventGetDTCOfEvent_GetDTCOfEvent_Event_PTS_Sensor_3_Circuit_Open_B129013: start-on-event=DemSatellite_0InternalBehavior/GetDTCOfEvent, operation=Event_PTS_Sensor_3_Circuit_Open_B129013.GetDTCOfEvent
        OpEventGetDTCOfEvent_GetDTCOfEvent_EvtInfo_ECU_In_Plant_Mode_C221200: start-on-event=DemSatellite_0InternalBehavior/GetDTCOfEvent, operation=EvtInfo_ECU_In_Plant_Mode_C221200.GetDTCOfEvent
        OpEventGetDTCOfEvent_GetDTCOfEvent_Event_ECU_In_Plant_Mode_C221200: start-on-event=DemSatellite_0InternalBehavior/GetDTCOfEvent, operation=Event_ECU_In_Plant_Mode_C221200.GetDTCOfEvent
        OpEventGetDTCOfEvent_GetDTCOfEvent_EvtInfo_Implausible_Data_from_ORC_module_U045500: start-on-event=DemSatellite_0InternalBehavior/GetDTCOfEvent, operation=EvtInfo_Implausible_Data_from_ORC_module_U045500.GetDTCOfEvent
        OpEventGetDTCOfEvent_GetDTCOfEvent_Event_Implausible_Data_from_ORC_module_U045500: start-on-event=DemSatellite_0InternalBehavior/GetDTCOfEvent, operation=Event_Implausible_Data_from_ORC_module_U045500.GetDTCOfEvent
        OpEventGetDTCOfEvent_GetDTCOfEvent_EvtInfo_Right_Camera_Performance_or_Incorrect_Operation_B23C792: start-on-event=DemSatellite_0InternalBehavior/GetDTCOfEvent, operation=EvtInfo_Right_Camera_Performance_or_Incorrect_Operation_B23C792.GetDTCOfEvent
        OpEventGetDTCOfEvent_GetDTCOfEvent_Event_Right_Camera_Performance_or_Incorrect_Operation_B23C792: start-on-event=DemSatellite_0InternalBehavior/GetDTCOfEvent, operation=Event_Right_Camera_Performance_or_Incorrect_Operation_B23C792.GetDTCOfEvent
        OpEventGetDTCOfEvent_GetDTCOfEvent_EvtInfo_Rear_Sensors_PS_VltgeAboveThreshold_B212B17: start-on-event=DemSatellite_0InternalBehavior/GetDTCOfEvent, operation=EvtInfo_Rear_Sensors_PS_VltgeAboveThreshold_B212B17.GetDTCOfEvent
        OpEventGetDTCOfEvent_GetDTCOfEvent_Event_Rear_Sensors_PS_VltgeAboveThreshold_B212B17: start-on-event=DemSatellite_0InternalBehavior/GetDTCOfEvent, operation=Event_Rear_Sensors_PS_VltgeAboveThreshold_B212B17.GetDTCOfEvent
        OpEventGetDTCOfEvent_GetDTCOfEvent_EvtInfo_PTS_Sensor_6_Performance_or_Incorrect_Operation_B129392: start-on-event=DemSatellite_0InternalBehavior/GetDTCOfEvent, operation=EvtInfo_PTS_Sensor_6_Performance_or_Incorrect_Operation_B129392.GetDTCOfEvent
        OpEventGetDTCOfEvent_GetDTCOfEvent_Event_PTS_Sensor_6_Performance_or_Incorrect_Operation_B129392: start-on-event=DemSatellite_0InternalBehavior/GetDTCOfEvent, operation=Event_PTS_Sensor_6_Performance_or_Incorrect_Operation_B129392.GetDTCOfEvent
        OpEventGetDTCOfEvent_GetDTCOfEvent_GeneralEvtInfo: start-on-event=DemSatellite_0InternalBehavior/GetDTCOfEvent, operation=GeneralEvtInfo.GetDTCOfEvent
        OpEventGetFaultDetectionCounter_GetFaultDetectionCounter_EvtInfo_Dem_SystemInternalFailure: start-on-event=DemSatellite_0InternalBehavior/GetFaultDetectionCounter, operation=EvtInfo_Dem_SystemInternalFailure.GetFaultDetectionCounter
        OpEventGetFaultDetectionCounter_GetFaultDetectionCounter_Event_Dem_SystemInternalFailure: start-on-event=DemSatellite_0InternalBehavior/GetFaultDetectionCounter, operation=Event_Dem_SystemInternalFailure.GetFaultDetectionCounter
        OpEventGetFaultDetectionCounter_GetFaultDetectionCounter_EvtInfo_Invalid_Data_Received_From_Power_Steering_Control_Modu_281ede3f: start-on-event=DemSatellite_0InternalBehavior/GetFaultDetectionCounter, operation=EvtInfo_Invalid_Data_Received_From_Power_Steering_Control_Module_U042000.GetFaultDetectionCounter
        OpEventGetFaultDetectionCounter_GetFaultDetectionCounter_Event_Invalid_Data_Received_From_Power_Steering_Control_Module_U042000: start-on-event=DemSatellite_0InternalBehavior/GetFaultDetectionCounter, operation=Event_Invalid_Data_Received_From_Power_Steering_Control_Module_U042000.GetFaultDetectionCounter
        OpEventGetFaultDetectionCounter_GetFaultDetectionCounter_EvtInfo_Lost_Communication_with_Left_Camera_U026600: start-on-event=DemSatellite_0InternalBehavior/GetFaultDetectionCounter, operation=EvtInfo_Lost_Communication_with_Left_Camera_U026600.GetFaultDetectionCounter
        OpEventGetFaultDetectionCounter_GetFaultDetectionCounter_Event_Lost_Communication_with_Left_Camera_U026600: start-on-event=DemSatellite_0InternalBehavior/GetFaultDetectionCounter, operation=Event_Lost_Communication_with_Left_Camera_U026600.GetFaultDetectionCounter
        OpEventGetFaultDetectionCounter_GetFaultDetectionCounter_EvtInfo_Front_Sensors_PS_VltgeBelowThreshold_B212A16: start-on-event=DemSatellite_0InternalBehavior/GetFaultDetectionCounter, operation=EvtInfo_Front_Sensors_PS_VltgeBelowThreshold_B212A16.GetFaultDetectionCounter
        OpEventGetFaultDetectionCounter_GetFaultDetectionCounter_Event_Front_Sensors_PS_VltgeBelowThreshold_B212A16: start-on-event=DemSatellite_0InternalBehavior/GetFaultDetectionCounter, operation=Event_Front_Sensors_PS_VltgeBelowThreshold_B212A16.GetFaultDetectionCounter
        OpEventGetFaultDetectionCounter_GetFaultDetectionCounter_EvtInfo_Left_Camera_Circuit_Voltage_Out_of_Range_B23C61C: start-on-event=DemSatellite_0InternalBehavior/GetFaultDetectionCounter, operation=EvtInfo_Left_Camera_Circuit_Voltage_Out_of_Range_B23C61C.GetFaultDetectionCounter
        OpEventGetFaultDetectionCounter_GetFaultDetectionCounter_Event_Left_Camera_Circuit_Voltage_Out_of_Range_B23C61C: start-on-event=DemSatellite_0InternalBehavior/GetFaultDetectionCounter, operation=Event_Left_Camera_Circuit_Voltage_Out_of_Range_B23C61C.GetFaultDetectionCounter
        OpEventGetFaultDetectionCounter_GetFaultDetectionCounter_EvtInfo_Rear_Sensors_PS_VltgeBelowThreshold_B212B16: start-on-event=DemSatellite_0InternalBehavior/GetFaultDetectionCounter, operation=EvtInfo_Rear_Sensors_PS_VltgeBelowThreshold_B212B16.GetFaultDetectionCounter
        OpEventGetFaultDetectionCounter_GetFaultDetectionCounter_Event_Rear_Sensors_PS_VltgeBelowThreshold_B212B16: start-on-event=DemSatellite_0InternalBehavior/GetFaultDetectionCounter, operation=Event_Rear_Sensors_PS_VltgeBelowThreshold_B212B16.GetFaultDetectionCounter
        OpEventGetFaultDetectionCounter_GetFaultDetectionCounter_EvtInfo_Rear_Sensors_PS_Bus_Sig_Msg_Failures_B212B08: start-on-event=DemSatellite_0InternalBehavior/GetFaultDetectionCounter, operation=EvtInfo_Rear_Sensors_PS_Bus_Sig_Msg_Failures_B212B08.GetFaultDetectionCounter
        OpEventGetFaultDetectionCounter_GetFaultDetectionCounter_Event_Rear_Sensors_PS_Bus_Sig_Msg_Failures_B212B08: start-on-event=DemSatellite_0InternalBehavior/GetFaultDetectionCounter, operation=Event_Rear_Sensors_PS_Bus_Sig_Msg_Failures_B212B08.GetFaultDetectionCounter
        OpEventGetFaultDetectionCounter_GetFaultDetectionCounter_EvtInfo_Rear_Camera_Circuit_Voltage_Out_of_Range_B217A1C: start-on-event=DemSatellite_0InternalBehavior/GetFaultDetectionCounter, operation=EvtInfo_Rear_Camera_Circuit_Voltage_Out_of_Range_B217A1C.GetFaultDetectionCounter
        OpEventGetFaultDetectionCounter_GetFaultDetectionCounter_Event_Rear_Camera_Circuit_Voltage_Out_of_Range_B217A1C: start-on-event=DemSatellite_0InternalBehavior/GetFaultDetectionCounter, operation=Event_Rear_Camera_Circuit_Voltage_Out_of_Range_B217A1C.GetFaultDetectionCounter
        OpEventGetFaultDetectionCounter_GetFaultDetectionCounter_EvtInfo_PTS_Sensor_12_Performance_or_Incorrect_Operation_B129992: start-on-event=DemSatellite_0InternalBehavior/GetFaultDetectionCounter, operation=EvtInfo_PTS_Sensor_12_Performance_or_Incorrect_Operation_B129992.GetFaultDetectionCounter
        OpEventGetFaultDetectionCounter_GetFaultDetectionCounter_Event_PTS_Sensor_12_Performance_or_Incorrect_Operation_B129992: start-on-event=DemSatellite_0InternalBehavior/GetFaultDetectionCounter, operation=Event_PTS_Sensor_12_Performance_or_Incorrect_Operation_B129992.GetFaultDetectionCounter
        OpEventGetFaultDetectionCounter_GetFaultDetectionCounter_EvtInfo_Battery_Voltage_Over_Voltage_B210C17: start-on-event=DemSatellite_0InternalBehavior/GetFaultDetectionCounter, operation=EvtInfo_Battery_Voltage_Over_Voltage_B210C17.GetFaultDetectionCounter
        OpEventGetFaultDetectionCounter_GetFaultDetectionCounter_Event_Battery_Voltage_Over_Voltage_B210C17: start-on-event=DemSatellite_0InternalBehavior/GetFaultDetectionCounter, operation=Event_Battery_Voltage_Over_Voltage_B210C17.GetFaultDetectionCounter
        OpEventGetFaultDetectionCounter_GetFaultDetectionCounter_EvtInfo_Front_Sensors_PS_VltgeAboveThreshold_B212A17: start-on-event=DemSatellite_0InternalBehavior/GetFaultDetectionCounter, operation=EvtInfo_Front_Sensors_PS_VltgeAboveThreshold_B212A17.GetFaultDetectionCounter
        OpEventGetFaultDetectionCounter_GetFaultDetectionCounter_Event_Front_Sensors_PS_VltgeAboveThreshold_B212A17: start-on-event=DemSatellite_0InternalBehavior/GetFaultDetectionCounter, operation=Event_Front_Sensors_PS_VltgeAboveThreshold_B212A17.GetFaultDetectionCounter
        OpEventGetFaultDetectionCounter_GetFaultDetectionCounter_EvtInfo_PTS_Sensor_4_Circuit_Open_B129113: start-on-event=DemSatellite_0InternalBehavior/GetFaultDetectionCounter, operation=EvtInfo_PTS_Sensor_4_Circuit_Open_B129113.GetFaultDetectionCounter
        OpEventGetFaultDetectionCounter_GetFaultDetectionCounter_Event_PTS_Sensor_4_Circuit_Open_B129113: start-on-event=DemSatellite_0InternalBehavior/GetFaultDetectionCounter, operation=Event_PTS_Sensor_4_Circuit_Open_B129113.GetFaultDetectionCounter
        OpEventGetFaultDetectionCounter_GetFaultDetectionCounter_EvtInfo_PTS_Sensor_12_Circuit_Open_B129913: start-on-event=DemSatellite_0InternalBehavior/GetFaultDetectionCounter, operation=EvtInfo_PTS_Sensor_12_Circuit_Open_B129913.GetFaultDetectionCounter
        OpEventGetFaultDetectionCounter_GetFaultDetectionCounter_Event_PTS_Sensor_12_Circuit_Open_B129913: start-on-event=DemSatellite_0InternalBehavior/GetFaultDetectionCounter, operation=Event_PTS_Sensor_12_Circuit_Open_B129913.GetFaultDetectionCounter
        OpEventGetFaultDetectionCounter_GetFaultDetectionCounter_EvtInfo_PTS_Sensor_11_Performance_or_Incorrect_Operation_B129892: start-on-event=DemSatellite_0InternalBehavior/GetFaultDetectionCounter, operation=EvtInfo_PTS_Sensor_11_Performance_or_Incorrect_Operation_B129892.GetFaultDetectionCounter
        OpEventGetFaultDetectionCounter_GetFaultDetectionCounter_Event_PTS_Sensor_11_Performance_or_Incorrect_Operation_B129892: start-on-event=DemSatellite_0InternalBehavior/GetFaultDetectionCounter, operation=Event_PTS_Sensor_11_Performance_or_Incorrect_Operation_B129892.GetFaultDetectionCounter
        OpEventGetFaultDetectionCounter_GetFaultDetectionCounter_EvtInfo_Lost_Communication_With_Radio_U018400: start-on-event=DemSatellite_0InternalBehavior/GetFaultDetectionCounter, operation=EvtInfo_Lost_Communication_With_Radio_U018400.GetFaultDetectionCounter
        OpEventGetFaultDetectionCounter_GetFaultDetectionCounter_Event_Lost_Communication_With_Radio_U018400: start-on-event=DemSatellite_0InternalBehavior/GetFaultDetectionCounter, operation=Event_Lost_Communication_With_Radio_U018400.GetFaultDetectionCounter
        OpEventGetFaultDetectionCounter_GetFaultDetectionCounter_EvtInfo_Park_Assist_PTS_Switch_Stuck_B12852A: start-on-event=DemSatellite_0InternalBehavior/GetFaultDetectionCounter, operation=EvtInfo_Park_Assist_PTS_Switch_Stuck_B12852A.GetFaultDetectionCounter
        OpEventGetFaultDetectionCounter_GetFaultDetectionCounter_Event_Park_Assist_PTS_Switch_Stuck_B12852A: start-on-event=DemSatellite_0InternalBehavior/GetFaultDetectionCounter, operation=Event_Park_Assist_PTS_Switch_Stuck_B12852A.GetFaultDetectionCounter
        OpEventGetFaultDetectionCounter_GetFaultDetectionCounter_EvtInfo_PTS_Sensor_5_Circuit_Open_B129213: start-on-event=DemSatellite_0InternalBehavior/GetFaultDetectionCounter, operation=EvtInfo_PTS_Sensor_5_Circuit_Open_B129213.GetFaultDetectionCounter
        OpEventGetFaultDetectionCounter_GetFaultDetectionCounter_Event_PTS_Sensor_5_Circuit_Open_B129213: start-on-event=DemSatellite_0InternalBehavior/GetFaultDetectionCounter, operation=Event_PTS_Sensor_5_Circuit_Open_B129213.GetFaultDetectionCounter
        OpEventGetFaultDetectionCounter_GetFaultDetectionCounter_EvtInfo_PTS_Sensor_5_Performance_or_Incorrect_Operation_B129292: start-on-event=DemSatellite_0InternalBehavior/GetFaultDetectionCounter, operation=EvtInfo_PTS_Sensor_5_Performance_or_Incorrect_Operation_B129292.GetFaultDetectionCounter
        OpEventGetFaultDetectionCounter_GetFaultDetectionCounter_Event_PTS_Sensor_5_Performance_or_Incorrect_Operation_B129292: start-on-event=DemSatellite_0InternalBehavior/GetFaultDetectionCounter, operation=Event_PTS_Sensor_5_Performance_or_Incorrect_Operation_B129292.GetFaultDetectionCounter
        OpEventGetFaultDetectionCounter_GetFaultDetectionCounter_EvtInfo_Battery_Voltage_Under_Voltage_B210C16: start-on-event=DemSatellite_0InternalBehavior/GetFaultDetectionCounter, operation=EvtInfo_Battery_Voltage_Under_Voltage_B210C16.GetFaultDetectionCounter
        OpEventGetFaultDetectionCounter_GetFaultDetectionCounter_Event_Battery_Voltage_Under_Voltage_B210C16: start-on-event=DemSatellite_0InternalBehavior/GetFaultDetectionCounter, operation=Event_Battery_Voltage_Under_Voltage_B210C16.GetFaultDetectionCounter
        OpEventGetFaultDetectionCounter_GetFaultDetectionCounter_EvtInfo_PTS_Sensor_4_Performance_or_Incorrect_Operation_B129192: start-on-event=DemSatellite_0InternalBehavior/GetFaultDetectionCounter, operation=EvtInfo_PTS_Sensor_4_Performance_or_Incorrect_Operation_B129192.GetFaultDetectionCounter
        OpEventGetFaultDetectionCounter_GetFaultDetectionCounter_Event_PTS_Sensor_4_Performance_or_Incorrect_Operation_B129192: start-on-event=DemSatellite_0InternalBehavior/GetFaultDetectionCounter, operation=Event_PTS_Sensor_4_Performance_or_Incorrect_Operation_B129192.GetFaultDetectionCounter
        OpEventGetFaultDetectionCounter_GetFaultDetectionCounter_EvtInfo_HS_FD_CAN2_Comm_Bus_Performance_U104E00: start-on-event=DemSatellite_0InternalBehavior/GetFaultDetectionCounter, operation=EvtInfo_HS_FD_CAN2_Comm_Bus_Performance_U104E00.GetFaultDetectionCounter
        OpEventGetFaultDetectionCounter_GetFaultDetectionCounter_Event_HS_FD_CAN2_Comm_Bus_Performance_U104E00: start-on-event=DemSatellite_0InternalBehavior/GetFaultDetectionCounter, operation=Event_HS_FD_CAN2_Comm_Bus_Performance_U104E00.GetFaultDetectionCounter
        OpEventGetFaultDetectionCounter_GetFaultDetectionCounter_EvtInfo_PTS_Sensor_9_Circuit_Open_B129613: start-on-event=DemSatellite_0InternalBehavior/GetFaultDetectionCounter, operation=EvtInfo_PTS_Sensor_9_Circuit_Open_B129613.GetFaultDetectionCounter
        OpEventGetFaultDetectionCounter_GetFaultDetectionCounter_Event_PTS_Sensor_9_Circuit_Open_B129613: start-on-event=DemSatellite_0InternalBehavior/GetFaultDetectionCounter, operation=Event_PTS_Sensor_9_Circuit_Open_B129613.GetFaultDetectionCounter
        OpEventGetFaultDetectionCounter_GetFaultDetectionCounter_EvtInfo_Loss_of_Comm_With_Engine_Control_Module_U010000: start-on-event=DemSatellite_0InternalBehavior/GetFaultDetectionCounter, operation=EvtInfo_Loss_of_Comm_With_Engine_Control_Module_U010000.GetFaultDetectionCounter
        OpEventGetFaultDetectionCounter_GetFaultDetectionCounter_Event_Loss_of_Comm_With_Engine_Control_Module_U010000: start-on-event=DemSatellite_0InternalBehavior/GetFaultDetectionCounter, operation=Event_Loss_of_Comm_With_Engine_Control_Module_U010000.GetFaultDetectionCounter
        OpEventGetFaultDetectionCounter_GetFaultDetectionCounter_EvtInfo_Lost_Communication_with_Right_Camera_U026700: start-on-event=DemSatellite_0InternalBehavior/GetFaultDetectionCounter, operation=EvtInfo_Lost_Communication_with_Right_Camera_U026700.GetFaultDetectionCounter
        OpEventGetFaultDetectionCounter_GetFaultDetectionCounter_Event_Lost_Communication_with_Right_Camera_U026700: start-on-event=DemSatellite_0InternalBehavior/GetFaultDetectionCounter, operation=Event_Lost_Communication_with_Right_Camera_U026700.GetFaultDetectionCounter
        OpEventGetFaultDetectionCounter_GetFaultDetectionCounter_EvtInfo_PTS_Sensor_1_Performance_or_Incorrect_Operation_B128E92: start-on-event=DemSatellite_0InternalBehavior/GetFaultDetectionCounter, operation=EvtInfo_PTS_Sensor_1_Performance_or_Incorrect_Operation_B128E92.GetFaultDetectionCounter
        OpEventGetFaultDetectionCounter_GetFaultDetectionCounter_Event_PTS_Sensor_1_Performance_or_Incorrect_Operation_B128E92: start-on-event=DemSatellite_0InternalBehavior/GetFaultDetectionCounter, operation=Event_PTS_Sensor_1_Performance_or_Incorrect_Operation_B128E92.GetFaultDetectionCounter
        OpEventGetFaultDetectionCounter_GetFaultDetectionCounter_EvtInfo_Rear_Camera_Performance_or_Incorrect_Operation_B217A92: start-on-event=DemSatellite_0InternalBehavior/GetFaultDetectionCounter, operation=EvtInfo_Rear_Camera_Performance_or_Incorrect_Operation_B217A92.GetFaultDetectionCounter
        OpEventGetFaultDetectionCounter_GetFaultDetectionCounter_Event_Rear_Camera_Performance_or_Incorrect_Operation_B217A92: start-on-event=DemSatellite_0InternalBehavior/GetFaultDetectionCounter, operation=Event_Rear_Camera_Performance_or_Incorrect_Operation_B217A92.GetFaultDetectionCounter
        OpEventGetFaultDetectionCounter_GetFaultDetectionCounter_EvtInfo_PTS_Sensor_2_Performance_or_Incorrect_Operation_B128F92: start-on-event=DemSatellite_0InternalBehavior/GetFaultDetectionCounter, operation=EvtInfo_PTS_Sensor_2_Performance_or_Incorrect_Operation_B128F92.GetFaultDetectionCounter
        OpEventGetFaultDetectionCounter_GetFaultDetectionCounter_Event_PTS_Sensor_2_Performance_or_Incorrect_Operation_B128F92: start-on-event=DemSatellite_0InternalBehavior/GetFaultDetectionCounter, operation=Event_PTS_Sensor_2_Performance_or_Incorrect_Operation_B128F92.GetFaultDetectionCounter
        OpEventGetFaultDetectionCounter_GetFaultDetectionCounter_EvtInfo_Right_Camera_Circuit_Voltage_Out_of_Range_B23C71C: start-on-event=DemSatellite_0InternalBehavior/GetFaultDetectionCounter, operation=EvtInfo_Right_Camera_Circuit_Voltage_Out_of_Range_B23C71C.GetFaultDetectionCounter
        OpEventGetFaultDetectionCounter_GetFaultDetectionCounter_Event_Right_Camera_Circuit_Voltage_Out_of_Range_B23C71C: start-on-event=DemSatellite_0InternalBehavior/GetFaultDetectionCounter, operation=Event_Right_Camera_Circuit_Voltage_Out_of_Range_B23C71C.GetFaultDetectionCounter
        OpEventGetFaultDetectionCounter_GetFaultDetectionCounter_EvtInfo_PTS_Sensor_8_Circuit_Open_B129513: start-on-event=DemSatellite_0InternalBehavior/GetFaultDetectionCounter, operation=EvtInfo_PTS_Sensor_8_Circuit_Open_B129513.GetFaultDetectionCounter
        OpEventGetFaultDetectionCounter_GetFaultDetectionCounter_Event_PTS_Sensor_8_Circuit_Open_B129513: start-on-event=DemSatellite_0InternalBehavior/GetFaultDetectionCounter, operation=Event_PTS_Sensor_8_Circuit_Open_B129513.GetFaultDetectionCounter
        OpEventGetFaultDetectionCounter_GetFaultDetectionCounter_EvtInfo_Implausible_Data_Received_from_Radio_U048500: start-on-event=DemSatellite_0InternalBehavior/GetFaultDetectionCounter, operation=EvtInfo_Implausible_Data_Received_from_Radio_U048500.GetFaultDetectionCounter
        OpEventGetFaultDetectionCounter_GetFaultDetectionCounter_Event_Implausible_Data_Received_from_Radio_U048500: start-on-event=DemSatellite_0InternalBehavior/GetFaultDetectionCounter, operation=Event_Implausible_Data_Received_from_Radio_U048500.GetFaultDetectionCounter
        OpEventGetFaultDetectionCounter_GetFaultDetectionCounter_EvtInfo_Implausible_Data_received_from_TRSKM_module_U14A000: start-on-event=DemSatellite_0InternalBehavior/GetFaultDetectionCounter, operation=EvtInfo_Implausible_Data_received_from_TRSKM_module_U14A000.GetFaultDetectionCounter
        OpEventGetFaultDetectionCounter_GetFaultDetectionCounter_Event_Implausible_Data_received_from_TRSKM_module_U14A000: start-on-event=DemSatellite_0InternalBehavior/GetFaultDetectionCounter, operation=Event_Implausible_Data_received_from_TRSKM_module_U14A000.GetFaultDetectionCounter
        OpEventGetFaultDetectionCounter_GetFaultDetectionCounter_EvtInfo_Front_Camera_Performance_or_Incorrect_Operation_B23C592: start-on-event=DemSatellite_0InternalBehavior/GetFaultDetectionCounter, operation=EvtInfo_Front_Camera_Performance_or_Incorrect_Operation_B23C592.GetFaultDetectionCounter
        OpEventGetFaultDetectionCounter_GetFaultDetectionCounter_Event_Front_Camera_Performance_or_Incorrect_Operation_B23C592: start-on-event=DemSatellite_0InternalBehavior/GetFaultDetectionCounter, operation=Event_Front_Camera_Performance_or_Incorrect_Operation_B23C592.GetFaultDetectionCounter
        OpEventGetFaultDetectionCounter_GetFaultDetectionCounter_EvtInfo_Loss_Communication_with_TRS_Knob_Module_U12B900: start-on-event=DemSatellite_0InternalBehavior/GetFaultDetectionCounter, operation=EvtInfo_Loss_Communication_with_TRS_Knob_Module_U12B900.GetFaultDetectionCounter
        OpEventGetFaultDetectionCounter_GetFaultDetectionCounter_Event_Loss_Communication_with_TRS_Knob_Module_U12B900: start-on-event=DemSatellite_0InternalBehavior/GetFaultDetectionCounter, operation=Event_Loss_Communication_with_TRS_Knob_Module_U12B900.GetFaultDetectionCounter
        OpEventGetFaultDetectionCounter_GetFaultDetectionCounter_EvtInfo_PTS_Sensor_7_Circuit_Open_B129413: start-on-event=DemSatellite_0InternalBehavior/GetFaultDetectionCounter, operation=EvtInfo_PTS_Sensor_7_Circuit_Open_B129413.GetFaultDetectionCounter
        OpEventGetFaultDetectionCounter_GetFaultDetectionCounter_Event_PTS_Sensor_7_Circuit_Open_B129413: start-on-event=DemSatellite_0InternalBehavior/GetFaultDetectionCounter, operation=Event_PTS_Sensor_7_Circuit_Open_B129413.GetFaultDetectionCounter
        OpEventGetFaultDetectionCounter_GetFaultDetectionCounter_EvtInfo_Front_Sensors_PS_Bus_Sig_Msg_Failures_B212A08: start-on-event=DemSatellite_0InternalBehavior/GetFaultDetectionCounter, operation=EvtInfo_Front_Sensors_PS_Bus_Sig_Msg_Failures_B212A08.GetFaultDetectionCounter
        OpEventGetFaultDetectionCounter_GetFaultDetectionCounter_Event_Front_Sensors_PS_Bus_Sig_Msg_Failures_B212A08: start-on-event=DemSatellite_0InternalBehavior/GetFaultDetectionCounter, operation=Event_Front_Sensors_PS_Bus_Sig_Msg_Failures_B212A08.GetFaultDetectionCounter
        OpEventGetFaultDetectionCounter_GetFaultDetectionCounter_EvtInfo_Lost_Communication_With_PSC_Module_A_U013100: start-on-event=DemSatellite_0InternalBehavior/GetFaultDetectionCounter, operation=EvtInfo_Lost_Communication_With_PSC_Module_A_U013100.GetFaultDetectionCounter
        OpEventGetFaultDetectionCounter_GetFaultDetectionCounter_Event_Lost_Communication_With_PSC_Module_A_U013100: start-on-event=DemSatellite_0InternalBehavior/GetFaultDetectionCounter, operation=Event_Lost_Communication_With_PSC_Module_A_U013100.GetFaultDetectionCounter
        OpEventGetFaultDetectionCounter_GetFaultDetectionCounter_EvtInfo_Lost_Communication_with_Front_Camera_U026500: start-on-event=DemSatellite_0InternalBehavior/GetFaultDetectionCounter, operation=EvtInfo_Lost_Communication_with_Front_Camera_U026500.GetFaultDetectionCounter
        OpEventGetFaultDetectionCounter_GetFaultDetectionCounter_Event_Lost_Communication_with_Front_Camera_U026500: start-on-event=DemSatellite_0InternalBehavior/GetFaultDetectionCounter, operation=Event_Lost_Communication_with_Front_Camera_U026500.GetFaultDetectionCounter
        OpEventGetFaultDetectionCounter_GetFaultDetectionCounter_EvtInfo_PTS_Sensor_3_Performance_or_Incorrect_Operation_B129092: start-on-event=DemSatellite_0InternalBehavior/GetFaultDetectionCounter, operation=EvtInfo_PTS_Sensor_3_Performance_or_Incorrect_Operation_B129092.GetFaultDetectionCounter
        OpEventGetFaultDetectionCounter_GetFaultDetectionCounter_Event_PTS_Sensor_3_Performance_or_Incorrect_Operation_B129092: start-on-event=DemSatellite_0InternalBehavior/GetFaultDetectionCounter, operation=Event_PTS_Sensor_3_Performance_or_Incorrect_Operation_B129092.GetFaultDetectionCounter
        OpEventGetFaultDetectionCounter_GetFaultDetectionCounter_EvtInfo_PTS_Sensor_8_Performance_or_Incorrect_Operation_B129592: start-on-event=DemSatellite_0InternalBehavior/GetFaultDetectionCounter, operation=EvtInfo_PTS_Sensor_8_Performance_or_Incorrect_Operation_B129592.GetFaultDetectionCounter
        OpEventGetFaultDetectionCounter_GetFaultDetectionCounter_Event_PTS_Sensor_8_Performance_or_Incorrect_Operation_B129592: start-on-event=DemSatellite_0InternalBehavior/GetFaultDetectionCounter, operation=Event_PTS_Sensor_8_Performance_or_Incorrect_Operation_B129592.GetFaultDetectionCounter
        OpEventGetFaultDetectionCounter_GetFaultDetectionCounter_EvtInfo_PPP_Assist_Switch_Stuck_B12B22A: start-on-event=DemSatellite_0InternalBehavior/GetFaultDetectionCounter, operation=EvtInfo_PPP_Assist_Switch_Stuck_B12B22A.GetFaultDetectionCounter
        OpEventGetFaultDetectionCounter_GetFaultDetectionCounter_Event_PPP_Assist_Switch_Stuck_B12B22A: start-on-event=DemSatellite_0InternalBehavior/GetFaultDetectionCounter, operation=Event_PPP_Assist_Switch_Stuck_B12B22A.GetFaultDetectionCounter
        OpEventGetFaultDetectionCounter_GetFaultDetectionCounter_EvtInfo_Implausible_data_received_from_ECM_U040100: start-on-event=DemSatellite_0InternalBehavior/GetFaultDetectionCounter, operation=EvtInfo_Implausible_data_received_from_ECM_U040100.GetFaultDetectionCounter
        OpEventGetFaultDetectionCounter_GetFaultDetectionCounter_Event_Implausible_data_received_from_ECM_U040100: start-on-event=DemSatellite_0InternalBehavior/GetFaultDetectionCounter, operation=Event_Implausible_data_received_from_ECM_U040100.GetFaultDetectionCounter
        OpEventGetFaultDetectionCounter_GetFaultDetectionCounter_EvtInfo_PTS_Sensor_10_Circuit_Open_B129713: start-on-event=DemSatellite_0InternalBehavior/GetFaultDetectionCounter, operation=EvtInfo_PTS_Sensor_10_Circuit_Open_B129713.GetFaultDetectionCounter
        OpEventGetFaultDetectionCounter_GetFaultDetectionCounter_Event_PTS_Sensor_10_Circuit_Open_B129713: start-on-event=DemSatellite_0InternalBehavior/GetFaultDetectionCounter, operation=Event_PTS_Sensor_10_Circuit_Open_B129713.GetFaultDetectionCounter
        OpEventGetFaultDetectionCounter_GetFaultDetectionCounter_EvtInfo_Lost_Communication_With_BSC_module_1_U012900: start-on-event=DemSatellite_0InternalBehavior/GetFaultDetectionCounter, operation=EvtInfo_Lost_Communication_With_BSC_module_1_U012900.GetFaultDetectionCounter
        OpEventGetFaultDetectionCounter_GetFaultDetectionCounter_Event_Lost_Communication_With_BSC_module_1_U012900: start-on-event=DemSatellite_0InternalBehavior/GetFaultDetectionCounter, operation=Event_Lost_Communication_With_BSC_module_1_U012900.GetFaultDetectionCounter
        OpEventGetFaultDetectionCounter_GetFaultDetectionCounter_EvtInfo_PTS_Sensor_7_Performance_or_Incorrect_Operation_B129492: start-on-event=DemSatellite_0InternalBehavior/GetFaultDetectionCounter, operation=EvtInfo_PTS_Sensor_7_Performance_or_Incorrect_Operation_B129492.GetFaultDetectionCounter
        OpEventGetFaultDetectionCounter_GetFaultDetectionCounter_Event_PTS_Sensor_7_Performance_or_Incorrect_Operation_B129492: start-on-event=DemSatellite_0InternalBehavior/GetFaultDetectionCounter, operation=Event_PTS_Sensor_7_Performance_or_Incorrect_Operation_B129492.GetFaultDetectionCounter
        OpEventGetFaultDetectionCounter_GetFaultDetectionCounter_EvtInfo_Left_Camera_Performance_or_Incorrect_Operation_B23C692: start-on-event=DemSatellite_0InternalBehavior/GetFaultDetectionCounter, operation=EvtInfo_Left_Camera_Performance_or_Incorrect_Operation_B23C692.GetFaultDetectionCounter
        OpEventGetFaultDetectionCounter_GetFaultDetectionCounter_Event_Left_Camera_Performance_or_Incorrect_Operation_B23C692: start-on-event=DemSatellite_0InternalBehavior/GetFaultDetectionCounter, operation=Event_Left_Camera_Performance_or_Incorrect_Operation_B23C692.GetFaultDetectionCounter
        OpEventGetFaultDetectionCounter_GetFaultDetectionCounter_EvtInfo_Vehicle_Configuration_Mismatch_B223B00: start-on-event=DemSatellite_0InternalBehavior/GetFaultDetectionCounter, operation=EvtInfo_Vehicle_Configuration_Mismatch_B223B00.GetFaultDetectionCounter
        OpEventGetFaultDetectionCounter_GetFaultDetectionCounter_Event_Vehicle_Configuration_Mismatch_B223B00: start-on-event=DemSatellite_0InternalBehavior/GetFaultDetectionCounter, operation=Event_Vehicle_Configuration_Mismatch_B223B00.GetFaultDetectionCounter
        OpEventGetFaultDetectionCounter_GetFaultDetectionCounter_EvtInfo_PTS_Sensor_6_Circuit_Open_B129313: start-on-event=DemSatellite_0InternalBehavior/GetFaultDetectionCounter, operation=EvtInfo_PTS_Sensor_6_Circuit_Open_B129313.GetFaultDetectionCounter
        OpEventGetFaultDetectionCounter_GetFaultDetectionCounter_Event_PTS_Sensor_6_Circuit_Open_B129313: start-on-event=DemSatellite_0InternalBehavior/GetFaultDetectionCounter, operation=Event_PTS_Sensor_6_Circuit_Open_B129313.GetFaultDetectionCounter
        OpEventGetFaultDetectionCounter_GetFaultDetectionCounter_EvtInfo_Front_Camera_Circuit_Voltage_Out_of_Range_B23C51C: start-on-event=DemSatellite_0InternalBehavior/GetFaultDetectionCounter, operation=EvtInfo_Front_Camera_Circuit_Voltage_Out_of_Range_B23C51C.GetFaultDetectionCounter
        OpEventGetFaultDetectionCounter_GetFaultDetectionCounter_Event_Front_Camera_Circuit_Voltage_Out_of_Range_B23C51C: start-on-event=DemSatellite_0InternalBehavior/GetFaultDetectionCounter, operation=Event_Front_Camera_Circuit_Voltage_Out_of_Range_B23C51C.GetFaultDetectionCounter
        OpEventGetFaultDetectionCounter_GetFaultDetectionCounter_EvtInfo_Implausible_Data_From_BSC_Module_1_U041800: start-on-event=DemSatellite_0InternalBehavior/GetFaultDetectionCounter, operation=EvtInfo_Implausible_Data_From_BSC_Module_1_U041800.GetFaultDetectionCounter
        OpEventGetFaultDetectionCounter_GetFaultDetectionCounter_Event_Implausible_Data_From_BSC_Module_1_U041800: start-on-event=DemSatellite_0InternalBehavior/GetFaultDetectionCounter, operation=Event_Implausible_Data_From_BSC_Module_1_U041800.GetFaultDetectionCounter
        OpEventGetFaultDetectionCounter_GetFaultDetectionCounter_EvtInfo_PTS_Sensor_10_Performance_or_Incorrect_Operation_B129792: start-on-event=DemSatellite_0InternalBehavior/GetFaultDetectionCounter, operation=EvtInfo_PTS_Sensor_10_Performance_or_Incorrect_Operation_B129792.GetFaultDetectionCounter
        OpEventGetFaultDetectionCounter_GetFaultDetectionCounter_Event_PTS_Sensor_10_Performance_or_Incorrect_Operation_B129792: start-on-event=DemSatellite_0InternalBehavior/GetFaultDetectionCounter, operation=Event_PTS_Sensor_10_Performance_or_Incorrect_Operation_B129792.GetFaultDetectionCounter
        OpEventGetFaultDetectionCounter_GetFaultDetectionCounter_EvtInfo_PTS_Sensor_11_Circuit_Open_B129813: start-on-event=DemSatellite_0InternalBehavior/GetFaultDetectionCounter, operation=EvtInfo_PTS_Sensor_11_Circuit_Open_B129813.GetFaultDetectionCounter
        OpEventGetFaultDetectionCounter_GetFaultDetectionCounter_Event_PTS_Sensor_11_Circuit_Open_B129813: start-on-event=DemSatellite_0InternalBehavior/GetFaultDetectionCounter, operation=Event_PTS_Sensor_11_Circuit_Open_B129813.GetFaultDetectionCounter
        OpEventGetFaultDetectionCounter_GetFaultDetectionCounter_EvtInfo_ECU_Internal_Performance_B22A900: start-on-event=DemSatellite_0InternalBehavior/GetFaultDetectionCounter, operation=EvtInfo_ECU_Internal_Performance_B22A900.GetFaultDetectionCounter
        OpEventGetFaultDetectionCounter_GetFaultDetectionCounter_Event_ECU_Internal_Performance_B22A900: start-on-event=DemSatellite_0InternalBehavior/GetFaultDetectionCounter, operation=Event_ECU_Internal_Performance_B22A900.GetFaultDetectionCounter
        OpEventGetFaultDetectionCounter_GetFaultDetectionCounter_EvtInfo_PTS_Sensor_9_Performance_or_Incorrect_Operation_B129692: start-on-event=DemSatellite_0InternalBehavior/GetFaultDetectionCounter, operation=EvtInfo_PTS_Sensor_9_Performance_or_Incorrect_Operation_B129692.GetFaultDetectionCounter
        OpEventGetFaultDetectionCounter_GetFaultDetectionCounter_Event_PTS_Sensor_9_Performance_or_Incorrect_Operation_B129692: start-on-event=DemSatellite_0InternalBehavior/GetFaultDetectionCounter, operation=Event_PTS_Sensor_9_Performance_or_Incorrect_Operation_B129692.GetFaultDetectionCounter
        OpEventGetFaultDetectionCounter_GetFaultDetectionCounter_EvtInfo_Calibration_Not_Learned_Lost_Calibration_B228600: start-on-event=DemSatellite_0InternalBehavior/GetFaultDetectionCounter, operation=EvtInfo_Calibration_Not_Learned_Lost_Calibration_B228600.GetFaultDetectionCounter
        OpEventGetFaultDetectionCounter_GetFaultDetectionCounter_Event_Calibration_Not_Learned_Lost_Calibration_B228600: start-on-event=DemSatellite_0InternalBehavior/GetFaultDetectionCounter, operation=Event_Calibration_Not_Learned_Lost_Calibration_B228600.GetFaultDetectionCounter
        OpEventGetFaultDetectionCounter_GetFaultDetectionCounter_EvtInfo_Lost_Communication_with_ORC_U015100: start-on-event=DemSatellite_0InternalBehavior/GetFaultDetectionCounter, operation=EvtInfo_Lost_Communication_with_ORC_U015100.GetFaultDetectionCounter
        OpEventGetFaultDetectionCounter_GetFaultDetectionCounter_Event_Lost_Communication_with_ORC_U015100: start-on-event=DemSatellite_0InternalBehavior/GetFaultDetectionCounter, operation=Event_Lost_Communication_with_ORC_U015100.GetFaultDetectionCounter
        OpEventGetFaultDetectionCounter_GetFaultDetectionCounter_EvtInfo_PTS_Sensor_1_Circuit_Open_B128E13: start-on-event=DemSatellite_0InternalBehavior/GetFaultDetectionCounter, operation=EvtInfo_PTS_Sensor_1_Circuit_Open_B128E13.GetFaultDetectionCounter
        OpEventGetFaultDetectionCounter_GetFaultDetectionCounter_Event_PTS_Sensor_1_Circuit_Open_B128E13: start-on-event=DemSatellite_0InternalBehavior/GetFaultDetectionCounter, operation=Event_PTS_Sensor_1_Circuit_Open_B128E13.GetFaultDetectionCounter
        OpEventGetFaultDetectionCounter_GetFaultDetectionCounter_EvtInfo_Lost_Communication_with_Rear_Camera_U026400: start-on-event=DemSatellite_0InternalBehavior/GetFaultDetectionCounter, operation=EvtInfo_Lost_Communication_with_Rear_Camera_U026400.GetFaultDetectionCounter
        OpEventGetFaultDetectionCounter_GetFaultDetectionCounter_Event_Lost_Communication_with_Rear_Camera_U026400: start-on-event=DemSatellite_0InternalBehavior/GetFaultDetectionCounter, operation=Event_Lost_Communication_with_Rear_Camera_U026400.GetFaultDetectionCounter
        OpEventGetFaultDetectionCounter_GetFaultDetectionCounter_EvtInfo_HS_FD_CANR_Comm_Bus_Performance_U100B00: start-on-event=DemSatellite_0InternalBehavior/GetFaultDetectionCounter, operation=EvtInfo_HS_FD_CANR_Comm_Bus_Performance_U100B00.GetFaultDetectionCounter
        OpEventGetFaultDetectionCounter_GetFaultDetectionCounter_Event_HS_FD_CANR_Comm_Bus_Performance_U100B00: start-on-event=DemSatellite_0InternalBehavior/GetFaultDetectionCounter, operation=Event_HS_FD_CANR_Comm_Bus_Performance_U100B00.GetFaultDetectionCounter
        OpEventGetFaultDetectionCounter_GetFaultDetectionCounter_EvtInfo_Implausible_Data_Received_From_Body_Control_Module_U042200: start-on-event=DemSatellite_0InternalBehavior/GetFaultDetectionCounter, operation=EvtInfo_Implausible_Data_Received_From_Body_Control_Module_U042200.GetFaultDetectionCounter
        OpEventGetFaultDetectionCounter_GetFaultDetectionCounter_Event_Implausible_Data_Received_From_Body_Control_Module_U042200: start-on-event=DemSatellite_0InternalBehavior/GetFaultDetectionCounter, operation=Event_Implausible_Data_Received_From_Body_Control_Module_U042200.GetFaultDetectionCounter
        OpEventGetFaultDetectionCounter_GetFaultDetectionCounter_EvtInfo_Lost_Communication_With_BCM_U014000: start-on-event=DemSatellite_0InternalBehavior/GetFaultDetectionCounter, operation=EvtInfo_Lost_Communication_With_BCM_U014000.GetFaultDetectionCounter
        OpEventGetFaultDetectionCounter_GetFaultDetectionCounter_Event_Lost_Communication_With_BCM_U014000: start-on-event=DemSatellite_0InternalBehavior/GetFaultDetectionCounter, operation=Event_Lost_Communication_With_BCM_U014000.GetFaultDetectionCounter
        OpEventGetFaultDetectionCounter_GetFaultDetectionCounter_EvtInfo_PTS_Sensor_2_Circuit_Open_B128F13: start-on-event=DemSatellite_0InternalBehavior/GetFaultDetectionCounter, operation=EvtInfo_PTS_Sensor_2_Circuit_Open_B128F13.GetFaultDetectionCounter
        OpEventGetFaultDetectionCounter_GetFaultDetectionCounter_Event_PTS_Sensor_2_Circuit_Open_B128F13: start-on-event=DemSatellite_0InternalBehavior/GetFaultDetectionCounter, operation=Event_PTS_Sensor_2_Circuit_Open_B128F13.GetFaultDetectionCounter
        OpEventGetFaultDetectionCounter_GetFaultDetectionCounter_EvtInfo_PTS_Sensor_3_Circuit_Open_B129013: start-on-event=DemSatellite_0InternalBehavior/GetFaultDetectionCounter, operation=EvtInfo_PTS_Sensor_3_Circuit_Open_B129013.GetFaultDetectionCounter
        OpEventGetFaultDetectionCounter_GetFaultDetectionCounter_Event_PTS_Sensor_3_Circuit_Open_B129013: start-on-event=DemSatellite_0InternalBehavior/GetFaultDetectionCounter, operation=Event_PTS_Sensor_3_Circuit_Open_B129013.GetFaultDetectionCounter
        OpEventGetFaultDetectionCounter_GetFaultDetectionCounter_EvtInfo_ECU_In_Plant_Mode_C221200: start-on-event=DemSatellite_0InternalBehavior/GetFaultDetectionCounter, operation=EvtInfo_ECU_In_Plant_Mode_C221200.GetFaultDetectionCounter
        OpEventGetFaultDetectionCounter_GetFaultDetectionCounter_Event_ECU_In_Plant_Mode_C221200: start-on-event=DemSatellite_0InternalBehavior/GetFaultDetectionCounter, operation=Event_ECU_In_Plant_Mode_C221200.GetFaultDetectionCounter
        OpEventGetFaultDetectionCounter_GetFaultDetectionCounter_EvtInfo_Implausible_Data_from_ORC_module_U045500: start-on-event=DemSatellite_0InternalBehavior/GetFaultDetectionCounter, operation=EvtInfo_Implausible_Data_from_ORC_module_U045500.GetFaultDetectionCounter
        OpEventGetFaultDetectionCounter_GetFaultDetectionCounter_Event_Implausible_Data_from_ORC_module_U045500: start-on-event=DemSatellite_0InternalBehavior/GetFaultDetectionCounter, operation=Event_Implausible_Data_from_ORC_module_U045500.GetFaultDetectionCounter
        OpEventGetFaultDetectionCounter_GetFaultDetectionCounter_EvtInfo_Right_Camera_Performance_or_Incorrect_Operation_B23C792: start-on-event=DemSatellite_0InternalBehavior/GetFaultDetectionCounter, operation=EvtInfo_Right_Camera_Performance_or_Incorrect_Operation_B23C792.GetFaultDetectionCounter
        OpEventGetFaultDetectionCounter_GetFaultDetectionCounter_Event_Right_Camera_Performance_or_Incorrect_Operation_B23C792: start-on-event=DemSatellite_0InternalBehavior/GetFaultDetectionCounter, operation=Event_Right_Camera_Performance_or_Incorrect_Operation_B23C792.GetFaultDetectionCounter
        OpEventGetFaultDetectionCounter_GetFaultDetectionCounter_EvtInfo_Rear_Sensors_PS_VltgeAboveThreshold_B212B17: start-on-event=DemSatellite_0InternalBehavior/GetFaultDetectionCounter, operation=EvtInfo_Rear_Sensors_PS_VltgeAboveThreshold_B212B17.GetFaultDetectionCounter
        OpEventGetFaultDetectionCounter_GetFaultDetectionCounter_Event_Rear_Sensors_PS_VltgeAboveThreshold_B212B17: start-on-event=DemSatellite_0InternalBehavior/GetFaultDetectionCounter, operation=Event_Rear_Sensors_PS_VltgeAboveThreshold_B212B17.GetFaultDetectionCounter
        OpEventGetFaultDetectionCounter_GetFaultDetectionCounter_EvtInfo_PTS_Sensor_6_Performance_or_Incorrect_Operation_B129392: start-on-event=DemSatellite_0InternalBehavior/GetFaultDetectionCounter, operation=EvtInfo_PTS_Sensor_6_Performance_or_Incorrect_Operation_B129392.GetFaultDetectionCounter
        OpEventGetFaultDetectionCounter_GetFaultDetectionCounter_Event_PTS_Sensor_6_Performance_or_Incorrect_Operation_B129392: start-on-event=DemSatellite_0InternalBehavior/GetFaultDetectionCounter, operation=Event_PTS_Sensor_6_Performance_or_Incorrect_Operation_B129392.GetFaultDetectionCounter
        OpEventGetFaultDetectionCounter_GetFaultDetectionCounter_GeneralEvtInfo: start-on-event=DemSatellite_0InternalBehavior/GetFaultDetectionCounter, operation=GeneralEvtInfo.GetFaultDetectionCounter
        OpEventGetEventFreezeFrameDataEx_GetEventFreezeFrameDataEx_EvtInfo_Dem_SystemInternalFailure: start-on-event=DemSatellite_0InternalBehavior/GetEventFreezeFrameDataEx, operation=EvtInfo_Dem_SystemInternalFailure.GetEventFreezeFrameDataEx
        OpEventGetEventFreezeFrameDataEx_GetEventFreezeFrameDataEx_Event_Dem_SystemInternalFailure: start-on-event=DemSatellite_0InternalBehavior/GetEventFreezeFrameDataEx, operation=Event_Dem_SystemInternalFailure.GetEventFreezeFrameDataEx
        OpEventGetEventFreezeFrameDataEx_GetEventFreezeFrameDataEx_EvtInfo_Invalid_Data_Received_From_Power_Steering_Control_Mo_805c40b7: start-on-event=DemSatellite_0InternalBehavior/GetEventFreezeFrameDataEx, operation=EvtInfo_Invalid_Data_Received_From_Power_Steering_Control_Module_U042000.GetEventFreezeFrameDataEx
        OpEventGetEventFreezeFrameDataEx_GetEventFreezeFrameDataEx_Event_Invalid_Data_Received_From_Power_Steering_Control_Modu_5020bf09: start-on-event=DemSatellite_0InternalBehavior/GetEventFreezeFrameDataEx, operation=Event_Invalid_Data_Received_From_Power_Steering_Control_Module_U042000.GetEventFreezeFrameDataEx
        OpEventGetEventFreezeFrameDataEx_GetEventFreezeFrameDataEx_EvtInfo_Lost_Communication_with_Left_Camera_U026600: start-on-event=DemSatellite_0InternalBehavior/GetEventFreezeFrameDataEx, operation=EvtInfo_Lost_Communication_with_Left_Camera_U026600.GetEventFreezeFrameDataEx
        OpEventGetEventFreezeFrameDataEx_GetEventFreezeFrameDataEx_Event_Lost_Communication_with_Left_Camera_U026600: start-on-event=DemSatellite_0InternalBehavior/GetEventFreezeFrameDataEx, operation=Event_Lost_Communication_with_Left_Camera_U026600.GetEventFreezeFrameDataEx
        OpEventGetEventFreezeFrameDataEx_GetEventFreezeFrameDataEx_EvtInfo_Front_Sensors_PS_VltgeBelowThreshold_B212A16: start-on-event=DemSatellite_0InternalBehavior/GetEventFreezeFrameDataEx, operation=EvtInfo_Front_Sensors_PS_VltgeBelowThreshold_B212A16.GetEventFreezeFrameDataEx
        OpEventGetEventFreezeFrameDataEx_GetEventFreezeFrameDataEx_Event_Front_Sensors_PS_VltgeBelowThreshold_B212A16: start-on-event=DemSatellite_0InternalBehavior/GetEventFreezeFrameDataEx, operation=Event_Front_Sensors_PS_VltgeBelowThreshold_B212A16.GetEventFreezeFrameDataEx
        OpEventGetEventFreezeFrameDataEx_GetEventFreezeFrameDataEx_EvtInfo_Left_Camera_Circuit_Voltage_Out_of_Range_B23C61C: start-on-event=DemSatellite_0InternalBehavior/GetEventFreezeFrameDataEx, operation=EvtInfo_Left_Camera_Circuit_Voltage_Out_of_Range_B23C61C.GetEventFreezeFrameDataEx
        OpEventGetEventFreezeFrameDataEx_GetEventFreezeFrameDataEx_Event_Left_Camera_Circuit_Voltage_Out_of_Range_B23C61C: start-on-event=DemSatellite_0InternalBehavior/GetEventFreezeFrameDataEx, operation=Event_Left_Camera_Circuit_Voltage_Out_of_Range_B23C61C.GetEventFreezeFrameDataEx
        OpEventGetEventFreezeFrameDataEx_GetEventFreezeFrameDataEx_EvtInfo_Rear_Sensors_PS_VltgeBelowThreshold_B212B16: start-on-event=DemSatellite_0InternalBehavior/GetEventFreezeFrameDataEx, operation=EvtInfo_Rear_Sensors_PS_VltgeBelowThreshold_B212B16.GetEventFreezeFrameDataEx
        OpEventGetEventFreezeFrameDataEx_GetEventFreezeFrameDataEx_Event_Rear_Sensors_PS_VltgeBelowThreshold_B212B16: start-on-event=DemSatellite_0InternalBehavior/GetEventFreezeFrameDataEx, operation=Event_Rear_Sensors_PS_VltgeBelowThreshold_B212B16.GetEventFreezeFrameDataEx
        OpEventGetEventFreezeFrameDataEx_GetEventFreezeFrameDataEx_EvtInfo_Rear_Sensors_PS_Bus_Sig_Msg_Failures_B212B08: start-on-event=DemSatellite_0InternalBehavior/GetEventFreezeFrameDataEx, operation=EvtInfo_Rear_Sensors_PS_Bus_Sig_Msg_Failures_B212B08.GetEventFreezeFrameDataEx
        OpEventGetEventFreezeFrameDataEx_GetEventFreezeFrameDataEx_Event_Rear_Sensors_PS_Bus_Sig_Msg_Failures_B212B08: start-on-event=DemSatellite_0InternalBehavior/GetEventFreezeFrameDataEx, operation=Event_Rear_Sensors_PS_Bus_Sig_Msg_Failures_B212B08.GetEventFreezeFrameDataEx
        OpEventGetEventFreezeFrameDataEx_GetEventFreezeFrameDataEx_EvtInfo_Rear_Camera_Circuit_Voltage_Out_of_Range_B217A1C: start-on-event=DemSatellite_0InternalBehavior/GetEventFreezeFrameDataEx, operation=EvtInfo_Rear_Camera_Circuit_Voltage_Out_of_Range_B217A1C.GetEventFreezeFrameDataEx
        OpEventGetEventFreezeFrameDataEx_GetEventFreezeFrameDataEx_Event_Rear_Camera_Circuit_Voltage_Out_of_Range_B217A1C: start-on-event=DemSatellite_0InternalBehavior/GetEventFreezeFrameDataEx, operation=Event_Rear_Camera_Circuit_Voltage_Out_of_Range_B217A1C.GetEventFreezeFrameDataEx
        OpEventGetEventFreezeFrameDataEx_GetEventFreezeFrameDataEx_EvtInfo_PTS_Sensor_12_Performance_or_Incorrect_Operation_B129992: start-on-event=DemSatellite_0InternalBehavior/GetEventFreezeFrameDataEx, operation=EvtInfo_PTS_Sensor_12_Performance_or_Incorrect_Operation_B129992.GetEventFreezeFrameDataEx
        OpEventGetEventFreezeFrameDataEx_GetEventFreezeFrameDataEx_Event_PTS_Sensor_12_Performance_or_Incorrect_Operation_B129992: start-on-event=DemSatellite_0InternalBehavior/GetEventFreezeFrameDataEx, operation=Event_PTS_Sensor_12_Performance_or_Incorrect_Operation_B129992.GetEventFreezeFrameDataEx
        OpEventGetEventFreezeFrameDataEx_GetEventFreezeFrameDataEx_EvtInfo_Battery_Voltage_Over_Voltage_B210C17: start-on-event=DemSatellite_0InternalBehavior/GetEventFreezeFrameDataEx, operation=EvtInfo_Battery_Voltage_Over_Voltage_B210C17.GetEventFreezeFrameDataEx
        OpEventGetEventFreezeFrameDataEx_GetEventFreezeFrameDataEx_Event_Battery_Voltage_Over_Voltage_B210C17: start-on-event=DemSatellite_0InternalBehavior/GetEventFreezeFrameDataEx, operation=Event_Battery_Voltage_Over_Voltage_B210C17.GetEventFreezeFrameDataEx
        OpEventGetEventFreezeFrameDataEx_GetEventFreezeFrameDataEx_EvtInfo_Front_Sensors_PS_VltgeAboveThreshold_B212A17: start-on-event=DemSatellite_0InternalBehavior/GetEventFreezeFrameDataEx, operation=EvtInfo_Front_Sensors_PS_VltgeAboveThreshold_B212A17.GetEventFreezeFrameDataEx
        OpEventGetEventFreezeFrameDataEx_GetEventFreezeFrameDataEx_Event_Front_Sensors_PS_VltgeAboveThreshold_B212A17: start-on-event=DemSatellite_0InternalBehavior/GetEventFreezeFrameDataEx, operation=Event_Front_Sensors_PS_VltgeAboveThreshold_B212A17.GetEventFreezeFrameDataEx
        OpEventGetEventFreezeFrameDataEx_GetEventFreezeFrameDataEx_EvtInfo_PTS_Sensor_4_Circuit_Open_B129113: start-on-event=DemSatellite_0InternalBehavior/GetEventFreezeFrameDataEx, operation=EvtInfo_PTS_Sensor_4_Circuit_Open_B129113.GetEventFreezeFrameDataEx
        OpEventGetEventFreezeFrameDataEx_GetEventFreezeFrameDataEx_Event_PTS_Sensor_4_Circuit_Open_B129113: start-on-event=DemSatellite_0InternalBehavior/GetEventFreezeFrameDataEx, operation=Event_PTS_Sensor_4_Circuit_Open_B129113.GetEventFreezeFrameDataEx
        OpEventGetEventFreezeFrameDataEx_GetEventFreezeFrameDataEx_EvtInfo_PTS_Sensor_12_Circuit_Open_B129913: start-on-event=DemSatellite_0InternalBehavior/GetEventFreezeFrameDataEx, operation=EvtInfo_PTS_Sensor_12_Circuit_Open_B129913.GetEventFreezeFrameDataEx
        OpEventGetEventFreezeFrameDataEx_GetEventFreezeFrameDataEx_Event_PTS_Sensor_12_Circuit_Open_B129913: start-on-event=DemSatellite_0InternalBehavior/GetEventFreezeFrameDataEx, operation=Event_PTS_Sensor_12_Circuit_Open_B129913.GetEventFreezeFrameDataEx
        OpEventGetEventFreezeFrameDataEx_GetEventFreezeFrameDataEx_EvtInfo_PTS_Sensor_11_Performance_or_Incorrect_Operation_B129892: start-on-event=DemSatellite_0InternalBehavior/GetEventFreezeFrameDataEx, operation=EvtInfo_PTS_Sensor_11_Performance_or_Incorrect_Operation_B129892.GetEventFreezeFrameDataEx
        OpEventGetEventFreezeFrameDataEx_GetEventFreezeFrameDataEx_Event_PTS_Sensor_11_Performance_or_Incorrect_Operation_B129892: start-on-event=DemSatellite_0InternalBehavior/GetEventFreezeFrameDataEx, operation=Event_PTS_Sensor_11_Performance_or_Incorrect_Operation_B129892.GetEventFreezeFrameDataEx
        OpEventGetEventFreezeFrameDataEx_GetEventFreezeFrameDataEx_EvtInfo_Lost_Communication_With_Radio_U018400: start-on-event=DemSatellite_0InternalBehavior/GetEventFreezeFrameDataEx, operation=EvtInfo_Lost_Communication_With_Radio_U018400.GetEventFreezeFrameDataEx
        OpEventGetEventFreezeFrameDataEx_GetEventFreezeFrameDataEx_Event_Lost_Communication_With_Radio_U018400: start-on-event=DemSatellite_0InternalBehavior/GetEventFreezeFrameDataEx, operation=Event_Lost_Communication_With_Radio_U018400.GetEventFreezeFrameDataEx
        OpEventGetEventFreezeFrameDataEx_GetEventFreezeFrameDataEx_EvtInfo_Park_Assist_PTS_Switch_Stuck_B12852A: start-on-event=DemSatellite_0InternalBehavior/GetEventFreezeFrameDataEx, operation=EvtInfo_Park_Assist_PTS_Switch_Stuck_B12852A.GetEventFreezeFrameDataEx
        OpEventGetEventFreezeFrameDataEx_GetEventFreezeFrameDataEx_Event_Park_Assist_PTS_Switch_Stuck_B12852A: start-on-event=DemSatellite_0InternalBehavior/GetEventFreezeFrameDataEx, operation=Event_Park_Assist_PTS_Switch_Stuck_B12852A.GetEventFreezeFrameDataEx
        OpEventGetEventFreezeFrameDataEx_GetEventFreezeFrameDataEx_EvtInfo_PTS_Sensor_5_Circuit_Open_B129213: start-on-event=DemSatellite_0InternalBehavior/GetEventFreezeFrameDataEx, operation=EvtInfo_PTS_Sensor_5_Circuit_Open_B129213.GetEventFreezeFrameDataEx
        OpEventGetEventFreezeFrameDataEx_GetEventFreezeFrameDataEx_Event_PTS_Sensor_5_Circuit_Open_B129213: start-on-event=DemSatellite_0InternalBehavior/GetEventFreezeFrameDataEx, operation=Event_PTS_Sensor_5_Circuit_Open_B129213.GetEventFreezeFrameDataEx
        OpEventGetEventFreezeFrameDataEx_GetEventFreezeFrameDataEx_EvtInfo_PTS_Sensor_5_Performance_or_Incorrect_Operation_B129292: start-on-event=DemSatellite_0InternalBehavior/GetEventFreezeFrameDataEx, operation=EvtInfo_PTS_Sensor_5_Performance_or_Incorrect_Operation_B129292.GetEventFreezeFrameDataEx
        OpEventGetEventFreezeFrameDataEx_GetEventFreezeFrameDataEx_Event_PTS_Sensor_5_Performance_or_Incorrect_Operation_B129292: start-on-event=DemSatellite_0InternalBehavior/GetEventFreezeFrameDataEx, operation=Event_PTS_Sensor_5_Performance_or_Incorrect_Operation_B129292.GetEventFreezeFrameDataEx
        OpEventGetEventFreezeFrameDataEx_GetEventFreezeFrameDataEx_EvtInfo_Battery_Voltage_Under_Voltage_B210C16: start-on-event=DemSatellite_0InternalBehavior/GetEventFreezeFrameDataEx, operation=EvtInfo_Battery_Voltage_Under_Voltage_B210C16.GetEventFreezeFrameDataEx
        OpEventGetEventFreezeFrameDataEx_GetEventFreezeFrameDataEx_Event_Battery_Voltage_Under_Voltage_B210C16: start-on-event=DemSatellite_0InternalBehavior/GetEventFreezeFrameDataEx, operation=Event_Battery_Voltage_Under_Voltage_B210C16.GetEventFreezeFrameDataEx
        OpEventGetEventFreezeFrameDataEx_GetEventFreezeFrameDataEx_EvtInfo_PTS_Sensor_4_Performance_or_Incorrect_Operation_B129192: start-on-event=DemSatellite_0InternalBehavior/GetEventFreezeFrameDataEx, operation=EvtInfo_PTS_Sensor_4_Performance_or_Incorrect_Operation_B129192.GetEventFreezeFrameDataEx
        OpEventGetEventFreezeFrameDataEx_GetEventFreezeFrameDataEx_Event_PTS_Sensor_4_Performance_or_Incorrect_Operation_B129192: start-on-event=DemSatellite_0InternalBehavior/GetEventFreezeFrameDataEx, operation=Event_PTS_Sensor_4_Performance_or_Incorrect_Operation_B129192.GetEventFreezeFrameDataEx
        OpEventGetEventFreezeFrameDataEx_GetEventFreezeFrameDataEx_EvtInfo_HS_FD_CAN2_Comm_Bus_Performance_U104E00: start-on-event=DemSatellite_0InternalBehavior/GetEventFreezeFrameDataEx, operation=EvtInfo_HS_FD_CAN2_Comm_Bus_Performance_U104E00.GetEventFreezeFrameDataEx
        OpEventGetEventFreezeFrameDataEx_GetEventFreezeFrameDataEx_Event_HS_FD_CAN2_Comm_Bus_Performance_U104E00: start-on-event=DemSatellite_0InternalBehavior/GetEventFreezeFrameDataEx, operation=Event_HS_FD_CAN2_Comm_Bus_Performance_U104E00.GetEventFreezeFrameDataEx
        OpEventGetEventFreezeFrameDataEx_GetEventFreezeFrameDataEx_EvtInfo_PTS_Sensor_9_Circuit_Open_B129613: start-on-event=DemSatellite_0InternalBehavior/GetEventFreezeFrameDataEx, operation=EvtInfo_PTS_Sensor_9_Circuit_Open_B129613.GetEventFreezeFrameDataEx
        OpEventGetEventFreezeFrameDataEx_GetEventFreezeFrameDataEx_Event_PTS_Sensor_9_Circuit_Open_B129613: start-on-event=DemSatellite_0InternalBehavior/GetEventFreezeFrameDataEx, operation=Event_PTS_Sensor_9_Circuit_Open_B129613.GetEventFreezeFrameDataEx
        OpEventGetEventFreezeFrameDataEx_GetEventFreezeFrameDataEx_EvtInfo_Loss_of_Comm_With_Engine_Control_Module_U010000: start-on-event=DemSatellite_0InternalBehavior/GetEventFreezeFrameDataEx, operation=EvtInfo_Loss_of_Comm_With_Engine_Control_Module_U010000.GetEventFreezeFrameDataEx
        OpEventGetEventFreezeFrameDataEx_GetEventFreezeFrameDataEx_Event_Loss_of_Comm_With_Engine_Control_Module_U010000: start-on-event=DemSatellite_0InternalBehavior/GetEventFreezeFrameDataEx, operation=Event_Loss_of_Comm_With_Engine_Control_Module_U010000.GetEventFreezeFrameDataEx
        OpEventGetEventFreezeFrameDataEx_GetEventFreezeFrameDataEx_EvtInfo_Lost_Communication_with_Right_Camera_U026700: start-on-event=DemSatellite_0InternalBehavior/GetEventFreezeFrameDataEx, operation=EvtInfo_Lost_Communication_with_Right_Camera_U026700.GetEventFreezeFrameDataEx
        OpEventGetEventFreezeFrameDataEx_GetEventFreezeFrameDataEx_Event_Lost_Communication_with_Right_Camera_U026700: start-on-event=DemSatellite_0InternalBehavior/GetEventFreezeFrameDataEx, operation=Event_Lost_Communication_with_Right_Camera_U026700.GetEventFreezeFrameDataEx
        OpEventGetEventFreezeFrameDataEx_GetEventFreezeFrameDataEx_EvtInfo_PTS_Sensor_1_Performance_or_Incorrect_Operation_B128E92: start-on-event=DemSatellite_0InternalBehavior/GetEventFreezeFrameDataEx, operation=EvtInfo_PTS_Sensor_1_Performance_or_Incorrect_Operation_B128E92.GetEventFreezeFrameDataEx
        OpEventGetEventFreezeFrameDataEx_GetEventFreezeFrameDataEx_Event_PTS_Sensor_1_Performance_or_Incorrect_Operation_B128E92: start-on-event=DemSatellite_0InternalBehavior/GetEventFreezeFrameDataEx, operation=Event_PTS_Sensor_1_Performance_or_Incorrect_Operation_B128E92.GetEventFreezeFrameDataEx
        OpEventGetEventFreezeFrameDataEx_GetEventFreezeFrameDataEx_EvtInfo_Rear_Camera_Performance_or_Incorrect_Operation_B217A92: start-on-event=DemSatellite_0InternalBehavior/GetEventFreezeFrameDataEx, operation=EvtInfo_Rear_Camera_Performance_or_Incorrect_Operation_B217A92.GetEventFreezeFrameDataEx
        OpEventGetEventFreezeFrameDataEx_GetEventFreezeFrameDataEx_Event_Rear_Camera_Performance_or_Incorrect_Operation_B217A92: start-on-event=DemSatellite_0InternalBehavior/GetEventFreezeFrameDataEx, operation=Event_Rear_Camera_Performance_or_Incorrect_Operation_B217A92.GetEventFreezeFrameDataEx
        OpEventGetEventFreezeFrameDataEx_GetEventFreezeFrameDataEx_EvtInfo_PTS_Sensor_2_Performance_or_Incorrect_Operation_B128F92: start-on-event=DemSatellite_0InternalBehavior/GetEventFreezeFrameDataEx, operation=EvtInfo_PTS_Sensor_2_Performance_or_Incorrect_Operation_B128F92.GetEventFreezeFrameDataEx
        OpEventGetEventFreezeFrameDataEx_GetEventFreezeFrameDataEx_Event_PTS_Sensor_2_Performance_or_Incorrect_Operation_B128F92: start-on-event=DemSatellite_0InternalBehavior/GetEventFreezeFrameDataEx, operation=Event_PTS_Sensor_2_Performance_or_Incorrect_Operation_B128F92.GetEventFreezeFrameDataEx
        OpEventGetEventFreezeFrameDataEx_GetEventFreezeFrameDataEx_EvtInfo_Right_Camera_Circuit_Voltage_Out_of_Range_B23C71C: start-on-event=DemSatellite_0InternalBehavior/GetEventFreezeFrameDataEx, operation=EvtInfo_Right_Camera_Circuit_Voltage_Out_of_Range_B23C71C.GetEventFreezeFrameDataEx
        OpEventGetEventFreezeFrameDataEx_GetEventFreezeFrameDataEx_Event_Right_Camera_Circuit_Voltage_Out_of_Range_B23C71C: start-on-event=DemSatellite_0InternalBehavior/GetEventFreezeFrameDataEx, operation=Event_Right_Camera_Circuit_Voltage_Out_of_Range_B23C71C.GetEventFreezeFrameDataEx
        OpEventGetEventFreezeFrameDataEx_GetEventFreezeFrameDataEx_EvtInfo_PTS_Sensor_8_Circuit_Open_B129513: start-on-event=DemSatellite_0InternalBehavior/GetEventFreezeFrameDataEx, operation=EvtInfo_PTS_Sensor_8_Circuit_Open_B129513.GetEventFreezeFrameDataEx
        OpEventGetEventFreezeFrameDataEx_GetEventFreezeFrameDataEx_Event_PTS_Sensor_8_Circuit_Open_B129513: start-on-event=DemSatellite_0InternalBehavior/GetEventFreezeFrameDataEx, operation=Event_PTS_Sensor_8_Circuit_Open_B129513.GetEventFreezeFrameDataEx
        OpEventGetEventFreezeFrameDataEx_GetEventFreezeFrameDataEx_EvtInfo_Implausible_Data_Received_from_Radio_U048500: start-on-event=DemSatellite_0InternalBehavior/GetEventFreezeFrameDataEx, operation=EvtInfo_Implausible_Data_Received_from_Radio_U048500.GetEventFreezeFrameDataEx
        OpEventGetEventFreezeFrameDataEx_GetEventFreezeFrameDataEx_Event_Implausible_Data_Received_from_Radio_U048500: start-on-event=DemSatellite_0InternalBehavior/GetEventFreezeFrameDataEx, operation=Event_Implausible_Data_Received_from_Radio_U048500.GetEventFreezeFrameDataEx
        OpEventGetEventFreezeFrameDataEx_GetEventFreezeFrameDataEx_EvtInfo_Implausible_Data_received_from_TRSKM_module_U14A000: start-on-event=DemSatellite_0InternalBehavior/GetEventFreezeFrameDataEx, operation=EvtInfo_Implausible_Data_received_from_TRSKM_module_U14A000.GetEventFreezeFrameDataEx
        OpEventGetEventFreezeFrameDataEx_GetEventFreezeFrameDataEx_Event_Implausible_Data_received_from_TRSKM_module_U14A000: start-on-event=DemSatellite_0InternalBehavior/GetEventFreezeFrameDataEx, operation=Event_Implausible_Data_received_from_TRSKM_module_U14A000.GetEventFreezeFrameDataEx
        OpEventGetEventFreezeFrameDataEx_GetEventFreezeFrameDataEx_EvtInfo_Front_Camera_Performance_or_Incorrect_Operation_B23C592: start-on-event=DemSatellite_0InternalBehavior/GetEventFreezeFrameDataEx, operation=EvtInfo_Front_Camera_Performance_or_Incorrect_Operation_B23C592.GetEventFreezeFrameDataEx
        OpEventGetEventFreezeFrameDataEx_GetEventFreezeFrameDataEx_Event_Front_Camera_Performance_or_Incorrect_Operation_B23C592: start-on-event=DemSatellite_0InternalBehavior/GetEventFreezeFrameDataEx, operation=Event_Front_Camera_Performance_or_Incorrect_Operation_B23C592.GetEventFreezeFrameDataEx
        OpEventGetEventFreezeFrameDataEx_GetEventFreezeFrameDataEx_EvtInfo_Loss_Communication_with_TRS_Knob_Module_U12B900: start-on-event=DemSatellite_0InternalBehavior/GetEventFreezeFrameDataEx, operation=EvtInfo_Loss_Communication_with_TRS_Knob_Module_U12B900.GetEventFreezeFrameDataEx
        OpEventGetEventFreezeFrameDataEx_GetEventFreezeFrameDataEx_Event_Loss_Communication_with_TRS_Knob_Module_U12B900: start-on-event=DemSatellite_0InternalBehavior/GetEventFreezeFrameDataEx, operation=Event_Loss_Communication_with_TRS_Knob_Module_U12B900.GetEventFreezeFrameDataEx
        OpEventGetEventFreezeFrameDataEx_GetEventFreezeFrameDataEx_EvtInfo_PTS_Sensor_7_Circuit_Open_B129413: start-on-event=DemSatellite_0InternalBehavior/GetEventFreezeFrameDataEx, operation=EvtInfo_PTS_Sensor_7_Circuit_Open_B129413.GetEventFreezeFrameDataEx
        OpEventGetEventFreezeFrameDataEx_GetEventFreezeFrameDataEx_Event_PTS_Sensor_7_Circuit_Open_B129413: start-on-event=DemSatellite_0InternalBehavior/GetEventFreezeFrameDataEx, operation=Event_PTS_Sensor_7_Circuit_Open_B129413.GetEventFreezeFrameDataEx
        OpEventGetEventFreezeFrameDataEx_GetEventFreezeFrameDataEx_EvtInfo_Front_Sensors_PS_Bus_Sig_Msg_Failures_B212A08: start-on-event=DemSatellite_0InternalBehavior/GetEventFreezeFrameDataEx, operation=EvtInfo_Front_Sensors_PS_Bus_Sig_Msg_Failures_B212A08.GetEventFreezeFrameDataEx
        OpEventGetEventFreezeFrameDataEx_GetEventFreezeFrameDataEx_Event_Front_Sensors_PS_Bus_Sig_Msg_Failures_B212A08: start-on-event=DemSatellite_0InternalBehavior/GetEventFreezeFrameDataEx, operation=Event_Front_Sensors_PS_Bus_Sig_Msg_Failures_B212A08.GetEventFreezeFrameDataEx
        OpEventGetEventFreezeFrameDataEx_GetEventFreezeFrameDataEx_EvtInfo_Lost_Communication_With_PSC_Module_A_U013100: start-on-event=DemSatellite_0InternalBehavior/GetEventFreezeFrameDataEx, operation=EvtInfo_Lost_Communication_With_PSC_Module_A_U013100.GetEventFreezeFrameDataEx
        OpEventGetEventFreezeFrameDataEx_GetEventFreezeFrameDataEx_Event_Lost_Communication_With_PSC_Module_A_U013100: start-on-event=DemSatellite_0InternalBehavior/GetEventFreezeFrameDataEx, operation=Event_Lost_Communication_With_PSC_Module_A_U013100.GetEventFreezeFrameDataEx
        OpEventGetEventFreezeFrameDataEx_GetEventFreezeFrameDataEx_EvtInfo_Lost_Communication_with_Front_Camera_U026500: start-on-event=DemSatellite_0InternalBehavior/GetEventFreezeFrameDataEx, operation=EvtInfo_Lost_Communication_with_Front_Camera_U026500.GetEventFreezeFrameDataEx
        OpEventGetEventFreezeFrameDataEx_GetEventFreezeFrameDataEx_Event_Lost_Communication_with_Front_Camera_U026500: start-on-event=DemSatellite_0InternalBehavior/GetEventFreezeFrameDataEx, operation=Event_Lost_Communication_with_Front_Camera_U026500.GetEventFreezeFrameDataEx
        OpEventGetEventFreezeFrameDataEx_GetEventFreezeFrameDataEx_EvtInfo_PTS_Sensor_3_Performance_or_Incorrect_Operation_B129092: start-on-event=DemSatellite_0InternalBehavior/GetEventFreezeFrameDataEx, operation=EvtInfo_PTS_Sensor_3_Performance_or_Incorrect_Operation_B129092.GetEventFreezeFrameDataEx
        OpEventGetEventFreezeFrameDataEx_GetEventFreezeFrameDataEx_Event_PTS_Sensor_3_Performance_or_Incorrect_Operation_B129092: start-on-event=DemSatellite_0InternalBehavior/GetEventFreezeFrameDataEx, operation=Event_PTS_Sensor_3_Performance_or_Incorrect_Operation_B129092.GetEventFreezeFrameDataEx
        OpEventGetEventFreezeFrameDataEx_GetEventFreezeFrameDataEx_EvtInfo_PTS_Sensor_8_Performance_or_Incorrect_Operation_B129592: start-on-event=DemSatellite_0InternalBehavior/GetEventFreezeFrameDataEx, operation=EvtInfo_PTS_Sensor_8_Performance_or_Incorrect_Operation_B129592.GetEventFreezeFrameDataEx
        OpEventGetEventFreezeFrameDataEx_GetEventFreezeFrameDataEx_Event_PTS_Sensor_8_Performance_or_Incorrect_Operation_B129592: start-on-event=DemSatellite_0InternalBehavior/GetEventFreezeFrameDataEx, operation=Event_PTS_Sensor_8_Performance_or_Incorrect_Operation_B129592.GetEventFreezeFrameDataEx
        OpEventGetEventFreezeFrameDataEx_GetEventFreezeFrameDataEx_EvtInfo_PPP_Assist_Switch_Stuck_B12B22A: start-on-event=DemSatellite_0InternalBehavior/GetEventFreezeFrameDataEx, operation=EvtInfo_PPP_Assist_Switch_Stuck_B12B22A.GetEventFreezeFrameDataEx
        OpEventGetEventFreezeFrameDataEx_GetEventFreezeFrameDataEx_Event_PPP_Assist_Switch_Stuck_B12B22A: start-on-event=DemSatellite_0InternalBehavior/GetEventFreezeFrameDataEx, operation=Event_PPP_Assist_Switch_Stuck_B12B22A.GetEventFreezeFrameDataEx
        OpEventGetEventFreezeFrameDataEx_GetEventFreezeFrameDataEx_EvtInfo_Implausible_data_received_from_ECM_U040100: start-on-event=DemSatellite_0InternalBehavior/GetEventFreezeFrameDataEx, operation=EvtInfo_Implausible_data_received_from_ECM_U040100.GetEventFreezeFrameDataEx
        OpEventGetEventFreezeFrameDataEx_GetEventFreezeFrameDataEx_Event_Implausible_data_received_from_ECM_U040100: start-on-event=DemSatellite_0InternalBehavior/GetEventFreezeFrameDataEx, operation=Event_Implausible_data_received_from_ECM_U040100.GetEventFreezeFrameDataEx
        OpEventGetEventFreezeFrameDataEx_GetEventFreezeFrameDataEx_EvtInfo_PTS_Sensor_10_Circuit_Open_B129713: start-on-event=DemSatellite_0InternalBehavior/GetEventFreezeFrameDataEx, operation=EvtInfo_PTS_Sensor_10_Circuit_Open_B129713.GetEventFreezeFrameDataEx
        OpEventGetEventFreezeFrameDataEx_GetEventFreezeFrameDataEx_Event_PTS_Sensor_10_Circuit_Open_B129713: start-on-event=DemSatellite_0InternalBehavior/GetEventFreezeFrameDataEx, operation=Event_PTS_Sensor_10_Circuit_Open_B129713.GetEventFreezeFrameDataEx
        OpEventGetEventFreezeFrameDataEx_GetEventFreezeFrameDataEx_EvtInfo_Lost_Communication_With_BSC_module_1_U012900: start-on-event=DemSatellite_0InternalBehavior/GetEventFreezeFrameDataEx, operation=EvtInfo_Lost_Communication_With_BSC_module_1_U012900.GetEventFreezeFrameDataEx
        OpEventGetEventFreezeFrameDataEx_GetEventFreezeFrameDataEx_Event_Lost_Communication_With_BSC_module_1_U012900: start-on-event=DemSatellite_0InternalBehavior/GetEventFreezeFrameDataEx, operation=Event_Lost_Communication_With_BSC_module_1_U012900.GetEventFreezeFrameDataEx
        OpEventGetEventFreezeFrameDataEx_GetEventFreezeFrameDataEx_EvtInfo_PTS_Sensor_7_Performance_or_Incorrect_Operation_B129492: start-on-event=DemSatellite_0InternalBehavior/GetEventFreezeFrameDataEx, operation=EvtInfo_PTS_Sensor_7_Performance_or_Incorrect_Operation_B129492.GetEventFreezeFrameDataEx
        OpEventGetEventFreezeFrameDataEx_GetEventFreezeFrameDataEx_Event_PTS_Sensor_7_Performance_or_Incorrect_Operation_B129492: start-on-event=DemSatellite_0InternalBehavior/GetEventFreezeFrameDataEx, operation=Event_PTS_Sensor_7_Performance_or_Incorrect_Operation_B129492.GetEventFreezeFrameDataEx
        OpEventGetEventFreezeFrameDataEx_GetEventFreezeFrameDataEx_EvtInfo_Left_Camera_Performance_or_Incorrect_Operation_B23C692: start-on-event=DemSatellite_0InternalBehavior/GetEventFreezeFrameDataEx, operation=EvtInfo_Left_Camera_Performance_or_Incorrect_Operation_B23C692.GetEventFreezeFrameDataEx
        OpEventGetEventFreezeFrameDataEx_GetEventFreezeFrameDataEx_Event_Left_Camera_Performance_or_Incorrect_Operation_B23C692: start-on-event=DemSatellite_0InternalBehavior/GetEventFreezeFrameDataEx, operation=Event_Left_Camera_Performance_or_Incorrect_Operation_B23C692.GetEventFreezeFrameDataEx
        OpEventGetEventFreezeFrameDataEx_GetEventFreezeFrameDataEx_EvtInfo_Vehicle_Configuration_Mismatch_B223B00: start-on-event=DemSatellite_0InternalBehavior/GetEventFreezeFrameDataEx, operation=EvtInfo_Vehicle_Configuration_Mismatch_B223B00.GetEventFreezeFrameDataEx
        OpEventGetEventFreezeFrameDataEx_GetEventFreezeFrameDataEx_Event_Vehicle_Configuration_Mismatch_B223B00: start-on-event=DemSatellite_0InternalBehavior/GetEventFreezeFrameDataEx, operation=Event_Vehicle_Configuration_Mismatch_B223B00.GetEventFreezeFrameDataEx
        OpEventGetEventFreezeFrameDataEx_GetEventFreezeFrameDataEx_EvtInfo_PTS_Sensor_6_Circuit_Open_B129313: start-on-event=DemSatellite_0InternalBehavior/GetEventFreezeFrameDataEx, operation=EvtInfo_PTS_Sensor_6_Circuit_Open_B129313.GetEventFreezeFrameDataEx
        OpEventGetEventFreezeFrameDataEx_GetEventFreezeFrameDataEx_Event_PTS_Sensor_6_Circuit_Open_B129313: start-on-event=DemSatellite_0InternalBehavior/GetEventFreezeFrameDataEx, operation=Event_PTS_Sensor_6_Circuit_Open_B129313.GetEventFreezeFrameDataEx
        OpEventGetEventFreezeFrameDataEx_GetEventFreezeFrameDataEx_EvtInfo_Front_Camera_Circuit_Voltage_Out_of_Range_B23C51C: start-on-event=DemSatellite_0InternalBehavior/GetEventFreezeFrameDataEx, operation=EvtInfo_Front_Camera_Circuit_Voltage_Out_of_Range_B23C51C.GetEventFreezeFrameDataEx
        OpEventGetEventFreezeFrameDataEx_GetEventFreezeFrameDataEx_Event_Front_Camera_Circuit_Voltage_Out_of_Range_B23C51C: start-on-event=DemSatellite_0InternalBehavior/GetEventFreezeFrameDataEx, operation=Event_Front_Camera_Circuit_Voltage_Out_of_Range_B23C51C.GetEventFreezeFrameDataEx
        OpEventGetEventFreezeFrameDataEx_GetEventFreezeFrameDataEx_EvtInfo_Implausible_Data_From_BSC_Module_1_U041800: start-on-event=DemSatellite_0InternalBehavior/GetEventFreezeFrameDataEx, operation=EvtInfo_Implausible_Data_From_BSC_Module_1_U041800.GetEventFreezeFrameDataEx
        OpEventGetEventFreezeFrameDataEx_GetEventFreezeFrameDataEx_Event_Implausible_Data_From_BSC_Module_1_U041800: start-on-event=DemSatellite_0InternalBehavior/GetEventFreezeFrameDataEx, operation=Event_Implausible_Data_From_BSC_Module_1_U041800.GetEventFreezeFrameDataEx
        OpEventGetEventFreezeFrameDataEx_GetEventFreezeFrameDataEx_EvtInfo_PTS_Sensor_10_Performance_or_Incorrect_Operation_B129792: start-on-event=DemSatellite_0InternalBehavior/GetEventFreezeFrameDataEx, operation=EvtInfo_PTS_Sensor_10_Performance_or_Incorrect_Operation_B129792.GetEventFreezeFrameDataEx
        OpEventGetEventFreezeFrameDataEx_GetEventFreezeFrameDataEx_Event_PTS_Sensor_10_Performance_or_Incorrect_Operation_B129792: start-on-event=DemSatellite_0InternalBehavior/GetEventFreezeFrameDataEx, operation=Event_PTS_Sensor_10_Performance_or_Incorrect_Operation_B129792.GetEventFreezeFrameDataEx
        OpEventGetEventFreezeFrameDataEx_GetEventFreezeFrameDataEx_EvtInfo_PTS_Sensor_11_Circuit_Open_B129813: start-on-event=DemSatellite_0InternalBehavior/GetEventFreezeFrameDataEx, operation=EvtInfo_PTS_Sensor_11_Circuit_Open_B129813.GetEventFreezeFrameDataEx
        OpEventGetEventFreezeFrameDataEx_GetEventFreezeFrameDataEx_Event_PTS_Sensor_11_Circuit_Open_B129813: start-on-event=DemSatellite_0InternalBehavior/GetEventFreezeFrameDataEx, operation=Event_PTS_Sensor_11_Circuit_Open_B129813.GetEventFreezeFrameDataEx
        OpEventGetEventFreezeFrameDataEx_GetEventFreezeFrameDataEx_EvtInfo_ECU_Internal_Performance_B22A900: start-on-event=DemSatellite_0InternalBehavior/GetEventFreezeFrameDataEx, operation=EvtInfo_ECU_Internal_Performance_B22A900.GetEventFreezeFrameDataEx
        OpEventGetEventFreezeFrameDataEx_GetEventFreezeFrameDataEx_Event_ECU_Internal_Performance_B22A900: start-on-event=DemSatellite_0InternalBehavior/GetEventFreezeFrameDataEx, operation=Event_ECU_Internal_Performance_B22A900.GetEventFreezeFrameDataEx
        OpEventGetEventFreezeFrameDataEx_GetEventFreezeFrameDataEx_EvtInfo_PTS_Sensor_9_Performance_or_Incorrect_Operation_B129692: start-on-event=DemSatellite_0InternalBehavior/GetEventFreezeFrameDataEx, operation=EvtInfo_PTS_Sensor_9_Performance_or_Incorrect_Operation_B129692.GetEventFreezeFrameDataEx
        OpEventGetEventFreezeFrameDataEx_GetEventFreezeFrameDataEx_Event_PTS_Sensor_9_Performance_or_Incorrect_Operation_B129692: start-on-event=DemSatellite_0InternalBehavior/GetEventFreezeFrameDataEx, operation=Event_PTS_Sensor_9_Performance_or_Incorrect_Operation_B129692.GetEventFreezeFrameDataEx
        OpEventGetEventFreezeFrameDataEx_GetEventFreezeFrameDataEx_EvtInfo_Calibration_Not_Learned_Lost_Calibration_B228600: start-on-event=DemSatellite_0InternalBehavior/GetEventFreezeFrameDataEx, operation=EvtInfo_Calibration_Not_Learned_Lost_Calibration_B228600.GetEventFreezeFrameDataEx
        OpEventGetEventFreezeFrameDataEx_GetEventFreezeFrameDataEx_Event_Calibration_Not_Learned_Lost_Calibration_B228600: start-on-event=DemSatellite_0InternalBehavior/GetEventFreezeFrameDataEx, operation=Event_Calibration_Not_Learned_Lost_Calibration_B228600.GetEventFreezeFrameDataEx
        OpEventGetEventFreezeFrameDataEx_GetEventFreezeFrameDataEx_EvtInfo_Lost_Communication_with_ORC_U015100: start-on-event=DemSatellite_0InternalBehavior/GetEventFreezeFrameDataEx, operation=EvtInfo_Lost_Communication_with_ORC_U015100.GetEventFreezeFrameDataEx
        OpEventGetEventFreezeFrameDataEx_GetEventFreezeFrameDataEx_Event_Lost_Communication_with_ORC_U015100: start-on-event=DemSatellite_0InternalBehavior/GetEventFreezeFrameDataEx, operation=Event_Lost_Communication_with_ORC_U015100.GetEventFreezeFrameDataEx
        OpEventGetEventFreezeFrameDataEx_GetEventFreezeFrameDataEx_EvtInfo_PTS_Sensor_1_Circuit_Open_B128E13: start-on-event=DemSatellite_0InternalBehavior/GetEventFreezeFrameDataEx, operation=EvtInfo_PTS_Sensor_1_Circuit_Open_B128E13.GetEventFreezeFrameDataEx
        OpEventGetEventFreezeFrameDataEx_GetEventFreezeFrameDataEx_Event_PTS_Sensor_1_Circuit_Open_B128E13: start-on-event=DemSatellite_0InternalBehavior/GetEventFreezeFrameDataEx, operation=Event_PTS_Sensor_1_Circuit_Open_B128E13.GetEventFreezeFrameDataEx
        OpEventGetEventFreezeFrameDataEx_GetEventFreezeFrameDataEx_EvtInfo_Lost_Communication_with_Rear_Camera_U026400: start-on-event=DemSatellite_0InternalBehavior/GetEventFreezeFrameDataEx, operation=EvtInfo_Lost_Communication_with_Rear_Camera_U026400.GetEventFreezeFrameDataEx
        OpEventGetEventFreezeFrameDataEx_GetEventFreezeFrameDataEx_Event_Lost_Communication_with_Rear_Camera_U026400: start-on-event=DemSatellite_0InternalBehavior/GetEventFreezeFrameDataEx, operation=Event_Lost_Communication_with_Rear_Camera_U026400.GetEventFreezeFrameDataEx
        OpEventGetEventFreezeFrameDataEx_GetEventFreezeFrameDataEx_EvtInfo_HS_FD_CANR_Comm_Bus_Performance_U100B00: start-on-event=DemSatellite_0InternalBehavior/GetEventFreezeFrameDataEx, operation=EvtInfo_HS_FD_CANR_Comm_Bus_Performance_U100B00.GetEventFreezeFrameDataEx
        OpEventGetEventFreezeFrameDataEx_GetEventFreezeFrameDataEx_Event_HS_FD_CANR_Comm_Bus_Performance_U100B00: start-on-event=DemSatellite_0InternalBehavior/GetEventFreezeFrameDataEx, operation=Event_HS_FD_CANR_Comm_Bus_Performance_U100B00.GetEventFreezeFrameDataEx
        OpEventGetEventFreezeFrameDataEx_GetEventFreezeFrameDataEx_EvtInfo_Implausible_Data_Received_From_Body_Control_Module_U042200: start-on-event=DemSatellite_0InternalBehavior/GetEventFreezeFrameDataEx, operation=EvtInfo_Implausible_Data_Received_From_Body_Control_Module_U042200.GetEventFreezeFrameDataEx
        OpEventGetEventFreezeFrameDataEx_GetEventFreezeFrameDataEx_Event_Implausible_Data_Received_From_Body_Control_Module_U042200: start-on-event=DemSatellite_0InternalBehavior/GetEventFreezeFrameDataEx, operation=Event_Implausible_Data_Received_From_Body_Control_Module_U042200.GetEventFreezeFrameDataEx
        OpEventGetEventFreezeFrameDataEx_GetEventFreezeFrameDataEx_EvtInfo_Lost_Communication_With_BCM_U014000: start-on-event=DemSatellite_0InternalBehavior/GetEventFreezeFrameDataEx, operation=EvtInfo_Lost_Communication_With_BCM_U014000.GetEventFreezeFrameDataEx
        OpEventGetEventFreezeFrameDataEx_GetEventFreezeFrameDataEx_Event_Lost_Communication_With_BCM_U014000: start-on-event=DemSatellite_0InternalBehavior/GetEventFreezeFrameDataEx, operation=Event_Lost_Communication_With_BCM_U014000.GetEventFreezeFrameDataEx
        OpEventGetEventFreezeFrameDataEx_GetEventFreezeFrameDataEx_EvtInfo_PTS_Sensor_2_Circuit_Open_B128F13: start-on-event=DemSatellite_0InternalBehavior/GetEventFreezeFrameDataEx, operation=EvtInfo_PTS_Sensor_2_Circuit_Open_B128F13.GetEventFreezeFrameDataEx
        OpEventGetEventFreezeFrameDataEx_GetEventFreezeFrameDataEx_Event_PTS_Sensor_2_Circuit_Open_B128F13: start-on-event=DemSatellite_0InternalBehavior/GetEventFreezeFrameDataEx, operation=Event_PTS_Sensor_2_Circuit_Open_B128F13.GetEventFreezeFrameDataEx
        OpEventGetEventFreezeFrameDataEx_GetEventFreezeFrameDataEx_EvtInfo_PTS_Sensor_3_Circuit_Open_B129013: start-on-event=DemSatellite_0InternalBehavior/GetEventFreezeFrameDataEx, operation=EvtInfo_PTS_Sensor_3_Circuit_Open_B129013.GetEventFreezeFrameDataEx
        OpEventGetEventFreezeFrameDataEx_GetEventFreezeFrameDataEx_Event_PTS_Sensor_3_Circuit_Open_B129013: start-on-event=DemSatellite_0InternalBehavior/GetEventFreezeFrameDataEx, operation=Event_PTS_Sensor_3_Circuit_Open_B129013.GetEventFreezeFrameDataEx
        OpEventGetEventFreezeFrameDataEx_GetEventFreezeFrameDataEx_EvtInfo_ECU_In_Plant_Mode_C221200: start-on-event=DemSatellite_0InternalBehavior/GetEventFreezeFrameDataEx, operation=EvtInfo_ECU_In_Plant_Mode_C221200.GetEventFreezeFrameDataEx
        OpEventGetEventFreezeFrameDataEx_GetEventFreezeFrameDataEx_Event_ECU_In_Plant_Mode_C221200: start-on-event=DemSatellite_0InternalBehavior/GetEventFreezeFrameDataEx, operation=Event_ECU_In_Plant_Mode_C221200.GetEventFreezeFrameDataEx
        OpEventGetEventFreezeFrameDataEx_GetEventFreezeFrameDataEx_EvtInfo_Implausible_Data_from_ORC_module_U045500: start-on-event=DemSatellite_0InternalBehavior/GetEventFreezeFrameDataEx, operation=EvtInfo_Implausible_Data_from_ORC_module_U045500.GetEventFreezeFrameDataEx
        OpEventGetEventFreezeFrameDataEx_GetEventFreezeFrameDataEx_Event_Implausible_Data_from_ORC_module_U045500: start-on-event=DemSatellite_0InternalBehavior/GetEventFreezeFrameDataEx, operation=Event_Implausible_Data_from_ORC_module_U045500.GetEventFreezeFrameDataEx
        OpEventGetEventFreezeFrameDataEx_GetEventFreezeFrameDataEx_EvtInfo_Right_Camera_Performance_or_Incorrect_Operation_B23C792: start-on-event=DemSatellite_0InternalBehavior/GetEventFreezeFrameDataEx, operation=EvtInfo_Right_Camera_Performance_or_Incorrect_Operation_B23C792.GetEventFreezeFrameDataEx
        OpEventGetEventFreezeFrameDataEx_GetEventFreezeFrameDataEx_Event_Right_Camera_Performance_or_Incorrect_Operation_B23C792: start-on-event=DemSatellite_0InternalBehavior/GetEventFreezeFrameDataEx, operation=Event_Right_Camera_Performance_or_Incorrect_Operation_B23C792.GetEventFreezeFrameDataEx
        OpEventGetEventFreezeFrameDataEx_GetEventFreezeFrameDataEx_EvtInfo_Rear_Sensors_PS_VltgeAboveThreshold_B212B17: start-on-event=DemSatellite_0InternalBehavior/GetEventFreezeFrameDataEx, operation=EvtInfo_Rear_Sensors_PS_VltgeAboveThreshold_B212B17.GetEventFreezeFrameDataEx
        OpEventGetEventFreezeFrameDataEx_GetEventFreezeFrameDataEx_Event_Rear_Sensors_PS_VltgeAboveThreshold_B212B17: start-on-event=DemSatellite_0InternalBehavior/GetEventFreezeFrameDataEx, operation=Event_Rear_Sensors_PS_VltgeAboveThreshold_B212B17.GetEventFreezeFrameDataEx
        OpEventGetEventFreezeFrameDataEx_GetEventFreezeFrameDataEx_EvtInfo_PTS_Sensor_6_Performance_or_Incorrect_Operation_B129392: start-on-event=DemSatellite_0InternalBehavior/GetEventFreezeFrameDataEx, operation=EvtInfo_PTS_Sensor_6_Performance_or_Incorrect_Operation_B129392.GetEventFreezeFrameDataEx
        OpEventGetEventFreezeFrameDataEx_GetEventFreezeFrameDataEx_Event_PTS_Sensor_6_Performance_or_Incorrect_Operation_B129392: start-on-event=DemSatellite_0InternalBehavior/GetEventFreezeFrameDataEx, operation=Event_PTS_Sensor_6_Performance_or_Incorrect_Operation_B129392.GetEventFreezeFrameDataEx
        OpEventGetEventFreezeFrameDataEx_GetEventFreezeFrameDataEx_GeneralEvtInfo: start-on-event=DemSatellite_0InternalBehavior/GetEventFreezeFrameDataEx, operation=GeneralEvtInfo.GetEventFreezeFrameDataEx
        OpEventGetEventExtendedDataRecordEx_GetEventExtendedDataRecordEx_EvtInfo_Dem_SystemInternalFailure: start-on-event=DemSatellite_0InternalBehavior/GetEventExtendedDataRecordEx, operation=EvtInfo_Dem_SystemInternalFailure.GetEventExtendedDataRecordEx
        OpEventGetEventExtendedDataRecordEx_GetEventExtendedDataRecordEx_Event_Dem_SystemInternalFailure: start-on-event=DemSatellite_0InternalBehavior/GetEventExtendedDataRecordEx, operation=Event_Dem_SystemInternalFailure.GetEventExtendedDataRecordEx
        OpEventGetEventExtendedDataRecordEx_GetEventExtendedDataRecordEx_EvtInfo_Invalid_Data_Received_From_Power_Steering_Cont_c119dc8e: start-on-event=DemSatellite_0InternalBehavior/GetEventExtendedDataRecordEx, operation=EvtInfo_Invalid_Data_Received_From_Power_Steering_Control_Module_U042000.GetEventExtendedDataRecordEx
        OpEventGetEventExtendedDataRecordEx_GetEventExtendedDataRecordEx_Event_Invalid_Data_Received_From_Power_Steering_Contro_b20374a2: start-on-event=DemSatellite_0InternalBehavior/GetEventExtendedDataRecordEx, operation=Event_Invalid_Data_Received_From_Power_Steering_Control_Module_U042000.GetEventExtendedDataRecordEx
        OpEventGetEventExtendedDataRecordEx_GetEventExtendedDataRecordEx_EvtInfo_Lost_Communication_with_Left_Camera_U026600: start-on-event=DemSatellite_0InternalBehavior/GetEventExtendedDataRecordEx, operation=EvtInfo_Lost_Communication_with_Left_Camera_U026600.GetEventExtendedDataRecordEx
        OpEventGetEventExtendedDataRecordEx_GetEventExtendedDataRecordEx_Event_Lost_Communication_with_Left_Camera_U026600: start-on-event=DemSatellite_0InternalBehavior/GetEventExtendedDataRecordEx, operation=Event_Lost_Communication_with_Left_Camera_U026600.GetEventExtendedDataRecordEx
        OpEventGetEventExtendedDataRecordEx_GetEventExtendedDataRecordEx_EvtInfo_Front_Sensors_PS_VltgeBelowThreshold_B212A16: start-on-event=DemSatellite_0InternalBehavior/GetEventExtendedDataRecordEx, operation=EvtInfo_Front_Sensors_PS_VltgeBelowThreshold_B212A16.GetEventExtendedDataRecordEx
        OpEventGetEventExtendedDataRecordEx_GetEventExtendedDataRecordEx_Event_Front_Sensors_PS_VltgeBelowThreshold_B212A16: start-on-event=DemSatellite_0InternalBehavior/GetEventExtendedDataRecordEx, operation=Event_Front_Sensors_PS_VltgeBelowThreshold_B212A16.GetEventExtendedDataRecordEx
        OpEventGetEventExtendedDataRecordEx_GetEventExtendedDataRecordEx_EvtInfo_Left_Camera_Circuit_Voltage_Out_of_Range_B23C61C: start-on-event=DemSatellite_0InternalBehavior/GetEventExtendedDataRecordEx, operation=EvtInfo_Left_Camera_Circuit_Voltage_Out_of_Range_B23C61C.GetEventExtendedDataRecordEx
        OpEventGetEventExtendedDataRecordEx_GetEventExtendedDataRecordEx_Event_Left_Camera_Circuit_Voltage_Out_of_Range_B23C61C: start-on-event=DemSatellite_0InternalBehavior/GetEventExtendedDataRecordEx, operation=Event_Left_Camera_Circuit_Voltage_Out_of_Range_B23C61C.GetEventExtendedDataRecordEx
        OpEventGetEventExtendedDataRecordEx_GetEventExtendedDataRecordEx_EvtInfo_Rear_Sensors_PS_VltgeBelowThreshold_B212B16: start-on-event=DemSatellite_0InternalBehavior/GetEventExtendedDataRecordEx, operation=EvtInfo_Rear_Sensors_PS_VltgeBelowThreshold_B212B16.GetEventExtendedDataRecordEx
        OpEventGetEventExtendedDataRecordEx_GetEventExtendedDataRecordEx_Event_Rear_Sensors_PS_VltgeBelowThreshold_B212B16: start-on-event=DemSatellite_0InternalBehavior/GetEventExtendedDataRecordEx, operation=Event_Rear_Sensors_PS_VltgeBelowThreshold_B212B16.GetEventExtendedDataRecordEx
        OpEventGetEventExtendedDataRecordEx_GetEventExtendedDataRecordEx_EvtInfo_Rear_Sensors_PS_Bus_Sig_Msg_Failures_B212B08: start-on-event=DemSatellite_0InternalBehavior/GetEventExtendedDataRecordEx, operation=EvtInfo_Rear_Sensors_PS_Bus_Sig_Msg_Failures_B212B08.GetEventExtendedDataRecordEx
        OpEventGetEventExtendedDataRecordEx_GetEventExtendedDataRecordEx_Event_Rear_Sensors_PS_Bus_Sig_Msg_Failures_B212B08: start-on-event=DemSatellite_0InternalBehavior/GetEventExtendedDataRecordEx, operation=Event_Rear_Sensors_PS_Bus_Sig_Msg_Failures_B212B08.GetEventExtendedDataRecordEx
        OpEventGetEventExtendedDataRecordEx_GetEventExtendedDataRecordEx_EvtInfo_Rear_Camera_Circuit_Voltage_Out_of_Range_B217A1C: start-on-event=DemSatellite_0InternalBehavior/GetEventExtendedDataRecordEx, operation=EvtInfo_Rear_Camera_Circuit_Voltage_Out_of_Range_B217A1C.GetEventExtendedDataRecordEx
        OpEventGetEventExtendedDataRecordEx_GetEventExtendedDataRecordEx_Event_Rear_Camera_Circuit_Voltage_Out_of_Range_B217A1C: start-on-event=DemSatellite_0InternalBehavior/GetEventExtendedDataRecordEx, operation=Event_Rear_Camera_Circuit_Voltage_Out_of_Range_B217A1C.GetEventExtendedDataRecordEx
        OpEventGetEventExtendedDataRecordEx_GetEventExtendedDataRecordEx_EvtInfo_PTS_Sensor_12_Performance_or_Incorrect_Operati_346a3681: start-on-event=DemSatellite_0InternalBehavior/GetEventExtendedDataRecordEx, operation=EvtInfo_PTS_Sensor_12_Performance_or_Incorrect_Operation_B129992.GetEventExtendedDataRecordEx
        OpEventGetEventExtendedDataRecordEx_GetEventExtendedDataRecordEx_Event_PTS_Sensor_12_Performance_or_Incorrect_Operation_B129992: start-on-event=DemSatellite_0InternalBehavior/GetEventExtendedDataRecordEx, operation=Event_PTS_Sensor_12_Performance_or_Incorrect_Operation_B129992.GetEventExtendedDataRecordEx
        OpEventGetEventExtendedDataRecordEx_GetEventExtendedDataRecordEx_EvtInfo_Battery_Voltage_Over_Voltage_B210C17: start-on-event=DemSatellite_0InternalBehavior/GetEventExtendedDataRecordEx, operation=EvtInfo_Battery_Voltage_Over_Voltage_B210C17.GetEventExtendedDataRecordEx
        OpEventGetEventExtendedDataRecordEx_GetEventExtendedDataRecordEx_Event_Battery_Voltage_Over_Voltage_B210C17: start-on-event=DemSatellite_0InternalBehavior/GetEventExtendedDataRecordEx, operation=Event_Battery_Voltage_Over_Voltage_B210C17.GetEventExtendedDataRecordEx
        OpEventGetEventExtendedDataRecordEx_GetEventExtendedDataRecordEx_EvtInfo_Front_Sensors_PS_VltgeAboveThreshold_B212A17: start-on-event=DemSatellite_0InternalBehavior/GetEventExtendedDataRecordEx, operation=EvtInfo_Front_Sensors_PS_VltgeAboveThreshold_B212A17.GetEventExtendedDataRecordEx
        OpEventGetEventExtendedDataRecordEx_GetEventExtendedDataRecordEx_Event_Front_Sensors_PS_VltgeAboveThreshold_B212A17: start-on-event=DemSatellite_0InternalBehavior/GetEventExtendedDataRecordEx, operation=Event_Front_Sensors_PS_VltgeAboveThreshold_B212A17.GetEventExtendedDataRecordEx
        OpEventGetEventExtendedDataRecordEx_GetEventExtendedDataRecordEx_EvtInfo_PTS_Sensor_4_Circuit_Open_B129113: start-on-event=DemSatellite_0InternalBehavior/GetEventExtendedDataRecordEx, operation=EvtInfo_PTS_Sensor_4_Circuit_Open_B129113.GetEventExtendedDataRecordEx
        OpEventGetEventExtendedDataRecordEx_GetEventExtendedDataRecordEx_Event_PTS_Sensor_4_Circuit_Open_B129113: start-on-event=DemSatellite_0InternalBehavior/GetEventExtendedDataRecordEx, operation=Event_PTS_Sensor_4_Circuit_Open_B129113.GetEventExtendedDataRecordEx
        OpEventGetEventExtendedDataRecordEx_GetEventExtendedDataRecordEx_EvtInfo_PTS_Sensor_12_Circuit_Open_B129913: start-on-event=DemSatellite_0InternalBehavior/GetEventExtendedDataRecordEx, operation=EvtInfo_PTS_Sensor_12_Circuit_Open_B129913.GetEventExtendedDataRecordEx
        OpEventGetEventExtendedDataRecordEx_GetEventExtendedDataRecordEx_Event_PTS_Sensor_12_Circuit_Open_B129913: start-on-event=DemSatellite_0InternalBehavior/GetEventExtendedDataRecordEx, operation=Event_PTS_Sensor_12_Circuit_Open_B129913.GetEventExtendedDataRecordEx
        OpEventGetEventExtendedDataRecordEx_GetEventExtendedDataRecordEx_EvtInfo_PTS_Sensor_11_Performance_or_Incorrect_Operati_4bd01410: start-on-event=DemSatellite_0InternalBehavior/GetEventExtendedDataRecordEx, operation=EvtInfo_PTS_Sensor_11_Performance_or_Incorrect_Operation_B129892.GetEventExtendedDataRecordEx
        OpEventGetEventExtendedDataRecordEx_GetEventExtendedDataRecordEx_Event_PTS_Sensor_11_Performance_or_Incorrect_Operation_B129892: start-on-event=DemSatellite_0InternalBehavior/GetEventExtendedDataRecordEx, operation=Event_PTS_Sensor_11_Performance_or_Incorrect_Operation_B129892.GetEventExtendedDataRecordEx
        OpEventGetEventExtendedDataRecordEx_GetEventExtendedDataRecordEx_EvtInfo_Lost_Communication_With_Radio_U018400: start-on-event=DemSatellite_0InternalBehavior/GetEventExtendedDataRecordEx, operation=EvtInfo_Lost_Communication_With_Radio_U018400.GetEventExtendedDataRecordEx
        OpEventGetEventExtendedDataRecordEx_GetEventExtendedDataRecordEx_Event_Lost_Communication_With_Radio_U018400: start-on-event=DemSatellite_0InternalBehavior/GetEventExtendedDataRecordEx, operation=Event_Lost_Communication_With_Radio_U018400.GetEventExtendedDataRecordEx
        OpEventGetEventExtendedDataRecordEx_GetEventExtendedDataRecordEx_EvtInfo_Park_Assist_PTS_Switch_Stuck_B12852A: start-on-event=DemSatellite_0InternalBehavior/GetEventExtendedDataRecordEx, operation=EvtInfo_Park_Assist_PTS_Switch_Stuck_B12852A.GetEventExtendedDataRecordEx
        OpEventGetEventExtendedDataRecordEx_GetEventExtendedDataRecordEx_Event_Park_Assist_PTS_Switch_Stuck_B12852A: start-on-event=DemSatellite_0InternalBehavior/GetEventExtendedDataRecordEx, operation=Event_Park_Assist_PTS_Switch_Stuck_B12852A.GetEventExtendedDataRecordEx
        OpEventGetEventExtendedDataRecordEx_GetEventExtendedDataRecordEx_EvtInfo_PTS_Sensor_5_Circuit_Open_B129213: start-on-event=DemSatellite_0InternalBehavior/GetEventExtendedDataRecordEx, operation=EvtInfo_PTS_Sensor_5_Circuit_Open_B129213.GetEventExtendedDataRecordEx
        OpEventGetEventExtendedDataRecordEx_GetEventExtendedDataRecordEx_Event_PTS_Sensor_5_Circuit_Open_B129213: start-on-event=DemSatellite_0InternalBehavior/GetEventExtendedDataRecordEx, operation=Event_PTS_Sensor_5_Circuit_Open_B129213.GetEventExtendedDataRecordEx
        OpEventGetEventExtendedDataRecordEx_GetEventExtendedDataRecordEx_EvtInfo_PTS_Sensor_5_Performance_or_Incorrect_Operation_B129292: start-on-event=DemSatellite_0InternalBehavior/GetEventExtendedDataRecordEx, operation=EvtInfo_PTS_Sensor_5_Performance_or_Incorrect_Operation_B129292.GetEventExtendedDataRecordEx
        OpEventGetEventExtendedDataRecordEx_GetEventExtendedDataRecordEx_Event_PTS_Sensor_5_Performance_or_Incorrect_Operation_B129292: start-on-event=DemSatellite_0InternalBehavior/GetEventExtendedDataRecordEx, operation=Event_PTS_Sensor_5_Performance_or_Incorrect_Operation_B129292.GetEventExtendedDataRecordEx
        OpEventGetEventExtendedDataRecordEx_GetEventExtendedDataRecordEx_EvtInfo_Battery_Voltage_Under_Voltage_B210C16: start-on-event=DemSatellite_0InternalBehavior/GetEventExtendedDataRecordEx, operation=EvtInfo_Battery_Voltage_Under_Voltage_B210C16.GetEventExtendedDataRecordEx
        OpEventGetEventExtendedDataRecordEx_GetEventExtendedDataRecordEx_Event_Battery_Voltage_Under_Voltage_B210C16: start-on-event=DemSatellite_0InternalBehavior/GetEventExtendedDataRecordEx, operation=Event_Battery_Voltage_Under_Voltage_B210C16.GetEventExtendedDataRecordEx
        OpEventGetEventExtendedDataRecordEx_GetEventExtendedDataRecordEx_EvtInfo_PTS_Sensor_4_Performance_or_Incorrect_Operation_B129192: start-on-event=DemSatellite_0InternalBehavior/GetEventExtendedDataRecordEx, operation=EvtInfo_PTS_Sensor_4_Performance_or_Incorrect_Operation_B129192.GetEventExtendedDataRecordEx
        OpEventGetEventExtendedDataRecordEx_GetEventExtendedDataRecordEx_Event_PTS_Sensor_4_Performance_or_Incorrect_Operation_B129192: start-on-event=DemSatellite_0InternalBehavior/GetEventExtendedDataRecordEx, operation=Event_PTS_Sensor_4_Performance_or_Incorrect_Operation_B129192.GetEventExtendedDataRecordEx
        OpEventGetEventExtendedDataRecordEx_GetEventExtendedDataRecordEx_EvtInfo_HS_FD_CAN2_Comm_Bus_Performance_U104E00: start-on-event=DemSatellite_0InternalBehavior/GetEventExtendedDataRecordEx, operation=EvtInfo_HS_FD_CAN2_Comm_Bus_Performance_U104E00.GetEventExtendedDataRecordEx
        OpEventGetEventExtendedDataRecordEx_GetEventExtendedDataRecordEx_Event_HS_FD_CAN2_Comm_Bus_Performance_U104E00: start-on-event=DemSatellite_0InternalBehavior/GetEventExtendedDataRecordEx, operation=Event_HS_FD_CAN2_Comm_Bus_Performance_U104E00.GetEventExtendedDataRecordEx
        OpEventGetEventExtendedDataRecordEx_GetEventExtendedDataRecordEx_EvtInfo_PTS_Sensor_9_Circuit_Open_B129613: start-on-event=DemSatellite_0InternalBehavior/GetEventExtendedDataRecordEx, operation=EvtInfo_PTS_Sensor_9_Circuit_Open_B129613.GetEventExtendedDataRecordEx
        OpEventGetEventExtendedDataRecordEx_GetEventExtendedDataRecordEx_Event_PTS_Sensor_9_Circuit_Open_B129613: start-on-event=DemSatellite_0InternalBehavior/GetEventExtendedDataRecordEx, operation=Event_PTS_Sensor_9_Circuit_Open_B129613.GetEventExtendedDataRecordEx
        OpEventGetEventExtendedDataRecordEx_GetEventExtendedDataRecordEx_EvtInfo_Loss_of_Comm_With_Engine_Control_Module_U010000: start-on-event=DemSatellite_0InternalBehavior/GetEventExtendedDataRecordEx, operation=EvtInfo_Loss_of_Comm_With_Engine_Control_Module_U010000.GetEventExtendedDataRecordEx
        OpEventGetEventExtendedDataRecordEx_GetEventExtendedDataRecordEx_Event_Loss_of_Comm_With_Engine_Control_Module_U010000: start-on-event=DemSatellite_0InternalBehavior/GetEventExtendedDataRecordEx, operation=Event_Loss_of_Comm_With_Engine_Control_Module_U010000.GetEventExtendedDataRecordEx
        OpEventGetEventExtendedDataRecordEx_GetEventExtendedDataRecordEx_EvtInfo_Lost_Communication_with_Right_Camera_U026700: start-on-event=DemSatellite_0InternalBehavior/GetEventExtendedDataRecordEx, operation=EvtInfo_Lost_Communication_with_Right_Camera_U026700.GetEventExtendedDataRecordEx
        OpEventGetEventExtendedDataRecordEx_GetEventExtendedDataRecordEx_Event_Lost_Communication_with_Right_Camera_U026700: start-on-event=DemSatellite_0InternalBehavior/GetEventExtendedDataRecordEx, operation=Event_Lost_Communication_with_Right_Camera_U026700.GetEventExtendedDataRecordEx
        OpEventGetEventExtendedDataRecordEx_GetEventExtendedDataRecordEx_EvtInfo_PTS_Sensor_1_Performance_or_Incorrect_Operation_B128E92: start-on-event=DemSatellite_0InternalBehavior/GetEventExtendedDataRecordEx, operation=EvtInfo_PTS_Sensor_1_Performance_or_Incorrect_Operation_B128E92.GetEventExtendedDataRecordEx
        OpEventGetEventExtendedDataRecordEx_GetEventExtendedDataRecordEx_Event_PTS_Sensor_1_Performance_or_Incorrect_Operation_B128E92: start-on-event=DemSatellite_0InternalBehavior/GetEventExtendedDataRecordEx, operation=Event_PTS_Sensor_1_Performance_or_Incorrect_Operation_B128E92.GetEventExtendedDataRecordEx
        OpEventGetEventExtendedDataRecordEx_GetEventExtendedDataRecordEx_EvtInfo_Rear_Camera_Performance_or_Incorrect_Operation_B217A92: start-on-event=DemSatellite_0InternalBehavior/GetEventExtendedDataRecordEx, operation=EvtInfo_Rear_Camera_Performance_or_Incorrect_Operation_B217A92.GetEventExtendedDataRecordEx
        OpEventGetEventExtendedDataRecordEx_GetEventExtendedDataRecordEx_Event_Rear_Camera_Performance_or_Incorrect_Operation_B217A92: start-on-event=DemSatellite_0InternalBehavior/GetEventExtendedDataRecordEx, operation=Event_Rear_Camera_Performance_or_Incorrect_Operation_B217A92.GetEventExtendedDataRecordEx
        OpEventGetEventExtendedDataRecordEx_GetEventExtendedDataRecordEx_EvtInfo_PTS_Sensor_2_Performance_or_Incorrect_Operation_B128F92: start-on-event=DemSatellite_0InternalBehavior/GetEventExtendedDataRecordEx, operation=EvtInfo_PTS_Sensor_2_Performance_or_Incorrect_Operation_B128F92.GetEventExtendedDataRecordEx
        OpEventGetEventExtendedDataRecordEx_GetEventExtendedDataRecordEx_Event_PTS_Sensor_2_Performance_or_Incorrect_Operation_B128F92: start-on-event=DemSatellite_0InternalBehavior/GetEventExtendedDataRecordEx, operation=Event_PTS_Sensor_2_Performance_or_Incorrect_Operation_B128F92.GetEventExtendedDataRecordEx
        OpEventGetEventExtendedDataRecordEx_GetEventExtendedDataRecordEx_EvtInfo_Right_Camera_Circuit_Voltage_Out_of_Range_B23C71C: start-on-event=DemSatellite_0InternalBehavior/GetEventExtendedDataRecordEx, operation=EvtInfo_Right_Camera_Circuit_Voltage_Out_of_Range_B23C71C.GetEventExtendedDataRecordEx
        OpEventGetEventExtendedDataRecordEx_GetEventExtendedDataRecordEx_Event_Right_Camera_Circuit_Voltage_Out_of_Range_B23C71C: start-on-event=DemSatellite_0InternalBehavior/GetEventExtendedDataRecordEx, operation=Event_Right_Camera_Circuit_Voltage_Out_of_Range_B23C71C.GetEventExtendedDataRecordEx
