[part 3 of 3: package /MICROSAR/Dem_swc/ComponentTypes]
AUTOSAR XML (schema 00050)
package /MICROSAR/Dem_swc/ComponentTypes  (continued)
  service sw component type DemSatellite_0: category=SERVICE_COMPONENT  (continued)
    behavior DemSatellite_0InternalBehavior: handle-termination-and-restart=NO-SUPPORT, included-data-type-set=data-type=[Dem_EventIdType, Dem_RatioIdType, Dem_EventStatusType, Dem_UdsStatusByteType, Dem_DTCFormatType, Dem_InitMonitorReasonType, Dem_OperationCycleStateType, Dem_DTCStatusMaskType, Dem_IndicatorStatusType, Dem_MaxDataValueType, Dem_DTCKindType, Dem_DTCGroupType, Dem_IumprDenomCondIdType, Dem_IumprDenomCondStatusType, Dem_DebounceResetStatusType, Dem_DebouncingStateType, Dem_IumprReadinessGroupType, Dem_DTRControlType, Dem_DTCSeverityType, Dem_MonitorStatusType]  (continued)
      1485 x operation invoked event:  (continued)
        OpEventGetEventExtendedDataRecordEx_GetEventExtendedDataRecordEx_EvtInfo_PTS_Sensor_8_Circuit_Open_B129513: start-on-event=DemSatellite_0InternalBehavior/GetEventExtendedDataRecordEx, operation=EvtInfo_PTS_Sensor_8_Circuit_Open_B129513.GetEventExtendedDataRecordEx
        OpEventGetEventExtendedDataRecordEx_GetEventExtendedDataRecordEx_Event_PTS_Sensor_8_Circuit_Open_B129513: start-on-event=DemSatellite_0InternalBehavior/GetEventExtendedDataRecordEx, operation=Event_PTS_Sensor_8_Circuit_Open_B129513.GetEventExtendedDataRecordEx
        OpEventGetEventExtendedDataRecordEx_GetEventExtendedDataRecordEx_EvtInfo_Implausible_Data_Received_from_Radio_U048500: start-on-event=DemSatellite_0InternalBehavior/GetEventExtendedDataRecordEx, operation=EvtInfo_Implausible_Data_Received_from_Radio_U048500.GetEventExtendedDataRecordEx
        OpEventGetEventExtendedDataRecordEx_GetEventExtendedDataRecordEx_Event_Implausible_Data_Received_from_Radio_U048500: start-on-event=DemSatellite_0InternalBehavior/GetEventExtendedDataRecordEx, operation=Event_Implausible_Data_Received_from_Radio_U048500.GetEventExtendedDataRecordEx
        OpEventGetEventExtendedDataRecordEx_GetEventExtendedDataRecordEx_EvtInfo_Implausible_Data_received_from_TRSKM_module_U14A000: start-on-event=DemSatellite_0InternalBehavior/GetEventExtendedDataRecordEx, operation=EvtInfo_Implausible_Data_received_from_TRSKM_module_U14A000.GetEventExtendedDataRecordEx
        OpEventGetEventExtendedDataRecordEx_GetEventExtendedDataRecordEx_Event_Implausible_Data_received_from_TRSKM_module_U14A000: start-on-event=DemSatellite_0InternalBehavior/GetEventExtendedDataRecordEx, operation=Event_Implausible_Data_received_from_TRSKM_module_U14A000.GetEventExtendedDataRecordEx
        OpEventGetEventExtendedDataRecordEx_GetEventExtendedDataRecordEx_EvtInfo_Front_Camera_Performance_or_Incorrect_Operation_B23C592: start-on-event=DemSatellite_0InternalBehavior/GetEventExtendedDataRecordEx, operation=EvtInfo_Front_Camera_Performance_or_Incorrect_Operation_B23C592.GetEventExtendedDataRecordEx
        OpEventGetEventExtendedDataRecordEx_GetEventExtendedDataRecordEx_Event_Front_Camera_Performance_or_Incorrect_Operation_B23C592: start-on-event=DemSatellite_0InternalBehavior/GetEventExtendedDataRecordEx, operation=Event_Front_Camera_Performance_or_Incorrect_Operation_B23C592.GetEventExtendedDataRecordEx
        OpEventGetEventExtendedDataRecordEx_GetEventExtendedDataRecordEx_EvtInfo_Loss_Communication_with_TRS_Knob_Module_U12B900: start-on-event=DemSatellite_0InternalBehavior/GetEventExtendedDataRecordEx, operation=EvtInfo_Loss_Communication_with_TRS_Knob_Module_U12B900.GetEventExtendedDataRecordEx
        OpEventGetEventExtendedDataRecordEx_GetEventExtendedDataRecordEx_Event_Loss_Communication_with_TRS_Knob_Module_U12B900: start-on-event=DemSatellite_0InternalBehavior/GetEventExtendedDataRecordEx, operation=Event_Loss_Communication_with_TRS_Knob_Module_U12B900.GetEventExtendedDataRecordEx
        OpEventGetEventExtendedDataRecordEx_GetEventExtendedDataRecordEx_EvtInfo_PTS_Sensor_7_Circuit_Open_B129413: start-on-event=DemSatellite_0InternalBehavior/GetEventExtendedDataRecordEx, operation=EvtInfo_PTS_Sensor_7_Circuit_Open_B129413.GetEventExtendedDataRecordEx
        OpEventGetEventExtendedDataRecordEx_GetEventExtendedDataRecordEx_Event_PTS_Sensor_7_Circuit_Open_B129413: start-on-event=DemSatellite_0InternalBehavior/GetEventExtendedDataRecordEx, operation=Event_PTS_Sensor_7_Circuit_Open_B129413.GetEventExtendedDataRecordEx
        OpEventGetEventExtendedDataRecordEx_GetEventExtendedDataRecordEx_EvtInfo_Front_Sensors_PS_Bus_Sig_Msg_Failures_B212A08: start-on-event=DemSatellite_0InternalBehavior/GetEventExtendedDataRecordEx, operation=EvtInfo_Front_Sensors_PS_Bus_Sig_Msg_Failures_B212A08.GetEventExtendedDataRecordEx
        OpEventGetEventExtendedDataRecordEx_GetEventExtendedDataRecordEx_Event_Front_Sensors_PS_Bus_Sig_Msg_Failures_B212A08: start-on-event=DemSatellite_0InternalBehavior/GetEventExtendedDataRecordEx, operation=Event_Front_Sensors_PS_Bus_Sig_Msg_Failures_B212A08.GetEventExtendedDataRecordEx
        OpEventGetEventExtendedDataRecordEx_GetEventExtendedDataRecordEx_EvtInfo_Lost_Communication_With_PSC_Module_A_U013100: start-on-event=DemSatellite_0InternalBehavior/GetEventExtendedDataRecordEx, operation=EvtInfo_Lost_Communication_With_PSC_Module_A_U013100.GetEventExtendedDataRecordEx
        OpEventGetEventExtendedDataRecordEx_GetEventExtendedDataRecordEx_Event_Lost_Communication_With_PSC_Module_A_U013100: start-on-event=DemSatellite_0InternalBehavior/GetEventExtendedDataRecordEx, operation=Event_Lost_Communication_With_PSC_Module_A_U013100.GetEventExtendedDataRecordEx
        OpEventGetEventExtendedDataRecordEx_GetEventExtendedDataRecordEx_EvtInfo_Lost_Communication_with_Front_Camera_U026500: start-on-event=DemSatellite_0InternalBehavior/GetEventExtendedDataRecordEx, operation=EvtInfo_Lost_Communication_with_Front_Camera_U026500.GetEventExtendedDataRecordEx
        OpEventGetEventExtendedDataRecordEx_GetEventExtendedDataRecordEx_Event_Lost_Communication_with_Front_Camera_U026500: start-on-event=DemSatellite_0InternalBehavior/GetEventExtendedDataRecordEx, operation=Event_Lost_Communication_with_Front_Camera_U026500.GetEventExtendedDataRecordEx
        OpEventGetEventExtendedDataRecordEx_GetEventExtendedDataRecordEx_EvtInfo_PTS_Sensor_3_Performance_or_Incorrect_Operation_B129092: start-on-event=DemSatellite_0InternalBehavior/GetEventExtendedDataRecordEx, operation=EvtInfo_PTS_Sensor_3_Performance_or_Incorrect_Operation_B129092.GetEventExtendedDataRecordEx
        OpEventGetEventExtendedDataRecordEx_GetEventExtendedDataRecordEx_Event_PTS_Sensor_3_Performance_or_Incorrect_Operation_B129092: start-on-event=DemSatellite_0InternalBehavior/GetEventExtendedDataRecordEx, operation=Event_PTS_Sensor_3_Performance_or_Incorrect_Operation_B129092.GetEventExtendedDataRecordEx
        OpEventGetEventExtendedDataRecordEx_GetEventExtendedDataRecordEx_EvtInfo_PTS_Sensor_8_Performance_or_Incorrect_Operation_B129592: start-on-event=DemSatellite_0InternalBehavior/GetEventExtendedDataRecordEx, operation=EvtInfo_PTS_Sensor_8_Performance_or_Incorrect_Operation_B129592.GetEventExtendedDataRecordEx
        OpEventGetEventExtendedDataRecordEx_GetEventExtendedDataRecordEx_Event_PTS_Sensor_8_Performance_or_Incorrect_Operation_B129592: start-on-event=DemSatellite_0InternalBehavior/GetEventExtendedDataRecordEx, operation=Event_PTS_Sensor_8_Performance_or_Incorrect_Operation_B129592.GetEventExtendedDataRecordEx
        OpEventGetEventExtendedDataRecordEx_GetEventExtendedDataRecordEx_EvtInfo_PPP_Assist_Switch_Stuck_B12B22A: start-on-event=DemSatellite_0InternalBehavior/GetEventExtendedDataRecordEx, operation=EvtInfo_PPP_Assist_Switch_Stuck_B12B22A.GetEventExtendedDataRecordEx
        OpEventGetEventExtendedDataRecordEx_GetEventExtendedDataRecordEx_Event_PPP_Assist_Switch_Stuck_B12B22A: start-on-event=DemSatellite_0InternalBehavior/GetEventExtendedDataRecordEx, operation=Event_PPP_Assist_Switch_Stuck_B12B22A.GetEventExtendedDataRecordEx
        OpEventGetEventExtendedDataRecordEx_GetEventExtendedDataRecordEx_EvtInfo_Implausible_data_received_from_ECM_U040100: start-on-event=DemSatellite_0InternalBehavior/GetEventExtendedDataRecordEx, operation=EvtInfo_Implausible_data_received_from_ECM_U040100.GetEventExtendedDataRecordEx
        OpEventGetEventExtendedDataRecordEx_GetEventExtendedDataRecordEx_Event_Implausible_data_received_from_ECM_U040100: start-on-event=DemSatellite_0InternalBehavior/GetEventExtendedDataRecordEx, operation=Event_Implausible_data_received_from_ECM_U040100.GetEventExtendedDataRecordEx
        OpEventGetEventExtendedDataRecordEx_GetEventExtendedDataRecordEx_EvtInfo_PTS_Sensor_10_Circuit_Open_B129713: start-on-event=DemSatellite_0InternalBehavior/GetEventExtendedDataRecordEx, operation=EvtInfo_PTS_Sensor_10_Circuit_Open_B129713.GetEventExtendedDataRecordEx
        OpEventGetEventExtendedDataRecordEx_GetEventExtendedDataRecordEx_Event_PTS_Sensor_10_Circuit_Open_B129713: start-on-event=DemSatellite_0InternalBehavior/GetEventExtendedDataRecordEx, operation=Event_PTS_Sensor_10_Circuit_Open_B129713.GetEventExtendedDataRecordEx
        OpEventGetEventExtendedDataRecordEx_GetEventExtendedDataRecordEx_EvtInfo_Lost_Communication_With_BSC_module_1_U012900: start-on-event=DemSatellite_0InternalBehavior/GetEventExtendedDataRecordEx, operation=EvtInfo_Lost_Communication_With_BSC_module_1_U012900.GetEventExtendedDataRecordEx
        OpEventGetEventExtendedDataRecordEx_GetEventExtendedDataRecordEx_Event_Lost_Communication_With_BSC_module_1_U012900: start-on-event=DemSatellite_0InternalBehavior/GetEventExtendedDataRecordEx, operation=Event_Lost_Communication_With_BSC_module_1_U012900.GetEventExtendedDataRecordEx
        OpEventGetEventExtendedDataRecordEx_GetEventExtendedDataRecordEx_EvtInfo_PTS_Sensor_7_Performance_or_Incorrect_Operation_B129492: start-on-event=DemSatellite_0InternalBehavior/GetEventExtendedDataRecordEx, operation=EvtInfo_PTS_Sensor_7_Performance_or_Incorrect_Operation_B129492.GetEventExtendedDataRecordEx
        OpEventGetEventExtendedDataRecordEx_GetEventExtendedDataRecordEx_Event_PTS_Sensor_7_Performance_or_Incorrect_Operation_B129492: start-on-event=DemSatellite_0InternalBehavior/GetEventExtendedDataRecordEx, operation=Event_PTS_Sensor_7_Performance_or_Incorrect_Operation_B129492.GetEventExtendedDataRecordEx
        OpEventGetEventExtendedDataRecordEx_GetEventExtendedDataRecordEx_EvtInfo_Left_Camera_Performance_or_Incorrect_Operation_B23C692: start-on-event=DemSatellite_0InternalBehavior/GetEventExtendedDataRecordEx, operation=EvtInfo_Left_Camera_Performance_or_Incorrect_Operation_B23C692.GetEventExtendedDataRecordEx
        OpEventGetEventExtendedDataRecordEx_GetEventExtendedDataRecordEx_Event_Left_Camera_Performance_or_Incorrect_Operation_B23C692: start-on-event=DemSatellite_0InternalBehavior/GetEventExtendedDataRecordEx, operation=Event_Left_Camera_Performance_or_Incorrect_Operation_B23C692.GetEventExtendedDataRecordEx
        OpEventGetEventExtendedDataRecordEx_GetEventExtendedDataRecordEx_EvtInfo_Vehicle_Configuration_Mismatch_B223B00: start-on-event=DemSatellite_0InternalBehavior/GetEventExtendedDataRecordEx, operation=EvtInfo_Vehicle_Configuration_Mismatch_B223B00.GetEventExtendedDataRecordEx
        OpEventGetEventExtendedDataRecordEx_GetEventExtendedDataRecordEx_Event_Vehicle_Configuration_Mismatch_B223B00: start-on-event=DemSatellite_0InternalBehavior/GetEventExtendedDataRecordEx, operation=Event_Vehicle_Configuration_Mismatch_B223B00.GetEventExtendedDataRecordEx
        OpEventGetEventExtendedDataRecordEx_GetEventExtendedDataRecordEx_EvtInfo_PTS_Sensor_6_Circuit_Open_B129313: start-on-event=DemSatellite_0InternalBehavior/GetEventExtendedDataRecordEx, operation=EvtInfo_PTS_Sensor_6_Circuit_Open_B129313.GetEventExtendedDataRecordEx
        OpEventGetEventExtendedDataRecordEx_GetEventExtendedDataRecordEx_Event_PTS_Sensor_6_Circuit_Open_B129313: start-on-event=DemSatellite_0InternalBehavior/GetEventExtendedDataRecordEx, operation=Event_PTS_Sensor_6_Circuit_Open_B129313.GetEventExtendedDataRecordEx
        OpEventGetEventExtendedDataRecordEx_GetEventExtendedDataRecordEx_EvtInfo_Front_Camera_Circuit_Voltage_Out_of_Range_B23C51C: start-on-event=DemSatellite_0InternalBehavior/GetEventExtendedDataRecordEx, operation=EvtInfo_Front_Camera_Circuit_Voltage_Out_of_Range_B23C51C.GetEventExtendedDataRecordEx
        OpEventGetEventExtendedDataRecordEx_GetEventExtendedDataRecordEx_Event_Front_Camera_Circuit_Voltage_Out_of_Range_B23C51C: start-on-event=DemSatellite_0InternalBehavior/GetEventExtendedDataRecordEx, operation=Event_Front_Camera_Circuit_Voltage_Out_of_Range_B23C51C.GetEventExtendedDataRecordEx
        OpEventGetEventExtendedDataRecordEx_GetEventExtendedDataRecordEx_EvtInfo_Implausible_Data_From_BSC_Module_1_U041800: start-on-event=DemSatellite_0InternalBehavior/GetEventExtendedDataRecordEx, operation=EvtInfo_Implausible_Data_From_BSC_Module_1_U041800.GetEventExtendedDataRecordEx
        OpEventGetEventExtendedDataRecordEx_GetEventExtendedDataRecordEx_Event_Implausible_Data_From_BSC_Module_1_U041800: start-on-event=DemSatellite_0InternalBehavior/GetEventExtendedDataRecordEx, operation=Event_Implausible_Data_From_BSC_Module_1_U041800.GetEventExtendedDataRecordEx
        OpEventGetEventExtendedDataRecordEx_GetEventExtendedDataRecordEx_EvtInfo_PTS_Sensor_10_Performance_or_Incorrect_Operati_6aa46b4f: start-on-event=DemSatellite_0InternalBehavior/GetEventExtendedDataRecordEx, operation=EvtInfo_PTS_Sensor_10_Performance_or_Incorrect_Operation_B129792.GetEventExtendedDataRecordEx
        OpEventGetEventExtendedDataRecordEx_GetEventExtendedDataRecordEx_Event_PTS_Sensor_10_Performance_or_Incorrect_Operation_B129792: start-on-event=DemSatellite_0InternalBehavior/GetEventExtendedDataRecordEx, operation=Event_PTS_Sensor_10_Performance_or_Incorrect_Operation_B129792.GetEventExtendedDataRecordEx
        OpEventGetEventExtendedDataRecordEx_GetEventExtendedDataRecordEx_EvtInfo_PTS_Sensor_11_Circuit_Open_B129813: start-on-event=DemSatellite_0InternalBehavior/GetEventExtendedDataRecordEx, operation=EvtInfo_PTS_Sensor_11_Circuit_Open_B129813.GetEventExtendedDataRecordEx
        OpEventGetEventExtendedDataRecordEx_GetEventExtendedDataRecordEx_Event_PTS_Sensor_11_Circuit_Open_B129813: start-on-event=DemSatellite_0InternalBehavior/GetEventExtendedDataRecordEx, operation=Event_PTS_Sensor_11_Circuit_Open_B129813.GetEventExtendedDataRecordEx
        OpEventGetEventExtendedDataRecordEx_GetEventExtendedDataRecordEx_EvtInfo_ECU_Internal_Performance_B22A900: start-on-event=DemSatellite_0InternalBehavior/GetEventExtendedDataRecordEx, operation=EvtInfo_ECU_Internal_Performance_B22A900.GetEventExtendedDataRecordEx
        OpEventGetEventExtendedDataRecordEx_GetEventExtendedDataRecordEx_Event_ECU_Internal_Performance_B22A900: start-on-event=DemSatellite_0InternalBehavior/GetEventExtendedDataRecordEx, operation=Event_ECU_Internal_Performance_B22A900.GetEventExtendedDataRecordEx
        OpEventGetEventExtendedDataRecordEx_GetEventExtendedDataRecordEx_EvtInfo_PTS_Sensor_9_Performance_or_Incorrect_Operation_B129692: start-on-event=DemSatellite_0InternalBehavior/GetEventExtendedDataRecordEx, operation=EvtInfo_PTS_Sensor_9_Performance_or_Incorrect_Operation_B129692.GetEventExtendedDataRecordEx
        OpEventGetEventExtendedDataRecordEx_GetEventExtendedDataRecordEx_Event_PTS_Sensor_9_Performance_or_Incorrect_Operation_B129692: start-on-event=DemSatellite_0InternalBehavior/GetEventExtendedDataRecordEx, operation=Event_PTS_Sensor_9_Performance_or_Incorrect_Operation_B129692.GetEventExtendedDataRecordEx
        OpEventGetEventExtendedDataRecordEx_GetEventExtendedDataRecordEx_EvtInfo_Calibration_Not_Learned_Lost_Calibration_B228600: start-on-event=DemSatellite_0InternalBehavior/GetEventExtendedDataRecordEx, operation=EvtInfo_Calibration_Not_Learned_Lost_Calibration_B228600.GetEventExtendedDataRecordEx
        OpEventGetEventExtendedDataRecordEx_GetEventExtendedDataRecordEx_Event_Calibration_Not_Learned_Lost_Calibration_B228600: start-on-event=DemSatellite_0InternalBehavior/GetEventExtendedDataRecordEx, operation=Event_Calibration_Not_Learned_Lost_Calibration_B228600.GetEventExtendedDataRecordEx
        OpEventGetEventExtendedDataRecordEx_GetEventExtendedDataRecordEx_EvtInfo_Lost_Communication_with_ORC_U015100: start-on-event=DemSatellite_0InternalBehavior/GetEventExtendedDataRecordEx, operation=EvtInfo_Lost_Communication_with_ORC_U015100.GetEventExtendedDataRecordEx
        OpEventGetEventExtendedDataRecordEx_GetEventExtendedDataRecordEx_Event_Lost_Communication_with_ORC_U015100: start-on-event=DemSatellite_0InternalBehavior/GetEventExtendedDataRecordEx, operation=Event_Lost_Communication_with_ORC_U015100.GetEventExtendedDataRecordEx
        OpEventGetEventExtendedDataRecordEx_GetEventExtendedDataRecordEx_EvtInfo_PTS_Sensor_1_Circuit_Open_B128E13: start-on-event=DemSatellite_0InternalBehavior/GetEventExtendedDataRecordEx, operation=EvtInfo_PTS_Sensor_1_Circuit_Open_B128E13.GetEventExtendedDataRecordEx
        OpEventGetEventExtendedDataRecordEx_GetEventExtendedDataRecordEx_Event_PTS_Sensor_1_Circuit_Open_B128E13: start-on-event=DemSatellite_0InternalBehavior/GetEventExtendedDataRecordEx, operation=Event_PTS_Sensor_1_Circuit_Open_B128E13.GetEventExtendedDataRecordEx
        OpEventGetEventExtendedDataRecordEx_GetEventExtendedDataRecordEx_EvtInfo_Lost_Communication_with_Rear_Camera_U026400: start-on-event=DemSatellite_0InternalBehavior/GetEventExtendedDataRecordEx, operation=EvtInfo_Lost_Communication_with_Rear_Camera_U026400.GetEventExtendedDataRecordEx
        OpEventGetEventExtendedDataRecordEx_GetEventExtendedDataRecordEx_Event_Lost_Communication_with_Rear_Camera_U026400: start-on-event=DemSatellite_0InternalBehavior/GetEventExtendedDataRecordEx, operation=Event_Lost_Communication_with_Rear_Camera_U026400.GetEventExtendedDataRecordEx
        OpEventGetEventExtendedDataRecordEx_GetEventExtendedDataRecordEx_EvtInfo_HS_FD_CANR_Comm_Bus_Performance_U100B00: start-on-event=DemSatellite_0InternalBehavior/GetEventExtendedDataRecordEx, operation=EvtInfo_HS_FD_CANR_Comm_Bus_Performance_U100B00.GetEventExtendedDataRecordEx
        OpEventGetEventExtendedDataRecordEx_GetEventExtendedDataRecordEx_Event_HS_FD_CANR_Comm_Bus_Performance_U100B00: start-on-event=DemSatellite_0InternalBehavior/GetEventExtendedDataRecordEx, operation=Event_HS_FD_CANR_Comm_Bus_Performance_U100B00.GetEventExtendedDataRecordEx
        OpEventGetEventExtendedDataRecordEx_GetEventExtendedDataRecordEx_EvtInfo_Implausible_Data_Received_From_Body_Control_Mo_0fb85e14: start-on-event=DemSatellite_0InternalBehavior/GetEventExtendedDataRecordEx, operation=EvtInfo_Implausible_Data_Received_From_Body_Control_Module_U042200.GetEventExtendedDataRecordEx
        OpEventGetEventExtendedDataRecordEx_GetEventExtendedDataRecordEx_Event_Implausible_Data_Received_From_Body_Control_Modu_63c40a72: start-on-event=DemSatellite_0InternalBehavior/GetEventExtendedDataRecordEx, operation=Event_Implausible_Data_Received_From_Body_Control_Module_U042200.GetEventExtendedDataRecordEx
        OpEventGetEventExtendedDataRecordEx_GetEventExtendedDataRecordEx_EvtInfo_Lost_Communication_With_BCM_U014000: start-on-event=DemSatellite_0InternalBehavior/GetEventExtendedDataRecordEx, operation=EvtInfo_Lost_Communication_With_BCM_U014000.GetEventExtendedDataRecordEx
        OpEventGetEventExtendedDataRecordEx_GetEventExtendedDataRecordEx_Event_Lost_Communication_With_BCM_U014000: start-on-event=DemSatellite_0InternalBehavior/GetEventExtendedDataRecordEx, operation=Event_Lost_Communication_With_BCM_U014000.GetEventExtendedDataRecordEx
        OpEventGetEventExtendedDataRecordEx_GetEventExtendedDataRecordEx_EvtInfo_PTS_Sensor_2_Circuit_Open_B128F13: start-on-event=DemSatellite_0InternalBehavior/GetEventExtendedDataRecordEx, operation=EvtInfo_PTS_Sensor_2_Circuit_Open_B128F13.GetEventExtendedDataRecordEx
        OpEventGetEventExtendedDataRecordEx_GetEventExtendedDataRecordEx_Event_PTS_Sensor_2_Circuit_Open_B128F13: start-on-event=DemSatellite_0InternalBehavior/GetEventExtendedDataRecordEx, operation=Event_PTS_Sensor_2_Circuit_Open_B128F13.GetEventExtendedDataRecordEx
        OpEventGetEventExtendedDataRecordEx_GetEventExtendedDataRecordEx_EvtInfo_PTS_Sensor_3_Circuit_Open_B129013: start-on-event=DemSatellite_0InternalBehavior/GetEventExtendedDataRecordEx, operation=EvtInfo_PTS_Sensor_3_Circuit_Open_B129013.GetEventExtendedDataRecordEx
        OpEventGetEventExtendedDataRecordEx_GetEventExtendedDataRecordEx_Event_PTS_Sensor_3_Circuit_Open_B129013: start-on-event=DemSatellite_0InternalBehavior/GetEventExtendedDataRecordEx, operation=Event_PTS_Sensor_3_Circuit_Open_B129013.GetEventExtendedDataRecordEx
        OpEventGetEventExtendedDataRecordEx_GetEventExtendedDataRecordEx_EvtInfo_ECU_In_Plant_Mode_C221200: start-on-event=DemSatellite_0InternalBehavior/GetEventExtendedDataRecordEx, operation=EvtInfo_ECU_In_Plant_Mode_C221200.GetEventExtendedDataRecordEx
        OpEventGetEventExtendedDataRecordEx_GetEventExtendedDataRecordEx_Event_ECU_In_Plant_Mode_C221200: start-on-event=DemSatellite_0InternalBehavior/GetEventExtendedDataRecordEx, operation=Event_ECU_In_Plant_Mode_C221200.GetEventExtendedDataRecordEx
        OpEventGetEventExtendedDataRecordEx_GetEventExtendedDataRecordEx_EvtInfo_Implausible_Data_from_ORC_module_U045500: start-on-event=DemSatellite_0InternalBehavior/GetEventExtendedDataRecordEx, operation=EvtInfo_Implausible_Data_from_ORC_module_U045500.GetEventExtendedDataRecordEx
        OpEventGetEventExtendedDataRecordEx_GetEventExtendedDataRecordEx_Event_Implausible_Data_from_ORC_module_U045500: start-on-event=DemSatellite_0InternalBehavior/GetEventExtendedDataRecordEx, operation=Event_Implausible_Data_from_ORC_module_U045500.GetEventExtendedDataRecordEx
        OpEventGetEventExtendedDataRecordEx_GetEventExtendedDataRecordEx_EvtInfo_Right_Camera_Performance_or_Incorrect_Operation_B23C792: start-on-event=DemSatellite_0InternalBehavior/GetEventExtendedDataRecordEx, operation=EvtInfo_Right_Camera_Performance_or_Incorrect_Operation_B23C792.GetEventExtendedDataRecordEx
        OpEventGetEventExtendedDataRecordEx_GetEventExtendedDataRecordEx_Event_Right_Camera_Performance_or_Incorrect_Operation_B23C792: start-on-event=DemSatellite_0InternalBehavior/GetEventExtendedDataRecordEx, operation=Event_Right_Camera_Performance_or_Incorrect_Operation_B23C792.GetEventExtendedDataRecordEx
        OpEventGetEventExtendedDataRecordEx_GetEventExtendedDataRecordEx_EvtInfo_Rear_Sensors_PS_VltgeAboveThreshold_B212B17: start-on-event=DemSatellite_0InternalBehavior/GetEventExtendedDataRecordEx, operation=EvtInfo_Rear_Sensors_PS_VltgeAboveThreshold_B212B17.GetEventExtendedDataRecordEx
        OpEventGetEventExtendedDataRecordEx_GetEventExtendedDataRecordEx_Event_Rear_Sensors_PS_VltgeAboveThreshold_B212B17: start-on-event=DemSatellite_0InternalBehavior/GetEventExtendedDataRecordEx, operation=Event_Rear_Sensors_PS_VltgeAboveThreshold_B212B17.GetEventExtendedDataRecordEx
        OpEventGetEventExtendedDataRecordEx_GetEventExtendedDataRecordEx_EvtInfo_PTS_Sensor_6_Performance_or_Incorrect_Operation_B129392: start-on-event=DemSatellite_0InternalBehavior/GetEventExtendedDataRecordEx, operation=EvtInfo_PTS_Sensor_6_Performance_or_Incorrect_Operation_B129392.GetEventExtendedDataRecordEx
        OpEventGetEventExtendedDataRecordEx_GetEventExtendedDataRecordEx_Event_PTS_Sensor_6_Performance_or_Incorrect_Operation_B129392: start-on-event=DemSatellite_0InternalBehavior/GetEventExtendedDataRecordEx, operation=Event_PTS_Sensor_6_Performance_or_Incorrect_Operation_B129392.GetEventExtendedDataRecordEx
        OpEventGetEventExtendedDataRecordEx_GetEventExtendedDataRecordEx_GeneralEvtInfo: start-on-event=DemSatellite_0InternalBehavior/GetEventExtendedDataRecordEx, operation=GeneralEvtInfo.GetEventExtendedDataRecordEx
        OpEventGetEventEnableCondition_GetEventEnableCondition_EvtInfo_Dem_SystemInternalFailure: start-on-event=DemSatellite_0InternalBehavior/GetEventEnableCondition, operation=EvtInfo_Dem_SystemInternalFailure.GetEventEnableCondition
        OpEventGetEventEnableCondition_GetEventEnableCondition_EvtInfo_Invalid_Data_Received_From_Power_Steering_Control_Module_U042000: start-on-event=DemSatellite_0InternalBehavior/GetEventEnableCondition, operation=EvtInfo_Invalid_Data_Received_From_Power_Steering_Control_Module_U042000.GetEventEnableCondition
        OpEventGetEventEnableCondition_GetEventEnableCondition_EvtInfo_Lost_Communication_with_Left_Camera_U026600: start-on-event=DemSatellite_0InternalBehavior/GetEventEnableCondition, operation=EvtInfo_Lost_Communication_with_Left_Camera_U026600.GetEventEnableCondition
        OpEventGetEventEnableCondition_GetEventEnableCondition_EvtInfo_Front_Sensors_PS_VltgeBelowThreshold_B212A16: start-on-event=DemSatellite_0InternalBehavior/GetEventEnableCondition, operation=EvtInfo_Front_Sensors_PS_VltgeBelowThreshold_B212A16.GetEventEnableCondition
        OpEventGetEventEnableCondition_GetEventEnableCondition_EvtInfo_Left_Camera_Circuit_Voltage_Out_of_Range_B23C61C: start-on-event=DemSatellite_0InternalBehavior/GetEventEnableCondition, operation=EvtInfo_Left_Camera_Circuit_Voltage_Out_of_Range_B23C61C.GetEventEnableCondition
        OpEventGetEventEnableCondition_GetEventEnableCondition_EvtInfo_Rear_Sensors_PS_VltgeBelowThreshold_B212B16: start-on-event=DemSatellite_0InternalBehavior/GetEventEnableCondition, operation=EvtInfo_Rear_Sensors_PS_VltgeBelowThreshold_B212B16.GetEventEnableCondition
        OpEventGetEventEnableCondition_GetEventEnableCondition_EvtInfo_Rear_Sensors_PS_Bus_Sig_Msg_Failures_B212B08: start-on-event=DemSatellite_0InternalBehavior/GetEventEnableCondition, operation=EvtInfo_Rear_Sensors_PS_Bus_Sig_Msg_Failures_B212B08.GetEventEnableCondition
        OpEventGetEventEnableCondition_GetEventEnableCondition_EvtInfo_Rear_Camera_Circuit_Voltage_Out_of_Range_B217A1C: start-on-event=DemSatellite_0InternalBehavior/GetEventEnableCondition, operation=EvtInfo_Rear_Camera_Circuit_Voltage_Out_of_Range_B217A1C.GetEventEnableCondition
        OpEventGetEventEnableCondition_GetEventEnableCondition_EvtInfo_PTS_Sensor_12_Performance_or_Incorrect_Operation_B129992: start-on-event=DemSatellite_0InternalBehavior/GetEventEnableCondition, operation=EvtInfo_PTS_Sensor_12_Performance_or_Incorrect_Operation_B129992.GetEventEnableCondition
        OpEventGetEventEnableCondition_GetEventEnableCondition_EvtInfo_Battery_Voltage_Over_Voltage_B210C17: start-on-event=DemSatellite_0InternalBehavior/GetEventEnableCondition, operation=EvtInfo_Battery_Voltage_Over_Voltage_B210C17.GetEventEnableCondition
        OpEventGetEventEnableCondition_GetEventEnableCondition_EvtInfo_Front_Sensors_PS_VltgeAboveThreshold_B212A17: start-on-event=DemSatellite_0InternalBehavior/GetEventEnableCondition, operation=EvtInfo_Front_Sensors_PS_VltgeAboveThreshold_B212A17.GetEventEnableCondition
        OpEventGetEventEnableCondition_GetEventEnableCondition_EvtInfo_PTS_Sensor_4_Circuit_Open_B129113: start-on-event=DemSatellite_0InternalBehavior/GetEventEnableCondition, operation=EvtInfo_PTS_Sensor_4_Circuit_Open_B129113.GetEventEnableCondition
        OpEventGetEventEnableCondition_GetEventEnableCondition_EvtInfo_PTS_Sensor_12_Circuit_Open_B129913: start-on-event=DemSatellite_0InternalBehavior/GetEventEnableCondition, operation=EvtInfo_PTS_Sensor_12_Circuit_Open_B129913.GetEventEnableCondition
        OpEventGetEventEnableCondition_GetEventEnableCondition_EvtInfo_PTS_Sensor_11_Performance_or_Incorrect_Operation_B129892: start-on-event=DemSatellite_0InternalBehavior/GetEventEnableCondition, operation=EvtInfo_PTS_Sensor_11_Performance_or_Incorrect_Operation_B129892.GetEventEnableCondition
        OpEventGetEventEnableCondition_GetEventEnableCondition_EvtInfo_Lost_Communication_With_Radio_U018400: start-on-event=DemSatellite_0InternalBehavior/GetEventEnableCondition, operation=EvtInfo_Lost_Communication_With_Radio_U018400.GetEventEnableCondition
        OpEventGetEventEnableCondition_GetEventEnableCondition_EvtInfo_Park_Assist_PTS_Switch_Stuck_B12852A: start-on-event=DemSatellite_0InternalBehavior/GetEventEnableCondition, operation=EvtInfo_Park_Assist_PTS_Switch_Stuck_B12852A.GetEventEnableCondition
        OpEventGetEventEnableCondition_GetEventEnableCondition_EvtInfo_PTS_Sensor_5_Circuit_Open_B129213: start-on-event=DemSatellite_0InternalBehavior/GetEventEnableCondition, operation=EvtInfo_PTS_Sensor_5_Circuit_Open_B129213.GetEventEnableCondition
        OpEventGetEventEnableCondition_GetEventEnableCondition_EvtInfo_PTS_Sensor_5_Performance_or_Incorrect_Operation_B129292: start-on-event=DemSatellite_0InternalBehavior/GetEventEnableCondition, operation=EvtInfo_PTS_Sensor_5_Performance_or_Incorrect_Operation_B129292.GetEventEnableCondition
        OpEventGetEventEnableCondition_GetEventEnableCondition_EvtInfo_Battery_Voltage_Under_Voltage_B210C16: start-on-event=DemSatellite_0InternalBehavior/GetEventEnableCondition, operation=EvtInfo_Battery_Voltage_Under_Voltage_B210C16.GetEventEnableCondition
        OpEventGetEventEnableCondition_GetEventEnableCondition_EvtInfo_PTS_Sensor_4_Performance_or_Incorrect_Operation_B129192: start-on-event=DemSatellite_0InternalBehavior/GetEventEnableCondition, operation=EvtInfo_PTS_Sensor_4_Performance_or_Incorrect_Operation_B129192.GetEventEnableCondition
        OpEventGetEventEnableCondition_GetEventEnableCondition_EvtInfo_HS_FD_CAN2_Comm_Bus_Performance_U104E00: start-on-event=DemSatellite_0InternalBehavior/GetEventEnableCondition, operation=EvtInfo_HS_FD_CAN2_Comm_Bus_Performance_U104E00.GetEventEnableCondition
        OpEventGetEventEnableCondition_GetEventEnableCondition_EvtInfo_PTS_Sensor_9_Circuit_Open_B129613: start-on-event=DemSatellite_0InternalBehavior/GetEventEnableCondition, operation=EvtInfo_PTS_Sensor_9_Circuit_Open_B129613.GetEventEnableCondition
        OpEventGetEventEnableCondition_GetEventEnableCondition_EvtInfo_Loss_of_Comm_With_Engine_Control_Module_U010000: start-on-event=DemSatellite_0InternalBehavior/GetEventEnableCondition, operation=EvtInfo_Loss_of_Comm_With_Engine_Control_Module_U010000.GetEventEnableCondition
        OpEventGetEventEnableCondition_GetEventEnableCondition_EvtInfo_Lost_Communication_with_Right_Camera_U026700: start-on-event=DemSatellite_0InternalBehavior/GetEventEnableCondition, operation=EvtInfo_Lost_Communication_with_Right_Camera_U026700.GetEventEnableCondition
        OpEventGetEventEnableCondition_GetEventEnableCondition_EvtInfo_PTS_Sensor_1_Performance_or_Incorrect_Operation_B128E92: start-on-event=DemSatellite_0InternalBehavior/GetEventEnableCondition, operation=EvtInfo_PTS_Sensor_1_Performance_or_Incorrect_Operation_B128E92.GetEventEnableCondition
        OpEventGetEventEnableCondition_GetEventEnableCondition_EvtInfo_Rear_Camera_Performance_or_Incorrect_Operation_B217A92: start-on-event=DemSatellite_0InternalBehavior/GetEventEnableCondition, operation=EvtInfo_Rear_Camera_Performance_or_Incorrect_Operation_B217A92.GetEventEnableCondition
        OpEventGetEventEnableCondition_GetEventEnableCondition_EvtInfo_PTS_Sensor_2_Performance_or_Incorrect_Operation_B128F92: start-on-event=DemSatellite_0InternalBehavior/GetEventEnableCondition, operation=EvtInfo_PTS_Sensor_2_Performance_or_Incorrect_Operation_B128F92.GetEventEnableCondition
        OpEventGetEventEnableCondition_GetEventEnableCondition_EvtInfo_Right_Camera_Circuit_Voltage_Out_of_Range_B23C71C: start-on-event=DemSatellite_0InternalBehavior/GetEventEnableCondition, operation=EvtInfo_Right_Camera_Circuit_Voltage_Out_of_Range_B23C71C.GetEventEnableCondition
        OpEventGetEventEnableCondition_GetEventEnableCondition_EvtInfo_PTS_Sensor_8_Circuit_Open_B129513: start-on-event=DemSatellite_0InternalBehavior/GetEventEnableCondition, operation=EvtInfo_PTS_Sensor_8_Circuit_Open_B129513.GetEventEnableCondition
        OpEventGetEventEnableCondition_GetEventEnableCondition_EvtInfo_Implausible_Data_Received_from_Radio_U048500: start-on-event=DemSatellite_0InternalBehavior/GetEventEnableCondition, operation=EvtInfo_Implausible_Data_Received_from_Radio_U048500.GetEventEnableCondition
        OpEventGetEventEnableCondition_GetEventEnableCondition_EvtInfo_Implausible_Data_received_from_TRSKM_module_U14A000: start-on-event=DemSatellite_0InternalBehavior/GetEventEnableCondition, operation=EvtInfo_Implausible_Data_received_from_TRSKM_module_U14A000.GetEventEnableCondition
        OpEventGetEventEnableCondition_GetEventEnableCondition_EvtInfo_Front_Camera_Performance_or_Incorrect_Operation_B23C592: start-on-event=DemSatellite_0InternalBehavior/GetEventEnableCondition, operation=EvtInfo_Front_Camera_Performance_or_Incorrect_Operation_B23C592.GetEventEnableCondition
        OpEventGetEventEnableCondition_GetEventEnableCondition_EvtInfo_Loss_Communication_with_TRS_Knob_Module_U12B900: start-on-event=DemSatellite_0InternalBehavior/GetEventEnableCondition, operation=EvtInfo_Loss_Communication_with_TRS_Knob_Module_U12B900.GetEventEnableCondition
        OpEventGetEventEnableCondition_GetEventEnableCondition_EvtInfo_PTS_Sensor_7_Circuit_Open_B129413: start-on-event=DemSatellite_0InternalBehavior/GetEventEnableCondition, operation=EvtInfo_PTS_Sensor_7_Circuit_Open_B129413.GetEventEnableCondition
        OpEventGetEventEnableCondition_GetEventEnableCondition_EvtInfo_Front_Sensors_PS_Bus_Sig_Msg_Failures_B212A08: start-on-event=DemSatellite_0InternalBehavior/GetEventEnableCondition, operation=EvtInfo_Front_Sensors_PS_Bus_Sig_Msg_Failures_B212A08.GetEventEnableCondition
        OpEventGetEventEnableCondition_GetEventEnableCondition_EvtInfo_Lost_Communication_With_PSC_Module_A_U013100: start-on-event=DemSatellite_0InternalBehavior/GetEventEnableCondition, operation=EvtInfo_Lost_Communication_With_PSC_Module_A_U013100.GetEventEnableCondition
        OpEventGetEventEnableCondition_GetEventEnableCondition_EvtInfo_Lost_Communication_with_Front_Camera_U026500: start-on-event=DemSatellite_0InternalBehavior/GetEventEnableCondition, operation=EvtInfo_Lost_Communication_with_Front_Camera_U026500.GetEventEnableCondition
        OpEventGetEventEnableCondition_GetEventEnableCondition_EvtInfo_PTS_Sensor_3_Performance_or_Incorrect_Operation_B129092: start-on-event=DemSatellite_0InternalBehavior/GetEventEnableCondition, operation=EvtInfo_PTS_Sensor_3_Performance_or_Incorrect_Operation_B129092.GetEventEnableCondition
        OpEventGetEventEnableCondition_GetEventEnableCondition_EvtInfo_PTS_Sensor_8_Performance_or_Incorrect_Operation_B129592: start-on-event=DemSatellite_0InternalBehavior/GetEventEnableCondition, operation=EvtInfo_PTS_Sensor_8_Performance_or_Incorrect_Operation_B129592.GetEventEnableCondition
        OpEventGetEventEnableCondition_GetEventEnableCondition_EvtInfo_PPP_Assist_Switch_Stuck_B12B22A: start-on-event=DemSatellite_0InternalBehavior/GetEventEnableCondition, operation=EvtInfo_PPP_Assist_Switch_Stuck_B12B22A.GetEventEnableCondition
        OpEventGetEventEnableCondition_GetEventEnableCondition_EvtInfo_Implausible_data_received_from_ECM_U040100: start-on-event=DemSatellite_0InternalBehavior/GetEventEnableCondition, operation=EvtInfo_Implausible_data_received_from_ECM_U040100.GetEventEnableCondition
        OpEventGetEventEnableCondition_GetEventEnableCondition_EvtInfo_PTS_Sensor_10_Circuit_Open_B129713: start-on-event=DemSatellite_0InternalBehavior/GetEventEnableCondition, operation=EvtInfo_PTS_Sensor_10_Circuit_Open_B129713.GetEventEnableCondition
        OpEventGetEventEnableCondition_GetEventEnableCondition_EvtInfo_Lost_Communication_With_BSC_module_1_U012900: start-on-event=DemSatellite_0InternalBehavior/GetEventEnableCondition, operation=EvtInfo_Lost_Communication_With_BSC_module_1_U012900.GetEventEnableCondition
        OpEventGetEventEnableCondition_GetEventEnableCondition_EvtInfo_PTS_Sensor_7_Performance_or_Incorrect_Operation_B129492: start-on-event=DemSatellite_0InternalBehavior/GetEventEnableCondition, operation=EvtInfo_PTS_Sensor_7_Performance_or_Incorrect_Operation_B129492.GetEventEnableCondition
        OpEventGetEventEnableCondition_GetEventEnableCondition_EvtInfo_Left_Camera_Performance_or_Incorrect_Operation_B23C692: start-on-event=DemSatellite_0InternalBehavior/GetEventEnableCondition, operation=EvtInfo_Left_Camera_Performance_or_Incorrect_Operation_B23C692.GetEventEnableCondition
        OpEventGetEventEnableCondition_GetEventEnableCondition_EvtInfo_Vehicle_Configuration_Mismatch_B223B00: start-on-event=DemSatellite_0InternalBehavior/GetEventEnableCondition, operation=EvtInfo_Vehicle_Configuration_Mismatch_B223B00.GetEventEnableCondition
        OpEventGetEventEnableCondition_GetEventEnableCondition_EvtInfo_PTS_Sensor_6_Circuit_Open_B129313: start-on-event=DemSatellite_0InternalBehavior/GetEventEnableCondition, operation=EvtInfo_PTS_Sensor_6_Circuit_Open_B129313.GetEventEnableCondition
        OpEventGetEventEnableCondition_GetEventEnableCondition_EvtInfo_Front_Camera_Circuit_Voltage_Out_of_Range_B23C51C: start-on-event=DemSatellite_0InternalBehavior/GetEventEnableCondition, operation=EvtInfo_Front_Camera_Circuit_Voltage_Out_of_Range_B23C51C.GetEventEnableCondition
        OpEventGetEventEnableCondition_GetEventEnableCondition_EvtInfo_Implausible_Data_From_BSC_Module_1_U041800: start-on-event=DemSatellite_0InternalBehavior/GetEventEnableCondition, operation=EvtInfo_Implausible_Data_From_BSC_Module_1_U041800.GetEventEnableCondition
        OpEventGetEventEnableCondition_GetEventEnableCondition_EvtInfo_PTS_Sensor_10_Performance_or_Incorrect_Operation_B129792: start-on-event=DemSatellite_0InternalBehavior/GetEventEnableCondition, operation=EvtInfo_PTS_Sensor_10_Performance_or_Incorrect_Operation_B129792.GetEventEnableCondition
        OpEventGetEventEnableCondition_GetEventEnableCondition_EvtInfo_PTS_Sensor_11_Circuit_Open_B129813: start-on-event=DemSatellite_0InternalBehavior/GetEventEnableCondition, operation=EvtInfo_PTS_Sensor_11_Circuit_Open_B129813.GetEventEnableCondition
        OpEventGetEventEnableCondition_GetEventEnableCondition_EvtInfo_ECU_Internal_Performance_B22A900: start-on-event=DemSatellite_0InternalBehavior/GetEventEnableCondition, operation=EvtInfo_ECU_Internal_Performance_B22A900.GetEventEnableCondition
        OpEventGetEventEnableCondition_GetEventEnableCondition_EvtInfo_PTS_Sensor_9_Performance_or_Incorrect_Operation_B129692: start-on-event=DemSatellite_0InternalBehavior/GetEventEnableCondition, operation=EvtInfo_PTS_Sensor_9_Performance_or_Incorrect_Operation_B129692.GetEventEnableCondition
        OpEventGetEventEnableCondition_GetEventEnableCondition_EvtInfo_Calibration_Not_Learned_Lost_Calibration_B228600: start-on-event=DemSatellite_0InternalBehavior/GetEventEnableCondition, operation=EvtInfo_Calibration_Not_Learned_Lost_Calibration_B228600.GetEventEnableCondition
        OpEventGetEventEnableCondition_GetEventEnableCondition_EvtInfo_Lost_Communication_with_ORC_U015100: start-on-event=DemSatellite_0InternalBehavior/GetEventEnableCondition, operation=EvtInfo_Lost_Communication_with_ORC_U015100.GetEventEnableCondition
        OpEventGetEventEnableCondition_GetEventEnableCondition_EvtInfo_PTS_Sensor_1_Circuit_Open_B128E13: start-on-event=DemSatellite_0InternalBehavior/GetEventEnableCondition, operation=EvtInfo_PTS_Sensor_1_Circuit_Open_B128E13.GetEventEnableCondition
        OpEventGetEventEnableCondition_GetEventEnableCondition_EvtInfo_Lost_Communication_with_Rear_Camera_U026400: start-on-event=DemSatellite_0InternalBehavior/GetEventEnableCondition, operation=EvtInfo_Lost_Communication_with_Rear_Camera_U026400.GetEventEnableCondition
        OpEventGetEventEnableCondition_GetEventEnableCondition_EvtInfo_HS_FD_CANR_Comm_Bus_Performance_U100B00: start-on-event=DemSatellite_0InternalBehavior/GetEventEnableCondition, operation=EvtInfo_HS_FD_CANR_Comm_Bus_Performance_U100B00.GetEventEnableCondition
        OpEventGetEventEnableCondition_GetEventEnableCondition_EvtInfo_Implausible_Data_Received_From_Body_Control_Module_U042200: start-on-event=DemSatellite_0InternalBehavior/GetEventEnableCondition, operation=EvtInfo_Implausible_Data_Received_From_Body_Control_Module_U042200.GetEventEnableCondition
        OpEventGetEventEnableCondition_GetEventEnableCondition_EvtInfo_Lost_Communication_With_BCM_U014000: start-on-event=DemSatellite_0InternalBehavior/GetEventEnableCondition, operation=EvtInfo_Lost_Communication_With_BCM_U014000.GetEventEnableCondition
        OpEventGetEventEnableCondition_GetEventEnableCondition_EvtInfo_PTS_Sensor_2_Circuit_Open_B128F13: start-on-event=DemSatellite_0InternalBehavior/GetEventEnableCondition, operation=EvtInfo_PTS_Sensor_2_Circuit_Open_B128F13.GetEventEnableCondition
        OpEventGetEventEnableCondition_GetEventEnableCondition_EvtInfo_PTS_Sensor_3_Circuit_Open_B129013: start-on-event=DemSatellite_0InternalBehavior/GetEventEnableCondition, operation=EvtInfo_PTS_Sensor_3_Circuit_Open_B129013.GetEventEnableCondition
        OpEventGetEventEnableCondition_GetEventEnableCondition_EvtInfo_ECU_In_Plant_Mode_C221200: start-on-event=DemSatellite_0InternalBehavior/GetEventEnableCondition, operation=EvtInfo_ECU_In_Plant_Mode_C221200.GetEventEnableCondition
        OpEventGetEventEnableCondition_GetEventEnableCondition_EvtInfo_Implausible_Data_from_ORC_module_U045500: start-on-event=DemSatellite_0InternalBehavior/GetEventEnableCondition, operation=EvtInfo_Implausible_Data_from_ORC_module_U045500.GetEventEnableCondition
        OpEventGetEventEnableCondition_GetEventEnableCondition_EvtInfo_Right_Camera_Performance_or_Incorrect_Operation_B23C792: start-on-event=DemSatellite_0InternalBehavior/GetEventEnableCondition, operation=EvtInfo_Right_Camera_Performance_or_Incorrect_Operation_B23C792.GetEventEnableCondition
        OpEventGetEventEnableCondition_GetEventEnableCondition_EvtInfo_Rear_Sensors_PS_VltgeAboveThreshold_B212B17: start-on-event=DemSatellite_0InternalBehavior/GetEventEnableCondition, operation=EvtInfo_Rear_Sensors_PS_VltgeAboveThreshold_B212B17.GetEventEnableCondition
        OpEventGetEventEnableCondition_GetEventEnableCondition_EvtInfo_PTS_Sensor_6_Performance_or_Incorrect_Operation_B129392: start-on-event=DemSatellite_0InternalBehavior/GetEventEnableCondition, operation=EvtInfo_PTS_Sensor_6_Performance_or_Incorrect_Operation_B129392.GetEventEnableCondition
        OpEventGetEventEnableCondition_GetEventEnableCondition_GeneralEvtInfo: start-on-event=DemSatellite_0InternalBehavior/GetEventEnableCondition, operation=GeneralEvtInfo.GetEventEnableCondition
        OpEventGetDebouncingOfEvent_GetDebouncingOfEvent_EvtInfo_Dem_SystemInternalFailure: start-on-event=DemSatellite_0InternalBehavior/GetDebouncingOfEvent, operation=EvtInfo_Dem_SystemInternalFailure.GetDebouncingOfEvent
        OpEventGetDebouncingOfEvent_GetDebouncingOfEvent_EvtInfo_Invalid_Data_Received_From_Power_Steering_Control_Module_U042000: start-on-event=DemSatellite_0InternalBehavior/GetDebouncingOfEvent, operation=EvtInfo_Invalid_Data_Received_From_Power_Steering_Control_Module_U042000.GetDebouncingOfEvent
        OpEventGetDebouncingOfEvent_GetDebouncingOfEvent_EvtInfo_Lost_Communication_with_Left_Camera_U026600: start-on-event=DemSatellite_0InternalBehavior/GetDebouncingOfEvent, operation=EvtInfo_Lost_Communication_with_Left_Camera_U026600.GetDebouncingOfEvent
        OpEventGetDebouncingOfEvent_GetDebouncingOfEvent_EvtInfo_Front_Sensors_PS_VltgeBelowThreshold_B212A16: start-on-event=DemSatellite_0InternalBehavior/GetDebouncingOfEvent, operation=EvtInfo_Front_Sensors_PS_VltgeBelowThreshold_B212A16.GetDebouncingOfEvent
        OpEventGetDebouncingOfEvent_GetDebouncingOfEvent_EvtInfo_Left_Camera_Circuit_Voltage_Out_of_Range_B23C61C: start-on-event=DemSatellite_0InternalBehavior/GetDebouncingOfEvent, operation=EvtInfo_Left_Camera_Circuit_Voltage_Out_of_Range_B23C61C.GetDebouncingOfEvent
        OpEventGetDebouncingOfEvent_GetDebouncingOfEvent_EvtInfo_Rear_Sensors_PS_VltgeBelowThreshold_B212B16: start-on-event=DemSatellite_0InternalBehavior/GetDebouncingOfEvent, operation=EvtInfo_Rear_Sensors_PS_VltgeBelowThreshold_B212B16.GetDebouncingOfEvent
        OpEventGetDebouncingOfEvent_GetDebouncingOfEvent_EvtInfo_Rear_Sensors_PS_Bus_Sig_Msg_Failures_B212B08: start-on-event=DemSatellite_0InternalBehavior/GetDebouncingOfEvent, operation=EvtInfo_Rear_Sensors_PS_Bus_Sig_Msg_Failures_B212B08.GetDebouncingOfEvent
        OpEventGetDebouncingOfEvent_GetDebouncingOfEvent_EvtInfo_Rear_Camera_Circuit_Voltage_Out_of_Range_B217A1C: start-on-event=DemSatellite_0InternalBehavior/GetDebouncingOfEvent, operation=EvtInfo_Rear_Camera_Circuit_Voltage_Out_of_Range_B217A1C.GetDebouncingOfEvent
        OpEventGetDebouncingOfEvent_GetDebouncingOfEvent_EvtInfo_PTS_Sensor_12_Performance_or_Incorrect_Operation_B129992: start-on-event=DemSatellite_0InternalBehavior/GetDebouncingOfEvent, operation=EvtInfo_PTS_Sensor_12_Performance_or_Incorrect_Operation_B129992.GetDebouncingOfEvent
        OpEventGetDebouncingOfEvent_GetDebouncingOfEvent_EvtInfo_Battery_Voltage_Over_Voltage_B210C17: start-on-event=DemSatellite_0InternalBehavior/GetDebouncingOfEvent, operation=EvtInfo_Battery_Voltage_Over_Voltage_B210C17.GetDebouncingOfEvent
        OpEventGetDebouncingOfEvent_GetDebouncingOfEvent_EvtInfo_Front_Sensors_PS_VltgeAboveThreshold_B212A17: start-on-event=DemSatellite_0InternalBehavior/GetDebouncingOfEvent, operation=EvtInfo_Front_Sensors_PS_VltgeAboveThreshold_B212A17.GetDebouncingOfEvent
        OpEventGetDebouncingOfEvent_GetDebouncingOfEvent_EvtInfo_PTS_Sensor_4_Circuit_Open_B129113: start-on-event=DemSatellite_0InternalBehavior/GetDebouncingOfEvent, operation=EvtInfo_PTS_Sensor_4_Circuit_Open_B129113.GetDebouncingOfEvent
        OpEventGetDebouncingOfEvent_GetDebouncingOfEvent_EvtInfo_PTS_Sensor_12_Circuit_Open_B129913: start-on-event=DemSatellite_0InternalBehavior/GetDebouncingOfEvent, operation=EvtInfo_PTS_Sensor_12_Circuit_Open_B129913.GetDebouncingOfEvent
        OpEventGetDebouncingOfEvent_GetDebouncingOfEvent_EvtInfo_PTS_Sensor_11_Performance_or_Incorrect_Operation_B129892: start-on-event=DemSatellite_0InternalBehavior/GetDebouncingOfEvent, operation=EvtInfo_PTS_Sensor_11_Performance_or_Incorrect_Operation_B129892.GetDebouncingOfEvent
        OpEventGetDebouncingOfEvent_GetDebouncingOfEvent_EvtInfo_Lost_Communication_With_Radio_U018400: start-on-event=DemSatellite_0InternalBehavior/GetDebouncingOfEvent, operation=EvtInfo_Lost_Communication_With_Radio_U018400.GetDebouncingOfEvent
        OpEventGetDebouncingOfEvent_GetDebouncingOfEvent_EvtInfo_Park_Assist_PTS_Switch_Stuck_B12852A: start-on-event=DemSatellite_0InternalBehavior/GetDebouncingOfEvent, operation=EvtInfo_Park_Assist_PTS_Switch_Stuck_B12852A.GetDebouncingOfEvent
        OpEventGetDebouncingOfEvent_GetDebouncingOfEvent_EvtInfo_PTS_Sensor_5_Circuit_Open_B129213: start-on-event=DemSatellite_0InternalBehavior/GetDebouncingOfEvent, operation=EvtInfo_PTS_Sensor_5_Circuit_Open_B129213.GetDebouncingOfEvent
        OpEventGetDebouncingOfEvent_GetDebouncingOfEvent_EvtInfo_PTS_Sensor_5_Performance_or_Incorrect_Operation_B129292: start-on-event=DemSatellite_0InternalBehavior/GetDebouncingOfEvent, operation=EvtInfo_PTS_Sensor_5_Performance_or_Incorrect_Operation_B129292.GetDebouncingOfEvent
        OpEventGetDebouncingOfEvent_GetDebouncingOfEvent_EvtInfo_Battery_Voltage_Under_Voltage_B210C16: start-on-event=DemSatellite_0InternalBehavior/GetDebouncingOfEvent, operation=EvtInfo_Battery_Voltage_Under_Voltage_B210C16.GetDebouncingOfEvent
        OpEventGetDebouncingOfEvent_GetDebouncingOfEvent_EvtInfo_PTS_Sensor_4_Performance_or_Incorrect_Operation_B129192: start-on-event=DemSatellite_0InternalBehavior/GetDebouncingOfEvent, operation=EvtInfo_PTS_Sensor_4_Performance_or_Incorrect_Operation_B129192.GetDebouncingOfEvent
        OpEventGetDebouncingOfEvent_GetDebouncingOfEvent_EvtInfo_HS_FD_CAN2_Comm_Bus_Performance_U104E00: start-on-event=DemSatellite_0InternalBehavior/GetDebouncingOfEvent, operation=EvtInfo_HS_FD_CAN2_Comm_Bus_Performance_U104E00.GetDebouncingOfEvent
        OpEventGetDebouncingOfEvent_GetDebouncingOfEvent_EvtInfo_PTS_Sensor_9_Circuit_Open_B129613: start-on-event=DemSatellite_0InternalBehavior/GetDebouncingOfEvent, operation=EvtInfo_PTS_Sensor_9_Circuit_Open_B129613.GetDebouncingOfEvent
        OpEventGetDebouncingOfEvent_GetDebouncingOfEvent_EvtInfo_Loss_of_Comm_With_Engine_Control_Module_U010000: start-on-event=DemSatellite_0InternalBehavior/GetDebouncingOfEvent, operation=EvtInfo_Loss_of_Comm_With_Engine_Control_Module_U010000.GetDebouncingOfEvent
        OpEventGetDebouncingOfEvent_GetDebouncingOfEvent_EvtInfo_Lost_Communication_with_Right_Camera_U026700: start-on-event=DemSatellite_0InternalBehavior/GetDebouncingOfEvent, operation=EvtInfo_Lost_Communication_with_Right_Camera_U026700.GetDebouncingOfEvent
        OpEventGetDebouncingOfEvent_GetDebouncingOfEvent_EvtInfo_PTS_Sensor_1_Performance_or_Incorrect_Operation_B128E92: start-on-event=DemSatellite_0InternalBehavior/GetDebouncingOfEvent, operation=EvtInfo_PTS_Sensor_1_Performance_or_Incorrect_Operation_B128E92.GetDebouncingOfEvent
        OpEventGetDebouncingOfEvent_GetDebouncingOfEvent_EvtInfo_Rear_Camera_Performance_or_Incorrect_Operation_B217A92: start-on-event=DemSatellite_0InternalBehavior/GetDebouncingOfEvent, operation=EvtInfo_Rear_Camera_Performance_or_Incorrect_Operation_B217A92.GetDebouncingOfEvent
        OpEventGetDebouncingOfEvent_GetDebouncingOfEvent_EvtInfo_PTS_Sensor_2_Performance_or_Incorrect_Operation_B128F92: start-on-event=DemSatellite_0InternalBehavior/GetDebouncingOfEvent, operation=EvtInfo_PTS_Sensor_2_Performance_or_Incorrect_Operation_B128F92.GetDebouncingOfEvent
        OpEventGetDebouncingOfEvent_GetDebouncingOfEvent_EvtInfo_Right_Camera_Circuit_Voltage_Out_of_Range_B23C71C: start-on-event=DemSatellite_0InternalBehavior/GetDebouncingOfEvent, operation=EvtInfo_Right_Camera_Circuit_Voltage_Out_of_Range_B23C71C.GetDebouncingOfEvent
        OpEventGetDebouncingOfEvent_GetDebouncingOfEvent_EvtInfo_PTS_Sensor_8_Circuit_Open_B129513: start-on-event=DemSatellite_0InternalBehavior/GetDebouncingOfEvent, operation=EvtInfo_PTS_Sensor_8_Circuit_Open_B129513.GetDebouncingOfEvent
        OpEventGetDebouncingOfEvent_GetDebouncingOfEvent_EvtInfo_Implausible_Data_Received_from_Radio_U048500: start-on-event=DemSatellite_0InternalBehavior/GetDebouncingOfEvent, operation=EvtInfo_Implausible_Data_Received_from_Radio_U048500.GetDebouncingOfEvent
        OpEventGetDebouncingOfEvent_GetDebouncingOfEvent_EvtInfo_Implausible_Data_received_from_TRSKM_module_U14A000: start-on-event=DemSatellite_0InternalBehavior/GetDebouncingOfEvent, operation=EvtInfo_Implausible_Data_received_from_TRSKM_module_U14A000.GetDebouncingOfEvent
        OpEventGetDebouncingOfEvent_GetDebouncingOfEvent_EvtInfo_Front_Camera_Performance_or_Incorrect_Operation_B23C592: start-on-event=DemSatellite_0InternalBehavior/GetDebouncingOfEvent, operation=EvtInfo_Front_Camera_Performance_or_Incorrect_Operation_B23C592.GetDebouncingOfEvent
        OpEventGetDebouncingOfEvent_GetDebouncingOfEvent_EvtInfo_Loss_Communication_with_TRS_Knob_Module_U12B900: start-on-event=DemSatellite_0InternalBehavior/GetDebouncingOfEvent, operation=EvtInfo_Loss_Communication_with_TRS_Knob_Module_U12B900.GetDebouncingOfEvent
        OpEventGetDebouncingOfEvent_GetDebouncingOfEvent_EvtInfo_PTS_Sensor_7_Circuit_Open_B129413: start-on-event=DemSatellite_0InternalBehavior/GetDebouncingOfEvent, operation=EvtInfo_PTS_Sensor_7_Circuit_Open_B129413.GetDebouncingOfEvent
        OpEventGetDebouncingOfEvent_GetDebouncingOfEvent_EvtInfo_Front_Sensors_PS_Bus_Sig_Msg_Failures_B212A08: start-on-event=DemSatellite_0InternalBehavior/GetDebouncingOfEvent, operation=EvtInfo_Front_Sensors_PS_Bus_Sig_Msg_Failures_B212A08.GetDebouncingOfEvent
        OpEventGetDebouncingOfEvent_GetDebouncingOfEvent_EvtInfo_Lost_Communication_With_PSC_Module_A_U013100: start-on-event=DemSatellite_0InternalBehavior/GetDebouncingOfEvent, operation=EvtInfo_Lost_Communication_With_PSC_Module_A_U013100.GetDebouncingOfEvent
        OpEventGetDebouncingOfEvent_GetDebouncingOfEvent_EvtInfo_Lost_Communication_with_Front_Camera_U026500: start-on-event=DemSatellite_0InternalBehavior/GetDebouncingOfEvent, operation=EvtInfo_Lost_Communication_with_Front_Camera_U026500.GetDebouncingOfEvent
        OpEventGetDebouncingOfEvent_GetDebouncingOfEvent_EvtInfo_PTS_Sensor_3_Performance_or_Incorrect_Operation_B129092: start-on-event=DemSatellite_0InternalBehavior/GetDebouncingOfEvent, operation=EvtInfo_PTS_Sensor_3_Performance_or_Incorrect_Operation_B129092.GetDebouncingOfEvent
        OpEventGetDebouncingOfEvent_GetDebouncingOfEvent_EvtInfo_PTS_Sensor_8_Performance_or_Incorrect_Operation_B129592: start-on-event=DemSatellite_0InternalBehavior/GetDebouncingOfEvent, operation=EvtInfo_PTS_Sensor_8_Performance_or_Incorrect_Operation_B129592.GetDebouncingOfEvent
        OpEventGetDebouncingOfEvent_GetDebouncingOfEvent_EvtInfo_PPP_Assist_Switch_Stuck_B12B22A: start-on-event=DemSatellite_0InternalBehavior/GetDebouncingOfEvent, operation=EvtInfo_PPP_Assist_Switch_Stuck_B12B22A.GetDebouncingOfEvent
        OpEventGetDebouncingOfEvent_GetDebouncingOfEvent_EvtInfo_Implausible_data_received_from_ECM_U040100: start-on-event=DemSatellite_0InternalBehavior/GetDebouncingOfEvent, operation=EvtInfo_Implausible_data_received_from_ECM_U040100.GetDebouncingOfEvent
        OpEventGetDebouncingOfEvent_GetDebouncingOfEvent_EvtInfo_PTS_Sensor_10_Circuit_Open_B129713: start-on-event=DemSatellite_0InternalBehavior/GetDebouncingOfEvent, operation=EvtInfo_PTS_Sensor_10_Circuit_Open_B129713.GetDebouncingOfEvent
        OpEventGetDebouncingOfEvent_GetDebouncingOfEvent_EvtInfo_Lost_Communication_With_BSC_module_1_U012900: start-on-event=DemSatellite_0InternalBehavior/GetDebouncingOfEvent, operation=EvtInfo_Lost_Communication_With_BSC_module_1_U012900.GetDebouncingOfEvent
        OpEventGetDebouncingOfEvent_GetDebouncingOfEvent_EvtInfo_PTS_Sensor_7_Performance_or_Incorrect_Operation_B129492: start-on-event=DemSatellite_0InternalBehavior/GetDebouncingOfEvent, operation=EvtInfo_PTS_Sensor_7_Performance_or_Incorrect_Operation_B129492.GetDebouncingOfEvent
        OpEventGetDebouncingOfEvent_GetDebouncingOfEvent_EvtInfo_Left_Camera_Performance_or_Incorrect_Operation_B23C692: start-on-event=DemSatellite_0InternalBehavior/GetDebouncingOfEvent, operation=EvtInfo_Left_Camera_Performance_or_Incorrect_Operation_B23C692.GetDebouncingOfEvent
        OpEventGetDebouncingOfEvent_GetDebouncingOfEvent_EvtInfo_Vehicle_Configuration_Mismatch_B223B00: start-on-event=DemSatellite_0InternalBehavior/GetDebouncingOfEvent, operation=EvtInfo_Vehicle_Configuration_Mismatch_B223B00.GetDebouncingOfEvent
        OpEventGetDebouncingOfEvent_GetDebouncingOfEvent_EvtInfo_PTS_Sensor_6_Circuit_Open_B129313: start-on-event=DemSatellite_0InternalBehavior/GetDebouncingOfEvent, operation=EvtInfo_PTS_Sensor_6_Circuit_Open_B129313.GetDebouncingOfEvent
        OpEventGetDebouncingOfEvent_GetDebouncingOfEvent_EvtInfo_Front_Camera_Circuit_Voltage_Out_of_Range_B23C51C: start-on-event=DemSatellite_0InternalBehavior/GetDebouncingOfEvent, operation=EvtInfo_Front_Camera_Circuit_Voltage_Out_of_Range_B23C51C.GetDebouncingOfEvent
        OpEventGetDebouncingOfEvent_GetDebouncingOfEvent_EvtInfo_Implausible_Data_From_BSC_Module_1_U041800: start-on-event=DemSatellite_0InternalBehavior/GetDebouncingOfEvent, operation=EvtInfo_Implausible_Data_From_BSC_Module_1_U041800.GetDebouncingOfEvent
        OpEventGetDebouncingOfEvent_GetDebouncingOfEvent_EvtInfo_PTS_Sensor_10_Performance_or_Incorrect_Operation_B129792: start-on-event=DemSatellite_0InternalBehavior/GetDebouncingOfEvent, operation=EvtInfo_PTS_Sensor_10_Performance_or_Incorrect_Operation_B129792.GetDebouncingOfEvent
        OpEventGetDebouncingOfEvent_GetDebouncingOfEvent_EvtInfo_PTS_Sensor_11_Circuit_Open_B129813: start-on-event=DemSatellite_0InternalBehavior/GetDebouncingOfEvent, operation=EvtInfo_PTS_Sensor_11_Circuit_Open_B129813.GetDebouncingOfEvent
        OpEventGetDebouncingOfEvent_GetDebouncingOfEvent_EvtInfo_ECU_Internal_Performance_B22A900: start-on-event=DemSatellite_0InternalBehavior/GetDebouncingOfEvent, operation=EvtInfo_ECU_Internal_Performance_B22A900.GetDebouncingOfEvent
        OpEventGetDebouncingOfEvent_GetDebouncingOfEvent_EvtInfo_PTS_Sensor_9_Performance_or_Incorrect_Operation_B129692: start-on-event=DemSatellite_0InternalBehavior/GetDebouncingOfEvent, operation=EvtInfo_PTS_Sensor_9_Performance_or_Incorrect_Operation_B129692.GetDebouncingOfEvent
        OpEventGetDebouncingOfEvent_GetDebouncingOfEvent_EvtInfo_Calibration_Not_Learned_Lost_Calibration_B228600: start-on-event=DemSatellite_0InternalBehavior/GetDebouncingOfEvent, operation=EvtInfo_Calibration_Not_Learned_Lost_Calibration_B228600.GetDebouncingOfEvent
        OpEventGetDebouncingOfEvent_GetDebouncingOfEvent_EvtInfo_Lost_Communication_with_ORC_U015100: start-on-event=DemSatellite_0InternalBehavior/GetDebouncingOfEvent, operation=EvtInfo_Lost_Communication_with_ORC_U015100.GetDebouncingOfEvent
        OpEventGetDebouncingOfEvent_GetDebouncingOfEvent_EvtInfo_PTS_Sensor_1_Circuit_Open_B128E13: start-on-event=DemSatellite_0InternalBehavior/GetDebouncingOfEvent, operation=EvtInfo_PTS_Sensor_1_Circuit_Open_B128E13.GetDebouncingOfEvent
        OpEventGetDebouncingOfEvent_GetDebouncingOfEvent_EvtInfo_Lost_Communication_with_Rear_Camera_U026400: start-on-event=DemSatellite_0InternalBehavior/GetDebouncingOfEvent, operation=EvtInfo_Lost_Communication_with_Rear_Camera_U026400.GetDebouncingOfEvent
        OpEventGetDebouncingOfEvent_GetDebouncingOfEvent_EvtInfo_HS_FD_CANR_Comm_Bus_Performance_U100B00: start-on-event=DemSatellite_0InternalBehavior/GetDebouncingOfEvent, operation=EvtInfo_HS_FD_CANR_Comm_Bus_Performance_U100B00.GetDebouncingOfEvent
        OpEventGetDebouncingOfEvent_GetDebouncingOfEvent_EvtInfo_Implausible_Data_Received_From_Body_Control_Module_U042200: start-on-event=DemSatellite_0InternalBehavior/GetDebouncingOfEvent, operation=EvtInfo_Implausible_Data_Received_From_Body_Control_Module_U042200.GetDebouncingOfEvent
        OpEventGetDebouncingOfEvent_GetDebouncingOfEvent_EvtInfo_Lost_Communication_With_BCM_U014000: start-on-event=DemSatellite_0InternalBehavior/GetDebouncingOfEvent, operation=EvtInfo_Lost_Communication_With_BCM_U014000.GetDebouncingOfEvent
        OpEventGetDebouncingOfEvent_GetDebouncingOfEvent_EvtInfo_PTS_Sensor_2_Circuit_Open_B128F13: start-on-event=DemSatellite_0InternalBehavior/GetDebouncingOfEvent, operation=EvtInfo_PTS_Sensor_2_Circuit_Open_B128F13.GetDebouncingOfEvent
        OpEventGetDebouncingOfEvent_GetDebouncingOfEvent_EvtInfo_PTS_Sensor_3_Circuit_Open_B129013: start-on-event=DemSatellite_0InternalBehavior/GetDebouncingOfEvent, operation=EvtInfo_PTS_Sensor_3_Circuit_Open_B129013.GetDebouncingOfEvent
        OpEventGetDebouncingOfEvent_GetDebouncingOfEvent_EvtInfo_ECU_In_Plant_Mode_C221200: start-on-event=DemSatellite_0InternalBehavior/GetDebouncingOfEvent, operation=EvtInfo_ECU_In_Plant_Mode_C221200.GetDebouncingOfEvent
        OpEventGetDebouncingOfEvent_GetDebouncingOfEvent_EvtInfo_Implausible_Data_from_ORC_module_U045500: start-on-event=DemSatellite_0InternalBehavior/GetDebouncingOfEvent, operation=EvtInfo_Implausible_Data_from_ORC_module_U045500.GetDebouncingOfEvent
        OpEventGetDebouncingOfEvent_GetDebouncingOfEvent_EvtInfo_Right_Camera_Performance_or_Incorrect_Operation_B23C792: start-on-event=DemSatellite_0InternalBehavior/GetDebouncingOfEvent, operation=EvtInfo_Right_Camera_Performance_or_Incorrect_Operation_B23C792.GetDebouncingOfEvent
        OpEventGetDebouncingOfEvent_GetDebouncingOfEvent_EvtInfo_Rear_Sensors_PS_VltgeAboveThreshold_B212B17: start-on-event=DemSatellite_0InternalBehavior/GetDebouncingOfEvent, operation=EvtInfo_Rear_Sensors_PS_VltgeAboveThreshold_B212B17.GetDebouncingOfEvent
        OpEventGetDebouncingOfEvent_GetDebouncingOfEvent_EvtInfo_PTS_Sensor_6_Performance_or_Incorrect_Operation_B129392: start-on-event=DemSatellite_0InternalBehavior/GetDebouncingOfEvent, operation=EvtInfo_PTS_Sensor_6_Performance_or_Incorrect_Operation_B129392.GetDebouncingOfEvent
        OpEventGetDebouncingOfEvent_GetDebouncingOfEvent_GeneralEvtInfo: start-on-event=DemSatellite_0InternalBehavior/GetDebouncingOfEvent, operation=GeneralEvtInfo.GetDebouncingOfEvent
        OpEventGetMonitorStatus_GetMonitorStatus_EvtInfo_Dem_SystemInternalFailure: start-on-event=DemSatellite_0InternalBehavior/GetMonitorStatus, operation=EvtInfo_Dem_SystemInternalFailure.GetMonitorStatus
        OpEventGetMonitorStatus_GetMonitorStatus_EvtInfo_Invalid_Data_Received_From_Power_Steering_Control_Module_U042000: start-on-event=DemSatellite_0InternalBehavior/GetMonitorStatus, operation=EvtInfo_Invalid_Data_Received_From_Power_Steering_Control_Module_U042000.GetMonitorStatus
        OpEventGetMonitorStatus_GetMonitorStatus_EvtInfo_Lost_Communication_with_Left_Camera_U026600: start-on-event=DemSatellite_0InternalBehavior/GetMonitorStatus, operation=EvtInfo_Lost_Communication_with_Left_Camera_U026600.GetMonitorStatus
        OpEventGetMonitorStatus_GetMonitorStatus_EvtInfo_Front_Sensors_PS_VltgeBelowThreshold_B212A16: start-on-event=DemSatellite_0InternalBehavior/GetMonitorStatus, operation=EvtInfo_Front_Sensors_PS_VltgeBelowThreshold_B212A16.GetMonitorStatus
        OpEventGetMonitorStatus_GetMonitorStatus_EvtInfo_Left_Camera_Circuit_Voltage_Out_of_Range_B23C61C: start-on-event=DemSatellite_0InternalBehavior/GetMonitorStatus, operation=EvtInfo_Left_Camera_Circuit_Voltage_Out_of_Range_B23C61C.GetMonitorStatus
        OpEventGetMonitorStatus_GetMonitorStatus_EvtInfo_Rear_Sensors_PS_VltgeBelowThreshold_B212B16: start-on-event=DemSatellite_0InternalBehavior/GetMonitorStatus, operation=EvtInfo_Rear_Sensors_PS_VltgeBelowThreshold_B212B16.GetMonitorStatus
        OpEventGetMonitorStatus_GetMonitorStatus_EvtInfo_Rear_Sensors_PS_Bus_Sig_Msg_Failures_B212B08: start-on-event=DemSatellite_0InternalBehavior/GetMonitorStatus, operation=EvtInfo_Rear_Sensors_PS_Bus_Sig_Msg_Failures_B212B08.GetMonitorStatus
        OpEventGetMonitorStatus_GetMonitorStatus_EvtInfo_Rear_Camera_Circuit_Voltage_Out_of_Range_B217A1C: start-on-event=DemSatellite_0InternalBehavior/GetMonitorStatus, operation=EvtInfo_Rear_Camera_Circuit_Voltage_Out_of_Range_B217A1C.GetMonitorStatus
        OpEventGetMonitorStatus_GetMonitorStatus_EvtInfo_PTS_Sensor_12_Performance_or_Incorrect_Operation_B129992: start-on-event=DemSatellite_0InternalBehavior/GetMonitorStatus, operation=EvtInfo_PTS_Sensor_12_Performance_or_Incorrect_Operation_B129992.GetMonitorStatus
        OpEventGetMonitorStatus_GetMonitorStatus_EvtInfo_Battery_Voltage_Over_Voltage_B210C17: start-on-event=DemSatellite_0InternalBehavior/GetMonitorStatus, operation=EvtInfo_Battery_Voltage_Over_Voltage_B210C17.GetMonitorStatus
        OpEventGetMonitorStatus_GetMonitorStatus_EvtInfo_Front_Sensors_PS_VltgeAboveThreshold_B212A17: start-on-event=DemSatellite_0InternalBehavior/GetMonitorStatus, operation=EvtInfo_Front_Sensors_PS_VltgeAboveThreshold_B212A17.GetMonitorStatus
        OpEventGetMonitorStatus_GetMonitorStatus_EvtInfo_PTS_Sensor_4_Circuit_Open_B129113: start-on-event=DemSatellite_0InternalBehavior/GetMonitorStatus, operation=EvtInfo_PTS_Sensor_4_Circuit_Open_B129113.GetMonitorStatus
        OpEventGetMonitorStatus_GetMonitorStatus_EvtInfo_PTS_Sensor_12_Circuit_Open_B129913: start-on-event=DemSatellite_0InternalBehavior/GetMonitorStatus, operation=EvtInfo_PTS_Sensor_12_Circuit_Open_B129913.GetMonitorStatus
        OpEventGetMonitorStatus_GetMonitorStatus_EvtInfo_PTS_Sensor_11_Performance_or_Incorrect_Operation_B129892: start-on-event=DemSatellite_0InternalBehavior/GetMonitorStatus, operation=EvtInfo_PTS_Sensor_11_Performance_or_Incorrect_Operation_B129892.GetMonitorStatus
        OpEventGetMonitorStatus_GetMonitorStatus_EvtInfo_Lost_Communication_With_Radio_U018400: start-on-event=DemSatellite_0InternalBehavior/GetMonitorStatus, operation=EvtInfo_Lost_Communication_With_Radio_U018400.GetMonitorStatus
        OpEventGetMonitorStatus_GetMonitorStatus_EvtInfo_Park_Assist_PTS_Switch_Stuck_B12852A: start-on-event=DemSatellite_0InternalBehavior/GetMonitorStatus, operation=EvtInfo_Park_Assist_PTS_Switch_Stuck_B12852A.GetMonitorStatus
        OpEventGetMonitorStatus_GetMonitorStatus_EvtInfo_PTS_Sensor_5_Circuit_Open_B129213: start-on-event=DemSatellite_0InternalBehavior/GetMonitorStatus, operation=EvtInfo_PTS_Sensor_5_Circuit_Open_B129213.GetMonitorStatus
        OpEventGetMonitorStatus_GetMonitorStatus_EvtInfo_PTS_Sensor_5_Performance_or_Incorrect_Operation_B129292: start-on-event=DemSatellite_0InternalBehavior/GetMonitorStatus, operation=EvtInfo_PTS_Sensor_5_Performance_or_Incorrect_Operation_B129292.GetMonitorStatus
        OpEventGetMonitorStatus_GetMonitorStatus_EvtInfo_Battery_Voltage_Under_Voltage_B210C16: start-on-event=DemSatellite_0InternalBehavior/GetMonitorStatus, operation=EvtInfo_Battery_Voltage_Under_Voltage_B210C16.GetMonitorStatus
        OpEventGetMonitorStatus_GetMonitorStatus_EvtInfo_PTS_Sensor_4_Performance_or_Incorrect_Operation_B129192: start-on-event=DemSatellite_0InternalBehavior/GetMonitorStatus, operation=EvtInfo_PTS_Sensor_4_Performance_or_Incorrect_Operation_B129192.GetMonitorStatus
        OpEventGetMonitorStatus_GetMonitorStatus_EvtInfo_HS_FD_CAN2_Comm_Bus_Performance_U104E00: start-on-event=DemSatellite_0InternalBehavior/GetMonitorStatus, operation=EvtInfo_HS_FD_CAN2_Comm_Bus_Performance_U104E00.GetMonitorStatus
        OpEventGetMonitorStatus_GetMonitorStatus_EvtInfo_PTS_Sensor_9_Circuit_Open_B129613: start-on-event=DemSatellite_0InternalBehavior/GetMonitorStatus, operation=EvtInfo_PTS_Sensor_9_Circuit_Open_B129613.GetMonitorStatus
        OpEventGetMonitorStatus_GetMonitorStatus_EvtInfo_Loss_of_Comm_With_Engine_Control_Module_U010000: start-on-event=DemSatellite_0InternalBehavior/GetMonitorStatus, operation=EvtInfo_Loss_of_Comm_With_Engine_Control_Module_U010000.GetMonitorStatus
        OpEventGetMonitorStatus_GetMonitorStatus_EvtInfo_Lost_Communication_with_Right_Camera_U026700: start-on-event=DemSatellite_0InternalBehavior/GetMonitorStatus, operation=EvtInfo_Lost_Communication_with_Right_Camera_U026700.GetMonitorStatus
        OpEventGetMonitorStatus_GetMonitorStatus_EvtInfo_PTS_Sensor_1_Performance_or_Incorrect_Operation_B128E92: start-on-event=DemSatellite_0InternalBehavior/GetMonitorStatus, operation=EvtInfo_PTS_Sensor_1_Performance_or_Incorrect_Operation_B128E92.GetMonitorStatus
        OpEventGetMonitorStatus_GetMonitorStatus_EvtInfo_Rear_Camera_Performance_or_Incorrect_Operation_B217A92: start-on-event=DemSatellite_0InternalBehavior/GetMonitorStatus, operation=EvtInfo_Rear_Camera_Performance_or_Incorrect_Operation_B217A92.GetMonitorStatus
        OpEventGetMonitorStatus_GetMonitorStatus_EvtInfo_PTS_Sensor_2_Performance_or_Incorrect_Operation_B128F92: start-on-event=DemSatellite_0InternalBehavior/GetMonitorStatus, operation=EvtInfo_PTS_Sensor_2_Performance_or_Incorrect_Operation_B128F92.GetMonitorStatus
        OpEventGetMonitorStatus_GetMonitorStatus_EvtInfo_Right_Camera_Circuit_Voltage_Out_of_Range_B23C71C: start-on-event=DemSatellite_0InternalBehavior/GetMonitorStatus, operation=EvtInfo_Right_Camera_Circuit_Voltage_Out_of_Range_B23C71C.GetMonitorStatus
        OpEventGetMonitorStatus_GetMonitorStatus_EvtInfo_PTS_Sensor_8_Circuit_Open_B129513: start-on-event=DemSatellite_0InternalBehavior/GetMonitorStatus, operation=EvtInfo_PTS_Sensor_8_Circuit_Open_B129513.GetMonitorStatus
        OpEventGetMonitorStatus_GetMonitorStatus_EvtInfo_Implausible_Data_Received_from_Radio_U048500: start-on-event=DemSatellite_0InternalBehavior/GetMonitorStatus, operation=EvtInfo_Implausible_Data_Received_from_Radio_U048500.GetMonitorStatus
        OpEventGetMonitorStatus_GetMonitorStatus_EvtInfo_Implausible_Data_received_from_TRSKM_module_U14A000: start-on-event=DemSatellite_0InternalBehavior/GetMonitorStatus, operation=EvtInfo_Implausible_Data_received_from_TRSKM_module_U14A000.GetMonitorStatus
        OpEventGetMonitorStatus_GetMonitorStatus_EvtInfo_Front_Camera_Performance_or_Incorrect_Operation_B23C592: start-on-event=DemSatellite_0InternalBehavior/GetMonitorStatus, operation=EvtInfo_Front_Camera_Performance_or_Incorrect_Operation_B23C592.GetMonitorStatus
        OpEventGetMonitorStatus_GetMonitorStatus_EvtInfo_Loss_Communication_with_TRS_Knob_Module_U12B900: start-on-event=DemSatellite_0InternalBehavior/GetMonitorStatus, operation=EvtInfo_Loss_Communication_with_TRS_Knob_Module_U12B900.GetMonitorStatus
        OpEventGetMonitorStatus_GetMonitorStatus_EvtInfo_PTS_Sensor_7_Circuit_Open_B129413: start-on-event=DemSatellite_0InternalBehavior/GetMonitorStatus, operation=EvtInfo_PTS_Sensor_7_Circuit_Open_B129413.GetMonitorStatus
        OpEventGetMonitorStatus_GetMonitorStatus_EvtInfo_Front_Sensors_PS_Bus_Sig_Msg_Failures_B212A08: start-on-event=DemSatellite_0InternalBehavior/GetMonitorStatus, operation=EvtInfo_Front_Sensors_PS_Bus_Sig_Msg_Failures_B212A08.GetMonitorStatus
        OpEventGetMonitorStatus_GetMonitorStatus_EvtInfo_Lost_Communication_With_PSC_Module_A_U013100: start-on-event=DemSatellite_0InternalBehavior/GetMonitorStatus, operation=EvtInfo_Lost_Communication_With_PSC_Module_A_U013100.GetMonitorStatus
        OpEventGetMonitorStatus_GetMonitorStatus_EvtInfo_Lost_Communication_with_Front_Camera_U026500: start-on-event=DemSatellite_0InternalBehavior/GetMonitorStatus, operation=EvtInfo_Lost_Communication_with_Front_Camera_U026500.GetMonitorStatus
        OpEventGetMonitorStatus_GetMonitorStatus_EvtInfo_PTS_Sensor_3_Performance_or_Incorrect_Operation_B129092: start-on-event=DemSatellite_0InternalBehavior/GetMonitorStatus, operation=EvtInfo_PTS_Sensor_3_Performance_or_Incorrect_Operation_B129092.GetMonitorStatus
        OpEventGetMonitorStatus_GetMonitorStatus_EvtInfo_PTS_Sensor_8_Performance_or_Incorrect_Operation_B129592: start-on-event=DemSatellite_0InternalBehavior/GetMonitorStatus, operation=EvtInfo_PTS_Sensor_8_Performance_or_Incorrect_Operation_B129592.GetMonitorStatus
        OpEventGetMonitorStatus_GetMonitorStatus_EvtInfo_PPP_Assist_Switch_Stuck_B12B22A: start-on-event=DemSatellite_0InternalBehavior/GetMonitorStatus, operation=EvtInfo_PPP_Assist_Switch_Stuck_B12B22A.GetMonitorStatus
        OpEventGetMonitorStatus_GetMonitorStatus_EvtInfo_Implausible_data_received_from_ECM_U040100: start-on-event=DemSatellite_0InternalBehavior/GetMonitorStatus, operation=EvtInfo_Implausible_data_received_from_ECM_U040100.GetMonitorStatus
        OpEventGetMonitorStatus_GetMonitorStatus_EvtInfo_PTS_Sensor_10_Circuit_Open_B129713: start-on-event=DemSatellite_0InternalBehavior/GetMonitorStatus, operation=EvtInfo_PTS_Sensor_10_Circuit_Open_B129713.GetMonitorStatus
        OpEventGetMonitorStatus_GetMonitorStatus_EvtInfo_Lost_Communication_With_BSC_module_1_U012900: start-on-event=DemSatellite_0InternalBehavior/GetMonitorStatus, operation=EvtInfo_Lost_Communication_With_BSC_module_1_U012900.GetMonitorStatus
        OpEventGetMonitorStatus_GetMonitorStatus_EvtInfo_PTS_Sensor_7_Performance_or_Incorrect_Operation_B129492: start-on-event=DemSatellite_0InternalBehavior/GetMonitorStatus, operation=EvtInfo_PTS_Sensor_7_Performance_or_Incorrect_Operation_B129492.GetMonitorStatus
        OpEventGetMonitorStatus_GetMonitorStatus_EvtInfo_Left_Camera_Performance_or_Incorrect_Operation_B23C692: start-on-event=DemSatellite_0InternalBehavior/GetMonitorStatus, operation=EvtInfo_Left_Camera_Performance_or_Incorrect_Operation_B23C692.GetMonitorStatus
        OpEventGetMonitorStatus_GetMonitorStatus_EvtInfo_Vehicle_Configuration_Mismatch_B223B00: start-on-event=DemSatellite_0InternalBehavior/GetMonitorStatus, operation=EvtInfo_Vehicle_Configuration_Mismatch_B223B00.GetMonitorStatus
        OpEventGetMonitorStatus_GetMonitorStatus_EvtInfo_PTS_Sensor_6_Circuit_Open_B129313: start-on-event=DemSatellite_0InternalBehavior/GetMonitorStatus, operation=EvtInfo_PTS_Sensor_6_Circuit_Open_B129313.GetMonitorStatus
        OpEventGetMonitorStatus_GetMonitorStatus_EvtInfo_Front_Camera_Circuit_Voltage_Out_of_Range_B23C51C: start-on-event=DemSatellite_0InternalBehavior/GetMonitorStatus, operation=EvtInfo_Front_Camera_Circuit_Voltage_Out_of_Range_B23C51C.GetMonitorStatus
        OpEventGetMonitorStatus_GetMonitorStatus_EvtInfo_Implausible_Data_From_BSC_Module_1_U041800: start-on-event=DemSatellite_0InternalBehavior/GetMonitorStatus, operation=EvtInfo_Implausible_Data_From_BSC_Module_1_U041800.GetMonitorStatus
        OpEventGetMonitorStatus_GetMonitorStatus_EvtInfo_PTS_Sensor_10_Performance_or_Incorrect_Operation_B129792: start-on-event=DemSatellite_0InternalBehavior/GetMonitorStatus, operation=EvtInfo_PTS_Sensor_10_Performance_or_Incorrect_Operation_B129792.GetMonitorStatus
        OpEventGetMonitorStatus_GetMonitorStatus_EvtInfo_PTS_Sensor_11_Circuit_Open_B129813: start-on-event=DemSatellite_0InternalBehavior/GetMonitorStatus, operation=EvtInfo_PTS_Sensor_11_Circuit_Open_B129813.GetMonitorStatus
        OpEventGetMonitorStatus_GetMonitorStatus_EvtInfo_ECU_Internal_Performance_B22A900: start-on-event=DemSatellite_0InternalBehavior/GetMonitorStatus, operation=EvtInfo_ECU_Internal_Performance_B22A900.GetMonitorStatus
        OpEventGetMonitorStatus_GetMonitorStatus_EvtInfo_PTS_Sensor_9_Performance_or_Incorrect_Operation_B129692: start-on-event=DemSatellite_0InternalBehavior/GetMonitorStatus, operation=EvtInfo_PTS_Sensor_9_Performance_or_Incorrect_Operation_B129692.GetMonitorStatus
        OpEventGetMonitorStatus_GetMonitorStatus_EvtInfo_Calibration_Not_Learned_Lost_Calibration_B228600: start-on-event=DemSatellite_0InternalBehavior/GetMonitorStatus, operation=EvtInfo_Calibration_Not_Learned_Lost_Calibration_B228600.GetMonitorStatus
        OpEventGetMonitorStatus_GetMonitorStatus_EvtInfo_Lost_Communication_with_ORC_U015100: start-on-event=DemSatellite_0InternalBehavior/GetMonitorStatus, operation=EvtInfo_Lost_Communication_with_ORC_U015100.GetMonitorStatus
        OpEventGetMonitorStatus_GetMonitorStatus_EvtInfo_PTS_Sensor_1_Circuit_Open_B128E13: start-on-event=DemSatellite_0InternalBehavior/GetMonitorStatus, operation=EvtInfo_PTS_Sensor_1_Circuit_Open_B128E13.GetMonitorStatus
        OpEventGetMonitorStatus_GetMonitorStatus_EvtInfo_Lost_Communication_with_Rear_Camera_U026400: start-on-event=DemSatellite_0InternalBehavior/GetMonitorStatus, operation=EvtInfo_Lost_Communication_with_Rear_Camera_U026400.GetMonitorStatus
        OpEventGetMonitorStatus_GetMonitorStatus_EvtInfo_HS_FD_CANR_Comm_Bus_Performance_U100B00: start-on-event=DemSatellite_0InternalBehavior/GetMonitorStatus, operation=EvtInfo_HS_FD_CANR_Comm_Bus_Performance_U100B00.GetMonitorStatus
        OpEventGetMonitorStatus_GetMonitorStatus_EvtInfo_Implausible_Data_Received_From_Body_Control_Module_U042200: start-on-event=DemSatellite_0InternalBehavior/GetMonitorStatus, operation=EvtInfo_Implausible_Data_Received_From_Body_Control_Module_U042200.GetMonitorStatus
        OpEventGetMonitorStatus_GetMonitorStatus_EvtInfo_Lost_Communication_With_BCM_U014000: start-on-event=DemSatellite_0InternalBehavior/GetMonitorStatus, operation=EvtInfo_Lost_Communication_With_BCM_U014000.GetMonitorStatus
        OpEventGetMonitorStatus_GetMonitorStatus_EvtInfo_PTS_Sensor_2_Circuit_Open_B128F13: start-on-event=DemSatellite_0InternalBehavior/GetMonitorStatus, operation=EvtInfo_PTS_Sensor_2_Circuit_Open_B128F13.GetMonitorStatus
        OpEventGetMonitorStatus_GetMonitorStatus_EvtInfo_PTS_Sensor_3_Circuit_Open_B129013: start-on-event=DemSatellite_0InternalBehavior/GetMonitorStatus, operation=EvtInfo_PTS_Sensor_3_Circuit_Open_B129013.GetMonitorStatus
        OpEventGetMonitorStatus_GetMonitorStatus_EvtInfo_ECU_In_Plant_Mode_C221200: start-on-event=DemSatellite_0InternalBehavior/GetMonitorStatus, operation=EvtInfo_ECU_In_Plant_Mode_C221200.GetMonitorStatus
        OpEventGetMonitorStatus_GetMonitorStatus_EvtInfo_Implausible_Data_from_ORC_module_U045500: start-on-event=DemSatellite_0InternalBehavior/GetMonitorStatus, operation=EvtInfo_Implausible_Data_from_ORC_module_U045500.GetMonitorStatus
        OpEventGetMonitorStatus_GetMonitorStatus_EvtInfo_Right_Camera_Performance_or_Incorrect_Operation_B23C792: start-on-event=DemSatellite_0InternalBehavior/GetMonitorStatus, operation=EvtInfo_Right_Camera_Performance_or_Incorrect_Operation_B23C792.GetMonitorStatus
        OpEventGetMonitorStatus_GetMonitorStatus_EvtInfo_Rear_Sensors_PS_VltgeAboveThreshold_B212B17: start-on-event=DemSatellite_0InternalBehavior/GetMonitorStatus, operation=EvtInfo_Rear_Sensors_PS_VltgeAboveThreshold_B212B17.GetMonitorStatus
        OpEventGetMonitorStatus_GetMonitorStatus_EvtInfo_PTS_Sensor_6_Performance_or_Incorrect_Operation_B129392: start-on-event=DemSatellite_0InternalBehavior/GetMonitorStatus, operation=EvtInfo_PTS_Sensor_6_Performance_or_Incorrect_Operation_B129392.GetMonitorStatus
        OpEventGetMonitorStatus_GetMonitorStatus_GeneralEvtInfo: start-on-event=DemSatellite_0InternalBehavior/GetMonitorStatus, operation=GeneralEvtInfo.GetMonitorStatus
        OpEventSetEventStatus_SetEventStatus_Event_Dem_SystemInternalFailure: start-on-event=SetEventStatus, operation=Event_Dem_SystemInternalFailure.SetEventStatus
        OpEventSetEventStatus_SetEventStatus_Event_Invalid_Data_Received_From_Power_Steering_Control_Module_U042000: start-on-event=SetEventStatus, operation=Event_Invalid_Data_Received_From_Power_Steering_Control_Module_U042000.SetEventStatus
        OpEventSetEventStatus_SetEventStatus_Event_Lost_Communication_with_Left_Camera_U026600: start-on-event=SetEventStatus, operation=Event_Lost_Communication_with_Left_Camera_U026600.SetEventStatus
        OpEventSetEventStatus_SetEventStatus_Event_Front_Sensors_PS_VltgeBelowThreshold_B212A16: start-on-event=SetEventStatus, operation=Event_Front_Sensors_PS_VltgeBelowThreshold_B212A16.SetEventStatus
        OpEventSetEventStatus_SetEventStatus_Event_Left_Camera_Circuit_Voltage_Out_of_Range_B23C61C: start-on-event=SetEventStatus, operation=Event_Left_Camera_Circuit_Voltage_Out_of_Range_B23C61C.SetEventStatus
        OpEventSetEventStatus_SetEventStatus_Event_Rear_Sensors_PS_VltgeBelowThreshold_B212B16: start-on-event=SetEventStatus, operation=Event_Rear_Sensors_PS_VltgeBelowThreshold_B212B16.SetEventStatus
        OpEventSetEventStatus_SetEventStatus_Event_Rear_Sensors_PS_Bus_Sig_Msg_Failures_B212B08: start-on-event=SetEventStatus, operation=Event_Rear_Sensors_PS_Bus_Sig_Msg_Failures_B212B08.SetEventStatus
        OpEventSetEventStatus_SetEventStatus_Event_Rear_Camera_Circuit_Voltage_Out_of_Range_B217A1C: start-on-event=SetEventStatus, operation=Event_Rear_Camera_Circuit_Voltage_Out_of_Range_B217A1C.SetEventStatus
        OpEventSetEventStatus_SetEventStatus_Event_PTS_Sensor_12_Performance_or_Incorrect_Operation_B129992: start-on-event=SetEventStatus, operation=Event_PTS_Sensor_12_Performance_or_Incorrect_Operation_B129992.SetEventStatus
        OpEventSetEventStatus_SetEventStatus_Event_Battery_Voltage_Over_Voltage_B210C17: start-on-event=SetEventStatus, operation=Event_Battery_Voltage_Over_Voltage_B210C17.SetEventStatus
        OpEventSetEventStatus_SetEventStatus_Event_Front_Sensors_PS_VltgeAboveThreshold_B212A17: start-on-event=SetEventStatus, operation=Event_Front_Sensors_PS_VltgeAboveThreshold_B212A17.SetEventStatus
        OpEventSetEventStatus_SetEventStatus_Event_PTS_Sensor_4_Circuit_Open_B129113: start-on-event=SetEventStatus, operation=Event_PTS_Sensor_4_Circuit_Open_B129113.SetEventStatus
        OpEventSetEventStatus_SetEventStatus_Event_PTS_Sensor_12_Circuit_Open_B129913: start-on-event=SetEventStatus, operation=Event_PTS_Sensor_12_Circuit_Open_B129913.SetEventStatus
        OpEventSetEventStatus_SetEventStatus_Event_PTS_Sensor_11_Performance_or_Incorrect_Operation_B129892: start-on-event=SetEventStatus, operation=Event_PTS_Sensor_11_Performance_or_Incorrect_Operation_B129892.SetEventStatus
        OpEventSetEventStatus_SetEventStatus_Event_Lost_Communication_With_Radio_U018400: start-on-event=SetEventStatus, operation=Event_Lost_Communication_With_Radio_U018400.SetEventStatus
        OpEventSetEventStatus_SetEventStatus_Event_Park_Assist_PTS_Switch_Stuck_B12852A: start-on-event=SetEventStatus, operation=Event_Park_Assist_PTS_Switch_Stuck_B12852A.SetEventStatus
        OpEventSetEventStatus_SetEventStatus_Event_PTS_Sensor_5_Circuit_Open_B129213: start-on-event=SetEventStatus, operation=Event_PTS_Sensor_5_Circuit_Open_B129213.SetEventStatus
        OpEventSetEventStatus_SetEventStatus_Event_PTS_Sensor_5_Performance_or_Incorrect_Operation_B129292: start-on-event=SetEventStatus, operation=Event_PTS_Sensor_5_Performance_or_Incorrect_Operation_B129292.SetEventStatus
        OpEventSetEventStatus_SetEventStatus_Event_Battery_Voltage_Under_Voltage_B210C16: start-on-event=SetEventStatus, operation=Event_Battery_Voltage_Under_Voltage_B210C16.SetEventStatus
        OpEventSetEventStatus_SetEventStatus_Event_PTS_Sensor_4_Performance_or_Incorrect_Operation_B129192: start-on-event=SetEventStatus, operation=Event_PTS_Sensor_4_Performance_or_Incorrect_Operation_B129192.SetEventStatus
        OpEventSetEventStatus_SetEventStatus_Event_HS_FD_CAN2_Comm_Bus_Performance_U104E00: start-on-event=SetEventStatus, operation=Event_HS_FD_CAN2_Comm_Bus_Performance_U104E00.SetEventStatus
        OpEventSetEventStatus_SetEventStatus_Event_PTS_Sensor_9_Circuit_Open_B129613: start-on-event=SetEventStatus, operation=Event_PTS_Sensor_9_Circuit_Open_B129613.SetEventStatus
        OpEventSetEventStatus_SetEventStatus_Event_Loss_of_Comm_With_Engine_Control_Module_U010000: start-on-event=SetEventStatus, operation=Event_Loss_of_Comm_With_Engine_Control_Module_U010000.SetEventStatus
        OpEventSetEventStatus_SetEventStatus_Event_Lost_Communication_with_Right_Camera_U026700: start-on-event=SetEventStatus, operation=Event_Lost_Communication_with_Right_Camera_U026700.SetEventStatus
        OpEventSetEventStatus_SetEventStatus_Event_PTS_Sensor_1_Performance_or_Incorrect_Operation_B128E92: start-on-event=SetEventStatus, operation=Event_PTS_Sensor_1_Performance_or_Incorrect_Operation_B128E92.SetEventStatus
        OpEventSetEventStatus_SetEventStatus_Event_Rear_Camera_Performance_or_Incorrect_Operation_B217A92: start-on-event=SetEventStatus, operation=Event_Rear_Camera_Performance_or_Incorrect_Operation_B217A92.SetEventStatus
        OpEventSetEventStatus_SetEventStatus_Event_PTS_Sensor_2_Performance_or_Incorrect_Operation_B128F92: start-on-event=SetEventStatus, operation=Event_PTS_Sensor_2_Performance_or_Incorrect_Operation_B128F92.SetEventStatus
        OpEventSetEventStatus_SetEventStatus_Event_Right_Camera_Circuit_Voltage_Out_of_Range_B23C71C: start-on-event=SetEventStatus, operation=Event_Right_Camera_Circuit_Voltage_Out_of_Range_B23C71C.SetEventStatus
        OpEventSetEventStatus_SetEventStatus_Event_PTS_Sensor_8_Circuit_Open_B129513: start-on-event=SetEventStatus, operation=Event_PTS_Sensor_8_Circuit_Open_B129513.SetEventStatus
        OpEventSetEventStatus_SetEventStatus_Event_Implausible_Data_Received_from_Radio_U048500: start-on-event=SetEventStatus, operation=Event_Implausible_Data_Received_from_Radio_U048500.SetEventStatus
        OpEventSetEventStatus_SetEventStatus_Event_Implausible_Data_received_from_TRSKM_module_U14A000: start-on-event=SetEventStatus, operation=Event_Implausible_Data_received_from_TRSKM_module_U14A000.SetEventStatus
        OpEventSetEventStatus_SetEventStatus_Event_Front_Camera_Performance_or_Incorrect_Operation_B23C592: start-on-event=SetEventStatus, operation=Event_Front_Camera_Performance_or_Incorrect_Operation_B23C592.SetEventStatus
        OpEventSetEventStatus_SetEventStatus_Event_Loss_Communication_with_TRS_Knob_Module_U12B900: start-on-event=SetEventStatus, operation=Event_Loss_Communication_with_TRS_Knob_Module_U12B900.SetEventStatus
        OpEventSetEventStatus_SetEventStatus_Event_PTS_Sensor_7_Circuit_Open_B129413: start-on-event=SetEventStatus, operation=Event_PTS_Sensor_7_Circuit_Open_B129413.SetEventStatus
        OpEventSetEventStatus_SetEventStatus_Event_Front_Sensors_PS_Bus_Sig_Msg_Failures_B212A08: start-on-event=SetEventStatus, operation=Event_Front_Sensors_PS_Bus_Sig_Msg_Failures_B212A08.SetEventStatus
        OpEventSetEventStatus_SetEventStatus_Event_Lost_Communication_With_PSC_Module_A_U013100: start-on-event=SetEventStatus, operation=Event_Lost_Communication_With_PSC_Module_A_U013100.SetEventStatus
        OpEventSetEventStatus_SetEventStatus_Event_Lost_Communication_with_Front_Camera_U026500: start-on-event=SetEventStatus, operation=Event_Lost_Communication_with_Front_Camera_U026500.SetEventStatus
        OpEventSetEventStatus_SetEventStatus_Event_PTS_Sensor_3_Performance_or_Incorrect_Operation_B129092: start-on-event=SetEventStatus, operation=Event_PTS_Sensor_3_Performance_or_Incorrect_Operation_B129092.SetEventStatus
        OpEventSetEventStatus_SetEventStatus_Event_PTS_Sensor_8_Performance_or_Incorrect_Operation_B129592: start-on-event=SetEventStatus, operation=Event_PTS_Sensor_8_Performance_or_Incorrect_Operation_B129592.SetEventStatus
        OpEventSetEventStatus_SetEventStatus_Event_PPP_Assist_Switch_Stuck_B12B22A: start-on-event=SetEventStatus, operation=Event_PPP_Assist_Switch_Stuck_B12B22A.SetEventStatus
        OpEventSetEventStatus_SetEventStatus_Event_Implausible_data_received_from_ECM_U040100: start-on-event=SetEventStatus, operation=Event_Implausible_data_received_from_ECM_U040100.SetEventStatus
        OpEventSetEventStatus_SetEventStatus_Event_PTS_Sensor_10_Circuit_Open_B129713: start-on-event=SetEventStatus, operation=Event_PTS_Sensor_10_Circuit_Open_B129713.SetEventStatus
        OpEventSetEventStatus_SetEventStatus_Event_Lost_Communication_With_BSC_module_1_U012900: start-on-event=SetEventStatus, operation=Event_Lost_Communication_With_BSC_module_1_U012900.SetEventStatus
        OpEventSetEventStatus_SetEventStatus_Event_PTS_Sensor_7_Performance_or_Incorrect_Operation_B129492: start-on-event=SetEventStatus, operation=Event_PTS_Sensor_7_Performance_or_Incorrect_Operation_B129492.SetEventStatus
        OpEventSetEventStatus_SetEventStatus_Event_Left_Camera_Performance_or_Incorrect_Operation_B23C692: start-on-event=SetEventStatus, operation=Event_Left_Camera_Performance_or_Incorrect_Operation_B23C692.SetEventStatus
        OpEventSetEventStatus_SetEventStatus_Event_Vehicle_Configuration_Mismatch_B223B00: start-on-event=SetEventStatus, operation=Event_Vehicle_Configuration_Mismatch_B223B00.SetEventStatus
        OpEventSetEventStatus_SetEventStatus_Event_PTS_Sensor_6_Circuit_Open_B129313: start-on-event=SetEventStatus, operation=Event_PTS_Sensor_6_Circuit_Open_B129313.SetEventStatus
        OpEventSetEventStatus_SetEventStatus_Event_Front_Camera_Circuit_Voltage_Out_of_Range_B23C51C: start-on-event=SetEventStatus, operation=Event_Front_Camera_Circuit_Voltage_Out_of_Range_B23C51C.SetEventStatus
        OpEventSetEventStatus_SetEventStatus_Event_Implausible_Data_From_BSC_Module_1_U041800: start-on-event=SetEventStatus, operation=Event_Implausible_Data_From_BSC_Module_1_U041800.SetEventStatus
        OpEventSetEventStatus_SetEventStatus_Event_PTS_Sensor_10_Performance_or_Incorrect_Operation_B129792: start-on-event=SetEventStatus, operation=Event_PTS_Sensor_10_Performance_or_Incorrect_Operation_B129792.SetEventStatus
        OpEventSetEventStatus_SetEventStatus_Event_PTS_Sensor_11_Circuit_Open_B129813: start-on-event=SetEventStatus, operation=Event_PTS_Sensor_11_Circuit_Open_B129813.SetEventStatus
        OpEventSetEventStatus_SetEventStatus_Event_ECU_Internal_Performance_B22A900: start-on-event=SetEventStatus, operation=Event_ECU_Internal_Performance_B22A900.SetEventStatus
        OpEventSetEventStatus_SetEventStatus_Event_PTS_Sensor_9_Performance_or_Incorrect_Operation_B129692: start-on-event=SetEventStatus, operation=Event_PTS_Sensor_9_Performance_or_Incorrect_Operation_B129692.SetEventStatus
        OpEventSetEventStatus_SetEventStatus_Event_Calibration_Not_Learned_Lost_Calibration_B228600: start-on-event=SetEventStatus, operation=Event_Calibration_Not_Learned_Lost_Calibration_B228600.SetEventStatus
        OpEventSetEventStatus_SetEventStatus_Event_Lost_Communication_with_ORC_U015100: start-on-event=SetEventStatus, operation=Event_Lost_Communication_with_ORC_U015100.SetEventStatus
        OpEventSetEventStatus_SetEventStatus_Event_PTS_Sensor_1_Circuit_Open_B128E13: start-on-event=SetEventStatus, operation=Event_PTS_Sensor_1_Circuit_Open_B128E13.SetEventStatus
        OpEventSetEventStatus_SetEventStatus_Event_Lost_Communication_with_Rear_Camera_U026400: start-on-event=SetEventStatus, operation=Event_Lost_Communication_with_Rear_Camera_U026400.SetEventStatus
        OpEventSetEventStatus_SetEventStatus_Event_HS_FD_CANR_Comm_Bus_Performance_U100B00: start-on-event=SetEventStatus, operation=Event_HS_FD_CANR_Comm_Bus_Performance_U100B00.SetEventStatus
        OpEventSetEventStatus_SetEventStatus_Event_Implausible_Data_Received_From_Body_Control_Module_U042200: start-on-event=SetEventStatus, operation=Event_Implausible_Data_Received_From_Body_Control_Module_U042200.SetEventStatus
        OpEventSetEventStatus_SetEventStatus_Event_Lost_Communication_With_BCM_U014000: start-on-event=SetEventStatus, operation=Event_Lost_Communication_With_BCM_U014000.SetEventStatus
        OpEventSetEventStatus_SetEventStatus_Event_PTS_Sensor_2_Circuit_Open_B128F13: start-on-event=SetEventStatus, operation=Event_PTS_Sensor_2_Circuit_Open_B128F13.SetEventStatus
        OpEventSetEventStatus_SetEventStatus_Event_PTS_Sensor_3_Circuit_Open_B129013: start-on-event=SetEventStatus, operation=Event_PTS_Sensor_3_Circuit_Open_B129013.SetEventStatus
        OpEventSetEventStatus_SetEventStatus_Event_ECU_In_Plant_Mode_C221200: start-on-event=SetEventStatus, operation=Event_ECU_In_Plant_Mode_C221200.SetEventStatus
        OpEventSetEventStatus_SetEventStatus_Event_Implausible_Data_from_ORC_module_U045500: start-on-event=SetEventStatus, operation=Event_Implausible_Data_from_ORC_module_U045500.SetEventStatus
        OpEventSetEventStatus_SetEventStatus_Event_Right_Camera_Performance_or_Incorrect_Operation_B23C792: start-on-event=SetEventStatus, operation=Event_Right_Camera_Performance_or_Incorrect_Operation_B23C792.SetEventStatus
        OpEventSetEventStatus_SetEventStatus_Event_Rear_Sensors_PS_VltgeAboveThreshold_B212B17: start-on-event=SetEventStatus, operation=Event_Rear_Sensors_PS_VltgeAboveThreshold_B212B17.SetEventStatus
        OpEventSetEventStatus_SetEventStatus_Event_PTS_Sensor_6_Performance_or_Incorrect_Operation_B129392: start-on-event=SetEventStatus, operation=Event_PTS_Sensor_6_Performance_or_Incorrect_Operation_B129392.SetEventStatus
        OpEventResetEventStatus_ResetEventStatus_Event_Dem_SystemInternalFailure: start-on-event=ResetEventStatus, operation=Event_Dem_SystemInternalFailure.ResetEventStatus
        OpEventResetEventStatus_ResetEventStatus_Event_Invalid_Data_Received_From_Power_Steering_Control_Module_U042000: start-on-event=ResetEventStatus, operation=Event_Invalid_Data_Received_From_Power_Steering_Control_Module_U042000.ResetEventStatus
        OpEventResetEventStatus_ResetEventStatus_Event_Lost_Communication_with_Left_Camera_U026600: start-on-event=ResetEventStatus, operation=Event_Lost_Communication_with_Left_Camera_U026600.ResetEventStatus
        OpEventResetEventStatus_ResetEventStatus_Event_Front_Sensors_PS_VltgeBelowThreshold_B212A16: start-on-event=ResetEventStatus, operation=Event_Front_Sensors_PS_VltgeBelowThreshold_B212A16.ResetEventStatus
        OpEventResetEventStatus_ResetEventStatus_Event_Left_Camera_Circuit_Voltage_Out_of_Range_B23C61C: start-on-event=ResetEventStatus, operation=Event_Left_Camera_Circuit_Voltage_Out_of_Range_B23C61C.ResetEventStatus
        OpEventResetEventStatus_ResetEventStatus_Event_Rear_Sensors_PS_VltgeBelowThreshold_B212B16: start-on-event=ResetEventStatus, operation=Event_Rear_Sensors_PS_VltgeBelowThreshold_B212B16.ResetEventStatus
        OpEventResetEventStatus_ResetEventStatus_Event_Rear_Sensors_PS_Bus_Sig_Msg_Failures_B212B08: start-on-event=ResetEventStatus, operation=Event_Rear_Sensors_PS_Bus_Sig_Msg_Failures_B212B08.ResetEventStatus
        OpEventResetEventStatus_ResetEventStatus_Event_Rear_Camera_Circuit_Voltage_Out_of_Range_B217A1C: start-on-event=ResetEventStatus, operation=Event_Rear_Camera_Circuit_Voltage_Out_of_Range_B217A1C.ResetEventStatus
        OpEventResetEventStatus_ResetEventStatus_Event_PTS_Sensor_12_Performance_or_Incorrect_Operation_B129992: start-on-event=ResetEventStatus, operation=Event_PTS_Sensor_12_Performance_or_Incorrect_Operation_B129992.ResetEventStatus
        OpEventResetEventStatus_ResetEventStatus_Event_Battery_Voltage_Over_Voltage_B210C17: start-on-event=ResetEventStatus, operation=Event_Battery_Voltage_Over_Voltage_B210C17.ResetEventStatus
        OpEventResetEventStatus_ResetEventStatus_Event_Front_Sensors_PS_VltgeAboveThreshold_B212A17: start-on-event=ResetEventStatus, operation=Event_Front_Sensors_PS_VltgeAboveThreshold_B212A17.ResetEventStatus
        OpEventResetEventStatus_ResetEventStatus_Event_PTS_Sensor_4_Circuit_Open_B129113: start-on-event=ResetEventStatus, operation=Event_PTS_Sensor_4_Circuit_Open_B129113.ResetEventStatus
        OpEventResetEventStatus_ResetEventStatus_Event_PTS_Sensor_12_Circuit_Open_B129913: start-on-event=ResetEventStatus, operation=Event_PTS_Sensor_12_Circuit_Open_B129913.ResetEventStatus
        OpEventResetEventStatus_ResetEventStatus_Event_PTS_Sensor_11_Performance_or_Incorrect_Operation_B129892: start-on-event=ResetEventStatus, operation=Event_PTS_Sensor_11_Performance_or_Incorrect_Operation_B129892.ResetEventStatus
        OpEventResetEventStatus_ResetEventStatus_Event_Lost_Communication_With_Radio_U018400: start-on-event=ResetEventStatus, operation=Event_Lost_Communication_With_Radio_U018400.ResetEventStatus
        OpEventResetEventStatus_ResetEventStatus_Event_Park_Assist_PTS_Switch_Stuck_B12852A: start-on-event=ResetEventStatus, operation=Event_Park_Assist_PTS_Switch_Stuck_B12852A.ResetEventStatus
        OpEventResetEventStatus_ResetEventStatus_Event_PTS_Sensor_5_Circuit_Open_B129213: start-on-event=ResetEventStatus, operation=Event_PTS_Sensor_5_Circuit_Open_B129213.ResetEventStatus
        OpEventResetEventStatus_ResetEventStatus_Event_PTS_Sensor_5_Performance_or_Incorrect_Operation_B129292: start-on-event=ResetEventStatus, operation=Event_PTS_Sensor_5_Performance_or_Incorrect_Operation_B129292.ResetEventStatus
        OpEventResetEventStatus_ResetEventStatus_Event_Battery_Voltage_Under_Voltage_B210C16: start-on-event=ResetEventStatus, operation=Event_Battery_Voltage_Under_Voltage_B210C16.ResetEventStatus
        OpEventResetEventStatus_ResetEventStatus_Event_PTS_Sensor_4_Performance_or_Incorrect_Operation_B129192: start-on-event=ResetEventStatus, operation=Event_PTS_Sensor_4_Performance_or_Incorrect_Operation_B129192.ResetEventStatus
        OpEventResetEventStatus_ResetEventStatus_Event_HS_FD_CAN2_Comm_Bus_Performance_U104E00: start-on-event=ResetEventStatus, operation=Event_HS_FD_CAN2_Comm_Bus_Performance_U104E00.ResetEventStatus
        OpEventResetEventStatus_ResetEventStatus_Event_PTS_Sensor_9_Circuit_Open_B129613: start-on-event=ResetEventStatus, operation=Event_PTS_Sensor_9_Circuit_Open_B129613.ResetEventStatus
        OpEventResetEventStatus_ResetEventStatus_Event_Loss_of_Comm_With_Engine_Control_Module_U010000: start-on-event=ResetEventStatus, operation=Event_Loss_of_Comm_With_Engine_Control_Module_U010000.ResetEventStatus
        OpEventResetEventStatus_ResetEventStatus_Event_Lost_Communication_with_Right_Camera_U026700: start-on-event=ResetEventStatus, operation=Event_Lost_Communication_with_Right_Camera_U026700.ResetEventStatus
        OpEventResetEventStatus_ResetEventStatus_Event_PTS_Sensor_1_Performance_or_Incorrect_Operation_B128E92: start-on-event=ResetEventStatus, operation=Event_PTS_Sensor_1_Performance_or_Incorrect_Operation_B128E92.ResetEventStatus
        OpEventResetEventStatus_ResetEventStatus_Event_Rear_Camera_Performance_or_Incorrect_Operation_B217A92: start-on-event=ResetEventStatus, operation=Event_Rear_Camera_Performance_or_Incorrect_Operation_B217A92.ResetEventStatus
        OpEventResetEventStatus_ResetEventStatus_Event_PTS_Sensor_2_Performance_or_Incorrect_Operation_B128F92: start-on-event=ResetEventStatus, operation=Event_PTS_Sensor_2_Performance_or_Incorrect_Operation_B128F92.ResetEventStatus
        OpEventResetEventStatus_ResetEventStatus_Event_Right_Camera_Circuit_Voltage_Out_of_Range_B23C71C: start-on-event=ResetEventStatus, operation=Event_Right_Camera_Circuit_Voltage_Out_of_Range_B23C71C.ResetEventStatus
        OpEventResetEventStatus_ResetEventStatus_Event_PTS_Sensor_8_Circuit_Open_B129513: start-on-event=ResetEventStatus, operation=Event_PTS_Sensor_8_Circuit_Open_B129513.ResetEventStatus
        OpEventResetEventStatus_ResetEventStatus_Event_Implausible_Data_Received_from_Radio_U048500: start-on-event=ResetEventStatus, operation=Event_Implausible_Data_Received_from_Radio_U048500.ResetEventStatus
        OpEventResetEventStatus_ResetEventStatus_Event_Implausible_Data_received_from_TRSKM_module_U14A000: start-on-event=ResetEventStatus, operation=Event_Implausible_Data_received_from_TRSKM_module_U14A000.ResetEventStatus
        OpEventResetEventStatus_ResetEventStatus_Event_Front_Camera_Performance_or_Incorrect_Operation_B23C592: start-on-event=ResetEventStatus, operation=Event_Front_Camera_Performance_or_Incorrect_Operation_B23C592.ResetEventStatus
        OpEventResetEventStatus_ResetEventStatus_Event_Loss_Communication_with_TRS_Knob_Module_U12B900: start-on-event=ResetEventStatus, operation=Event_Loss_Communication_with_TRS_Knob_Module_U12B900.ResetEventStatus
        OpEventResetEventStatus_ResetEventStatus_Event_PTS_Sensor_7_Circuit_Open_B129413: start-on-event=ResetEventStatus, operation=Event_PTS_Sensor_7_Circuit_Open_B129413.ResetEventStatus
        OpEventResetEventStatus_ResetEventStatus_Event_Front_Sensors_PS_Bus_Sig_Msg_Failures_B212A08: start-on-event=ResetEventStatus, operation=Event_Front_Sensors_PS_Bus_Sig_Msg_Failures_B212A08.ResetEventStatus
        OpEventResetEventStatus_ResetEventStatus_Event_Lost_Communication_With_PSC_Module_A_U013100: start-on-event=ResetEventStatus, operation=Event_Lost_Communication_With_PSC_Module_A_U013100.ResetEventStatus
        OpEventResetEventStatus_ResetEventStatus_Event_Lost_Communication_with_Front_Camera_U026500: start-on-event=ResetEventStatus, operation=Event_Lost_Communication_with_Front_Camera_U026500.ResetEventStatus
        OpEventResetEventStatus_ResetEventStatus_Event_PTS_Sensor_3_Performance_or_Incorrect_Operation_B129092: start-on-event=ResetEventStatus, operation=Event_PTS_Sensor_3_Performance_or_Incorrect_Operation_B129092.ResetEventStatus
        OpEventResetEventStatus_ResetEventStatus_Event_PTS_Sensor_8_Performance_or_Incorrect_Operation_B129592: start-on-event=ResetEventStatus, operation=Event_PTS_Sensor_8_Performance_or_Incorrect_Operation_B129592.ResetEventStatus
        OpEventResetEventStatus_ResetEventStatus_Event_PPP_Assist_Switch_Stuck_B12B22A: start-on-event=ResetEventStatus, operation=Event_PPP_Assist_Switch_Stuck_B12B22A.ResetEventStatus
        OpEventResetEventStatus_ResetEventStatus_Event_Implausible_data_received_from_ECM_U040100: start-on-event=ResetEventStatus, operation=Event_Implausible_data_received_from_ECM_U040100.ResetEventStatus
        OpEventResetEventStatus_ResetEventStatus_Event_PTS_Sensor_10_Circuit_Open_B129713: start-on-event=ResetEventStatus, operation=Event_PTS_Sensor_10_Circuit_Open_B129713.ResetEventStatus
        OpEventResetEventStatus_ResetEventStatus_Event_Lost_Communication_With_BSC_module_1_U012900: start-on-event=ResetEventStatus, operation=Event_Lost_Communication_With_BSC_module_1_U012900.ResetEventStatus
        OpEventResetEventStatus_ResetEventStatus_Event_PTS_Sensor_7_Performance_or_Incorrect_Operation_B129492: start-on-event=ResetEventStatus, operation=Event_PTS_Sensor_7_Performance_or_Incorrect_Operation_B129492.ResetEventStatus
        OpEventResetEventStatus_ResetEventStatus_Event_Left_Camera_Performance_or_Incorrect_Operation_B23C692: start-on-event=ResetEventStatus, operation=Event_Left_Camera_Performance_or_Incorrect_Operation_B23C692.ResetEventStatus
        OpEventResetEventStatus_ResetEventStatus_Event_Vehicle_Configuration_Mismatch_B223B00: start-on-event=ResetEventStatus, operation=Event_Vehicle_Configuration_Mismatch_B223B00.ResetEventStatus
        OpEventResetEventStatus_ResetEventStatus_Event_PTS_Sensor_6_Circuit_Open_B129313: start-on-event=ResetEventStatus, operation=Event_PTS_Sensor_6_Circuit_Open_B129313.ResetEventStatus
        OpEventResetEventStatus_ResetEventStatus_Event_Front_Camera_Circuit_Voltage_Out_of_Range_B23C51C: start-on-event=ResetEventStatus, operation=Event_Front_Camera_Circuit_Voltage_Out_of_Range_B23C51C.ResetEventStatus
        OpEventResetEventStatus_ResetEventStatus_Event_Implausible_Data_From_BSC_Module_1_U041800: start-on-event=ResetEventStatus, operation=Event_Implausible_Data_From_BSC_Module_1_U041800.ResetEventStatus
        OpEventResetEventStatus_ResetEventStatus_Event_PTS_Sensor_10_Performance_or_Incorrect_Operation_B129792: start-on-event=ResetEventStatus, operation=Event_PTS_Sensor_10_Performance_or_Incorrect_Operation_B129792.ResetEventStatus
        OpEventResetEventStatus_ResetEventStatus_Event_PTS_Sensor_11_Circuit_Open_B129813: start-on-event=ResetEventStatus, operation=Event_PTS_Sensor_11_Circuit_Open_B129813.ResetEventStatus
        OpEventResetEventStatus_ResetEventStatus_Event_ECU_Internal_Performance_B22A900: start-on-event=ResetEventStatus, operation=Event_ECU_Internal_Performance_B22A900.ResetEventStatus
        OpEventResetEventStatus_ResetEventStatus_Event_PTS_Sensor_9_Performance_or_Incorrect_Operation_B129692: start-on-event=ResetEventStatus, operation=Event_PTS_Sensor_9_Performance_or_Incorrect_Operation_B129692.ResetEventStatus
        OpEventResetEventStatus_ResetEventStatus_Event_Calibration_Not_Learned_Lost_Calibration_B228600: start-on-event=ResetEventStatus, operation=Event_Calibration_Not_Learned_Lost_Calibration_B228600.ResetEventStatus
        OpEventResetEventStatus_ResetEventStatus_Event_Lost_Communication_with_ORC_U015100: start-on-event=ResetEventStatus, operation=Event_Lost_Communication_with_ORC_U015100.ResetEventStatus
        OpEventResetEventStatus_ResetEventStatus_Event_PTS_Sensor_1_Circuit_Open_B128E13: start-on-event=ResetEventStatus, operation=Event_PTS_Sensor_1_Circuit_Open_B128E13.ResetEventStatus
        OpEventResetEventStatus_ResetEventStatus_Event_Lost_Communication_with_Rear_Camera_U026400: start-on-event=ResetEventStatus, operation=Event_Lost_Communication_with_Rear_Camera_U026400.ResetEventStatus
        OpEventResetEventStatus_ResetEventStatus_Event_HS_FD_CANR_Comm_Bus_Performance_U100B00: start-on-event=ResetEventStatus, operation=Event_HS_FD_CANR_Comm_Bus_Performance_U100B00.ResetEventStatus
        OpEventResetEventStatus_ResetEventStatus_Event_Implausible_Data_Received_From_Body_Control_Module_U042200: start-on-event=ResetEventStatus, operation=Event_Implausible_Data_Received_From_Body_Control_Module_U042200.ResetEventStatus
        OpEventResetEventStatus_ResetEventStatus_Event_Lost_Communication_With_BCM_U014000: start-on-event=ResetEventStatus, operation=Event_Lost_Communication_With_BCM_U014000.ResetEventStatus
        OpEventResetEventStatus_ResetEventStatus_Event_PTS_Sensor_2_Circuit_Open_B128F13: start-on-event=ResetEventStatus, operation=Event_PTS_Sensor_2_Circuit_Open_B128F13.ResetEventStatus
        OpEventResetEventStatus_ResetEventStatus_Event_PTS_Sensor_3_Circuit_Open_B129013: start-on-event=ResetEventStatus, operation=Event_PTS_Sensor_3_Circuit_Open_B129013.ResetEventStatus
        OpEventResetEventStatus_ResetEventStatus_Event_ECU_In_Plant_Mode_C221200: start-on-event=ResetEventStatus, operation=Event_ECU_In_Plant_Mode_C221200.ResetEventStatus
        OpEventResetEventStatus_ResetEventStatus_Event_Implausible_Data_from_ORC_module_U045500: start-on-event=ResetEventStatus, operation=Event_Implausible_Data_from_ORC_module_U045500.ResetEventStatus
        OpEventResetEventStatus_ResetEventStatus_Event_Right_Camera_Performance_or_Incorrect_Operation_B23C792: start-on-event=ResetEventStatus, operation=Event_Right_Camera_Performance_or_Incorrect_Operation_B23C792.ResetEventStatus
        OpEventResetEventStatus_ResetEventStatus_Event_Rear_Sensors_PS_VltgeAboveThreshold_B212B17: start-on-event=ResetEventStatus, operation=Event_Rear_Sensors_PS_VltgeAboveThreshold_B212B17.ResetEventStatus
        OpEventResetEventStatus_ResetEventStatus_Event_PTS_Sensor_6_Performance_or_Incorrect_Operation_B129392: start-on-event=ResetEventStatus, operation=Event_PTS_Sensor_6_Performance_or_Incorrect_Operation_B129392.ResetEventStatus
        OpEventResetEventDebounceStatus_ResetEventDebounceStatus_Event_Dem_SystemInternalFailure: start-on-event=ResetEventDebounceStatus, operation=Event_Dem_SystemInternalFailure.ResetEventDebounceStatus
        OpEventResetEventDebounceStatus_ResetEventDebounceStatus_Event_Invalid_Data_Received_From_Power_Steering_Control_Module_U042000: start-on-event=ResetEventDebounceStatus, operation=Event_Invalid_Data_Received_From_Power_Steering_Control_Module_U042000.ResetEventDebounceStatus
        OpEventResetEventDebounceStatus_ResetEventDebounceStatus_Event_Lost_Communication_with_Left_Camera_U026600: start-on-event=ResetEventDebounceStatus, operation=Event_Lost_Communication_with_Left_Camera_U026600.ResetEventDebounceStatus
        OpEventResetEventDebounceStatus_ResetEventDebounceStatus_Event_Front_Sensors_PS_VltgeBelowThreshold_B212A16: start-on-event=ResetEventDebounceStatus, operation=Event_Front_Sensors_PS_VltgeBelowThreshold_B212A16.ResetEventDebounceStatus
        OpEventResetEventDebounceStatus_ResetEventDebounceStatus_Event_Left_Camera_Circuit_Voltage_Out_of_Range_B23C61C: start-on-event=ResetEventDebounceStatus, operation=Event_Left_Camera_Circuit_Voltage_Out_of_Range_B23C61C.ResetEventDebounceStatus
        OpEventResetEventDebounceStatus_ResetEventDebounceStatus_Event_Rear_Sensors_PS_VltgeBelowThreshold_B212B16: start-on-event=ResetEventDebounceStatus, operation=Event_Rear_Sensors_PS_VltgeBelowThreshold_B212B16.ResetEventDebounceStatus
        OpEventResetEventDebounceStatus_ResetEventDebounceStatus_Event_Rear_Sensors_PS_Bus_Sig_Msg_Failures_B212B08: start-on-event=ResetEventDebounceStatus, operation=Event_Rear_Sensors_PS_Bus_Sig_Msg_Failures_B212B08.ResetEventDebounceStatus
        OpEventResetEventDebounceStatus_ResetEventDebounceStatus_Event_Rear_Camera_Circuit_Voltage_Out_of_Range_B217A1C: start-on-event=ResetEventDebounceStatus, operation=Event_Rear_Camera_Circuit_Voltage_Out_of_Range_B217A1C.ResetEventDebounceStatus
        OpEventResetEventDebounceStatus_ResetEventDebounceStatus_Event_PTS_Sensor_12_Performance_or_Incorrect_Operation_B129992: start-on-event=ResetEventDebounceStatus, operation=Event_PTS_Sensor_12_Performance_or_Incorrect_Operation_B129992.ResetEventDebounceStatus
        OpEventResetEventDebounceStatus_ResetEventDebounceStatus_Event_Battery_Voltage_Over_Voltage_B210C17: start-on-event=ResetEventDebounceStatus, operation=Event_Battery_Voltage_Over_Voltage_B210C17.ResetEventDebounceStatus
        OpEventResetEventDebounceStatus_ResetEventDebounceStatus_Event_Front_Sensors_PS_VltgeAboveThreshold_B212A17: start-on-event=ResetEventDebounceStatus, operation=Event_Front_Sensors_PS_VltgeAboveThreshold_B212A17.ResetEventDebounceStatus
        OpEventResetEventDebounceStatus_ResetEventDebounceStatus_Event_PTS_Sensor_4_Circuit_Open_B129113: start-on-event=ResetEventDebounceStatus, operation=Event_PTS_Sensor_4_Circuit_Open_B129113.ResetEventDebounceStatus
        OpEventResetEventDebounceStatus_ResetEventDebounceStatus_Event_PTS_Sensor_12_Circuit_Open_B129913: start-on-event=ResetEventDebounceStatus, operation=Event_PTS_Sensor_12_Circuit_Open_B129913.ResetEventDebounceStatus
        OpEventResetEventDebounceStatus_ResetEventDebounceStatus_Event_PTS_Sensor_11_Performance_or_Incorrect_Operation_B129892: start-on-event=ResetEventDebounceStatus, operation=Event_PTS_Sensor_11_Performance_or_Incorrect_Operation_B129892.ResetEventDebounceStatus
        OpEventResetEventDebounceStatus_ResetEventDebounceStatus_Event_Lost_Communication_With_Radio_U018400: start-on-event=ResetEventDebounceStatus, operation=Event_Lost_Communication_With_Radio_U018400.ResetEventDebounceStatus
        OpEventResetEventDebounceStatus_ResetEventDebounceStatus_Event_Park_Assist_PTS_Switch_Stuck_B12852A: start-on-event=ResetEventDebounceStatus, operation=Event_Park_Assist_PTS_Switch_Stuck_B12852A.ResetEventDebounceStatus
        OpEventResetEventDebounceStatus_ResetEventDebounceStatus_Event_PTS_Sensor_5_Circuit_Open_B129213: start-on-event=ResetEventDebounceStatus, operation=Event_PTS_Sensor_5_Circuit_Open_B129213.ResetEventDebounceStatus
        OpEventResetEventDebounceStatus_ResetEventDebounceStatus_Event_PTS_Sensor_5_Performance_or_Incorrect_Operation_B129292: start-on-event=ResetEventDebounceStatus, operation=Event_PTS_Sensor_5_Performance_or_Incorrect_Operation_B129292.ResetEventDebounceStatus
        OpEventResetEventDebounceStatus_ResetEventDebounceStatus_Event_Battery_Voltage_Under_Voltage_B210C16: start-on-event=ResetEventDebounceStatus, operation=Event_Battery_Voltage_Under_Voltage_B210C16.ResetEventDebounceStatus
        OpEventResetEventDebounceStatus_ResetEventDebounceStatus_Event_PTS_Sensor_4_Performance_or_Incorrect_Operation_B129192: start-on-event=ResetEventDebounceStatus, operation=Event_PTS_Sensor_4_Performance_or_Incorrect_Operation_B129192.ResetEventDebounceStatus
        OpEventResetEventDebounceStatus_ResetEventDebounceStatus_Event_HS_FD_CAN2_Comm_Bus_Performance_U104E00: start-on-event=ResetEventDebounceStatus, operation=Event_HS_FD_CAN2_Comm_Bus_Performance_U104E00.ResetEventDebounceStatus
        OpEventResetEventDebounceStatus_ResetEventDebounceStatus_Event_PTS_Sensor_9_Circuit_Open_B129613: start-on-event=ResetEventDebounceStatus, operation=Event_PTS_Sensor_9_Circuit_Open_B129613.ResetEventDebounceStatus
        OpEventResetEventDebounceStatus_ResetEventDebounceStatus_Event_Loss_of_Comm_With_Engine_Control_Module_U010000: start-on-event=ResetEventDebounceStatus, operation=Event_Loss_of_Comm_With_Engine_Control_Module_U010000.ResetEventDebounceStatus
        OpEventResetEventDebounceStatus_ResetEventDebounceStatus_Event_Lost_Communication_with_Right_Camera_U026700: start-on-event=ResetEventDebounceStatus, operation=Event_Lost_Communication_with_Right_Camera_U026700.ResetEventDebounceStatus
        OpEventResetEventDebounceStatus_ResetEventDebounceStatus_Event_PTS_Sensor_1_Performance_or_Incorrect_Operation_B128E92: start-on-event=ResetEventDebounceStatus, operation=Event_PTS_Sensor_1_Performance_or_Incorrect_Operation_B128E92.ResetEventDebounceStatus
        OpEventResetEventDebounceStatus_ResetEventDebounceStatus_Event_Rear_Camera_Performance_or_Incorrect_Operation_B217A92: start-on-event=ResetEventDebounceStatus, operation=Event_Rear_Camera_Performance_or_Incorrect_Operation_B217A92.ResetEventDebounceStatus
        OpEventResetEventDebounceStatus_ResetEventDebounceStatus_Event_PTS_Sensor_2_Performance_or_Incorrect_Operation_B128F92: start-on-event=ResetEventDebounceStatus, operation=Event_PTS_Sensor_2_Performance_or_Incorrect_Operation_B128F92.ResetEventDebounceStatus
        OpEventResetEventDebounceStatus_ResetEventDebounceStatus_Event_Right_Camera_Circuit_Voltage_Out_of_Range_B23C71C: start-on-event=ResetEventDebounceStatus, operation=Event_Right_Camera_Circuit_Voltage_Out_of_Range_B23C71C.ResetEventDebounceStatus
        OpEventResetEventDebounceStatus_ResetEventDebounceStatus_Event_PTS_Sensor_8_Circuit_Open_B129513: start-on-event=ResetEventDebounceStatus, operation=Event_PTS_Sensor_8_Circuit_Open_B129513.ResetEventDebounceStatus
        OpEventResetEventDebounceStatus_ResetEventDebounceStatus_Event_Implausible_Data_Received_from_Radio_U048500: start-on-event=ResetEventDebounceStatus, operation=Event_Implausible_Data_Received_from_Radio_U048500.ResetEventDebounceStatus
        OpEventResetEventDebounceStatus_ResetEventDebounceStatus_Event_Implausible_Data_received_from_TRSKM_module_U14A000: start-on-event=ResetEventDebounceStatus, operation=Event_Implausible_Data_received_from_TRSKM_module_U14A000.ResetEventDebounceStatus
        OpEventResetEventDebounceStatus_ResetEventDebounceStatus_Event_Front_Camera_Performance_or_Incorrect_Operation_B23C592: start-on-event=ResetEventDebounceStatus, operation=Event_Front_Camera_Performance_or_Incorrect_Operation_B23C592.ResetEventDebounceStatus
        OpEventResetEventDebounceStatus_ResetEventDebounceStatus_Event_Loss_Communication_with_TRS_Knob_Module_U12B900: start-on-event=ResetEventDebounceStatus, operation=Event_Loss_Communication_with_TRS_Knob_Module_U12B900.ResetEventDebounceStatus
        OpEventResetEventDebounceStatus_ResetEventDebounceStatus_Event_PTS_Sensor_7_Circuit_Open_B129413: start-on-event=ResetEventDebounceStatus, operation=Event_PTS_Sensor_7_Circuit_Open_B129413.ResetEventDebounceStatus
        OpEventResetEventDebounceStatus_ResetEventDebounceStatus_Event_Front_Sensors_PS_Bus_Sig_Msg_Failures_B212A08: start-on-event=ResetEventDebounceStatus, operation=Event_Front_Sensors_PS_Bus_Sig_Msg_Failures_B212A08.ResetEventDebounceStatus
        OpEventResetEventDebounceStatus_ResetEventDebounceStatus_Event_Lost_Communication_With_PSC_Module_A_U013100: start-on-event=ResetEventDebounceStatus, operation=Event_Lost_Communication_With_PSC_Module_A_U013100.ResetEventDebounceStatus
        OpEventResetEventDebounceStatus_ResetEventDebounceStatus_Event_Lost_Communication_with_Front_Camera_U026500: start-on-event=ResetEventDebounceStatus, operation=Event_Lost_Communication_with_Front_Camera_U026500.ResetEventDebounceStatus
        OpEventResetEventDebounceStatus_ResetEventDebounceStatus_Event_PTS_Sensor_3_Performance_or_Incorrect_Operation_B129092: start-on-event=ResetEventDebounceStatus, operation=Event_PTS_Sensor_3_Performance_or_Incorrect_Operation_B129092.ResetEventDebounceStatus
        OpEventResetEventDebounceStatus_ResetEventDebounceStatus_Event_PTS_Sensor_8_Performance_or_Incorrect_Operation_B129592: start-on-event=ResetEventDebounceStatus, operation=Event_PTS_Sensor_8_Performance_or_Incorrect_Operation_B129592.ResetEventDebounceStatus
        OpEventResetEventDebounceStatus_ResetEventDebounceStatus_Event_PPP_Assist_Switch_Stuck_B12B22A: start-on-event=ResetEventDebounceStatus, operation=Event_PPP_Assist_Switch_Stuck_B12B22A.ResetEventDebounceStatus
        OpEventResetEventDebounceStatus_ResetEventDebounceStatus_Event_Implausible_data_received_from_ECM_U040100: start-on-event=ResetEventDebounceStatus, operation=Event_Implausible_data_received_from_ECM_U040100.ResetEventDebounceStatus
        OpEventResetEventDebounceStatus_ResetEventDebounceStatus_Event_PTS_Sensor_10_Circuit_Open_B129713: start-on-event=ResetEventDebounceStatus, operation=Event_PTS_Sensor_10_Circuit_Open_B129713.ResetEventDebounceStatus
        OpEventResetEventDebounceStatus_ResetEventDebounceStatus_Event_Lost_Communication_With_BSC_module_1_U012900: start-on-event=ResetEventDebounceStatus, operation=Event_Lost_Communication_With_BSC_module_1_U012900.ResetEventDebounceStatus
        OpEventResetEventDebounceStatus_ResetEventDebounceStatus_Event_PTS_Sensor_7_Performance_or_Incorrect_Operation_B129492: start-on-event=ResetEventDebounceStatus, operation=Event_PTS_Sensor_7_Performance_or_Incorrect_Operation_B129492.ResetEventDebounceStatus
        OpEventResetEventDebounceStatus_ResetEventDebounceStatus_Event_Left_Camera_Performance_or_Incorrect_Operation_B23C692: start-on-event=ResetEventDebounceStatus, operation=Event_Left_Camera_Performance_or_Incorrect_Operation_B23C692.ResetEventDebounceStatus
        OpEventResetEventDebounceStatus_ResetEventDebounceStatus_Event_Vehicle_Configuration_Mismatch_B223B00: start-on-event=ResetEventDebounceStatus, operation=Event_Vehicle_Configuration_Mismatch_B223B00.ResetEventDebounceStatus
        OpEventResetEventDebounceStatus_ResetEventDebounceStatus_Event_PTS_Sensor_6_Circuit_Open_B129313: start-on-event=ResetEventDebounceStatus, operation=Event_PTS_Sensor_6_Circuit_Open_B129313.ResetEventDebounceStatus
        OpEventResetEventDebounceStatus_ResetEventDebounceStatus_Event_Front_Camera_Circuit_Voltage_Out_of_Range_B23C51C: start-on-event=ResetEventDebounceStatus, operation=Event_Front_Camera_Circuit_Voltage_Out_of_Range_B23C51C.ResetEventDebounceStatus
        OpEventResetEventDebounceStatus_ResetEventDebounceStatus_Event_Implausible_Data_From_BSC_Module_1_U041800: start-on-event=ResetEventDebounceStatus, operation=Event_Implausible_Data_From_BSC_Module_1_U041800.ResetEventDebounceStatus
        OpEventResetEventDebounceStatus_ResetEventDebounceStatus_Event_PTS_Sensor_10_Performance_or_Incorrect_Operation_B129792: start-on-event=ResetEventDebounceStatus, operation=Event_PTS_Sensor_10_Performance_or_Incorrect_Operation_B129792.ResetEventDebounceStatus
        OpEventResetEventDebounceStatus_ResetEventDebounceStatus_Event_PTS_Sensor_11_Circuit_Open_B129813: start-on-event=ResetEventDebounceStatus, operation=Event_PTS_Sensor_11_Circuit_Open_B129813.ResetEventDebounceStatus
        OpEventResetEventDebounceStatus_ResetEventDebounceStatus_Event_ECU_Internal_Performance_B22A900: start-on-event=ResetEventDebounceStatus, operation=Event_ECU_Internal_Performance_B22A900.ResetEventDebounceStatus
        OpEventResetEventDebounceStatus_ResetEventDebounceStatus_Event_PTS_Sensor_9_Performance_or_Incorrect_Operation_B129692: start-on-event=ResetEventDebounceStatus, operation=Event_PTS_Sensor_9_Performance_or_Incorrect_Operation_B129692.ResetEventDebounceStatus
        OpEventResetEventDebounceStatus_ResetEventDebounceStatus_Event_Calibration_Not_Learned_Lost_Calibration_B228600: start-on-event=ResetEventDebounceStatus, operation=Event_Calibration_Not_Learned_Lost_Calibration_B228600.ResetEventDebounceStatus
        OpEventResetEventDebounceStatus_ResetEventDebounceStatus_Event_Lost_Communication_with_ORC_U015100: start-on-event=ResetEventDebounceStatus, operation=Event_Lost_Communication_with_ORC_U015100.ResetEventDebounceStatus
        OpEventResetEventDebounceStatus_ResetEventDebounceStatus_Event_PTS_Sensor_1_Circuit_Open_B128E13: start-on-event=ResetEventDebounceStatus, operation=Event_PTS_Sensor_1_Circuit_Open_B128E13.ResetEventDebounceStatus
        OpEventResetEventDebounceStatus_ResetEventDebounceStatus_Event_Lost_Communication_with_Rear_Camera_U026400: start-on-event=ResetEventDebounceStatus, operation=Event_Lost_Communication_with_Rear_Camera_U026400.ResetEventDebounceStatus
        OpEventResetEventDebounceStatus_ResetEventDebounceStatus_Event_HS_FD_CANR_Comm_Bus_Performance_U100B00: start-on-event=ResetEventDebounceStatus, operation=Event_HS_FD_CANR_Comm_Bus_Performance_U100B00.ResetEventDebounceStatus
        OpEventResetEventDebounceStatus_ResetEventDebounceStatus_Event_Implausible_Data_Received_From_Body_Control_Module_U042200: start-on-event=ResetEventDebounceStatus, operation=Event_Implausible_Data_Received_From_Body_Control_Module_U042200.ResetEventDebounceStatus
        OpEventResetEventDebounceStatus_ResetEventDebounceStatus_Event_Lost_Communication_With_BCM_U014000: start-on-event=ResetEventDebounceStatus, operation=Event_Lost_Communication_With_BCM_U014000.ResetEventDebounceStatus
        OpEventResetEventDebounceStatus_ResetEventDebounceStatus_Event_PTS_Sensor_2_Circuit_Open_B128F13: start-on-event=ResetEventDebounceStatus, operation=Event_PTS_Sensor_2_Circuit_Open_B128F13.ResetEventDebounceStatus
        OpEventResetEventDebounceStatus_ResetEventDebounceStatus_Event_PTS_Sensor_3_Circuit_Open_B129013: start-on-event=ResetEventDebounceStatus, operation=Event_PTS_Sensor_3_Circuit_Open_B129013.ResetEventDebounceStatus
        OpEventResetEventDebounceStatus_ResetEventDebounceStatus_Event_ECU_In_Plant_Mode_C221200: start-on-event=ResetEventDebounceStatus, operation=Event_ECU_In_Plant_Mode_C221200.ResetEventDebounceStatus
        OpEventResetEventDebounceStatus_ResetEventDebounceStatus_Event_Implausible_Data_from_ORC_module_U045500: start-on-event=ResetEventDebounceStatus, operation=Event_Implausible_Data_from_ORC_module_U045500.ResetEventDebounceStatus
        OpEventResetEventDebounceStatus_ResetEventDebounceStatus_Event_Right_Camera_Performance_or_Incorrect_Operation_B23C792: start-on-event=ResetEventDebounceStatus, operation=Event_Right_Camera_Performance_or_Incorrect_Operation_B23C792.ResetEventDebounceStatus
        OpEventResetEventDebounceStatus_ResetEventDebounceStatus_Event_Rear_Sensors_PS_VltgeAboveThreshold_B212B17: start-on-event=ResetEventDebounceStatus, operation=Event_Rear_Sensors_PS_VltgeAboveThreshold_B212B17.ResetEventDebounceStatus
        OpEventResetEventDebounceStatus_ResetEventDebounceStatus_Event_PTS_Sensor_6_Performance_or_Incorrect_Operation_B129392: start-on-event=ResetEventDebounceStatus, operation=Event_PTS_Sensor_6_Performance_or_Incorrect_Operation_B129392.ResetEventDebounceStatus
      port-api-options:
        {enable-take-address=true, indirect-api=false, port-defined-argument-value{value=67, value-type=Dem_EventIdType}, port=EvtInfo_Dem_SystemInternalFailure}
        {enable-take-address=true, indirect-api=false, port-defined-argument-value{value=67, value-type=Dem_EventIdType}, port=Event_Dem_SystemInternalFailure}
        {enable-take-address=true, indirect-api=false, port-defined-argument-value{value=19, value-type=Dem_EventIdType}, port=EvtInfo_Invalid_Data_Received_From_Power_Steering_Control_Module_U042000}
        {enable-take-address=true, indirect-api=false, port-defined-argument-value{value=19, value-type=Dem_EventIdType}, port=Event_Invalid_Data_Received_From_Power_Steering_Control_Module_U042000}
        {enable-take-address=true, indirect-api=false, port-defined-argument-value{value=29, value-type=Dem_EventIdType}, port=EvtInfo_Lost_Communication_with_Left_Camera_U026600}
        {enable-take-address=true, indirect-api=false, port-defined-argument-value{value=29, value-type=Dem_EventIdType}, port=Event_Lost_Communication_with_Left_Camera_U026600}
        {enable-take-address=true, indirect-api=false, port-defined-argument-value{value=10, value-type=Dem_EventIdType}, port=EvtInfo_Front_Sensors_PS_VltgeBelowThreshold_B212A16}
        {enable-take-address=true, indirect-api=false, port-defined-argument-value{value=10, value-type=Dem_EventIdType}, port=Event_Front_Sensors_PS_VltgeBelowThreshold_B212A16}
        {enable-take-address=true, indirect-api=false, port-defined-argument-value{value=20, value-type=Dem_EventIdType}, port=EvtInfo_Left_Camera_Circuit_Voltage_Out_of_Range_B23C61C}
        {enable-take-address=true, indirect-api=false, port-defined-argument-value{value=20, value-type=Dem_EventIdType}, port=Event_Left_Camera_Circuit_Voltage_Out_of_Range_B23C61C}
        {enable-take-address=true, indirect-api=false, port-defined-argument-value{value=62, value-type=Dem_EventIdType}, port=EvtInfo_Rear_Sensors_PS_VltgeBelowThreshold_B212B16}
        {enable-take-address=true, indirect-api=false, port-defined-argument-value{value=62, value-type=Dem_EventIdType}, port=Event_Rear_Sensors_PS_VltgeBelowThreshold_B212B16}
        {enable-take-address=true, indirect-api=false, port-defined-argument-value{value=60, value-type=Dem_EventIdType}, port=EvtInfo_Rear_Sensors_PS_Bus_Sig_Msg_Failures_B212B08}
        {enable-take-address=true, indirect-api=false, port-defined-argument-value{value=60, value-type=Dem_EventIdType}, port=Event_Rear_Sensors_PS_Bus_Sig_Msg_Failures_B212B08}
        {enable-take-address=true, indirect-api=false, port-defined-argument-value{value=58, value-type=Dem_EventIdType}, port=EvtInfo_Rear_Camera_Circuit_Voltage_Out_of_Range_B217A1C}
        {enable-take-address=true, indirect-api=false, port-defined-argument-value{value=58, value-type=Dem_EventIdType}, port=Event_Rear_Camera_Circuit_Voltage_Out_of_Range_B217A1C}
        {enable-take-address=true, indirect-api=false, port-defined-argument-value{value=56, value-type=Dem_EventIdType}, port=EvtInfo_PTS_Sensor_12_Performance_or_Incorrect_Operation_B129992}
        {enable-take-address=true, indirect-api=false, port-defined-argument-value{value=56, value-type=Dem_EventIdType}, port=Event_PTS_Sensor_12_Performance_or_Incorrect_Operation_B129992}
        {enable-take-address=true, indirect-api=false, port-defined-argument-value{value=1, value-type=Dem_EventIdType}, port=EvtInfo_Battery_Voltage_Over_Voltage_B210C17}
        {enable-take-address=true, indirect-api=false, port-defined-argument-value{value=1, value-type=Dem_EventIdType}, port=Event_Battery_Voltage_Over_Voltage_B210C17}
        {enable-take-address=true, indirect-api=false, port-defined-argument-value{value=9, value-type=Dem_EventIdType}, port=EvtInfo_Front_Sensors_PS_VltgeAboveThreshold_B212A17}
        {enable-take-address=true, indirect-api=false, port-defined-argument-value{value=9, value-type=Dem_EventIdType}, port=Event_Front_Sensors_PS_VltgeAboveThreshold_B212A17}
        {enable-take-address=true, indirect-api=false, port-defined-argument-value{value=40, value-type=Dem_EventIdType}, port=EvtInfo_PTS_Sensor_4_Circuit_Open_B129113}
        {enable-take-address=true, indirect-api=false, port-defined-argument-value{value=40, value-type=Dem_EventIdType}, port=Event_PTS_Sensor_4_Circuit_Open_B129113}
        {enable-take-address=true, indirect-api=false, port-defined-argument-value{value=55, value-type=Dem_EventIdType}, port=EvtInfo_PTS_Sensor_12_Circuit_Open_B129913}
        {enable-take-address=true, indirect-api=false, port-defined-argument-value{value=55, value-type=Dem_EventIdType}, port=Event_PTS_Sensor_12_Circuit_Open_B129913}
        {enable-take-address=true, indirect-api=false, port-defined-argument-value{value=54, value-type=Dem_EventIdType}, port=EvtInfo_PTS_Sensor_11_Performance_or_Incorrect_Operation_B129892}
        {enable-take-address=true, indirect-api=false, port-defined-argument-value{value=54, value-type=Dem_EventIdType}, port=Event_PTS_Sensor_11_Performance_or_Incorrect_Operation_B129892}
        {enable-take-address=true, indirect-api=false, port-defined-argument-value{value=27, value-type=Dem_EventIdType}, port=EvtInfo_Lost_Communication_With_Radio_U018400}
        {enable-take-address=true, indirect-api=false, port-defined-argument-value{value=27, value-type=Dem_EventIdType}, port=Event_Lost_Communication_With_Radio_U018400}
        {enable-take-address=true, indirect-api=false, port-defined-argument-value{value=57, value-type=Dem_EventIdType}, port=EvtInfo_Park_Assist_PTS_Switch_Stuck_B12852A}
        {enable-take-address=true, indirect-api=false, port-defined-argument-value{value=57, value-type=Dem_EventIdType}, port=Event_Park_Assist_PTS_Switch_Stuck_B12852A}
        {enable-take-address=true, indirect-api=false, port-defined-argument-value{value=42, value-type=Dem_EventIdType}, port=EvtInfo_PTS_Sensor_5_Circuit_Open_B129213}
        {enable-take-address=true, indirect-api=false, port-defined-argument-value{value=42, value-type=Dem_EventIdType}, port=Event_PTS_Sensor_5_Circuit_Open_B129213}
        {enable-take-address=true, indirect-api=false, port-defined-argument-value{value=43, value-type=Dem_EventIdType}, port=EvtInfo_PTS_Sensor_5_Performance_or_Incorrect_Operation_B129292}
        {enable-take-address=true, indirect-api=false, port-defined-argument-value{value=43, value-type=Dem_EventIdType}, port=Event_PTS_Sensor_5_Performance_or_Incorrect_Operation_B129292}
        {enable-take-address=true, indirect-api=false, port-defined-argument-value{value=2, value-type=Dem_EventIdType}, port=EvtInfo_Battery_Voltage_Under_Voltage_B210C16}
        {enable-take-address=true, indirect-api=false, port-defined-argument-value{value=2, value-type=Dem_EventIdType}, port=Event_Battery_Voltage_Under_Voltage_B210C16}
        {enable-take-address=true, indirect-api=false, port-defined-argument-value{value=41, value-type=Dem_EventIdType}, port=EvtInfo_PTS_Sensor_4_Performance_or_Incorrect_Operation_B129192}
        {enable-take-address=true, indirect-api=false, port-defined-argument-value{value=41, value-type=Dem_EventIdType}, port=Event_PTS_Sensor_4_Performance_or_Incorrect_Operation_B129192}
        {enable-take-address=true, indirect-api=false, port-defined-argument-value{value=11, value-type=Dem_EventIdType}, port=EvtInfo_HS_FD_CAN2_Comm_Bus_Performance_U104E00}
        {enable-take-address=true, indirect-api=false, port-defined-argument-value{value=11, value-type=Dem_EventIdType}, port=Event_HS_FD_CAN2_Comm_Bus_Performance_U104E00}
        {enable-take-address=true, indirect-api=false, port-defined-argument-value{value=49, value-type=Dem_EventIdType}, port=EvtInfo_PTS_Sensor_9_Circuit_Open_B129613}
        {enable-take-address=true, indirect-api=false, port-defined-argument-value{value=49, value-type=Dem_EventIdType}, port=Event_PTS_Sensor_9_Circuit_Open_B129613}
        {enable-take-address=true, indirect-api=false, port-defined-argument-value{value=23, value-type=Dem_EventIdType}, port=EvtInfo_Loss_of_Comm_With_Engine_Control_Module_U010000}
        {enable-take-address=true, indirect-api=false, port-defined-argument-value{value=23, value-type=Dem_EventIdType}, port=Event_Loss_of_Comm_With_Engine_Control_Module_U010000}
        {enable-take-address=true, indirect-api=false, port-defined-argument-value{value=32, value-type=Dem_EventIdType}, port=EvtInfo_Lost_Communication_with_Right_Camera_U026700}
        {enable-take-address=true, indirect-api=false, port-defined-argument-value{value=32, value-type=Dem_EventIdType}, port=Event_Lost_Communication_with_Right_Camera_U026700}
        {enable-take-address=true, indirect-api=false, port-defined-argument-value{value=35, value-type=Dem_EventIdType}, port=EvtInfo_PTS_Sensor_1_Performance_or_Incorrect_Operation_B128E92}
        {enable-take-address=true, indirect-api=false, port-defined-argument-value{value=35, value-type=Dem_EventIdType}, port=Event_PTS_Sensor_1_Performance_or_Incorrect_Operation_B128E92}
        {enable-take-address=true, indirect-api=false, port-defined-argument-value{value=59, value-type=Dem_EventIdType}, port=EvtInfo_Rear_Camera_Performance_or_Incorrect_Operation_B217A92}
        {enable-take-address=true, indirect-api=false, port-defined-argument-value{value=59, value-type=Dem_EventIdType}, port=Event_Rear_Camera_Performance_or_Incorrect_Operation_B217A92}
        {enable-take-address=true, indirect-api=false, port-defined-argument-value{value=37, value-type=Dem_EventIdType}, port=EvtInfo_PTS_Sensor_2_Performance_or_Incorrect_Operation_B128F92}
        {enable-take-address=true, indirect-api=false, port-defined-argument-value{value=37, value-type=Dem_EventIdType}, port=Event_PTS_Sensor_2_Performance_or_Incorrect_Operation_B128F92}
        {enable-take-address=true, indirect-api=false, port-defined-argument-value{value=63, value-type=Dem_EventIdType}, port=EvtInfo_Right_Camera_Circuit_Voltage_Out_of_Range_B23C71C}
        {enable-take-address=true, indirect-api=false, port-defined-argument-value{value=63, value-type=Dem_EventIdType}, port=Event_Right_Camera_Circuit_Voltage_Out_of_Range_B23C71C}
        {enable-take-address=true, indirect-api=false, port-defined-argument-value{value=47, value-type=Dem_EventIdType}, port=EvtInfo_PTS_Sensor_8_Circuit_Open_B129513}
        {enable-take-address=true, indirect-api=false, port-defined-argument-value{value=47, value-type=Dem_EventIdType}, port=Event_PTS_Sensor_8_Circuit_Open_B129513}
        {enable-take-address=true, indirect-api=false, port-defined-argument-value{value=15, value-type=Dem_EventIdType}, port=EvtInfo_Implausible_Data_Received_from_Radio_U048500}
        {enable-take-address=true, indirect-api=false, port-defined-argument-value{value=15, value-type=Dem_EventIdType}, port=Event_Implausible_Data_Received_from_Radio_U048500}
        {enable-take-address=true, indirect-api=false, port-defined-argument-value{value=17, value-type=Dem_EventIdType}, port=EvtInfo_Implausible_Data_received_from_TRSKM_module_U14A000}
        {enable-take-address=true, indirect-api=false, port-defined-argument-value{value=17, value-type=Dem_EventIdType}, port=Event_Implausible_Data_received_from_TRSKM_module_U14A000}
        {enable-take-address=true, indirect-api=false, port-defined-argument-value{value=7, value-type=Dem_EventIdType}, port=EvtInfo_Front_Camera_Performance_or_Incorrect_Operation_B23C592}
        {enable-take-address=true, indirect-api=false, port-defined-argument-value{value=7, value-type=Dem_EventIdType}, port=Event_Front_Camera_Performance_or_Incorrect_Operation_B23C592}
        {enable-take-address=true, indirect-api=false, port-defined-argument-value{value=22, value-type=Dem_EventIdType}, port=EvtInfo_Loss_Communication_with_TRS_Knob_Module_U12B900}
        {enable-take-address=true, indirect-api=false, port-defined-argument-value{value=22, value-type=Dem_EventIdType}, port=Event_Loss_Communication_with_TRS_Knob_Module_U12B900}
        {enable-take-address=true, indirect-api=false, port-defined-argument-value{value=45, value-type=Dem_EventIdType}, port=EvtInfo_PTS_Sensor_7_Circuit_Open_B129413}
        {enable-take-address=true, indirect-api=false, port-defined-argument-value{value=45, value-type=Dem_EventIdType}, port=Event_PTS_Sensor_7_Circuit_Open_B129413}
        {enable-take-address=true, indirect-api=false, port-defined-argument-value{value=8, value-type=Dem_EventIdType}, port=EvtInfo_Front_Sensors_PS_Bus_Sig_Msg_Failures_B212A08}
        {enable-take-address=true, indirect-api=false, port-defined-argument-value{value=8, value-type=Dem_EventIdType}, port=Event_Front_Sensors_PS_Bus_Sig_Msg_Failures_B212A08}
        {enable-take-address=true, indirect-api=false, port-defined-argument-value{value=26, value-type=Dem_EventIdType}, port=EvtInfo_Lost_Communication_With_PSC_Module_A_U013100}
        {enable-take-address=true, indirect-api=false, port-defined-argument-value{value=26, value-type=Dem_EventIdType}, port=Event_Lost_Communication_With_PSC_Module_A_U013100}
        {enable-take-address=true, indirect-api=false, port-defined-argument-value{value=28, value-type=Dem_EventIdType}, port=EvtInfo_Lost_Communication_with_Front_Camera_U026500}
        {enable-take-address=true, indirect-api=false, port-defined-argument-value{value=28, value-type=Dem_EventIdType}, port=Event_Lost_Communication_with_Front_Camera_U026500}
        {enable-take-address=true, indirect-api=false, port-defined-argument-value{value=39, value-type=Dem_EventIdType}, port=EvtInfo_PTS_Sensor_3_Performance_or_Incorrect_Operation_B129092}
        {enable-take-address=true, indirect-api=false, port-defined-argument-value{value=39, value-type=Dem_EventIdType}, port=Event_PTS_Sensor_3_Performance_or_Incorrect_Operation_B129092}
        {enable-take-address=true, indirect-api=false, port-defined-argument-value{value=48, value-type=Dem_EventIdType}, port=EvtInfo_PTS_Sensor_8_Performance_or_Incorrect_Operation_B129592}
        {enable-take-address=true, indirect-api=false, port-defined-argument-value{value=48, value-type=Dem_EventIdType}, port=Event_PTS_Sensor_8_Performance_or_Incorrect_Operation_B129592}
        {enable-take-address=true, indirect-api=false, port-defined-argument-value{value=33, value-type=Dem_EventIdType}, port=EvtInfo_PPP_Assist_Switch_Stuck_B12B22A}
        {enable-take-address=true, indirect-api=false, port-defined-argument-value{value=33, value-type=Dem_EventIdType}, port=Event_PPP_Assist_Switch_Stuck_B12B22A}
        {enable-take-address=true, indirect-api=false, port-defined-argument-value{value=18, value-type=Dem_EventIdType}, port=EvtInfo_Implausible_data_received_from_ECM_U040100}
        {enable-take-address=true, indirect-api=false, port-defined-argument-value{value=18, value-type=Dem_EventIdType}, port=Event_Implausible_data_received_from_ECM_U040100}
        {enable-take-address=true, indirect-api=false, port-defined-argument-value{value=51, value-type=Dem_EventIdType}, port=EvtInfo_PTS_Sensor_10_Circuit_Open_B129713}
        {enable-take-address=true, indirect-api=false, port-defined-argument-value{value=51, value-type=Dem_EventIdType}, port=Event_PTS_Sensor_10_Circuit_Open_B129713}
        {enable-take-address=true, indirect-api=false, port-defined-argument-value{value=25, value-type=Dem_EventIdType}, port=EvtInfo_Lost_Communication_With_BSC_module_1_U012900}
        {enable-take-address=true, indirect-api=false, port-defined-argument-value{value=25, value-type=Dem_EventIdType}, port=Event_Lost_Communication_With_BSC_module_1_U012900}
        {enable-take-address=true, indirect-api=false, port-defined-argument-value{value=46, value-type=Dem_EventIdType}, port=EvtInfo_PTS_Sensor_7_Performance_or_Incorrect_Operation_B129492}
        {enable-take-address=true, indirect-api=false, port-defined-argument-value{value=46, value-type=Dem_EventIdType}, port=Event_PTS_Sensor_7_Performance_or_Incorrect_Operation_B129492}
        {enable-take-address=true, indirect-api=false, port-defined-argument-value{value=21, value-type=Dem_EventIdType}, port=EvtInfo_Left_Camera_Performance_or_Incorrect_Operation_B23C692}
        {enable-take-address=true, indirect-api=false, port-defined-argument-value{value=21, value-type=Dem_EventIdType}, port=Event_Left_Camera_Performance_or_Incorrect_Operation_B23C692}
        {enable-take-address=true, indirect-api=false, port-defined-argument-value{value=65, value-type=Dem_EventIdType}, port=EvtInfo_Vehicle_Configuration_Mismatch_B223B00}
        {enable-take-address=true, indirect-api=false, port-defined-argument-value{value=65, value-type=Dem_EventIdType}, port=Event_Vehicle_Configuration_Mismatch_B223B00}
        {enable-take-address=true, indirect-api=false, port-defined-argument-value{value=44, value-type=Dem_EventIdType}, port=EvtInfo_PTS_Sensor_6_Circuit_Open_B129313}
        {enable-take-address=true, indirect-api=false, port-defined-argument-value{value=44, value-type=Dem_EventIdType}, port=Event_PTS_Sensor_6_Circuit_Open_B129313}
        {enable-take-address=true, indirect-api=false, port-defined-argument-value{value=6, value-type=Dem_EventIdType}, port=EvtInfo_Front_Camera_Circuit_Voltage_Out_of_Range_B23C51C}
        {enable-take-address=true, indirect-api=false, port-defined-argument-value{value=6, value-type=Dem_EventIdType}, port=Event_Front_Camera_Circuit_Voltage_Out_of_Range_B23C51C}
        {enable-take-address=true, indirect-api=false, port-defined-argument-value{value=13, value-type=Dem_EventIdType}, port=EvtInfo_Implausible_Data_From_BSC_Module_1_U041800}
        {enable-take-address=true, indirect-api=false, port-defined-argument-value{value=13, value-type=Dem_EventIdType}, port=Event_Implausible_Data_From_BSC_Module_1_U041800}
        {enable-take-address=true, indirect-api=false, port-defined-argument-value{value=52, value-type=Dem_EventIdType}, port=EvtInfo_PTS_Sensor_10_Performance_or_Incorrect_Operation_B129792}
        {enable-take-address=true, indirect-api=false, port-defined-argument-value{value=52, value-type=Dem_EventIdType}, port=Event_PTS_Sensor_10_Performance_or_Incorrect_Operation_B129792}
        {enable-take-address=true, indirect-api=false, port-defined-argument-value{value=53, value-type=Dem_EventIdType}, port=EvtInfo_PTS_Sensor_11_Circuit_Open_B129813}
        {enable-take-address=true, indirect-api=false, port-defined-argument-value{value=53, value-type=Dem_EventIdType}, port=Event_PTS_Sensor_11_Circuit_Open_B129813}
        {enable-take-address=true, indirect-api=false, port-defined-argument-value{value=5, value-type=Dem_EventIdType}, port=EvtInfo_ECU_Internal_Performance_B22A900}
        {enable-take-address=true, indirect-api=false, port-defined-argument-value{value=5, value-type=Dem_EventIdType}, port=Event_ECU_Internal_Performance_B22A900}
        {enable-take-address=true, indirect-api=false, port-defined-argument-value{value=50, value-type=Dem_EventIdType}, port=EvtInfo_PTS_Sensor_9_Performance_or_Incorrect_Operation_B129692}
        {enable-take-address=true, indirect-api=false, port-defined-argument-value{value=50, value-type=Dem_EventIdType}, port=Event_PTS_Sensor_9_Performance_or_Incorrect_Operation_B129692}
        {enable-take-address=true, indirect-api=false, port-defined-argument-value{value=3, value-type=Dem_EventIdType}, port=EvtInfo_Calibration_Not_Learned_Lost_Calibration_B228600}
        {enable-take-address=true, indirect-api=false, port-defined-argument-value{value=3, value-type=Dem_EventIdType}, port=Event_Calibration_Not_Learned_Lost_Calibration_B228600}
        {enable-take-address=true, indirect-api=false, port-defined-argument-value{value=30, value-type=Dem_EventIdType}, port=EvtInfo_Lost_Communication_with_ORC_U015100}
        {enable-take-address=true, indirect-api=false, port-defined-argument-value{value=30, value-type=Dem_EventIdType}, port=Event_Lost_Communication_with_ORC_U015100}
        {enable-take-address=true, indirect-api=false, port-defined-argument-value{value=34, value-type=Dem_EventIdType}, port=EvtInfo_PTS_Sensor_1_Circuit_Open_B128E13}
        {enable-take-address=true, indirect-api=false, port-defined-argument-value{value=34, value-type=Dem_EventIdType}, port=Event_PTS_Sensor_1_Circuit_Open_B128E13}
        {enable-take-address=true, indirect-api=false, port-defined-argument-value{value=31, value-type=Dem_EventIdType}, port=EvtInfo_Lost_Communication_with_Rear_Camera_U026400}
        {enable-take-address=true, indirect-api=false, port-defined-argument-value{value=31, value-type=Dem_EventIdType}, port=Event_Lost_Communication_with_Rear_Camera_U026400}
        {enable-take-address=true, indirect-api=false, port-defined-argument-value{value=12, value-type=Dem_EventIdType}, port=EvtInfo_HS_FD_CANR_Comm_Bus_Performance_U100B00}
        {enable-take-address=true, indirect-api=false, port-defined-argument-value{value=12, value-type=Dem_EventIdType}, port=Event_HS_FD_CANR_Comm_Bus_Performance_U100B00}
        {enable-take-address=true, indirect-api=false, port-defined-argument-value{value=14, value-type=Dem_EventIdType}, port=EvtInfo_Implausible_Data_Received_From_Body_Control_Module_U042200}
        {enable-take-address=true, indirect-api=false, port-defined-argument-value{value=14, value-type=Dem_EventIdType}, port=Event_Implausible_Data_Received_From_Body_Control_Module_U042200}
        {enable-take-address=true, indirect-api=false, port-defined-argument-value{value=24, value-type=Dem_EventIdType}, port=EvtInfo_Lost_Communication_With_BCM_U014000}
        {enable-take-address=true, indirect-api=false, port-defined-argument-value{value=24, value-type=Dem_EventIdType}, port=Event_Lost_Communication_With_BCM_U014000}
        {enable-take-address=true, indirect-api=false, port-defined-argument-value{value=36, value-type=Dem_EventIdType}, port=EvtInfo_PTS_Sensor_2_Circuit_Open_B128F13}
        {enable-take-address=true, indirect-api=false, port-defined-argument-value{value=36, value-type=Dem_EventIdType}, port=Event_PTS_Sensor_2_Circuit_Open_B128F13}
        {enable-take-address=true, indirect-api=false, port-defined-argument-value{value=38, value-type=Dem_EventIdType}, port=EvtInfo_PTS_Sensor_3_Circuit_Open_B129013}
        {enable-take-address=true, indirect-api=false, port-defined-argument-value{value=38, value-type=Dem_EventIdType}, port=Event_PTS_Sensor_3_Circuit_Open_B129013}
        {enable-take-address=true, indirect-api=false, port-defined-argument-value{value=4, value-type=Dem_EventIdType}, port=EvtInfo_ECU_In_Plant_Mode_C221200}
        {enable-take-address=true, indirect-api=false, port-defined-argument-value{value=4, value-type=Dem_EventIdType}, port=Event_ECU_In_Plant_Mode_C221200}
        {enable-take-address=true, indirect-api=false, port-defined-argument-value{value=16, value-type=Dem_EventIdType}, port=EvtInfo_Implausible_Data_from_ORC_module_U045500}
        {enable-take-address=true, indirect-api=false, port-defined-argument-value{value=16, value-type=Dem_EventIdType}, port=Event_Implausible_Data_from_ORC_module_U045500}
        {enable-take-address=true, indirect-api=false, port-defined-argument-value{value=64, value-type=Dem_EventIdType}, port=EvtInfo_Right_Camera_Performance_or_Incorrect_Operation_B23C792}
        {enable-take-address=true, indirect-api=false, port-defined-argument-value{value=64, value-type=Dem_EventIdType}, port=Event_Right_Camera_Performance_or_Incorrect_Operation_B23C792}
        {enable-take-address=true, indirect-api=false, port-defined-argument-value{value=61, value-type=Dem_EventIdType}, port=EvtInfo_Rear_Sensors_PS_VltgeAboveThreshold_B212B17}
        {enable-take-address=true, indirect-api=false, port-defined-argument-value{value=61, value-type=Dem_EventIdType}, port=Event_Rear_Sensors_PS_VltgeAboveThreshold_B212B17}
        {enable-take-address=true, indirect-api=false, port-defined-argument-value{value=66, value-type=Dem_EventIdType}, port=EvtInfo_PTS_Sensor_6_Performance_or_Incorrect_Operation_B129392}
        {enable-take-address=true, indirect-api=false, port-defined-argument-value{value=66, value-type=Dem_EventIdType}, port=Event_PTS_Sensor_6_Performance_or_Incorrect_Operation_B129392}
        enable-take-address=true, indirect-api=false, port=DemSatellite_0/GeneralEvtInfo
        enable-take-address=true, indirect-api=false, port=DemSatellite_0/CBReadData_Data_DID_0x1004_Battery_Voltage_24
        enable-take-address=true, indirect-api=false, port=DemSatellite_0/CBReadData_Data_DID_0x1008_ECU_Life_Time_24
        enable-take-address=true, indirect-api=false, port=DemSatellite_0/CBReadData_Data_DID_0x1009_ECU_Time_Since_Ignition_ON
        enable-take-address=true, indirect-api=false, port=DemSatellite_0/CBReadData_Data_OccurrenceCounter_Aging_Counter_ID
        enable-take-address=true, indirect-api=false, port=DemSatellite_0/CBReadData_Data_OccurrenceCounter_Frequency_Counter_ID
        enable-take-address=true, indirect-api=false, port=DemSatellite_0/CBReadData_Data_DID_0x200a_Ignition_ON_Counter_24
        enable-take-address=true, indirect-api=false, port=DemSatellite_0/CBReadData_Data_DID_0x1002_Vehicle_Speed_24
        enable-take-address=true, indirect-api=false, port=DemSatellite_0/CBReadData_Data_DID_0x2001_Odometer_24
        enable-take-address=true, indirect-api=false, port=DemSatellite_0/CBReadData_Data_OccurrenceCounter_Touch_Screen_Y_Coordinate
        enable-take-address=true, indirect-api=false, port=DemSatellite_0/CBReadData_Data_OccurrenceCounter_Odometer_Value
        enable-take-address=true, indirect-api=false, port=DemSatellite_0/CBReadData_Data_OccurrenceCounter_Camera_Occlusion
        enable-take-address=true, indirect-api=false, port=DemSatellite_0/CBReadData_Data_OccurrenceCounter_THA_state
        enable-take-address=true, indirect-api=false, port=DemSatellite_0/CBReadData_Data_OccurrenceCounter_Supplier_Internal_Code
        enable-take-address=true, indirect-api=false, port=DemSatellite_0/CBReadData_Data_OccurrenceCounter_Current_Gear
        enable-take-address=true, indirect-api=false, port=DemSatellite_0/CBReadData_Data_OccurrenceCounter_Vehicle_Speed
        enable-take-address=true, indirect-api=false, port=DemSatellite_0/CBReadData_Data_OccurrenceCounter_DisplayStatus
        enable-take-address=true, indirect-api=false, port=DemSatellite_0/CBReadData_Data_OccurrenceCounter_TRSC_Stat
        enable-take-address=true, indirect-api=false, port=DemSatellite_0/CBReadData_Data_OccurrenceCounter_ECU_Voltage
        enable-take-address=true, indirect-api=false, port=DemSatellite_0/CBReadData_Data_OccurrenceCounter_Touch_Screen_X_Coordinate
        enable-take-address=true, indirect-api=false, port=DemSatellite_0/CBReadData_Data_OccurrenceCounter_Touch_Screen_Status
        enable-take-address=true, indirect-api=false, port=DemSatellite_0/CBReadData_Data_OccurrenceCounter_External_Temperature
        enable-take-address=true, indirect-api=false, port=DemSatellite_0/CBReadData_Data_OccurrenceCounter_TireLines
        enable-take-address=true, indirect-api=false, port=DemSatellite_0/CBReadData_Data_OccurrenceCounter_Door_Status
        enable-take-address=true, indirect-api=false, port=DemSatellite_0/CBReadData_Data_OccurrenceCounter_Radio_Display_Status
        enable-take-address=true, indirect-api=false, port=DemSatellite_0/CBReadData_Data_OccurrenceCounter_TRSKM_and_USS_status
        enable-take-address=true, indirect-api=false, port=DemSatellite_0/CBReadData_Data_OccurrenceCounter_LiftgateAjar
        enable-take-address=true, indirect-api=false, port=DemSatellite_0/CBReadData_Data_OccurrenceCounter_Cycles_to_Switch_off_the_Warning_Indication_ID
        enable-take-address=true, indirect-api=false, port=DemSatellite_0/CBReadData_Data_OccurrenceCounter_Steering_Wheel_Angle
        enable-take-address=true, indirect-api=false, port=DemSatellite_0/CBReadData_Data_OccurrenceCounter_Reserved
        enable-take-address=true, indirect-api=false, port=DemSatellite_0/CBReadData_Data_OccurrenceCounter_Reserved_1
        enable-take-address=true, indirect-api=false, port=DemSatellite_0/CBReadData_Data_OccurrenceCounter_Calibration_Aborted_Failed
        enable-take-address=true, indirect-api=false, port=DemSatellite_0/CBReadData_Data_OccurrenceCounter_Calibration_Pending
        enable-take-address=true, indirect-api=false, port=DemSatellite_0/CBReadData_Data_OccurrenceCounter_Calibration_Running
        enable-take-address=true, indirect-api=false, port=DemSatellite_0/CBReadData_Data_OccurrenceCounter_New_Bit_Field
        enable-take-address=true, indirect-api=false, port=DemSatellite_0/CBReadData_Data_OccurrenceCounter_Calibration_Not_Started
        enable-take-address=true, indirect-api=false, port=DemSatellite_0/CBReadData_Data_OccurrenceCounter_Calibrated_Successfully
        enable-take-address=true, indirect-api=false, port=DemSatellite_0/CBReadData_Data_OccurrenceCounter_Reserved_2
        enable-take-address=true, indirect-api=false, port=DemSatellite_0/CBReadData_Data_DID_0x1921_CombinedSignal
      15 x runnable:
        Dem_SatelliteMainFunction
          38 x sync call, all with timeout=0:
            OpServerCallDem_SatelliteMainFunction_ReadData_CBReadData_Data_DID_0x1004_Battery_Voltage_24: operation=CBReadData_Data_DID_0x1004_Battery_Voltage_24.ReadData
            OpServerCallDem_SatelliteMainFunction_ReadData_CBReadData_Data_DID_0x1008_ECU_Life_Time_24: operation=CBReadData_Data_DID_0x1008_ECU_Life_Time_24.ReadData
            OpServerCallDem_SatelliteMainFunction_ReadData_CBReadData_Data_DID_0x1009_ECU_Time_Since_Ignition_ON: operation=CBReadData_Data_DID_0x1009_ECU_Time_Since_Ignition_ON.ReadData
            OpServerCallDem_SatelliteMainFunction_ReadData_CBReadData_Data_OccurrenceCounter_Aging_Counter_ID: operation=CBReadData_Data_OccurrenceCounter_Aging_Counter_ID.ReadData
            OpServerCallDem_SatelliteMainFunction_ReadData_CBReadData_Data_OccurrenceCounter_Frequency_Counter_ID: operation=CBReadData_Data_OccurrenceCounter_Frequency_Counter_ID.ReadData
            OpServerCallDem_SatelliteMainFunction_ReadData_CBReadData_Data_DID_0x200a_Ignition_ON_Counter_24: operation=CBReadData_Data_DID_0x200a_Ignition_ON_Counter_24.ReadData
            OpServerCallDem_SatelliteMainFunction_ReadData_CBReadData_Data_DID_0x1002_Vehicle_Speed_24: operation=CBReadData_Data_DID_0x1002_Vehicle_Speed_24.ReadData
            OpServerCallDem_SatelliteMainFunction_ReadData_CBReadData_Data_DID_0x2001_Odometer_24: operation=CBReadData_Data_DID_0x2001_Odometer_24.ReadData
            OpServerCallDem_SatelliteMainFunction_ReadData_CBReadData_Data_OccurrenceCounter_Touch_Screen_Y_Coordinate: operation=CBReadData_Data_OccurrenceCounter_Touch_Screen_Y_Coordinate.ReadData
            OpServerCallDem_SatelliteMainFunction_ReadData_CBReadData_Data_OccurrenceCounter_Odometer_Value: operation=CBReadData_Data_OccurrenceCounter_Odometer_Value.ReadData
            OpServerCallDem_SatelliteMainFunction_ReadData_CBReadData_Data_OccurrenceCounter_Camera_Occlusion: operation=CBReadData_Data_OccurrenceCounter_Camera_Occlusion.ReadData
            OpServerCallDem_SatelliteMainFunction_ReadData_CBReadData_Data_OccurrenceCounter_THA_state: operation=CBReadData_Data_OccurrenceCounter_THA_state.ReadData
            OpServerCallDem_SatelliteMainFunction_ReadData_CBReadData_Data_OccurrenceCounter_Supplier_Internal_Code: operation=CBReadData_Data_OccurrenceCounter_Supplier_Internal_Code.ReadData
            OpServerCallDem_SatelliteMainFunction_ReadData_CBReadData_Data_OccurrenceCounter_Current_Gear: operation=CBReadData_Data_OccurrenceCounter_Current_Gear.ReadData
            OpServerCallDem_SatelliteMainFunction_ReadData_CBReadData_Data_OccurrenceCounter_Vehicle_Speed: operation=CBReadData_Data_OccurrenceCounter_Vehicle_Speed.ReadData
            OpServerCallDem_SatelliteMainFunction_ReadData_CBReadData_Data_OccurrenceCounter_DisplayStatus: operation=CBReadData_Data_OccurrenceCounter_DisplayStatus.ReadData
            OpServerCallDem_SatelliteMainFunction_ReadData_CBReadData_Data_OccurrenceCounter_TRSC_Stat: operation=CBReadData_Data_OccurrenceCounter_TRSC_Stat.ReadData
            OpServerCallDem_SatelliteMainFunction_ReadData_CBReadData_Data_OccurrenceCounter_ECU_Voltage: operation=CBReadData_Data_OccurrenceCounter_ECU_Voltage.ReadData
            OpServerCallDem_SatelliteMainFunction_ReadData_CBReadData_Data_OccurrenceCounter_Touch_Screen_X_Coordinate: operation=CBReadData_Data_OccurrenceCounter_Touch_Screen_X_Coordinate.ReadData
            OpServerCallDem_SatelliteMainFunction_ReadData_CBReadData_Data_OccurrenceCounter_Touch_Screen_Status: operation=CBReadData_Data_OccurrenceCounter_Touch_Screen_Status.ReadData
            OpServerCallDem_SatelliteMainFunction_ReadData_CBReadData_Data_OccurrenceCounter_External_Temperature: operation=CBReadData_Data_OccurrenceCounter_External_Temperature.ReadData
            OpServerCallDem_SatelliteMainFunction_ReadData_CBReadData_Data_OccurrenceCounter_TireLines: operation=CBReadData_Data_OccurrenceCounter_TireLines.ReadData
            OpServerCallDem_SatelliteMainFunction_ReadData_CBReadData_Data_OccurrenceCounter_Door_Status: operation=CBReadData_Data_OccurrenceCounter_Door_Status.ReadData
            OpServerCallDem_SatelliteMainFunction_ReadData_CBReadData_Data_OccurrenceCounter_Radio_Display_Status: operation=CBReadData_Data_OccurrenceCounter_Radio_Display_Status.ReadData
            OpServerCallDem_SatelliteMainFunction_ReadData_CBReadData_Data_OccurrenceCounter_TRSKM_and_USS_status: operation=CBReadData_Data_OccurrenceCounter_TRSKM_and_USS_status.ReadData
            OpServerCallDem_SatelliteMainFunction_ReadData_CBReadData_Data_OccurrenceCounter_LiftgateAjar: operation=CBReadData_Data_OccurrenceCounter_LiftgateAjar.ReadData
            OpServerCallDem_SatelliteMainFunction_ReadData_CBReadData_Data_OccurrenceCounter_Cycles_to_Switch_off_the_Warning_Indication_ID: operation=CBReadData_Data_OccurrenceCounter_Cycles_to_Switch_off_the_Warning_Indication_ID.ReadData
            OpServerCallDem_SatelliteMainFunction_ReadData_CBReadData_Data_OccurrenceCounter_Steering_Wheel_Angle: operation=CBReadData_Data_OccurrenceCounter_Steering_Wheel_Angle.ReadData
            OpServerCallDem_SatelliteMainFunction_ReadData_CBReadData_Data_OccurrenceCounter_Reserved: operation=CBReadData_Data_OccurrenceCounter_Reserved.ReadData
            OpServerCallDem_SatelliteMainFunction_ReadData_CBReadData_Data_OccurrenceCounter_Reserved_1: operation=CBReadData_Data_OccurrenceCounter_Reserved_1.ReadData
            OpServerCallDem_SatelliteMainFunction_ReadData_CBReadData_Data_OccurrenceCounter_Calibration_Aborted_Failed: operation=CBReadData_Data_OccurrenceCounter_Calibration_Aborted_Failed.ReadData
            OpServerCallDem_SatelliteMainFunction_ReadData_CBReadData_Data_OccurrenceCounter_Calibration_Pending: operation=CBReadData_Data_OccurrenceCounter_Calibration_Pending.ReadData
            OpServerCallDem_SatelliteMainFunction_ReadData_CBReadData_Data_OccurrenceCounter_Calibration_Running: operation=CBReadData_Data_OccurrenceCounter_Calibration_Running.ReadData
            OpServerCallDem_SatelliteMainFunction_ReadData_CBReadData_Data_OccurrenceCounter_New_Bit_Field: operation=CBReadData_Data_OccurrenceCounter_New_Bit_Field.ReadData
            OpServerCallDem_SatelliteMainFunction_ReadData_CBReadData_Data_OccurrenceCounter_Calibration_Not_Started: operation=CBReadData_Data_OccurrenceCounter_Calibration_Not_Started.ReadData
            OpServerCallDem_SatelliteMainFunction_ReadData_CBReadData_Data_OccurrenceCounter_Calibrated_Successfully: operation=CBReadData_Data_OccurrenceCounter_Calibrated_Successfully.ReadData
            OpServerCallDem_SatelliteMainFunction_ReadData_CBReadData_Data_OccurrenceCounter_Reserved_2: operation=CBReadData_Data_OccurrenceCounter_Reserved_2.ReadData
            OpServerCallDem_SatelliteMainFunction_ReadData_CBReadData_Data_DID_0x1921_CombinedSignal: operation=CBReadData_Data_DID_0x1921_CombinedSignal.ReadData
        GetEventUdsStatus: can-be-invoked-concurrently=true, symbol=Dem_GetEventUdsStatus
        GetEventStatus: can-be-invoked-concurrently=true, symbol=Dem_GetEventUdsStatus
        GetEventFailed: can-be-invoked-concurrently=true, symbol=Dem_GetEventFailed
        GetEventTested: can-be-invoked-concurrently=true, symbol=Dem_GetEventTested
        GetDTCOfEvent: can-be-invoked-concurrently=true, symbol=Dem_GetDTCOfEvent
        GetFaultDetectionCounter: can-be-invoked-concurrently=true, symbol=Dem_GetFaultDetectionCounter
        GetEventFreezeFrameDataEx: can-be-invoked-concurrently=true, symbol=Dem_GetEventFreezeFrameDataEx
        GetEventExtendedDataRecordEx: can-be-invoked-concurrently=true, symbol=Dem_GetEventExtendedDataRecordEx
        GetEventEnableCondition: can-be-invoked-concurrently=true, symbol=Dem_GetEventEnableCondition
        GetDebouncingOfEvent: can-be-invoked-concurrently=true, symbol=Dem_GetDebouncingOfEvent
        GetMonitorStatus: can-be-invoked-concurrently=true, symbol=Dem_GetMonitorStatus
        SetEventStatus: can-be-invoked-concurrently=true, symbol=Dem_SetEventStatus
        ResetEventStatus: can-be-invoked-concurrently=true, symbol=Dem_ResetEventStatus
        ResetEventDebounceStatus: can-be-invoked-concurrently=true, symbol=Dem_ResetEventDebounceStatus
  swc implementation DemSatellite_0Implementation: programming-language=C, behavior=DemSatellite_0InternalBehavior
