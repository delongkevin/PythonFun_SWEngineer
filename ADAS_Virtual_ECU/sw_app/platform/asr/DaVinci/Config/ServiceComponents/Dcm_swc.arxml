[part 1 of 2: packages /MICROSAR/Dcm_swc to /MICROSAR/Dcm_swc/Interfaces]
AUTOSAR XML (schema 00048)
package /MICROSAR/Dcm_swc
  4 x mode declaration group, all with category=EXPLICIT_ORDER:
    DcmControlDtcSetting: initial-mode=ENABLEDTCSETTING, on-transition-value=2
      mode ENABLEDTCSETTING: value=0
      mode DISABLEDTCSETTING: value=1
    DcmEcuReset: initial-mode=NONE, on-transition-value=7
      7 x mode:
        NONE: value=0
        HARD: value=1
        KEYONOFF: value=2
        SOFT: value=3
        JUMPTOBOOTLOADER: value=4
        JUMPTOSYSSUPPLIERBOOTLOADER: value=5
        EXECUTE: value=6
    DcmDiagnosticSessionControl: initial-mode=DEFAULT_SESSION, on-transition-value=255
      mode DEFAULT_SESSION: value=1
      mode PROGRAMMING_SESSION: value=2
      mode EXTENDED_SESSION: value=3
    DcmCommunicationControl: initial-mode=DCM_ENABLE_RX_TX_NORM, on-transition-value=12
      12 x mode:
        DCM_ENABLE_RX_TX_NORM: value=0
        DCM_ENABLE_RX_DISABLE_TX_NORM: value=1
        DCM_DISABLE_RX_ENABLE_TX_NORM: value=2
        DCM_DISABLE_RX_TX_NORMAL: value=3
        DCM_ENABLE_RX_TX_NM: value=4
        DCM_ENABLE_RX_DISABLE_TX_NM: value=5
        DCM_DISABLE_RX_ENABLE_TX_NM: value=6
        DCM_DISABLE_RX_TX_NM: value=7
        DCM_ENABLE_RX_TX_NORM_NM: value=8
        DCM_ENABLE_RX_DISABLE_TX_NORM_NM: value=9
        DCM_DISABLE_RX_ENABLE_TX_NORM_NM: value=10
        DCM_DISABLE_RX_TX_NORM_NM: value=11
  data type mapping set DcmMappingSet  # Contains mapping for ModeDeclarationGroups which are provided by Dcm.
    mode-request-type-maps:
      implementation-data-type=Dcm_ControlDtcSettingType, mode-group=DcmControlDtcSetting
      implementation-data-type=Dcm_EcuResetType, mode-group=DcmEcuReset
      implementation-data-type=Dcm_DiagnosticSessionControlType, mode-group=DcmDiagnosticSessionControl
      implementation-data-type=Dcm_CommunicationModeType, mode-group=DcmCommunicationControl
  mode declaration group ProgPreconditionState: category=ALPHABETIC_ORDER, initial-mode=StateOK
    mode StateNotOK
    mode StateOK
package /MICROSAR/Dcm_swc/DataTypes
  116 x impl type:
    Dcm_ConfirmationStatusType: compu {0=DCM_RES_POS_OK, 1=DCM_RES_POS_NOT_OK, 2=DCM_RES_NEG_OK, 3=DCM_RES_NEG_NOT_OK}, range raw 0..3, implementation-data-type=uint8
    Dcm_OpStatusType: compu {0=DCM_INITIAL, 1=DCM_PENDING, 2=DCM_CANCEL, 3=DCM_FORCE_RCRRP_OK, 64=DCM_FORCE_RCRRP_NOT_OK}, range raw 0..64, implementation-data-type=uint8
    Dcm_NegativeResponseCodeType:
      compu {0=DCM_E_POSITIVERESPONSE, 16=DCM_E_GENERALREJECT, 17=DCM_E_SERVICENOTSUPPORTED, 18=DCM_E_SUBFUNCTIONNOTSUPPORTED, 19=DCM_E_INCORRECTMESSAGELENGTHORINVALIDFORMAT, 20=DCM_E_RESPONSETOOLONG, 33=DCM_E_BUSYREPEATREQUEST, 34=DCM_E_CONDITIONSNOTCORRECT, 36=DCM_E_REQUESTSEQUENCEERROR, 37=DCM_E_NORESPONSEFROMSUBNETCOMPONENT, 38=DCM_E_FAILUREPREVENTSEXECUTIONOFREQUESTEDACTION, 49=DCM_E_REQUESTOUTOFRANGE, 51=DCM_E_SECURITYACCESSDENIED, 52=DCM_E_AUTHENTICATIONREQUIRED, 53=DCM_E_INVALIDKEY, 54=DCM_E_EXCEEDNUMBEROFATTEMPTS, 55=DCM_E_REQUIREDTIMEDELAYNOTEXPIRED, 80=DCM_E_CVF_INVALIDTIMEPERIOD, 81=DCM_E_CVF_INVALIDSIGNATURE, 82=DCM_E_CVF_INVALIDCHAINOFTRUST, 83=DCM_E_CVF_INVALIDTYPE, 84=DCM_E_CVF_INVALIDFORMAT, 85=DCM_E_CVF_INVALIDCONTENT, 86=DCM_E_CVF_INVALIDSCOPE, 87=DCM_E_CVF_INVALIDCERTIFICATEREVOKED, 88=DCM_E_OWNERSHIPVERIFICATIONFAILED, 89=DCM_E_CHALLENGECALCULATIONFAILED, 112=DCM_E_UPLOADDOWNLOADNOTACCEPTED, 113=DCM_E_TRANSFERDATASUSPENDED, 114=DCM_E_GENERALPROGRAMMINGFAILURE, 115=DCM_E_WRONGBLOCKSEQUENCECOUNTER, 120=DCM_E_REQUESTCORRECTLYRECEIVEDRESPONSEPENDING, 126=DCM_E_SUBFUNCTIONNOTSUPPORTEDINACTIVESESSION, 127=DCM_E_SERVICENOTSUPPORTEDINACTIVESESSION, 129=DCM_E_RPMTOOHIGH, 130=DCM_E_RPMTOOLOW, 131=DCM_E_ENGINEISRUNNING, 132=DCM_E_ENGINEISNOTRUNNING, 133=DCM_E_ENGINERUNTIMETOOLOW, 134=DCM_E_TEMPERATURETOOHIGH, 135=DCM_E_TEMPERATURETOOLOW, 136=DCM_E_VEHICLESPEEDTOOHIGH, 137=DCM_E_VEHICLESPEEDTOOLOW, 138=DCM_E_THROTTLE_PEDALTOOHIGH, 139=DCM_E_THROTTLE_PEDALTOOLOW, 140=DCM_E_TRANSMISSIONRANGENOTINNEUTRAL, 141=DCM_E_TRANSMISSIONRANGENOTINGEAR, 143=DCM_E_BRAKESWITCH_NOTCLOSED, 144=DCM_E_SHIFTERLEVERNOTINPARK, 145=DCM_E_TORQUECONVERTERCLUTCHLOCKED, 146=DCM_E_VOLTAGETOOHIGH, 147=DCM_E_VOLTAGETOOLOW, 240..249=DCM_E_VMSCNC_0..DCM_E_VMSCNC_9, 250=DCM_E_VMSCNC_A, 251=DCM_E_VMSCNC_B, 252=DCM_E_VMSCNC_C, 253=DCM_E_VMSCNC_D, 254=DCM_E_VMSCNC_E}
      range raw 0..255
      implementation-data-type=uint8
    Dcm_ProtocolType: compu {0=DCM_OBD_ON_CAN, 1=DCM_OBD_ON_FLEXRAY, 2=DCM_OBD_ON_IP, 3=DCM_UDS_ON_CAN, 4=DCM_UDS_ON_FLEXRAY, 5=DCM_UDS_ON_IP, 12=DCM_NO_ACTIVE_PROTOCOL, 240..254=DCM_SUPPLIER_1..DCM_SUPPLIER_15}, range raw 0..254, implementation-data-type=uint8
    Dcm_RequestKindType: compu {0=DCM_REQ_KIND_NONE, 1=DCM_REQ_KIND_EXTERNAL, 2=DCM_REQ_KIND_ROE}, range raw 0..2, implementation-data-type=uint8
    Dcm_SecLevelType: compu {0=DCM_SEC_LEV_LOCKED, 9=DCM_SEC_LEV_L9}, range raw 0..9, implementation-data-type=uint8
    Dcm_SesCtrlType: compu {1=DCM_DEFAULT_SESSION, 2=DCM_PROGRAMMING_SESSION, 3=DCM_EXTENDED_DIAGNOSTIC_SESSION}, range raw 0..3, implementation-data-type=uint8
    Dcm_ControlDtcSettingType: compu {0=DCM_ENUM_ENABLEDTCSETTING, 1=DCM_ENUM_DISABLEDTCSETTING}, range raw 0..255, implementation-data-type=uint8
    Dcm_EcuResetType: compu {0=DCM_ENUM_NONE, 1=DCM_ENUM_HARD, 2=DCM_ENUM_KEYONOFF, 3=DCM_ENUM_SOFT, 4=DCM_ENUM_JUMPTOBOOTLOADER, 5=DCM_ENUM_JUMPTOSYSSUPPLIERBOOTLOADER, 6=DCM_ENUM_EXECUTE}, range raw 0..255, implementation-data-type=uint8
    Dcm_DiagnosticSessionControlType: compu {1=DCM_ENUM_DEFAULT_SESSION, 2=DCM_ENUM_PROGRAMMING_SESSION, 3=DCM_ENUM_EXTENDED_SESSION}, range raw 0..255, implementation-data-type=uint8
    Dcm_CommunicationModeType:
      compu {0=DCM_ENABLE_RX_TX_NORM, 1=DCM_ENABLE_RX_DISABLE_TX_NORM, 2=DCM_DISABLE_RX_ENABLE_TX_NORM, 3=DCM_DISABLE_RX_TX_NORMAL, 4=DCM_ENABLE_RX_TX_NM, 5=DCM_ENABLE_RX_DISABLE_TX_NM, 6=DCM_DISABLE_RX_ENABLE_TX_NM, 7=DCM_DISABLE_RX_TX_NM, 8=DCM_ENABLE_RX_TX_NORM_NM, 9=DCM_ENABLE_RX_DISABLE_TX_NORM_NM, 10=DCM_DISABLE_RX_ENABLE_TX_NORM_NM, 11=DCM_DISABLE_RX_TX_NORM_NM}
      range raw 0..255
      implementation-data-type=uint8
    Dcm_Data32ByteType: category=ARRAY, sw-calibration-access=READ-ONLY
      element Dcm_Data32ByteTypeElement: array-size=32, array-size-semantics=FIXED-SIZE, implementation-data-type=uint8
    Dcm_StartDataIn_Routine_31015000_Park_Assist_ON_OFF_State_Start_In_ReqDataArrayType: implementation-data-type=uint8
    Dcm_StartDataIn_Routine_31015000_Park_Assist_ON_OFF_State_Start_In_ReqDataType: category=ARRAY, sw-calibration-access=READ-ONLY
      element Dcm_StartDataIn_Routine_31015000_Park_Assist_ON_OFF_State_Start_In_ReqDataTypeElement: array-size=1, array-size-semantics=FIXED-SIZE, implementation-data-type=Dcm_StartDataIn_Routine_31015000_Park_Assist_ON_OFF_State_Start_In_ReqDataArrayType
    Dcm_StartDataIn_Routine_31015200_Plant_Mode_Routine_Start_In_ReqDataArrayType: implementation-data-type=uint8
    Dcm_StartDataIn_Routine_31015200_Plant_Mode_Routine_Start_In_ReqDataType: category=ARRAY, sw-calibration-access=READ-ONLY
      element Dcm_StartDataIn_Routine_31015200_Plant_Mode_Routine_Start_In_ReqDataTypeElement: array-size=1, array-size-semantics=FIXED-SIZE, implementation-data-type=Dcm_StartDataIn_Routine_31015200_Plant_Mode_Routine_Start_In_ReqDataArrayType
    Dcm_RequestDataOut_Routine_31015200_Plant_Mode_Routine_Start_Out_ResDataArrayType: implementation-data-type=uint8
    Dcm_RequestDataOut_Routine_31015200_Plant_Mode_Routine_Start_Out_ResDataType: category=ARRAY, sw-calibration-access=READ-ONLY
      element Dcm_RequestDataOut_Routine_31015200_Plant_Mode_Routine_Start_Out_ResDataTypeElement: array-size=1, array-size-semantics=FIXED-SIZE, implementation-data-type=Dcm_RequestDataOut_Routine_31015200_Plant_Mode_Routine_Start_Out_ResDataArrayType
    Dcm_StartDataIn_Routine_31015400_Camera_EOL_Calibration_Start_In_ReqDataArrayType: implementation-data-type=uint8
    Dcm_StartDataIn_Routine_31015400_Camera_EOL_Calibration_Start_In_ReqDataType: category=ARRAY, sw-calibration-access=READ-ONLY
      element Dcm_StartDataIn_Routine_31015400_Camera_EOL_Calibration_Start_In_ReqDataTypeElement: array-size=1, array-size-semantics=FIXED-SIZE, implementation-data-type=Dcm_StartDataIn_Routine_31015400_Camera_EOL_Calibration_Start_In_ReqDataArrayType
    Dcm_StartDataOut_Routine_31015400_Camera_EOL_Calibration_Start_Out_ResDataArrayType: implementation-data-type=uint8
    Dcm_StartDataOut_Routine_31015400_Camera_EOL_Calibration_Start_Out_ResDataType: category=ARRAY, sw-calibration-access=READ-ONLY
      element Dcm_StartDataOut_Routine_31015400_Camera_EOL_Calibration_Start_Out_ResDataTypeElement: array-size=1, array-size-semantics=FIXED-SIZE, implementation-data-type=Dcm_StartDataOut_Routine_31015400_Camera_EOL_Calibration_Start_Out_ResDataArrayType
    Dcm_RequestDataOut_Routine_31015400_Camera_EOL_Calibration_Start_Out_ResDataArrayType: implementation-data-type=uint8
    Dcm_RequestDataOut_Routine_31015400_Camera_EOL_Calibration_Start_Out_ResDataType: category=ARRAY, sw-calibration-access=READ-ONLY
      element Dcm_RequestDataOut_Routine_31015400_Camera_EOL_Calibration_Start_Out_ResDataTypeElement: array-size=8, array-size-semantics=FIXED-SIZE, implementation-data-type=Dcm_RequestDataOut_Routine_31015400_Camera_EOL_Calibration_Start_Out_ResDataArrayType
    Dcm_StartDataIn_Routine_31015401_Camera_Service_Calibration_Start_In_ReqDataArrayType: implementation-data-type=uint8
    Dcm_StartDataIn_Routine_31015401_Camera_Service_Calibration_Start_In_ReqDataType: category=ARRAY, sw-calibration-access=READ-ONLY
      element Dcm_StartDataIn_Routine_31015401_Camera_Service_Calibration_Start_In_ReqDataTypeElement: array-size=1, array-size-semantics=FIXED-SIZE, implementation-data-type=Dcm_StartDataIn_Routine_31015401_Camera_Service_Calibration_Start_In_ReqDataArrayType
    Dcm_StartDataOut_Routine_31015401_Camera_Service_Calibration_Start_Out_ResDataArrayType: implementation-data-type=uint8
    Dcm_StartDataOut_Routine_31015401_Camera_Service_Calibration_Start_Out_ResDataType: category=ARRAY, sw-calibration-access=READ-ONLY
      element Dcm_StartDataOut_Routine_31015401_Camera_Service_Calibration_Start_Out_ResDataTypeElement: array-size=1, array-size-semantics=FIXED-SIZE, implementation-data-type=Dcm_StartDataOut_Routine_31015401_Camera_Service_Calibration_Start_Out_ResDataArrayType
    Dcm_RequestDataOut_Routine_31015401_Camera_Service_Calibration_Start_Out_ResDataArrayType: implementation-data-type=uint8
    Dcm_StartFlexibleOutArrayData_Routine_3101D002_Check_Programming_Preconditions_Start_Out_ResDataType: category=ARRAY, sw-calibration-access=READ-ONLY
      element Dcm_StartFlexibleOutArrayData_Routine_3101D002_Check_Programming_Preconditions_Start_Out_ResDataTypeElement: array-size=256, array-size-semantics=FIXED-SIZE, implementation-data-type=uint8
    Dcm_StartDataIn_Routine_3101D003_Application_Logical_Block_Hash_In_ReqDataArrayType: implementation-data-type=uint8
    Dcm_StartDataIn_Routine_3101D003_Application_Logical_Block_Hash_In_ReqDataType: category=ARRAY, sw-calibration-access=READ-ONLY
      element Dcm_StartDataIn_Routine_3101D003_Application_Logical_Block_Hash_In_ReqDataTypeElement: array-size=1, array-size-semantics=FIXED-SIZE, implementation-data-type=Dcm_StartDataIn_Routine_3101D003_Application_Logical_Block_Hash_In_ReqDataArrayType
    Dcm_StartDataOut_Routine_3101D003_Application_Logical_Block_Hash_Out_ResDataArrayType: implementation-data-type=uint8
    Dcm_StartDataOut_Routine_3101D003_Application_Logical_Block_Hash_Out_ResDataType: category=ARRAY, sw-calibration-access=READ-ONLY
      element Dcm_StartDataOut_Routine_3101D003_Application_Logical_Block_Hash_Out_ResDataTypeElement: array-size=32, array-size-semantics=FIXED-SIZE, implementation-data-type=Dcm_StartDataOut_Routine_3101D003_Application_Logical_Block_Hash_Out_ResDataArrayType
    Dcm_StartDataOut_Routine_3101F000_Check_Program_Start_Out_ResDataArrayType: implementation-data-type=uint8
    Dcm_StartDataOut_Routine_3101F000_Check_Program_Start_Out_ResDataType: category=ARRAY, sw-calibration-access=READ-ONLY
      element Dcm_StartDataOut_Routine_3101F000_Check_Program_Start_Out_ResDataTypeElement: array-size=1, array-size-semantics=FIXED-SIZE, implementation-data-type=Dcm_StartDataOut_Routine_3101F000_Check_Program_Start_Out_ResDataArrayType
    Dcm_StartDataIn_Routine_3101FE02_Test_Write_PMIC_Register_Start_In_ReqDataArrayType: implementation-data-type=uint8
    Dcm_StartDataIn_Routine_3101FE02_Test_Write_PMIC_Register_Start_In_ReqDataType: category=ARRAY, sw-calibration-access=READ-ONLY
      element Dcm_StartDataIn_Routine_3101FE02_Test_Write_PMIC_Register_Start_In_ReqDataTypeElement: array-size=5, array-size-semantics=FIXED-SIZE, implementation-data-type=Dcm_StartDataIn_Routine_3101FE02_Test_Write_PMIC_Register_Start_In_ReqDataArrayType
    Dcm_StartDataOut_Routine_3101FF00_FlashErase_Start_Out_ResDataArrayType: implementation-data-type=uint8
    Dcm_StartDataOut_Routine_3101FF00_FlashErase_Start_Out_ResDataType: category=ARRAY, sw-calibration-access=READ-ONLY
      element Dcm_StartDataOut_Routine_3101FF00_FlashErase_Start_Out_ResDataTypeElement: array-size=9, array-size-semantics=FIXED-SIZE, implementation-data-type=Dcm_StartDataOut_Routine_3101FF00_FlashErase_Start_Out_ResDataArrayType
    Dcm_StartDataOut_Routine_3101FF01_checkProgrammingDependencies_FlashChecksum_Start_Out_ResDataArrayType: implementation-data-type=uint8
    Dcm_StartDataOut_Routine_3101FF01_checkProgrammingDependencies_FlashChecksum_Start_Out_ResDataType: category=ARRAY, sw-calibration-access=READ-ONLY
      element Dcm_StartDataOut_Routine_3101FF01_checkProgrammingDependencies_FlashChecksum_Start_Out_ResDataTypeElement: array-size=1, array-size-semantics=FIXED-SIZE, implementation-data-type=Dcm_StartDataOut_Routine_3101FF01_checkProgrammingDependencies_FlashChecksum_Start_Out_ResDataArrayType
    Dcm_Data41ByteType: category=ARRAY, sw-calibration-access=READ-ONLY
      element Dcm_Data41ByteTypeElement: array-size=41, array-size-semantics=FIXED-SIZE, implementation-data-type=uint8
    Dcm_Data21ByteType: category=ARRAY, sw-calibration-access=READ-ONLY
      element Dcm_Data21ByteTypeElement: array-size=21, array-size-semantics=FIXED-SIZE, implementation-data-type=uint8
    Dcm_Data1ByteType: category=ARRAY, sw-calibration-access=READ-ONLY
      element Dcm_Data1ByteTypeElement: array-size=1, array-size-semantics=FIXED-SIZE, implementation-data-type=uint8
    Dcm_Data52ByteType: category=ARRAY, sw-calibration-access=READ-ONLY
      element Dcm_Data52ByteTypeElement: array-size=52, array-size-semantics=FIXED-SIZE, implementation-data-type=uint8
    Dcm_Data9ByteType: category=ARRAY, sw-calibration-access=READ-ONLY
      element Dcm_Data9ByteTypeElement: array-size=9, array-size-semantics=FIXED-SIZE, implementation-data-type=uint8
    Dcm_Data16ByteType: category=ARRAY, sw-calibration-access=READ-ONLY
      element Dcm_Data16ByteTypeElement: array-size=16, array-size-semantics=FIXED-SIZE, implementation-data-type=uint8
    Dcm_Data14ByteType: category=ARRAY, sw-calibration-access=READ-ONLY
      element Dcm_Data14ByteTypeElement: array-size=14, array-size-semantics=FIXED-SIZE, implementation-data-type=uint8
    Dcm_Data10ByteType: category=ARRAY, sw-calibration-access=READ-ONLY
      element Dcm_Data10ByteTypeElement: array-size=10, array-size-semantics=FIXED-SIZE, implementation-data-type=uint8
    Dcm_Data2ByteType: category=ARRAY, sw-calibration-access=READ-ONLY
      element Dcm_Data2ByteTypeElement: array-size=2, array-size-semantics=FIXED-SIZE, implementation-data-type=uint8
    Dcm_Data11ByteType: category=ARRAY, sw-calibration-access=READ-ONLY
      element Dcm_Data11ByteTypeElement: array-size=11, array-size-semantics=FIXED-SIZE, implementation-data-type=uint8
    Dcm_Data12ByteType: category=ARRAY, sw-calibration-access=READ-ONLY
      element Dcm_Data12ByteTypeElement: array-size=12, array-size-semantics=FIXED-SIZE, implementation-data-type=uint8
    Dcm_Data4ByteType: category=ARRAY, sw-calibration-access=READ-ONLY
      element Dcm_Data4ByteTypeElement: array-size=4, array-size-semantics=FIXED-SIZE, implementation-data-type=uint8
    Dcm_Data256ByteType: category=ARRAY, sw-calibration-access=READ-ONLY
      element Dcm_Data256ByteTypeElement: array-size=256, array-size-semantics=FIXED-SIZE, implementation-data-type=uint8
    Dcm_Data13ByteType: category=ARRAY, sw-calibration-access=READ-ONLY
      element Dcm_Data13ByteTypeElement: array-size=13, array-size-semantics=FIXED-SIZE, implementation-data-type=uint8
    Dcm_Data3ByteType: category=ARRAY, sw-calibration-access=READ-ONLY
      element Dcm_Data3ByteTypeElement: array-size=3, array-size-semantics=FIXED-SIZE, implementation-data-type=uint8
    Dcm_Data24ByteType: category=ARRAY, sw-calibration-access=READ-ONLY
      element Dcm_Data24ByteTypeElement: array-size=24, array-size-semantics=FIXED-SIZE, implementation-data-type=uint8
    Dcm_Data28ByteType: category=ARRAY, sw-calibration-access=READ-ONLY
      element Dcm_Data28ByteTypeElement: array-size=28, array-size-semantics=FIXED-SIZE, implementation-data-type=uint8
    Dcm_Data42ByteType: category=ARRAY, sw-calibration-access=READ-ONLY
      element Dcm_Data42ByteTypeElement: array-size=42, array-size-semantics=FIXED-SIZE, implementation-data-type=uint8
    Dcm_Data17ByteType: category=ARRAY, sw-calibration-access=READ-ONLY
      element Dcm_Data17ByteTypeElement: array-size=17, array-size-semantics=FIXED-SIZE, implementation-data-type=uint8
    Dcm_Data34ByteType: category=ARRAY, sw-calibration-access=READ-ONLY
      element Dcm_Data34ByteTypeElement: array-size=34, array-size-semantics=FIXED-SIZE, implementation-data-type=uint8
    Dcm_Data15ByteType: category=ARRAY, sw-calibration-access=READ-ONLY
      element Dcm_Data15ByteTypeElement: array-size=15, array-size-semantics=FIXED-SIZE, implementation-data-type=uint8
    Dcm_Data48ByteType: category=ARRAY, sw-calibration-access=READ-ONLY
      element Dcm_Data48ByteTypeElement: array-size=48, array-size-semantics=FIXED-SIZE, implementation-data-type=uint8
    Dcm_Data8ByteType: category=ARRAY, sw-calibration-access=READ-ONLY
      element Dcm_Data8ByteTypeElement: array-size=8, array-size-semantics=FIXED-SIZE, implementation-data-type=uint8
    Dcm_Data255ByteType: category=ARRAY, sw-calibration-access=READ-ONLY
      element Dcm_Data255ByteTypeElement: array-size=255, array-size-semantics=FIXED-SIZE, implementation-data-type=uint8
    Dcm_Data5ByteType: category=ARRAY, sw-calibration-access=READ-ONLY
      element Dcm_Data5ByteTypeElement: array-size=5, array-size-semantics=FIXED-SIZE, implementation-data-type=uint8
    Dcm_Data50ByteType: category=ARRAY, sw-calibration-access=READ-ONLY
      element Dcm_Data50ByteTypeElement: array-size=50, array-size-semantics=FIXED-SIZE, implementation-data-type=uint8
    Dcm_Data64ByteType: category=ARRAY, sw-calibration-access=READ-ONLY
      element Dcm_Data64ByteTypeElement: array-size=64, array-size-semantics=FIXED-SIZE, implementation-data-type=uint8
    Dcm_Data19ByteType: category=ARRAY, sw-calibration-access=READ-ONLY
      element Dcm_Data19ByteTypeElement: array-size=19, array-size-semantics=FIXED-SIZE, implementation-data-type=uint8
    Dcm_Data90ByteType: category=ARRAY, sw-calibration-access=READ-ONLY
      element Dcm_Data90ByteTypeElement: array-size=90, array-size-semantics=FIXED-SIZE, implementation-data-type=uint8
    Dcm_Data200ByteType: category=ARRAY, sw-calibration-access=READ-ONLY
      element Dcm_Data200ByteTypeElement: array-size=200, array-size-semantics=FIXED-SIZE, implementation-data-type=uint8
    Dcm_StartDataIn_Routine_3101FE01_Calibration_Data_Reset_Start_In_ReqDataArrayType: implementation-data-type=uint8
    Dcm_StartDataIn_Routine_3101FE01_Calibration_Data_Reset_Start_In_ReqDataType: category=ARRAY, sw-calibration-access=READ-ONLY
      element Dcm_StartDataIn_Routine_3101FE01_Calibration_Data_Reset_Start_In_ReqDataTypeElement: array-size=2, array-size-semantics=FIXED-SIZE, implementation-data-type=Dcm_StartDataIn_Routine_3101FE01_Calibration_Data_Reset_Start_In_ReqDataArrayType
    Dcm_StartDataOut_Routine_3101FE01_Calibration_Data_Reset_Start_Out_ResDataArrayType: implementation-data-type=uint8
    Dcm_StartDataOut_Routine_3101FE01_Calibration_Data_Reset_Start_Out_ResDataType: category=ARRAY, sw-calibration-access=READ-ONLY
      element Dcm_StartDataOut_Routine_3101FE01_Calibration_Data_Reset_Start_Out_ResDataTypeElement: array-size=2, array-size-semantics=FIXED-SIZE, implementation-data-type=Dcm_StartDataOut_Routine_3101FE01_Calibration_Data_Reset_Start_Out_ResDataArrayType
    Dcm_StartDataIn_Routine_3101FE0E_Test_Pattern_Control_Start_In_ReqDataArrayType: implementation-data-type=uint8
    Dcm_StartDataIn_Routine_3101FE0E_Test_Pattern_Control_Start_In_ReqDataType: category=ARRAY, sw-calibration-access=READ-ONLY
      element Dcm_StartDataIn_Routine_3101FE0E_Test_Pattern_Control_Start_In_ReqDataTypeElement: array-size=2, array-size-semantics=FIXED-SIZE, implementation-data-type=Dcm_StartDataIn_Routine_3101FE0E_Test_Pattern_Control_Start_In_ReqDataArrayType
    Dcm_StartDataOut_Routine_3101FE0E_Test_Pattern_Control_Start_Out_ResDataArrayType: implementation-data-type=uint8
    Dcm_StartDataOut_Routine_3101FE0E_Test_Pattern_Control_Start_Out_ResDataType: category=ARRAY, sw-calibration-access=READ-ONLY
      element Dcm_StartDataOut_Routine_3101FE0E_Test_Pattern_Control_Start_Out_ResDataTypeElement: array-size=2, array-size-semantics=FIXED-SIZE, implementation-data-type=Dcm_StartDataOut_Routine_3101FE0E_Test_Pattern_Control_Start_Out_ResDataArrayType
    Dcm_StartDataIn_Routine_3101FF03_Test_Read_PMIC_Register_Start_In_ReqDataArrayType: implementation-data-type=uint8
    Dcm_StartDataIn_Routine_3101FF03_Test_Read_PMIC_Register_Start_In_ReqDataType: category=ARRAY, sw-calibration-access=READ-ONLY
      element Dcm_StartDataIn_Routine_3101FF03_Test_Read_PMIC_Register_Start_In_ReqDataTypeElement: array-size=3, array-size-semantics=FIXED-SIZE, implementation-data-type=Dcm_StartDataIn_Routine_3101FF03_Test_Read_PMIC_Register_Start_In_ReqDataArrayType
    Dcm_StartDataOut_Routine_3101FF03_Test_Read_PMIC_Register_Start_Out_ResDataArrayType: implementation-data-type=uint8
    Dcm_StartDataOut_Routine_3101FF03_Test_Read_PMIC_Register_Start_Out_ResDataType: category=ARRAY, sw-calibration-access=READ-ONLY
      element Dcm_StartDataOut_Routine_3101FF03_Test_Read_PMIC_Register_Start_Out_ResDataTypeElement: array-size=2, array-size-semantics=FIXED-SIZE, implementation-data-type=Dcm_StartDataOut_Routine_3101FF03_Test_Read_PMIC_Register_Start_Out_ResDataArrayType
    Dcm_StartDataIn_Routine_31011000_USS_Debug_Signals_Enable_Disable_Start_In_ReqDataArrayType: implementation-data-type=uint8
    Dcm_StartDataIn_Routine_31011000_USS_Debug_Signals_Enable_Disable_Start_In_ReqDataType: category=ARRAY, sw-calibration-access=READ-ONLY
      element Dcm_StartDataIn_Routine_31011000_USS_Debug_Signals_Enable_Disable_Start_In_ReqDataTypeElement: array-size=1, array-size-semantics=FIXED-SIZE, implementation-data-type=Dcm_StartDataIn_Routine_31011000_USS_Debug_Signals_Enable_Disable_Start_In_ReqDataArrayType
    Dcm_StartDataOut_Routine_31011000_USS_Debug_Signals_Enable_Disable_Start_Out_ResDataArrayType: implementation-data-type=uint8
    Dcm_StartDataOut_Routine_31011000_USS_Debug_Signals_Enable_Disable_Start_Out_ResDataType: category=ARRAY, sw-calibration-access=READ-ONLY
      element Dcm_StartDataOut_Routine_31011000_USS_Debug_Signals_Enable_Disable_Start_Out_ResDataTypeElement: array-size=1, array-size-semantics=FIXED-SIZE, implementation-data-type=Dcm_StartDataOut_Routine_31011000_USS_Debug_Signals_Enable_Disable_Start_Out_ResDataArrayType
    Dcm_StartDataIn_Routine_31013000_XCP_Enable_Disable_Start_In_ReqDataArrayType: implementation-data-type=uint8
    Dcm_StartDataIn_Routine_31013000_XCP_Enable_Disable_Start_In_ReqDataType: category=ARRAY, sw-calibration-access=READ-ONLY
      element Dcm_StartDataIn_Routine_31013000_XCP_Enable_Disable_Start_In_ReqDataTypeElement: array-size=1, array-size-semantics=FIXED-SIZE, implementation-data-type=Dcm_StartDataIn_Routine_31013000_XCP_Enable_Disable_Start_In_ReqDataArrayType
    Dcm_StartDataOut_Routine_31013000_XCP_Enable_Disable_Start_Out_ResDataArrayType: implementation-data-type=uint8
    Dcm_StartDataOut_Routine_31013000_XCP_Enable_Disable_Start_Out_ResDataType: category=ARRAY, sw-calibration-access=READ-ONLY
      element Dcm_StartDataOut_Routine_31013000_XCP_Enable_Disable_Start_Out_ResDataTypeElement: array-size=1, array-size-semantics=FIXED-SIZE, implementation-data-type=Dcm_StartDataOut_Routine_31013000_XCP_Enable_Disable_Start_Out_ResDataArrayType
    Dcm_Data5003ByteType: category=ARRAY, sw-calibration-access=READ-ONLY
      element Dcm_Data5003ByteTypeElement: array-size=5003, array-size-semantics=FIXED-SIZE, implementation-data-type=uint8
    Dcm_Data176ByteType: category=ARRAY, sw-calibration-access=READ-ONLY
      element Dcm_Data176ByteTypeElement: array-size=176, array-size-semantics=FIXED-SIZE, implementation-data-type=uint8
    Dcm_Data960ByteType: category=ARRAY, sw-calibration-access=READ-ONLY
      element Dcm_Data960ByteTypeElement: array-size=960, array-size-semantics=FIXED-SIZE, implementation-data-type=uint8
    Dcm_Data3072ByteType: category=ARRAY, sw-calibration-access=READ-ONLY
      element Dcm_Data3072ByteTypeElement: array-size=3072, array-size-semantics=FIXED-SIZE, implementation-data-type=uint8
    Dcm_Data43ByteType: category=ARRAY, sw-calibration-access=READ-ONLY
      element Dcm_Data43ByteTypeElement: array-size=43, array-size-semantics=FIXED-SIZE, implementation-data-type=uint8
    Dcm_Data71ByteType: category=ARRAY, sw-calibration-access=READ-ONLY
      element Dcm_Data71ByteTypeElement: array-size=71, array-size-semantics=FIXED-SIZE, implementation-data-type=uint8
    Dcm_Data20ByteType: category=ARRAY, sw-calibration-access=READ-ONLY
      element Dcm_Data20ByteTypeElement: array-size=20, array-size-semantics=FIXED-SIZE, implementation-data-type=uint8
    Dcm_Data40ByteType: category=ARRAY, sw-calibration-access=READ-ONLY
      element Dcm_Data40ByteTypeElement: array-size=40, array-size-semantics=FIXED-SIZE, implementation-data-type=uint8
    Dcm_Data66ByteType: category=ARRAY, sw-calibration-access=READ-ONLY
      element Dcm_Data66ByteTypeElement: array-size=66, array-size-semantics=FIXED-SIZE, implementation-data-type=uint8
    Dcm_Data352ByteType: category=ARRAY, sw-calibration-access=READ-ONLY
      element Dcm_Data352ByteTypeElement: array-size=352, array-size-semantics=FIXED-SIZE, implementation-data-type=uint8
    Dcm_Data96ByteType: category=ARRAY, sw-calibration-access=READ-ONLY
      element Dcm_Data96ByteTypeElement: array-size=96, array-size-semantics=FIXED-SIZE, implementation-data-type=uint8
    Dcm_Data1056ByteType: category=ARRAY, sw-calibration-access=READ-ONLY
      element Dcm_Data1056ByteTypeElement: array-size=1056, array-size-semantics=FIXED-SIZE, implementation-data-type=uint8
    Dcm_Data6ByteType: category=ARRAY, sw-calibration-access=READ-ONLY
      element Dcm_Data6ByteTypeElement: array-size=6, array-size-semantics=FIXED-SIZE, implementation-data-type=uint8
    Dcm_Data54ByteType: category=ARRAY, sw-calibration-access=READ-ONLY
      element Dcm_Data54ByteTypeElement: array-size=54, array-size-semantics=FIXED-SIZE, implementation-data-type=uint8
    Dcm_RequestDataOut_Routine_31015401_Camera_Service_Calibration_Start_Out_ResDataType: category=ARRAY, sw-calibration-access=READ-ONLY
      element Dcm_RequestDataOut_Routine_31015401_Camera_Service_Calibration_Start_Out_ResDataTypeElement: array-size=9, array-size-semantics=FIXED-SIZE, implementation-data-type=Dcm_RequestDataOut_Routine_31015401_Camera_Service_Calibration_Start_Out_ResDataArrayType
    Dcm_Data1296ByteType: category=ARRAY, sw-calibration-access=READ-ONLY
      element Dcm_Data1296ByteTypeElement: array-size=1296, array-size-semantics=FIXED-SIZE, implementation-data-type=uint8
    Dcm_Data44ByteType: category=ARRAY, sw-calibration-access=READ-ONLY
      element Dcm_Data44ByteTypeElement: array-size=44, array-size-semantics=FIXED-SIZE, implementation-data-type=uint8
    Dcm_StartDataOut_Routine_31015502_TRSC_Trailer_Calibration_Memory_Clear_Start_Out_ResDataArrayType: implementation-data-type=uint8
    Dcm_StartDataOut_Routine_31015502_TRSC_Trailer_Calibration_Memory_Clear_Start_Out_ResDataType: category=ARRAY, sw-calibration-access=READ-ONLY
      element Dcm_StartDataOut_Routine_31015502_TRSC_Trailer_Calibration_Memory_Clear_Start_Out_ResDataTypeElement: array-size=1, array-size-semantics=FIXED-SIZE, implementation-data-type=Dcm_StartDataOut_Routine_31015502_TRSC_Trailer_Calibration_Memory_Clear_Start_Out_ResDataArrayType
    Dcm_RequestDataOut_Routine_31015502_TRSC_Trailer_Calibration_Memory_Clear_Start_Out_ResDataArrayType: implementation-data-type=uint8
    Dcm_RequestDataOut_Routine_31015502_TRSC_Trailer_Calibration_Memory_Clear_Start_Out_ResDataType: category=ARRAY, sw-calibration-access=READ-ONLY
      element Dcm_RequestDataOut_Routine_31015502_TRSC_Trailer_Calibration_Memory_Clear_Start_Out_ResDataTypeElement: array-size=2, array-size-semantics=FIXED-SIZE, implementation-data-type=Dcm_RequestDataOut_Routine_31015502_TRSC_Trailer_Calibration_Memory_Clear_Start_Out_ResDataArrayType
    Dcm_Data138ByteType: category=ARRAY, sw-calibration-access=READ-ONLY
      element Dcm_Data138ByteTypeElement: array-size=138, array-size-semantics=FIXED-SIZE, implementation-data-type=uint8
    Dcm_Data306ByteType: category=ARRAY, sw-calibration-access=READ-ONLY
      element Dcm_Data306ByteTypeElement: array-size=306, array-size-semantics=FIXED-SIZE, implementation-data-type=uint8
    Dcm_Data37ByteType: category=ARRAY, sw-calibration-access=READ-ONLY
      element Dcm_Data37ByteTypeElement: array-size=37, array-size-semantics=FIXED-SIZE, implementation-data-type=uint8
package /MICROSAR/Dcm_swc/Interfaces
  4 x mode switch interface, all with is-service=true, service-kind=DIAGNOSTIC-COMMUNICATION-MANAGER:
    DcmControlDtcSetting
      mode group DcmControlDtcSetting: type=DcmControlDtcSetting
    DcmEcuReset
      mode group DcmEcuReset: type=DcmEcuReset
    DcmDiagnosticSessionControl
      mode group DcmDiagnosticSessionControl: type=DcmDiagnosticSessionControl
    DcmCommunicationControl_ComMConf_ComMChannel_CN_FDCAN2_28a8fc44
      mode group DcmCommunicationControl_ComMConf_ComMChannel_CN_FDCAN2_28a8fc44: type=DcmCommunicationControl
  184 x client server interface, all with is-service=true, service-kind=DIAGNOSTIC-COMMUNICATION-MANAGER:
    DCMServices
      6 x operation:
        GetActiveProtocol: possible-error=E_OK
          arg ActiveProtocol: type=Dcm_ProtocolType, direction=OUT
        GetSesCtrlType: possible-error=E_OK
          arg SesCtrlType: type=Dcm_SesCtrlType, direction=OUT
        ResetToDefaultSession: possible-error=E_OK
        GetSecurityLevel: possible-error=E_OK
          arg SecLevel: type=Dcm_SecLevelType, direction=OUT
        SetActiveDiagnostic: possible-error=E_OK
          arg active: type=boolean, direction=IN
        GetRequestKind: possible-error=DCMServices/E_NOT_OK
          arg TesterSourceAddress: type=uint16, direction=IN
          arg RequestKind: type=Dcm_RequestKindType, direction=OUT
      error E_OK: error-code=0
      error E_NOT_OK: error-code=1
    RoutineServices_Routine_31012000_Original_VIN_Lock
      operation Start: possible-error=[RoutineServices_Routine_31012000_Original_VIN_Lock/E_NOT_OK, RoutineServices_Routine_31012000_Original_VIN_Lock/DCM_E_PENDING, RoutineServices_Routine_31012000_Original_VIN_Lock/DCM_E_FORCE_RCRRP]
        arg OpStatus: type=Dcm_OpStatusType, direction=IN
        arg ErrorCode: type=Dcm_NegativeResponseCodeType, direction=OUT
      error E_NOT_OK: error-code=1
      error DCM_E_PENDING: error-code=10
      error DCM_E_FORCE_RCRRP: error-code=12
    RoutineServices_Routine_31012001_Original_VIN_Unlock
      operation Start: possible-error=[RoutineServices_Routine_31012001_Original_VIN_Unlock/E_NOT_OK, RoutineServices_Routine_31012001_Original_VIN_Unlock/DCM_E_PENDING, RoutineServices_Routine_31012001_Original_VIN_Unlock/DCM_E_FORCE_RCRRP]
        arg OpStatus: type=Dcm_OpStatusType, direction=IN
        arg ErrorCode: type=Dcm_NegativeResponseCodeType, direction=OUT
      error E_NOT_OK: error-code=1
      error DCM_E_PENDING: error-code=10
      error DCM_E_FORCE_RCRRP: error-code=12
    RoutineServices_Routine_31015000_Park_Assist_ON_OFF_State_Start
      operation Start: possible-error=[RoutineServices_Routine_31015000_Park_Assist_ON_OFF_State_Start/E_NOT_OK, RoutineServices_Routine_31015000_Park_Assist_ON_OFF_State_Start/DCM_E_PENDING, RoutineServices_Routine_31015000_Park_Assist_ON_OFF_State_Start/DCM_E_FORCE_RCRRP]
        arg In_ReqData: type=Dcm_StartDataIn_Routine_31015000_Park_Assist_ON_OFF_State_Start_In_ReqDataType, direction=IN
        arg OpStatus: type=Dcm_OpStatusType, direction=IN
        arg ErrorCode: type=Dcm_NegativeResponseCodeType, direction=OUT
      error E_NOT_OK: error-code=1
      error DCM_E_PENDING: error-code=10
      error DCM_E_FORCE_RCRRP: error-code=12
    RoutineServices_Routine_31015101_Sensor_Functional_Test_Start
      operation Start: possible-error=[RoutineServices_Routine_31015101_Sensor_Functional_Test_Start/E_NOT_OK, RoutineServices_Routine_31015101_Sensor_Functional_Test_Start/DCM_E_PENDING, RoutineServices_Routine_31015101_Sensor_Functional_Test_Start/DCM_E_FORCE_RCRRP]
        arg OpStatus: type=Dcm_OpStatusType, direction=IN
        arg ErrorCode: type=Dcm_NegativeResponseCodeType, direction=OUT
      error E_NOT_OK: error-code=1
      error DCM_E_PENDING: error-code=10
      error DCM_E_FORCE_RCRRP: error-code=12
    RoutineServices_Routine_31015200_Plant_Mode_Routine_Start
      operation Start: possible-error=[RoutineServices_Routine_31015200_Plant_Mode_Routine_Start/E_NOT_OK, RoutineServices_Routine_31015200_Plant_Mode_Routine_Start/DCM_E_PENDING, RoutineServices_Routine_31015200_Plant_Mode_Routine_Start/DCM_E_FORCE_RCRRP]
        arg In_ReqData: type=Dcm_StartDataIn_Routine_31015200_Plant_Mode_Routine_Start_In_ReqDataType, direction=IN
        arg OpStatus: type=Dcm_OpStatusType, direction=IN
        arg ErrorCode: type=Dcm_NegativeResponseCodeType, direction=OUT
      operation RequestResults: possible-error=[RoutineServices_Routine_31015200_Plant_Mode_Routine_Start/E_NOT_OK, RoutineServices_Routine_31015200_Plant_Mode_Routine_Start/DCM_E_PENDING, RoutineServices_Routine_31015200_Plant_Mode_Routine_Start/DCM_E_FORCE_RCRRP]
        arg OpStatus: type=Dcm_OpStatusType, direction=IN
        arg Out_ResData: type=Dcm_RequestDataOut_Routine_31015200_Plant_Mode_Routine_Start_Out_ResDataType, direction=OUT
        arg ErrorCode: type=Dcm_NegativeResponseCodeType, direction=OUT
      error E_NOT_OK: error-code=1
      error DCM_E_PENDING: error-code=10
      error DCM_E_FORCE_RCRRP: error-code=12
    RoutineServices_Routine_31015400_Camera_EOL_Calibration_Start
      operation Start: possible-error=[RoutineServices_Routine_31015400_Camera_EOL_Calibration_Start/E_NOT_OK, RoutineServices_Routine_31015400_Camera_EOL_Calibration_Start/DCM_E_PENDING, RoutineServices_Routine_31015400_Camera_EOL_Calibration_Start/DCM_E_FORCE_RCRRP]
        4 x arg:
          In_ReqData: type=Dcm_StartDataIn_Routine_31015400_Camera_EOL_Calibration_Start_In_ReqDataType, direction=IN
          OpStatus: type=Dcm_OpStatusType, direction=IN
          Out_ResData: type=Dcm_StartDataOut_Routine_31015400_Camera_EOL_Calibration_Start_Out_ResDataType, direction=OUT
          ErrorCode: type=Dcm_NegativeResponseCodeType, direction=OUT
      operation RequestResults: possible-error=[RoutineServices_Routine_31015400_Camera_EOL_Calibration_Start/E_NOT_OK, RoutineServices_Routine_31015400_Camera_EOL_Calibration_Start/DCM_E_PENDING, RoutineServices_Routine_31015400_Camera_EOL_Calibration_Start/DCM_E_FORCE_RCRRP]
        arg OpStatus: type=Dcm_OpStatusType, direction=IN
        arg Out_ResData: type=Dcm_RequestDataOut_Routine_31015400_Camera_EOL_Calibration_Start_Out_ResDataType, direction=OUT
        arg ErrorCode: type=Dcm_NegativeResponseCodeType, direction=OUT
      error E_NOT_OK: error-code=1
      error DCM_E_PENDING: error-code=10
      error DCM_E_FORCE_RCRRP: error-code=12
    RoutineServices_Routine_31015401_Camera_Service_Calibration_Start
      operation Start: possible-error=[RoutineServices_Routine_31015401_Camera_Service_Calibration_Start/E_NOT_OK, RoutineServices_Routine_31015401_Camera_Service_Calibration_Start/DCM_E_PENDING, RoutineServices_Routine_31015401_Camera_Service_Calibration_Start/DCM_E_FORCE_RCRRP]
        4 x arg:
          In_ReqData: type=Dcm_StartDataIn_Routine_31015401_Camera_Service_Calibration_Start_In_ReqDataType, direction=IN
          OpStatus: type=Dcm_OpStatusType, direction=IN
          Out_ResData: type=Dcm_StartDataOut_Routine_31015401_Camera_Service_Calibration_Start_Out_ResDataType, direction=OUT
          ErrorCode: type=Dcm_NegativeResponseCodeType, direction=OUT
      operation RequestResults: possible-error=[RoutineServices_Routine_31015401_Camera_Service_Calibration_Start/E_NOT_OK, RoutineServices_Routine_31015401_Camera_Service_Calibration_Start/DCM_E_PENDING, RoutineServices_Routine_31015401_Camera_Service_Calibration_Start/DCM_E_FORCE_RCRRP]
        arg OpStatus: type=Dcm_OpStatusType, direction=IN
        arg Out_ResData: type=Dcm_RequestDataOut_Routine_31015401_Camera_Service_Calibration_Start_Out_ResDataType, direction=OUT
        arg ErrorCode: type=Dcm_NegativeResponseCodeType, direction=OUT
      error E_NOT_OK: error-code=1
      error DCM_E_PENDING: error-code=10
      error DCM_E_FORCE_RCRRP: error-code=12
    RoutineServices_Routine_3101D001_Disable_Fail_safe_reaction_Start
      operation Start: possible-error=[RoutineServices_Routine_3101D001_Disable_Fail_safe_reaction_Start/E_NOT_OK, RoutineServices_Routine_3101D001_Disable_Fail_safe_reaction_Start/DCM_E_PENDING, RoutineServices_Routine_3101D001_Disable_Fail_safe_reaction_Start/DCM_E_FORCE_RCRRP]
        arg OpStatus: type=Dcm_OpStatusType, direction=IN
        arg ErrorCode: type=Dcm_NegativeResponseCodeType, direction=OUT
      operation Stop: possible-error=[RoutineServices_Routine_3101D001_Disable_Fail_safe_reaction_Start/E_NOT_OK, RoutineServices_Routine_3101D001_Disable_Fail_safe_reaction_Start/DCM_E_PENDING, RoutineServices_Routine_3101D001_Disable_Fail_safe_reaction_Start/DCM_E_FORCE_RCRRP]
        arg OpStatus: type=Dcm_OpStatusType, direction=IN
        arg ErrorCode: type=Dcm_NegativeResponseCodeType, direction=OUT
      error E_NOT_OK: error-code=1
      error DCM_E_PENDING: error-code=10
      error DCM_E_FORCE_RCRRP: error-code=12
    RoutineServices_Routine_3101D002_Check_Programming_Preconditions_Start
      operation Start: possible-error=[RoutineServices_Routine_3101D002_Check_Programming_Preconditions_Start/E_NOT_OK, RoutineServices_Routine_3101D002_Check_Programming_Preconditions_Start/DCM_E_PENDING, RoutineServices_Routine_3101D002_Check_Programming_Preconditions_Start/DCM_E_FORCE_RCRRP]
        4 x arg:
          OpStatus: type=Dcm_OpStatusType, direction=IN
          Out_ResData: type=Dcm_StartFlexibleOutArrayData_Routine_3101D002_Check_Programming_Preconditions_Start_Out_ResDataType, direction=OUT
          DataLength: type=uint16, direction=OUT
          ErrorCode: type=Dcm_NegativeResponseCodeType, direction=OUT
      error E_NOT_OK: error-code=1
      error DCM_E_PENDING: error-code=10
      error DCM_E_FORCE_RCRRP: error-code=12
    RoutineServices_Routine_3101D003_Application_Logical_Block_Hash
      operation Start: possible-error=[RoutineServices_Routine_3101D003_Application_Logical_Block_Hash/E_NOT_OK, RoutineServices_Routine_3101D003_Application_Logical_Block_Hash/DCM_E_PENDING, RoutineServices_Routine_3101D003_Application_Logical_Block_Hash/DCM_E_FORCE_RCRRP]
        4 x arg:
          In_ReqData: type=Dcm_StartDataIn_Routine_3101D003_Application_Logical_Block_Hash_In_ReqDataType, direction=IN
          OpStatus: type=Dcm_OpStatusType, direction=IN
          Out_ResData: type=Dcm_StartDataOut_Routine_3101D003_Application_Logical_Block_Hash_Out_ResDataType, direction=OUT
          ErrorCode: type=Dcm_NegativeResponseCodeType, direction=OUT
      error E_NOT_OK: error-code=1
      error DCM_E_PENDING: error-code=10
      error DCM_E_FORCE_RCRRP: error-code=12
    RoutineServices_Routine_3101F000_Check_Program_Start
      operation Start: possible-error=[RoutineServices_Routine_3101F000_Check_Program_Start/E_NOT_OK, RoutineServices_Routine_3101F000_Check_Program_Start/DCM_E_PENDING, RoutineServices_Routine_3101F000_Check_Program_Start/DCM_E_FORCE_RCRRP]
        arg OpStatus: type=Dcm_OpStatusType, direction=IN
        arg Out_ResData: type=Dcm_StartDataOut_Routine_3101F000_Check_Program_Start_Out_ResDataType, direction=OUT
        arg ErrorCode: type=Dcm_NegativeResponseCodeType, direction=OUT
      error E_NOT_OK: error-code=1
      error DCM_E_PENDING: error-code=10
      error DCM_E_FORCE_RCRRP: error-code=12
    RoutineServices_Routine_3101FE02_Test_Write_PMIC_Register_Start
      operation Start: possible-error=[RoutineServices_Routine_3101FE02_Test_Write_PMIC_Register_Start/E_NOT_OK, RoutineServices_Routine_3101FE02_Test_Write_PMIC_Register_Start/DCM_E_PENDING, RoutineServices_Routine_3101FE02_Test_Write_PMIC_Register_Start/DCM_E_FORCE_RCRRP]
        arg In_ReqData: type=Dcm_StartDataIn_Routine_3101FE02_Test_Write_PMIC_Register_Start_In_ReqDataType, direction=IN
        arg OpStatus: type=Dcm_OpStatusType, direction=IN
        arg ErrorCode: type=Dcm_NegativeResponseCodeType, direction=OUT
      error E_NOT_OK: error-code=1
      error DCM_E_PENDING: error-code=10
      error DCM_E_FORCE_RCRRP: error-code=12
    RoutineServices_Routine_3101FF00_FlashErase_Start
      operation Start: possible-error=[RoutineServices_Routine_3101FF00_FlashErase_Start/E_NOT_OK, RoutineServices_Routine_3101FF00_FlashErase_Start/DCM_E_PENDING, RoutineServices_Routine_3101FF00_FlashErase_Start/DCM_E_FORCE_RCRRP]
        arg OpStatus: type=Dcm_OpStatusType, direction=IN
        arg Out_ResData: type=Dcm_StartDataOut_Routine_3101FF00_FlashErase_Start_Out_ResDataType, direction=OUT
        arg ErrorCode: type=Dcm_NegativeResponseCodeType, direction=OUT
      error E_NOT_OK: error-code=1
      error DCM_E_PENDING: error-code=10
      error DCM_E_FORCE_RCRRP: error-code=12
    RoutineServices_Routine_3101FF01_checkProgrammingDependencies_FlashChecksum_Start
      operation Start: possible-error=[RoutineServices_Routine_3101FF01_checkProgrammingDependencies_FlashChecksum_Start/E_NOT_OK, RoutineServices_Routine_3101FF01_checkProgrammingDependencies_FlashChecksum_Start/DCM_E_PENDING, RoutineServices_Routine_3101FF01_checkProgrammingDependencies_FlashChecksum_Start/DCM_E_FORCE_RCRRP]
        arg OpStatus: type=Dcm_OpStatusType, direction=IN
        arg Out_ResData: type=Dcm_StartDataOut_Routine_3101FF01_checkProgrammingDependencies_FlashChecksum_Start_Out_ResDataType, direction=OUT
        arg ErrorCode: type=Dcm_NegativeResponseCodeType, direction=OUT
      error E_NOT_OK: error-code=1
      error DCM_E_PENDING: error-code=10
      error DCM_E_FORCE_RCRRP: error-code=12
    DataServices_Data_225103_FD_CAN2_Rx_Signals_Read
      operation ReadData: possible-error=[DataServices_Data_225103_FD_CAN2_Rx_Signals_Read/E_NOT_OK, DataServices_Data_225103_FD_CAN2_Rx_Signals_Read/DCM_E_PENDING]
        arg OpStatus: type=Dcm_OpStatusType, direction=IN
        arg Data: type=Dcm_Data41ByteType, direction=OUT
      error E_NOT_OK: error-code=1
      error DCM_E_PENDING: error-code=10
    DataServices_Data_22FD1E_Calibration_Status_Read
      operation ReadData: possible-error=[DataServices_Data_22FD1E_Calibration_Status_Read/E_NOT_OK, DataServices_Data_22FD1E_Calibration_Status_Read/DCM_E_PENDING]
        arg OpStatus: type=Dcm_OpStatusType, direction=IN
        arg Data: type=Dcm_Data21ByteType, direction=OUT
      error E_NOT_OK: error-code=1
      error DCM_E_PENDING: error-code=10
    DataServices_Data_220107_RoE_Activation_State
      operation ReadData: possible-error=[DataServices_Data_220107_RoE_Activation_State/E_NOT_OK, DataServices_Data_220107_RoE_Activation_State/DCM_E_PENDING]
        arg OpStatus: type=Dcm_OpStatusType, direction=IN
        arg Data: type=Dcm_Data1ByteType, direction=OUT
      operation WriteData: possible-error=[DataServices_Data_220107_RoE_Activation_State/E_NOT_OK, DataServices_Data_220107_RoE_Activation_State/DCM_E_PENDING]
        arg Data: type=Dcm_Data1ByteType, direction=IN
        arg OpStatus: type=Dcm_OpStatusType, direction=IN
        arg ErrorCode: type=Dcm_NegativeResponseCodeType, direction=OUT
      error E_NOT_OK: error-code=1
      error DCM_E_PENDING: error-code=10
    DataServices_Data_22FD1C_Current_Camera_Calibration_Data_Read
      operation ReadData: possible-error=[DataServices_Data_22FD1C_Current_Camera_Calibration_Data_Read/E_NOT_OK, DataServices_Data_22FD1C_Current_Camera_Calibration_Data_Read/DCM_E_PENDING]
        arg OpStatus: type=Dcm_OpStatusType, direction=IN
        arg Data: type=Dcm_Data52ByteType, direction=OUT
      error E_NOT_OK: error-code=1
      error DCM_E_PENDING: error-code=10
    DataServices_Data_22102A_Check_EOL_Configuration_Data
      operation ReadData: possible-error=[DataServices_Data_22102A_Check_EOL_Configuration_Data/E_NOT_OK, DataServices_Data_22102A_Check_EOL_Configuration_Data/DCM_E_PENDING]
        arg OpStatus: type=Dcm_OpStatusType, direction=IN
        arg Data: type=Dcm_Data9ByteType, direction=OUT
      error E_NOT_OK: error-code=1
      error DCM_E_PENDING: error-code=10
    DataServices_Data_2EF185_Application_Data_Software_Fingerprint_Writing_Information
      operation WriteData: possible-error=[DataServices_Data_2EF185_Application_Data_Software_Fingerprint_Writing_Information/E_NOT_OK, DataServices_Data_2EF185_Application_Data_Software_Fingerprint_Writing_Information/DCM_E_PENDING]
        arg Data: type=Dcm_Data14ByteType, direction=IN
        arg OpStatus: type=Dcm_OpStatusType, direction=IN
        arg ErrorCode: type=Dcm_NegativeResponseCodeType, direction=OUT
      error E_NOT_OK: error-code=1
      error DCM_E_PENDING: error-code=10
    DataServices_Data_222001_Odometer
      operation ReadData: possible-error=[DataServices_Data_222001_Odometer/E_NOT_OK, DataServices_Data_222001_Odometer/DCM_E_PENDING]
        arg OpStatus: type=Dcm_OpStatusType, direction=IN
        arg Data: type=Dcm_Data2ByteType, direction=OUT
      error E_NOT_OK: error-code=1
      error DCM_E_PENDING: error-code=10
    DataServices_Data_22F191_FCA_ESLM_ECU_Hardware_Number
      operation ReadData: possible-error=[DataServices_Data_22F191_FCA_ESLM_ECU_Hardware_Number/E_NOT_OK, DataServices_Data_22F191_FCA_ESLM_ECU_Hardware_Number/DCM_E_PENDING]
        arg OpStatus: type=Dcm_OpStatusType, direction=IN
        arg Data: type=Dcm_Data11ByteType, direction=OUT
      error E_NOT_OK: error-code=1
      error DCM_E_PENDING: error-code=10
    DataServices_Data_225303_SPM_Event_Abort_1_Read
      operation ReadData: possible-error=[DataServices_Data_225303_SPM_Event_Abort_1_Read/E_NOT_OK, DataServices_Data_225303_SPM_Event_Abort_1_Read/DCM_E_PENDING]
        arg OpStatus: type=Dcm_OpStatusType, direction=IN
        arg Data: type=Dcm_Data12ByteType, direction=OUT
      error E_NOT_OK: error-code=1
      error DCM_E_PENDING: error-code=10
    DataServices_Data_22100B_Diagnostic_Tool_and_Session_Status
      operation ReadData: possible-error=[DataServices_Data_22100B_Diagnostic_Tool_and_Session_Status/E_NOT_OK, DataServices_Data_22100B_Diagnostic_Tool_and_Session_Status/DCM_E_PENDING]
        arg OpStatus: type=Dcm_OpStatusType, direction=IN
        arg Data: type=Dcm_Data1ByteType, direction=OUT
      error E_NOT_OK: error-code=1
      error DCM_E_PENDING: error-code=10
    DataServices_Data_222002_Odometer_at_last_Flash_programming
      operation ReadData: possible-error=[DataServices_Data_222002_Odometer_at_last_Flash_programming/E_NOT_OK, DataServices_Data_222002_Odometer_at_last_Flash_programming/DCM_E_PENDING]
        arg OpStatus: type=Dcm_OpStatusType, direction=IN
        arg Data: type=Dcm_Data2ByteType, direction=OUT
      error E_NOT_OK: error-code=1
      error DCM_E_PENDING: error-code=10
    DataServices_Data_22FD48_PCBA_Temperature_Read
      operation ReadData: possible-error=[DataServices_Data_22FD48_PCBA_Temperature_Read/E_NOT_OK, DataServices_Data_22FD48_PCBA_Temperature_Read/DCM_E_PENDING]
        arg OpStatus: type=Dcm_OpStatusType, direction=IN
        arg Data: type=Dcm_Data4ByteType, direction=OUT
      error E_NOT_OK: error-code=1
      error DCM_E_PENDING: error-code=10
    DataServices_Data_22FD0E_Rear_Camera_Data_EEPROM_Read
      operation ReadData: possible-error=[DataServices_Data_22FD0E_Rear_Camera_Data_EEPROM_Read/E_NOT_OK, DataServices_Data_22FD0E_Rear_Camera_Data_EEPROM_Read/DCM_E_PENDING]
        arg OpStatus: type=Dcm_OpStatusType, direction=IN
        arg Data: type=Dcm_Data256ByteType, direction=OUT
      error E_NOT_OK: error-code=1
      error DCM_E_PENDING: error-code=10
    DataServices_Data_22FDF2_Reset_Reason_Read
      operation ReadData: possible-error=[DataServices_Data_22FDF2_Reset_Reason_Read/E_NOT_OK, DataServices_Data_22FDF2_Reset_Reason_Read/DCM_E_PENDING]
        arg OpStatus: type=Dcm_OpStatusType, direction=IN
        arg Data: type=Dcm_Data2ByteType, direction=OUT
      error E_NOT_OK: error-code=1
      error DCM_E_PENDING: error-code=10
    DataServices_Data_224422_USS_Sensor2_Part_Number_Read
      operation ReadData: possible-error=[DataServices_Data_224422_USS_Sensor2_Part_Number_Read/E_NOT_OK, DataServices_Data_224422_USS_Sensor2_Part_Number_Read/DCM_E_PENDING]
        arg OpStatus: type=Dcm_OpStatusType, direction=IN
        arg Data: type=Dcm_Data13ByteType, direction=OUT
      error E_NOT_OK: error-code=1
      error DCM_E_PENDING: error-code=10
    DataServices_Data_22F1B5_Application_Data_Software_Fingerprint_Reading_Information
      operation ReadData: possible-error=[DataServices_Data_22F1B5_Application_Data_Software_Fingerprint_Reading_Information/E_NOT_OK, DataServices_Data_22F1B5_Application_Data_Software_Fingerprint_Reading_Information/DCM_E_PENDING]
        arg OpStatus: type=Dcm_OpStatusType, direction=IN
        arg Data: type=Dcm_Data43ByteType, direction=OUT
      error E_NOT_OK: error-code=1
      error DCM_E_PENDING: error-code=10
    DataServices_Data_224428_USS_Sensor_8_Part_Number_Read
      operation ReadData: possible-error=[DataServices_Data_224428_USS_Sensor_8_Part_Number_Read/E_NOT_OK, DataServices_Data_224428_USS_Sensor_8_Part_Number_Read/DCM_E_PENDING]
        arg OpStatus: type=Dcm_OpStatusType, direction=IN
        arg Data: type=Dcm_Data13ByteType, direction=OUT
      error E_NOT_OK: error-code=1
      error DCM_E_PENDING: error-code=10
    DataServices_Data_221004_Battery_Voltage
      operation ReadData: possible-error=[DataServices_Data_221004_Battery_Voltage/E_NOT_OK, DataServices_Data_221004_Battery_Voltage/DCM_E_PENDING]
        arg OpStatus: type=Dcm_OpStatusType, direction=IN
        arg Data: type=Dcm_Data1ByteType, direction=OUT
      error E_NOT_OK: error-code=1
      error DCM_E_PENDING: error-code=10
    DataServices_Data_22200B_Time_First_DTC_Detection
      operation ReadData: possible-error=[DataServices_Data_22200B_Time_First_DTC_Detection/E_NOT_OK, DataServices_Data_22200B_Time_First_DTC_Detection/DCM_E_PENDING]
        arg OpStatus: type=Dcm_OpStatusType, direction=IN
        arg Data: type=Dcm_Data3ByteType, direction=OUT
      error E_NOT_OK: error-code=1
      error DCM_E_PENDING: error-code=10
    DataServices_Data_22F133_EBOM_Assembly_Part_Number
      operation ReadData: possible-error=[DataServices_Data_22F133_EBOM_Assembly_Part_Number/E_NOT_OK, DataServices_Data_22F133_EBOM_Assembly_Part_Number/DCM_E_PENDING]
        arg OpStatus: type=Dcm_OpStatusType, direction=IN
        arg Data: type=Dcm_Data10ByteType, direction=OUT
      error E_NOT_OK: error-code=1
      error DCM_E_PENDING: error-code=10
    DataServices_Data_22FD20_ECU_PinStates_Read
      operation ReadData: possible-error=[DataServices_Data_22FD20_ECU_PinStates_Read/E_NOT_OK, DataServices_Data_22FD20_ECU_PinStates_Read/DCM_E_PENDING]
        arg OpStatus: type=Dcm_OpStatusType, direction=IN
        arg Data: type=Dcm_Data2ByteType, direction=OUT
      error E_NOT_OK: error-code=1
      error DCM_E_PENDING: error-code=10
    DataServices_Data_22F112_PTESLM_Hardware_Number
      operation ReadData: possible-error=[DataServices_Data_22F112_PTESLM_Hardware_Number/E_NOT_OK, DataServices_Data_22F112_PTESLM_Hardware_Number/DCM_E_PENDING]
        arg OpStatus: type=Dcm_OpStatusType, direction=IN
        arg Data: type=Dcm_Data10ByteType, direction=OUT
      error E_NOT_OK: error-code=1
      error DCM_E_PENDING: error-code=10
    DataServices_Data_222939_FDCAN2_BUS_Network_WakeUp_Reason
      operation ReadData: possible-error=[DataServices_Data_222939_FDCAN2_BUS_Network_WakeUp_Reason/E_NOT_OK, DataServices_Data_222939_FDCAN2_BUS_Network_WakeUp_Reason/DCM_E_PENDING]
        arg OpStatus: type=Dcm_OpStatusType, direction=IN
        arg Data: type=Dcm_Data24ByteType, direction=OUT
      error E_NOT_OK: error-code=1
      error DCM_E_PENDING: error-code=10
    DataServices_Data_22FD0A_SC_Data_Read
      operation ReadData: possible-error=[DataServices_Data_22FD0A_SC_Data_Read/E_NOT_OK, DataServices_Data_22FD0A_SC_Data_Read/DCM_E_PENDING]
        arg OpStatus: type=Dcm_OpStatusType, direction=IN
        arg Data: type=Dcm_Data28ByteType, direction=OUT
      operation WriteData: possible-error=[DataServices_Data_22FD0A_SC_Data_Read/E_NOT_OK, DataServices_Data_22FD0A_SC_Data_Read/DCM_E_PENDING]
        arg Data: type=Dcm_Data28ByteType, direction=IN
        arg OpStatus: type=Dcm_OpStatusType, direction=IN
        arg ErrorCode: type=Dcm_NegativeResponseCodeType, direction=OUT
      error E_NOT_OK: error-code=1
      error DCM_E_PENDING: error-code=10
    DataServices_Data_221009_ECU_Time_Since_Ignition_ON
      operation ReadData: possible-error=[DataServices_Data_221009_ECU_Time_Since_Ignition_ON/E_NOT_OK, DataServices_Data_221009_ECU_Time_Since_Ignition_ON/DCM_E_PENDING]
        arg OpStatus: type=Dcm_OpStatusType, direction=IN
        arg Data: type=Dcm_Data2ByteType, direction=OUT
      error E_NOT_OK: error-code=1
      error DCM_E_PENDING: error-code=10
    DataServices_Data_22FD2B_USS_Direct_Distance_0xFD2B_Read
      operation ReadData: possible-error=[DataServices_Data_22FD2B_USS_Direct_Distance_0xFD2B_Read/E_NOT_OK, DataServices_Data_22FD2B_USS_Direct_Distance_0xFD2B_Read/DCM_E_PENDING]
        arg OpStatus: type=Dcm_OpStatusType, direction=IN
        arg Data: type=Dcm_Data24ByteType, direction=OUT
      error E_NOT_OK: error-code=1
      error DCM_E_PENDING: error-code=10
    DataServices_Data_22292E_PROXI_Write_Counter
      operation ReadData: possible-error=[DataServices_Data_22292E_PROXI_Write_Counter/E_NOT_OK, DataServices_Data_22292E_PROXI_Write_Counter/DCM_E_PENDING]
        arg OpStatus: type=Dcm_OpStatusType, direction=IN
        arg Data: type=Dcm_Data1ByteType, direction=OUT
      error E_NOT_OK: error-code=1
      error DCM_E_PENDING: error-code=10
    DataServices_Data_221002_Vehicle_Speed
      operation ReadData: possible-error=[DataServices_Data_221002_Vehicle_Speed/E_NOT_OK, DataServices_Data_221002_Vehicle_Speed/DCM_E_PENDING]
        arg OpStatus: type=Dcm_OpStatusType, direction=IN
        arg Data: type=Dcm_Data2ByteType, direction=OUT
      error E_NOT_OK: error-code=1
      error DCM_E_PENDING: error-code=10
    DataServices_Data_225500_Trailer_Sense_and_Drive_Function_Data_Read
      operation ReadData: possible-error=[DataServices_Data_225500_Trailer_Sense_and_Drive_Function_Data_Read/E_NOT_OK, DataServices_Data_225500_Trailer_Sense_and_Drive_Function_Data_Read/DCM_E_PENDING]
        arg OpStatus: type=Dcm_OpStatusType, direction=IN
        arg Data: type=Dcm_Data42ByteType, direction=OUT
      error E_NOT_OK: error-code=1
      error DCM_E_PENDING: error-code=10
    DataServices_Data_22F190_VIN_Original
      operation ReadData: possible-error=[DataServices_Data_22F190_VIN_Original/E_NOT_OK, DataServices_Data_22F190_VIN_Original/DCM_E_PENDING]
        arg OpStatus: type=Dcm_OpStatusType, direction=IN
        arg Data: type=Dcm_Data17ByteType, direction=OUT
      error E_NOT_OK: error-code=1
      error DCM_E_PENDING: error-code=10
    DataServices_Data_22FD42_Failsafe_Behaviour_Read
      operation ReadData: possible-error=[DataServices_Data_22FD42_Failsafe_Behaviour_Read/E_NOT_OK, DataServices_Data_22FD42_Failsafe_Behaviour_Read/DCM_E_PENDING]
        arg OpStatus: type=Dcm_OpStatusType, direction=IN
        arg Data: type=Dcm_Data1ByteType, direction=OUT
      operation WriteData: possible-error=[DataServices_Data_22FD42_Failsafe_Behaviour_Read/E_NOT_OK, DataServices_Data_22FD42_Failsafe_Behaviour_Read/DCM_E_PENDING]
        arg Data: type=Dcm_Data1ByteType, direction=IN
        arg OpStatus: type=Dcm_OpStatusType, direction=IN
        arg ErrorCode: type=Dcm_NegativeResponseCodeType, direction=OUT
      error E_NOT_OK: error-code=1
      error DCM_E_PENDING: error-code=10
    DataServices_Data_225302_Rear_Braking_Event_3_Read
      operation ReadData: possible-error=[DataServices_Data_225302_Rear_Braking_Event_3_Read/E_NOT_OK, DataServices_Data_225302_Rear_Braking_Event_3_Read/DCM_E_PENDING]
        arg OpStatus: type=Dcm_OpStatusType, direction=IN
        arg Data: type=Dcm_Data14ByteType, direction=OUT
      error E_NOT_OK: error-code=1
      error DCM_E_PENDING: error-code=10
    DataServices_Data_225300_Rear_Braking_Event_1_Read
      operation ReadData: possible-error=[DataServices_Data_225300_Rear_Braking_Event_1_Read/E_NOT_OK, DataServices_Data_225300_Rear_Braking_Event_1_Read/DCM_E_PENDING]
        arg OpStatus: type=Dcm_OpStatusType, direction=IN
        arg Data: type=Dcm_Data14ByteType, direction=OUT
      error E_NOT_OK: error-code=1
      error DCM_E_PENDING: error-code=10
    DataServices_Data_22FD2C_USS_Temperature_Read
      operation ReadData: possible-error=[DataServices_Data_22FD2C_USS_Temperature_Read/E_NOT_OK, DataServices_Data_22FD2C_USS_Temperature_Read/DCM_E_PENDING]
        arg OpStatus: type=Dcm_OpStatusType, direction=IN
        arg Data: type=Dcm_Data24ByteType, direction=OUT
      error E_NOT_OK: error-code=1
      error DCM_E_PENDING: error-code=10
    DataServices_Data_222003_Boot_Software_Programming_Attempt_Counter
      operation ReadData: possible-error=[DataServices_Data_222003_Boot_Software_Programming_Attempt_Counter/E_NOT_OK, DataServices_Data_222003_Boot_Software_Programming_Attempt_Counter/DCM_E_PENDING]
        arg OpStatus: type=Dcm_OpStatusType, direction=IN
        arg Data: type=Dcm_Data4ByteType, direction=OUT
      error E_NOT_OK: error-code=1
      error DCM_E_PENDING: error-code=10
    DataServices_Data_225501_Trailer_coupler_sense_detection_Function_Data_Read
      operation ReadData: possible-error=[DataServices_Data_225501_Trailer_coupler_sense_detection_Function_Data_Read/E_NOT_OK, DataServices_Data_225501_Trailer_coupler_sense_detection_Function_Data_Read/DCM_E_PENDING]
        arg OpStatus: type=Dcm_OpStatusType, direction=IN
        arg Data: type=Dcm_Data48ByteType, direction=OUT
      error E_NOT_OK: error-code=1
      error DCM_E_PENDING: error-code=10
    DataServices_Data_22F132_EBOM_ECU_Part_Number
      operation ReadData: possible-error=[DataServices_Data_22F132_EBOM_ECU_Part_Number/E_NOT_OK, DataServices_Data_22F132_EBOM_ECU_Part_Number/DCM_E_PENDING]
        arg OpStatus: type=Dcm_OpStatusType, direction=IN
        arg Data: type=Dcm_Data10ByteType, direction=OUT
      error E_NOT_OK: error-code=1
      error DCM_E_PENDING: error-code=10
    DataServices_Data_22F1B3_Boot_Software_Fingerprint_Reading_Information
      operation ReadData: possible-error=[DataServices_Data_22F1B3_Boot_Software_Fingerprint_Reading_Information/E_NOT_OK, DataServices_Data_22F1B3_Boot_Software_Fingerprint_Reading_Information/DCM_E_PENDING]
        arg OpStatus: type=Dcm_OpStatusType, direction=IN
        arg Data: type=Dcm_Data15ByteType, direction=OUT
      error E_NOT_OK: error-code=1
      error DCM_E_PENDING: error-code=10
    DataServices_Data_2F5001_Gear_Position_Read
      operation ReadData: possible-error=[DataServices_Data_2F5001_Gear_Position_Read/E_NOT_OK, DataServices_Data_2F5001_Gear_Position_Read/DCM_E_PENDING]
        arg OpStatus: type=Dcm_OpStatusType, direction=IN
        arg Data: type=Dcm_Data1ByteType, direction=OUT
      operation ReturnControlToECU: possible-error=[DataServices_Data_2F5001_Gear_Position_Read/E_NOT_OK, DataServices_Data_2F5001_Gear_Position_Read/DCM_E_PENDING]
        arg OpStatus: type=Dcm_OpStatusType, direction=IN
        arg ErrorCode: type=Dcm_NegativeResponseCodeType, direction=OUT
      operation ShortTermAdjustment: possible-error=[DataServices_Data_2F5001_Gear_Position_Read/E_NOT_OK, DataServices_Data_2F5001_Gear_Position_Read/DCM_E_PENDING]
        arg Data: type=Dcm_Data1ByteType, direction=IN
        arg OpStatus: type=Dcm_OpStatusType, direction=IN
        arg ErrorCode: type=Dcm_NegativeResponseCodeType, direction=OUT
      error E_NOT_OK: error-code=1
      error DCM_E_PENDING: error-code=10
    DataServices_Data_22F1B4_Application_Software_Fingerprint_Reading_Information
      operation ReadData: possible-error=[DataServices_Data_22F1B4_Application_Software_Fingerprint_Reading_Information/E_NOT_OK, DataServices_Data_22F1B4_Application_Software_Fingerprint_Reading_Information/DCM_E_PENDING]
        arg OpStatus: type=Dcm_OpStatusType, direction=IN
        arg Data: type=Dcm_Data71ByteType, direction=OUT
      error E_NOT_OK: error-code=1
      error DCM_E_PENDING: error-code=10
    DataServices_Data_22FD28_USS_Ringing_Frequency_Read
      operation ReadData: possible-error=[DataServices_Data_22FD28_USS_Ringing_Frequency_Read/E_NOT_OK, DataServices_Data_22FD28_USS_Ringing_Frequency_Read/DCM_E_PENDING]
        arg OpStatus: type=Dcm_OpStatusType, direction=IN
        arg Data: type=Dcm_Data24ByteType, direction=OUT
      error E_NOT_OK: error-code=1
      error DCM_E_PENDING: error-code=10
    DataServices_Data_22200D_Odometer_Last_Clear_Data_Trouble_Code_DTC
      operation ReadData: possible-error=[DataServices_Data_22200D_Odometer_Last_Clear_Data_Trouble_Code_DTC/E_NOT_OK, DataServices_Data_22200D_Odometer_Last_Clear_Data_Trouble_Code_DTC/DCM_E_PENDING]
        arg OpStatus: type=Dcm_OpStatusType, direction=IN
        arg Data: type=Dcm_Data2ByteType, direction=OUT
      error E_NOT_OK: error-code=1
      error DCM_E_PENDING: error-code=10
    DataServices_Data_22FD2D_USS_Sensor_ID_IME_SN_Read
      operation ReadData: possible-error=[DataServices_Data_22FD2D_USS_Sensor_ID_IME_SN_Read/E_NOT_OK, DataServices_Data_22FD2D_USS_Sensor_ID_IME_SN_Read/DCM_E_PENDING]
        arg OpStatus: type=Dcm_OpStatusType, direction=IN
        arg Data: type=Dcm_Data48ByteType, direction=OUT
      error E_NOT_OK: error-code=1
      error DCM_E_PENDING: error-code=10
    DataServices_Data_22F134_CODEP_assembly_part_number
      operation ReadData: possible-error=[DataServices_Data_22F134_CODEP_assembly_part_number/E_NOT_OK, DataServices_Data_22F134_CODEP_assembly_part_number/DCM_E_PENDING]
        arg OpStatus: type=Dcm_OpStatusType, direction=IN
        arg Data: type=Dcm_Data11ByteType, direction=OUT
      error E_NOT_OK: error-code=1
      error DCM_E_PENDING: error-code=10
    DataServices_Data_225301_Rear_Braking_Event_2_Read
      operation ReadData: possible-error=[DataServices_Data_225301_Rear_Braking_Event_2_Read/E_NOT_OK, DataServices_Data_225301_Rear_Braking_Event_2_Read/DCM_E_PENDING]
        arg OpStatus: type=Dcm_OpStatusType, direction=IN
        arg Data: type=Dcm_Data14ByteType, direction=OUT
      error E_NOT_OK: error-code=1
      error DCM_E_PENDING: error-code=10
    DataServices_Data_22201A_Application_Software_Programming_Attempt_Counter
      operation ReadData: possible-error=[DataServices_Data_22201A_Application_Software_Programming_Attempt_Counter/E_NOT_OK, DataServices_Data_22201A_Application_Software_Programming_Attempt_Counter/DCM_E_PENDING]
        arg OpStatus: type=Dcm_OpStatusType, direction=IN
        arg Data: type=Dcm_Data20ByteType, direction=OUT
      error E_NOT_OK: error-code=1
      error DCM_E_PENDING: error-code=10
    DataServices_Data_225102_FD_CAN14_Rx_Signals_Read
      operation ReadData: possible-error=[DataServices_Data_225102_FD_CAN14_Rx_Signals_Read/E_NOT_OK, DataServices_Data_225102_FD_CAN14_Rx_Signals_Read/DCM_E_PENDING]
        arg OpStatus: type=Dcm_OpStatusType, direction=IN
        arg Data: type=Dcm_Data34ByteType, direction=OUT
      error E_NOT_OK: error-code=1
      error DCM_E_PENDING: error-code=10
    DataServices_Data_22F1B0_VIN_Current
      operation ReadData: possible-error=[DataServices_Data_22F1B0_VIN_Current/E_NOT_OK, DataServices_Data_22F1B0_VIN_Current/DCM_E_PENDING]
        arg OpStatus: type=Dcm_OpStatusType, direction=IN
        arg Data: type=Dcm_Data17ByteType, direction=OUT
      error E_NOT_OK: error-code=1
      error DCM_E_PENDING: error-code=10
    DataServices_Data_22FD15_Magna_Production_HW_Number_Read
      operation ReadData: possible-error=[DataServices_Data_22FD15_Magna_Production_HW_Number_Read/E_NOT_OK, DataServices_Data_22FD15_Magna_Production_HW_Number_Read/DCM_E_PENDING]
        arg OpStatus: type=Dcm_OpStatusType, direction=IN
        arg Data: type=Dcm_Data13ByteType, direction=OUT
      error E_NOT_OK: error-code=1
      error DCM_E_PENDING: error-code=10
    DataServices_Data_22201B_Application_Data_Software_Programming_Attempt_Counter
      operation ReadData: possible-error=[DataServices_Data_22201B_Application_Data_Software_Programming_Attempt_Counter/E_NOT_OK, DataServices_Data_22201B_Application_Data_Software_Programming_Attempt_Counter/DCM_E_PENDING]
        arg OpStatus: type=Dcm_OpStatusType, direction=IN
        arg Data: type=Dcm_Data12ByteType, direction=OUT
      error E_NOT_OK: error-code=1
      error DCM_E_PENDING: error-code=10
    DataServices_Data_22200C_Time_Since_Ignition_ON_of_first_DTC_Detection
      operation ReadData: possible-error=[DataServices_Data_22200C_Time_Since_Ignition_ON_of_first_DTC_Detection/E_NOT_OK, DataServices_Data_22200C_Time_Since_Ignition_ON_of_first_DTC_Detection/DCM_E_PENDING]
        arg OpStatus: type=Dcm_OpStatusType, direction=IN
        arg Data: type=Dcm_Data2ByteType, direction=OUT
      error E_NOT_OK: error-code=1
      error DCM_E_PENDING: error-code=10
    DataServices_Data_22FD31_Magna_EOL_Coding_State_Read
      operation ReadData: possible-error=[DataServices_Data_22FD31_Magna_EOL_Coding_State_Read/E_NOT_OK, DataServices_Data_22FD31_Magna_EOL_Coding_State_Read/DCM_E_PENDING]
        arg OpStatus: type=Dcm_OpStatusType, direction=IN
        arg Data: type=Dcm_Data4ByteType, direction=OUT
      operation WriteData: possible-error=[DataServices_Data_22FD31_Magna_EOL_Coding_State_Read/E_NOT_OK, DataServices_Data_22FD31_Magna_EOL_Coding_State_Read/DCM_E_PENDING]
        arg Data: type=Dcm_Data4ByteType, direction=IN
        arg OpStatus: type=Dcm_OpStatusType, direction=IN
        arg ErrorCode: type=Dcm_NegativeResponseCodeType, direction=OUT
      error E_NOT_OK: error-code=1
      error DCM_E_PENDING: error-code=10
    DataServices_Data_224451_EOL_Calibration_State_Read
      operation ReadData: possible-error=[DataServices_Data_224451_EOL_Calibration_State_Read/E_NOT_OK, DataServices_Data_224451_EOL_Calibration_State_Read/DCM_E_PENDING]
        arg OpStatus: type=Dcm_OpStatusType, direction=IN
        arg Data: type=Dcm_Data44ByteType, direction=OUT
      error E_NOT_OK: error-code=1
      error DCM_E_PENDING: error-code=10
    DataServices_Data_22F155_Software_Supplier_Identification
      operation ReadData: possible-error=[DataServices_Data_22F155_Software_Supplier_Identification/E_NOT_OK, DataServices_Data_22F155_Software_Supplier_Identification/DCM_E_PENDING]
        arg OpStatus: type=Dcm_OpStatusType, direction=IN
        arg Data: type=Dcm_Data2ByteType, direction=OUT
      error E_NOT_OK: error-code=1
      error DCM_E_PENDING: error-code=10
    DataServices_Data_22F110_ECU_Diagnostic_Identification
      operation ReadData: possible-error=[DataServices_Data_22F110_ECU_Diagnostic_Identification/E_NOT_OK, DataServices_Data_22F110_ECU_Diagnostic_Identification/DCM_E_PENDING]
        arg OpStatus: type=Dcm_OpStatusType, direction=IN
        arg Data: type=Dcm_Data10ByteType, direction=OUT
      error E_NOT_OK: error-code=1
      error DCM_E_PENDING: error-code=10
    DataServices_Data_222024_Read_ECU_PROXI_Data
      operation ReadData: possible-error=[DataServices_Data_222024_Read_ECU_PROXI_Data/E_NOT_OK, DataServices_Data_222024_Read_ECU_PROXI_Data/DCM_E_PENDING]
        arg OpStatus: type=Dcm_OpStatusType, direction=IN
        arg Data: type=Dcm_Data255ByteType, direction=OUT
      operation ReadDataLength: possible-error=[DataServices_Data_222024_Read_ECU_PROXI_Data/E_NOT_OK, DataServices_Data_222024_Read_ECU_PROXI_Data/DCM_E_PENDING]
        arg OpStatus: type=Dcm_OpStatusType, direction=IN
        arg DataLength: type=uint16, direction=OUT
      error E_NOT_OK: error-code=1
      error DCM_E_PENDING: error-code=10
    DataServices_Data_22FD47_SoC_Temperature_0xFD47_Read
      operation ReadData: possible-error=[DataServices_Data_22FD47_SoC_Temperature_0xFD47_Read/E_NOT_OK, DataServices_Data_22FD47_SoC_Temperature_0xFD47_Read/DCM_E_PENDING]
        arg OpStatus: type=Dcm_OpStatusType, direction=IN
        arg Data: type=Dcm_Data10ByteType, direction=OUT
      error E_NOT_OK: error-code=1
      error DCM_E_PENDING: error-code=10
    DataServices_Data_222013_VIN_Lock_State_Read
      operation ReadData: possible-error=[DataServices_Data_222013_VIN_Lock_State_Read/E_NOT_OK, DataServices_Data_222013_VIN_Lock_State_Read/DCM_E_PENDING]
        arg OpStatus: type=Dcm_OpStatusType, direction=IN
        arg Data: type=Dcm_Data1ByteType, direction=OUT
      error E_NOT_OK: error-code=1
      error DCM_E_PENDING: error-code=10
    DataServices_Data_22F154_Hardware_Supplier_Identification
      operation ReadData: possible-error=[DataServices_Data_22F154_Hardware_Supplier_Identification/E_NOT_OK, DataServices_Data_22F154_Hardware_Supplier_Identification/DCM_E_PENDING]
        arg OpStatus: type=Dcm_OpStatusType, direction=IN
        arg Data: type=Dcm_Data2ByteType, direction=OUT
      error E_NOT_OK: error-code=1
      error DCM_E_PENDING: error-code=10
    DataServices_Data_22442A_USS_Sensor_10_Part_Number_Read
      operation ReadData: possible-error=[DataServices_Data_22442A_USS_Sensor_10_Part_Number_Read/E_NOT_OK, DataServices_Data_22442A_USS_Sensor_10_Part_Number_Read/DCM_E_PENDING]
        arg OpStatus: type=Dcm_OpStatusType, direction=IN
        arg Data: type=Dcm_Data13ByteType, direction=OUT
      error E_NOT_OK: error-code=1
      error DCM_E_PENDING: error-code=10
    DataServices_Data_22FD17_Magna_Production_HW_Version_information_Read
      operation ReadData: possible-error=[DataServices_Data_22FD17_Magna_Production_HW_Version_information_Read/E_NOT_OK, DataServices_Data_22FD17_Magna_Production_HW_Version_information_Read/DCM_E_PENDING]
        arg OpStatus: type=Dcm_OpStatusType, direction=IN
        arg Data: type=Dcm_Data3ByteType, direction=OUT
      error E_NOT_OK: error-code=1
      error DCM_E_PENDING: error-code=10
    DataServices_Data_225104_FD_CAN14_Tx_Signals_Read
      operation ReadData: possible-error=[DataServices_Data_225104_FD_CAN14_Tx_Signals_Read/E_NOT_OK, DataServices_Data_225104_FD_CAN14_Tx_Signals_Read/DCM_E_PENDING]
        arg OpStatus: type=Dcm_OpStatusType, direction=IN
        arg Data: type=Dcm_Data5ByteType, direction=OUT
      error E_NOT_OK: error-code=1
      error DCM_E_PENDING: error-code=10
    DataServices_Data_22FD07_OC_Result_Read
      operation ReadData: possible-error=[DataServices_Data_22FD07_OC_Result_Read/E_NOT_OK, DataServices_Data_22FD07_OC_Result_Read/DCM_E_PENDING]
        arg OpStatus: type=Dcm_OpStatusType, direction=IN
        arg Data: type=Dcm_Data8ByteType, direction=OUT
      error E_NOT_OK: error-code=1
      error DCM_E_PENDING: error-code=10
    DataServices_Data_22F18C_ECU_Serial_Number
      operation ReadData: possible-error=[DataServices_Data_22F18C_ECU_Serial_Number/E_NOT_OK, DataServices_Data_22F18C_ECU_Serial_Number/DCM_E_PENDING]
        arg OpStatus: type=Dcm_OpStatusType, direction=IN
        arg Data: type=Dcm_Data15ByteType, direction=OUT
      error E_NOT_OK: error-code=1
      error DCM_E_PENDING: error-code=10
    DataServices_Data_224421_USS_Sensor_1_Part_Number_Read
      operation ReadData: possible-error=[DataServices_Data_224421_USS_Sensor_1_Part_Number_Read/E_NOT_OK, DataServices_Data_224421_USS_Sensor_1_Part_Number_Read/DCM_E_PENDING]
        arg OpStatus: type=Dcm_OpStatusType, direction=IN
        arg Data: type=Dcm_Data13ByteType, direction=OUT
      error E_NOT_OK: error-code=1
      error DCM_E_PENDING: error-code=10
    DataServices_Data_22FD46_Camera_Power_Supply_Read
      operation ReadData: possible-error=[DataServices_Data_22FD46_Camera_Power_Supply_Read/E_NOT_OK, DataServices_Data_22FD46_Camera_Power_Supply_Read/DCM_E_PENDING]
        arg OpStatus: type=Dcm_OpStatusType, direction=IN
        arg Data: type=Dcm_Data8ByteType, direction=OUT
      error E_NOT_OK: error-code=1
      error DCM_E_PENDING: error-code=10
    DataServices_Data_22201F_Boot_Failure_Reason_Read
      operation ReadData: possible-error=[DataServices_Data_22201F_Boot_Failure_Reason_Read/E_NOT_OK, DataServices_Data_22201F_Boot_Failure_Reason_Read/DCM_E_PENDING]
        arg OpStatus: type=Dcm_OpStatusType, direction=IN
        arg Data: type=Dcm_Data2ByteType, direction=OUT
      error E_NOT_OK: error-code=1
      error DCM_E_PENDING: error-code=10
    DataServices_Data_22F18B_FCA_ESLM_ECU_Software_Application_Number
      operation ReadData: possible-error=[DataServices_Data_22F18B_FCA_ESLM_ECU_Software_Application_Number/E_NOT_OK, DataServices_Data_22F18B_FCA_ESLM_ECU_Software_Application_Number/DCM_E_PENDING]
        arg OpStatus: type=Dcm_OpStatusType, direction=IN
        arg Data: type=Dcm_Data10ByteType, direction=OUT
      error E_NOT_OK: error-code=1
      error DCM_E_PENDING: error-code=10
    DataServices_Data_22200A_Ignition_ON_Counter
      operation ReadData: possible-error=[DataServices_Data_22200A_Ignition_ON_Counter/E_NOT_OK, DataServices_Data_22200A_Ignition_ON_Counter/DCM_E_PENDING]
        arg OpStatus: type=Dcm_OpStatusType, direction=IN
        arg Data: type=Dcm_Data2ByteType, direction=OUT
      error E_NOT_OK: error-code=1
      error DCM_E_PENDING: error-code=10
    DataServices_Data_22F10D_Diagnostic_Specification_Information
      operation ReadData: possible-error=[DataServices_Data_22F10D_Diagnostic_Specification_Information/E_NOT_OK, DataServices_Data_22F10D_Diagnostic_Specification_Information/DCM_E_PENDING]
        arg OpStatus: type=Dcm_OpStatusType, direction=IN
        arg Data: type=Dcm_Data4ByteType, direction=OUT
      error E_NOT_OK: error-code=1
      error DCM_E_PENDING: error-code=10
    DataServices_Data_22F192_Supplier_ECU_Hardware_Part_Number
      operation ReadData: possible-error=[DataServices_Data_22F192_Supplier_ECU_Hardware_Part_Number/E_NOT_OK, DataServices_Data_22F192_Supplier_ECU_Hardware_Part_Number/DCM_E_PENDING]
        arg OpStatus: type=Dcm_OpStatusType, direction=IN
        arg Data: type=Dcm_Data11ByteType, direction=OUT
      error E_NOT_OK: error-code=1
      error DCM_E_PENDING: error-code=10
    DataServices_Data_222026_CAN_Overrun_Counters
      operation ReadData: possible-error=[DataServices_Data_222026_CAN_Overrun_Counters/E_NOT_OK, DataServices_Data_222026_CAN_Overrun_Counters/DCM_E_PENDING]
        arg OpStatus: type=Dcm_OpStatusType, direction=IN
        arg Data: type=Dcm_Data8ByteType, direction=OUT
      error E_NOT_OK: error-code=1
      error DCM_E_PENDING: error-code=10
    DataServices_Data_22F193_Supplier_ECU_Hardware_Version_Number
      operation ReadData: possible-error=[DataServices_Data_22F193_Supplier_ECU_Hardware_Version_Number/E_NOT_OK, DataServices_Data_22F193_Supplier_ECU_Hardware_Version_Number/DCM_E_PENDING]
        arg OpStatus: type=Dcm_OpStatusType, direction=IN
        arg Data: type=Dcm_Data1ByteType, direction=OUT
      error E_NOT_OK: error-code=1
      error DCM_E_PENDING: error-code=10
    DataServices_Data_22F1A2_Vector_Delivery_ID
      operation ReadData: possible-error=[DataServices_Data_22F1A2_Vector_Delivery_ID/E_NOT_OK, DataServices_Data_22F1A2_Vector_Delivery_ID/DCM_E_PENDING]
        arg OpStatus: type=Dcm_OpStatusType, direction=IN
        arg Data: type=Dcm_Data10ByteType, direction=OUT
      error E_NOT_OK: error-code=1
      error DCM_E_PENDING: error-code=10
    DataServices_Data_22FD0D_Left_Camera_Data_EEPROM_Read
      operation ReadData: possible-error=[DataServices_Data_22FD0D_Left_Camera_Data_EEPROM_Read/E_NOT_OK, DataServices_Data_22FD0D_Left_Camera_Data_EEPROM_Read/DCM_E_PENDING]
        arg OpStatus: type=Dcm_OpStatusType, direction=IN
        arg Data: type=Dcm_Data256ByteType, direction=OUT
      error E_NOT_OK: error-code=1
      error DCM_E_PENDING: error-code=10
    DataServices_Data_225100_SPM_status_Read
      operation ReadData: possible-error=[DataServices_Data_225100_SPM_status_Read/E_NOT_OK, DataServices_Data_225100_SPM_status_Read/DCM_E_PENDING]
        arg OpStatus: type=Dcm_OpStatusType, direction=IN
        arg Data: type=Dcm_Data4ByteType, direction=OUT
      error E_NOT_OK: error-code=1
      error DCM_E_PENDING: error-code=10
    DataServices_Data_22FD0C_Front_Camera_Data_EEPROM_Read
      operation ReadData: possible-error=[DataServices_Data_22FD0C_Front_Camera_Data_EEPROM_Read/E_NOT_OK, DataServices_Data_22FD0C_Front_Camera_Data_EEPROM_Read/DCM_E_PENDING]
        arg OpStatus: type=Dcm_OpStatusType, direction=IN
        arg Data: type=Dcm_Data256ByteType, direction=OUT
      error E_NOT_OK: error-code=1
      error DCM_E_PENDING: error-code=10
    DataServices_Data_220103_VIN_Lock_Status
      operation ReadData: possible-error=[DataServices_Data_220103_VIN_Lock_Status/E_NOT_OK, DataServices_Data_220103_VIN_Lock_Status/DCM_E_PENDING]
        arg OpStatus: type=Dcm_OpStatusType, direction=IN
        arg Data: type=Dcm_Data2ByteType, direction=OUT
      error E_NOT_OK: error-code=1
      error DCM_E_PENDING: error-code=10
    DataServices_Data_22FDF0_ECU_shutdown_process_Read
      operation ReadData: possible-error=[DataServices_Data_22FDF0_ECU_shutdown_process_Read/E_NOT_OK, DataServices_Data_22FDF0_ECU_shutdown_process_Read/DCM_E_PENDING]
        arg OpStatus: type=Dcm_OpStatusType, direction=IN
        arg Data: type=Dcm_Data1ByteType, direction=OUT
      operation WriteData: possible-error=[DataServices_Data_22FDF0_ECU_shutdown_process_Read/E_NOT_OK, DataServices_Data_22FDF0_ECU_shutdown_process_Read/DCM_E_PENDING]
        arg Data: type=Dcm_Data1ByteType, direction=IN
        arg OpStatus: type=Dcm_OpStatusType, direction=IN
        arg ErrorCode: type=Dcm_NegativeResponseCodeType, direction=OUT
      error E_NOT_OK: error-code=1
      error DCM_E_PENDING: error-code=10
    DataServices_Data_22191D_Time_of_Power_Latch
      operation ReadData: possible-error=[DataServices_Data_22191D_Time_of_Power_Latch/E_NOT_OK, DataServices_Data_22191D_Time_of_Power_Latch/DCM_E_PENDING]
        arg OpStatus: type=Dcm_OpStatusType, direction=IN
        arg Data: type=Dcm_Data1ByteType, direction=OUT
      error E_NOT_OK: error-code=1
      error DCM_E_PENDING: error-code=10
    DataServices_Data_22FDF1_CPU_Load_Read
      operation ReadData: possible-error=[DataServices_Data_22FDF1_CPU_Load_Read/E_NOT_OK, DataServices_Data_22FDF1_CPU_Load_Read/DCM_E_PENDING]
        arg OpStatus: type=Dcm_OpStatusType, direction=IN
        arg Data: type=Dcm_Data5ByteType, direction=OUT
      error E_NOT_OK: error-code=1
      error DCM_E_PENDING: error-code=10
    DataServices_Data_22F182_Application_Data_Identification
      operation ReadData: possible-error=[DataServices_Data_22F182_Application_Data_Identification/E_NOT_OK, DataServices_Data_22F182_Application_Data_Identification/DCM_E_PENDING]
        arg OpStatus: type=Dcm_OpStatusType, direction=IN
        arg Data: type=Dcm_Data40ByteType, direction=OUT
      error E_NOT_OK: error-code=1
      error DCM_E_PENDING: error-code=10
    DataServices_Data_22442B_USS_Sensor_11_Part_Number_Read
      operation ReadData: possible-error=[DataServices_Data_22442B_USS_Sensor_11_Part_Number_Read/E_NOT_OK, DataServices_Data_22442B_USS_Sensor_11_Part_Number_Read/DCM_E_PENDING]
        arg OpStatus: type=Dcm_OpStatusType, direction=IN
        arg Data: type=Dcm_Data13ByteType, direction=OUT
      error E_NOT_OK: error-code=1
      error DCM_E_PENDING: error-code=10
    DataServices_Data_2EF184_Application_Software_Fingerprint_writing_information
      operation WriteData: possible-error=[DataServices_Data_2EF184_Application_Software_Fingerprint_writing_information/E_NOT_OK, DataServices_Data_2EF184_Application_Software_Fingerprint_writing_information/DCM_E_PENDING]
        arg Data: type=Dcm_Data14ByteType, direction=IN
        arg OpStatus: type=Dcm_OpStatusType, direction=IN
        arg ErrorCode: type=Dcm_NegativeResponseCodeType, direction=OUT
      error E_NOT_OK: error-code=1
      error DCM_E_PENDING: error-code=10
    DataServices_Data_22F180_Boot_Software_Version_Information
      operation ReadData: possible-error=[DataServices_Data_22F180_Boot_Software_Version_Information/E_NOT_OK, DataServices_Data_22F180_Boot_Software_Version_Information/DCM_E_PENDING]
        arg OpStatus: type=Dcm_OpStatusType, direction=IN
        arg Data: type=Dcm_Data14ByteType, direction=OUT
      error E_NOT_OK: error-code=1
      error DCM_E_PENDING: error-code=10
    DataServices_Data_22FD29_USS_Driving_Frequency_Read
      operation ReadData: possible-error=[DataServices_Data_22FD29_USS_Driving_Frequency_Read/E_NOT_OK, DataServices_Data_22FD29_USS_Driving_Frequency_Read/DCM_E_PENDING]
        arg OpStatus: type=Dcm_OpStatusType, direction=IN
        arg Data: type=Dcm_Data24ByteType, direction=OUT
      error E_NOT_OK: error-code=1
      error DCM_E_PENDING: error-code=10
    DataServices_Data_22FD2A_USS_Ringing_Time_Read
      operation ReadData: possible-error=[DataServices_Data_22FD2A_USS_Ringing_Time_Read/E_NOT_OK, DataServices_Data_22FD2A_USS_Ringing_Time_Read/DCM_E_PENDING]
        arg OpStatus: type=Dcm_OpStatusType, direction=IN
        arg Data: type=Dcm_Data24ByteType, direction=OUT
      error E_NOT_OK: error-code=1
      error DCM_E_PENDING: error-code=10
    DataServices_Data_221921_Operational_Mode_Status
      operation ReadData: possible-error=[DataServices_Data_221921_Operational_Mode_Status/E_NOT_OK, DataServices_Data_221921_Operational_Mode_Status/DCM_E_PENDING]
        arg OpStatus: type=Dcm_OpStatusType, direction=IN
        arg Data: type=Dcm_Data9ByteType, direction=OUT
      error E_NOT_OK: error-code=1
      error DCM_E_PENDING: error-code=10
    DataServices_Data_225304_SPM_Event_Abort_2_Read
      operation ReadData: possible-error=[DataServices_Data_225304_SPM_Event_Abort_2_Read/E_NOT_OK, DataServices_Data_225304_SPM_Event_Abort_2_Read/DCM_E_PENDING]
        arg OpStatus: type=Dcm_OpStatusType, direction=IN
        arg Data: type=Dcm_Data12ByteType, direction=OUT
      error E_NOT_OK: error-code=1
      error DCM_E_PENDING: error-code=10
    DataServices_Data_22F1A1_Configuration_Code
      operation ReadData: possible-error=[DataServices_Data_22F1A1_Configuration_Code/E_NOT_OK, DataServices_Data_22F1A1_Configuration_Code/DCM_E_PENDING]
        arg OpStatus: type=Dcm_OpStatusType, direction=IN
        arg Data: type=Dcm_Data11ByteType, direction=OUT
      error E_NOT_OK: error-code=1
      error DCM_E_PENDING: error-code=10
    DataServices_Data_22F195_Supplier_ECU_Software_Version_Number
      operation ReadData: possible-error=[DataServices_Data_22F195_Supplier_ECU_Software_Version_Number/E_NOT_OK, DataServices_Data_22F195_Supplier_ECU_Software_Version_Number/DCM_E_PENDING]
        arg OpStatus: type=Dcm_OpStatusType, direction=IN
        arg Data: type=Dcm_Data2ByteType, direction=OUT
      error E_NOT_OK: error-code=1
      error DCM_E_PENDING: error-code=10
    DataServices_Data_22FD16_Magna_Production_ICT_Data_Read
      operation ReadData: possible-error=[DataServices_Data_22FD16_Magna_Production_ICT_Data_Read/E_NOT_OK, DataServices_Data_22FD16_Magna_Production_ICT_Data_Read/DCM_E_PENDING]
        arg OpStatus: type=Dcm_OpStatusType, direction=IN
        arg Data: type=Dcm_Data64ByteType, direction=OUT
      error E_NOT_OK: error-code=1
      error DCM_E_PENDING: error-code=10
    DataServices_Data_224429_USS_Sensor_9_Part_Number_Read
      operation ReadData: possible-error=[DataServices_Data_224429_USS_Sensor_9_Part_Number_Read/E_NOT_OK, DataServices_Data_224429_USS_Sensor_9_Part_Number_Read/DCM_E_PENDING]
        arg OpStatus: type=Dcm_OpStatusType, direction=IN
        arg Data: type=Dcm_Data13ByteType, direction=OUT
      error E_NOT_OK: error-code=1
      error DCM_E_PENDING: error-code=10
    DataServices_Data_222010_Programming_Status
      operation ReadData: possible-error=[DataServices_Data_222010_Programming_Status/E_NOT_OK, DataServices_Data_222010_Programming_Status/DCM_E_PENDING]
        arg OpStatus: type=Dcm_OpStatusType, direction=IN
        arg Data: type=Dcm_Data2ByteType, direction=OUT
      error E_NOT_OK: error-code=1
      error DCM_E_PENDING: error-code=10
    DataServices_Data_22F187_CODEP_ECU_Part_Number
      operation ReadData: possible-error=[DataServices_Data_22F187_CODEP_ECU_Part_Number/E_NOT_OK, DataServices_Data_22F187_CODEP_ECU_Part_Number/DCM_E_PENDING]
        arg OpStatus: type=Dcm_OpStatusType, direction=IN
        arg Data: type=Dcm_Data11ByteType, direction=OUT
      error E_NOT_OK: error-code=1
      error DCM_E_PENDING: error-code=10
    DataServices_Data_2E2023_PROXI_Data
      operation WriteData: possible-error=[DataServices_Data_2E2023_PROXI_Data/E_NOT_OK, DataServices_Data_2E2023_PROXI_Data/DCM_E_PENDING]
        4 x arg:
          Data: type=Dcm_Data255ByteType, direction=IN
          DataLength: type=uint16, direction=IN
          OpStatus: type=Dcm_OpStatusType, direction=IN
          ErrorCode: type=Dcm_NegativeResponseCodeType, direction=OUT
      error E_NOT_OK: error-code=1
      error DCM_E_PENDING: error-code=10
    DataServices_Data_22FD49_SoC_Die_Temperature_ID_0xFD49_Read
      operation ReadData: possible-error=[DataServices_Data_22FD49_SoC_Die_Temperature_ID_0xFD49_Read/E_NOT_OK, DataServices_Data_22FD49_SoC_Die_Temperature_ID_0xFD49_Read/DCM_E_PENDING]
        arg OpStatus: type=Dcm_OpStatusType, direction=IN
        arg Data: type=Dcm_Data16ByteType, direction=OUT
      error E_NOT_OK: error-code=1
      error DCM_E_PENDING: error-code=10
    DataServices_Data_22FD08_OC_Data_Read
      operation ReadData: possible-error=[DataServices_Data_22FD08_OC_Data_Read/E_NOT_OK, DataServices_Data_22FD08_OC_Data_Read/DCM_E_PENDING]
        arg OpStatus: type=Dcm_OpStatusType, direction=IN
        arg Data: type=Dcm_Data28ByteType, direction=OUT
      operation WriteData: possible-error=[DataServices_Data_22FD08_OC_Data_Read/E_NOT_OK, DataServices_Data_22FD08_OC_Data_Read/DCM_E_PENDING]
        arg Data: type=Dcm_Data28ByteType, direction=IN
        arg OpStatus: type=Dcm_OpStatusType, direction=IN
        arg ErrorCode: type=Dcm_NegativeResponseCodeType, direction=OUT
      error E_NOT_OK: error-code=1
      error DCM_E_PENDING: error-code=10
    DataServices_Data_22FD61_Vehicle_Variant_Coding_Data_Read
      operation ReadData: possible-error=[DataServices_Data_22FD61_Vehicle_Variant_Coding_Data_Read/E_NOT_OK, DataServices_Data_22FD61_Vehicle_Variant_Coding_Data_Read/DCM_E_PENDING]
        arg OpStatus: type=Dcm_OpStatusType, direction=IN
        arg Data: type=Dcm_Data12ByteType, direction=OUT
      error E_NOT_OK: error-code=1
      error DCM_E_PENDING: error-code=10
    DataServices_Data_22FD33_Magna_Testing_2_Read
      operation ReadData: possible-error=[DataServices_Data_22FD33_Magna_Testing_2_Read/E_NOT_OK, DataServices_Data_22FD33_Magna_Testing_2_Read/DCM_E_PENDING]
        arg OpStatus: type=Dcm_OpStatusType, direction=IN
        arg Data: type=Dcm_Data10ByteType, direction=OUT
      operation WriteData: possible-error=[DataServices_Data_22FD33_Magna_Testing_2_Read/E_NOT_OK, DataServices_Data_22FD33_Magna_Testing_2_Read/DCM_E_PENDING]
        arg Data: type=Dcm_Data10ByteType, direction=IN
        arg OpStatus: type=Dcm_OpStatusType, direction=IN
        arg ErrorCode: type=Dcm_NegativeResponseCodeType, direction=OUT
      error E_NOT_OK: error-code=1
      error DCM_E_PENDING: error-code=10
    DataServices_Data_22F181_Application_Software_Identification
      operation ReadData: possible-error=[DataServices_Data_22F181_Application_Software_Identification/E_NOT_OK, DataServices_Data_22F181_Application_Software_Identification/DCM_E_PENDING]
        arg OpStatus: type=Dcm_OpStatusType, direction=IN
        arg Data: type=Dcm_Data66ByteType, direction=OUT
      error E_NOT_OK: error-code=1
      error DCM_E_PENDING: error-code=10
    DataServices_Data_224427_USS_Sensor_7_Part_Number_Read
      operation ReadData: possible-error=[DataServices_Data_224427_USS_Sensor_7_Part_Number_Read/E_NOT_OK, DataServices_Data_224427_USS_Sensor_7_Part_Number_Read/DCM_E_PENDING]
        arg OpStatus: type=Dcm_OpStatusType, direction=IN
        arg Data: type=Dcm_Data13ByteType, direction=OUT
      error E_NOT_OK: error-code=1
      error DCM_E_PENDING: error-code=10
    DataServices_Data_22F188_FCA_ESLM_ECU_Software_Number
      operation ReadData: possible-error=[DataServices_Data_22F188_FCA_ESLM_ECU_Software_Number/E_NOT_OK, DataServices_Data_22F188_FCA_ESLM_ECU_Software_Number/DCM_E_PENDING]
        arg OpStatus: type=Dcm_OpStatusType, direction=IN
        arg Data: type=Dcm_Data11ByteType, direction=OUT
      error E_NOT_OK: error-code=1
      error DCM_E_PENDING: error-code=10
    DataServices_Data_22442C_USS_Sensor_12_Part_Number_Read
      operation ReadData: possible-error=[DataServices_Data_22442C_USS_Sensor_12_Part_Number_Read/E_NOT_OK, DataServices_Data_22442C_USS_Sensor_12_Part_Number_Read/DCM_E_PENDING]
        arg OpStatus: type=Dcm_OpStatusType, direction=IN
        arg Data: type=Dcm_Data13ByteType, direction=OUT
      error E_NOT_OK: error-code=1
      error DCM_E_PENDING: error-code=10
    DataServices_Data_224426_USS_Sensor_6_Part_Number_Read
      operation ReadData: possible-error=[DataServices_Data_224426_USS_Sensor_6_Part_Number_Read/E_NOT_OK, DataServices_Data_224426_USS_Sensor_6_Part_Number_Read/DCM_E_PENDING]
        arg OpStatus: type=Dcm_OpStatusType, direction=IN
        arg Data: type=Dcm_Data13ByteType, direction=OUT
      error E_NOT_OK: error-code=1
      error DCM_E_PENDING: error-code=10
    DataServices_Data_22F10B_ECU_Qualification
      operation ReadData: possible-error=[DataServices_Data_22F10B_ECU_Qualification/E_NOT_OK, DataServices_Data_22F10B_ECU_Qualification/DCM_E_PENDING]
        arg OpStatus: type=Dcm_OpStatusType, direction=IN
        arg Data: type=Dcm_Data2ByteType, direction=OUT
      error E_NOT_OK: error-code=1
      error DCM_E_PENDING: error-code=10
    DataServices_Data_225201_Plant_Mode_Status_Read
      operation ReadData: possible-error=[DataServices_Data_225201_Plant_Mode_Status_Read/E_NOT_OK, DataServices_Data_225201_Plant_Mode_Status_Read/DCM_E_PENDING]
        arg OpStatus: type=Dcm_OpStatusType, direction=IN
        arg Data: type=Dcm_Data1ByteType, direction=OUT
      error E_NOT_OK: error-code=1
      error DCM_E_PENDING: error-code=10
    DataServices_Data_222008_ECU_Life_Time_Not_Volatile_Memory
      operation ReadData: possible-error=[DataServices_Data_222008_ECU_Life_Time_Not_Volatile_Memory/E_NOT_OK, DataServices_Data_222008_ECU_Life_Time_Not_Volatile_Memory/DCM_E_PENDING]
        arg OpStatus: type=Dcm_OpStatusType, direction=IN
        arg Data: type=Dcm_Data3ByteType, direction=OUT
      error E_NOT_OK: error-code=1
      error DCM_E_PENDING: error-code=10
    DataServices_Data_22F18A_FCA_ESLM_ECU_Software_Calibration_Number
      operation ReadData: possible-error=[DataServices_Data_22F18A_FCA_ESLM_ECU_Software_Calibration_Number/E_NOT_OK, DataServices_Data_22F18A_FCA_ESLM_ECU_Software_Calibration_Number/DCM_E_PENDING]
        arg OpStatus: type=Dcm_OpStatusType, direction=IN
        arg Data: type=Dcm_Data10ByteType, direction=OUT
      error E_NOT_OK: error-code=1
      error DCM_E_PENDING: error-code=10
    DataServices_Data_224425_USS_Sensor_5_Part_Number_Read
      operation ReadData: possible-error=[DataServices_Data_224425_USS_Sensor_5_Part_Number_Read/E_NOT_OK, DataServices_Data_224425_USS_Sensor_5_Part_Number_Read/DCM_E_PENDING]
        arg OpStatus: type=Dcm_OpStatusType, direction=IN
        arg Data: type=Dcm_Data13ByteType, direction=OUT
      error E_NOT_OK: error-code=1
      error DCM_E_PENDING: error-code=10
    DataServices_Data_22F122_Software_EBOM_Part_Number
      operation ReadData: possible-error=[DataServices_Data_22F122_Software_EBOM_Part_Number/E_NOT_OK, DataServices_Data_22F122_Software_EBOM_Part_Number/DCM_E_PENDING]
        arg OpStatus: type=Dcm_OpStatusType, direction=IN
        arg Data: type=Dcm_Data90ByteType, direction=OUT
      error E_NOT_OK: error-code=1
      error DCM_E_PENDING: error-code=10
    DataServices_Data_225105_FD_CAN2_Tx_Signals_Read
      operation ReadData: possible-error=[DataServices_Data_225105_FD_CAN2_Tx_Signals_Read/E_NOT_OK, DataServices_Data_225105_FD_CAN2_Tx_Signals_Read/DCM_E_PENDING]
        arg OpStatus: type=Dcm_OpStatusType, direction=IN
        arg Data: type=Dcm_Data19ByteType, direction=OUT
      error E_NOT_OK: error-code=1
      error DCM_E_PENDING: error-code=10
    DataServices_Data_22F1A0_System_Identification_Data
      operation ReadData: possible-error=[DataServices_Data_22F1A0_System_Identification_Data/E_NOT_OK, DataServices_Data_22F1A0_System_Identification_Data/DCM_E_PENDING]
        arg OpStatus: type=Dcm_OpStatusType, direction=IN
        arg Data: type=Dcm_Data90ByteType, direction=OUT
      error E_NOT_OK: error-code=1
      error DCM_E_PENDING: error-code=10
    DataServices_Data_22FD0F_Right_Camera_Data_EEPROM_Read
      operation ReadData: possible-error=[DataServices_Data_22FD0F_Right_Camera_Data_EEPROM_Read/E_NOT_OK, DataServices_Data_22FD0F_Right_Camera_Data_EEPROM_Read/DCM_E_PENDING]
        arg OpStatus: type=Dcm_OpStatusType, direction=IN
        arg Data: type=Dcm_Data256ByteType, direction=OUT
      error E_NOT_OK: error-code=1
      error DCM_E_PENDING: error-code=10
    DataServices_Data_224424_USS_Sensor_4_Part_Number_Read
      operation ReadData: possible-error=[DataServices_Data_224424_USS_Sensor_4_Part_Number_Read/E_NOT_OK, DataServices_Data_224424_USS_Sensor_4_Part_Number_Read/DCM_E_PENDING]
        arg OpStatus: type=Dcm_OpStatusType, direction=IN
        arg Data: type=Dcm_Data13ByteType, direction=OUT
      error E_NOT_OK: error-code=1
      error DCM_E_PENDING: error-code=10
    DataServices_Data_221008_ECU_Life_Time
      operation ReadData: possible-error=[DataServices_Data_221008_ECU_Life_Time/E_NOT_OK, DataServices_Data_221008_ECU_Life_Time/DCM_E_PENDING]
        arg OpStatus: type=Dcm_OpStatusType, direction=IN
        arg Data: type=Dcm_Data3ByteType, direction=OUT
      error E_NOT_OK: error-code=1
      error DCM_E_PENDING: error-code=10
    DataServices_Data_22F194_Supplier_ECU_Software_Part_Number
      operation ReadData: possible-error=[DataServices_Data_22F194_Supplier_ECU_Software_Part_Number/E_NOT_OK, DataServices_Data_22F194_Supplier_ECU_Software_Part_Number/DCM_E_PENDING]
        arg OpStatus: type=Dcm_OpStatusType, direction=IN
        arg Data: type=Dcm_Data11ByteType, direction=OUT
      error E_NOT_OK: error-code=1
      error DCM_E_PENDING: error-code=10
    DataServices_Data_224423_USS_Sensor_3_Part_Number_Read
      operation ReadData: possible-error=[DataServices_Data_224423_USS_Sensor_3_Part_Number_Read/E_NOT_OK, DataServices_Data_224423_USS_Sensor_3_Part_Number_Read/DCM_E_PENDING]
        arg OpStatus: type=Dcm_OpStatusType, direction=IN
        arg Data: type=Dcm_Data13ByteType, direction=OUT
      error E_NOT_OK: error-code=1
      error DCM_E_PENDING: error-code=10
    DataServices_Data_22FD2E_USS_Sensor_ID_Murata_SN_Read
      operation ReadData: possible-error=[DataServices_Data_22FD2E_USS_Sensor_ID_Murata_SN_Read/E_NOT_OK, DataServices_Data_22FD2E_USS_Sensor_ID_Murata_SN_Read/DCM_E_PENDING]
        arg OpStatus: type=Dcm_OpStatusType, direction=IN
        arg Data: type=Dcm_Data48ByteType, direction=OUT
      error E_NOT_OK: error-code=1
      error DCM_E_PENDING: error-code=10
    DataServices_Data_22F1A6_Message_Matrix
      operation ReadData: possible-error=[DataServices_Data_22F1A6_Message_Matrix/E_NOT_OK, DataServices_Data_22F1A6_Message_Matrix/DCM_E_PENDING]
        arg OpStatus: type=Dcm_OpStatusType, direction=IN
        arg Data: type=Dcm_Data3ByteType, direction=OUT
      error E_NOT_OK: error-code=1
      error DCM_E_PENDING: error-code=10
    DataServices_Data_222945_Flow_Control_Test
      operation ReadData: possible-error=[DataServices_Data_222945_Flow_Control_Test/E_NOT_OK, DataServices_Data_222945_Flow_Control_Test/DCM_E_PENDING]
        arg OpStatus: type=Dcm_OpStatusType, direction=IN
        arg Data: type=Dcm_Data200ByteType, direction=OUT
      operation WriteData: possible-error=[DataServices_Data_222945_Flow_Control_Test/E_NOT_OK, DataServices_Data_222945_Flow_Control_Test/DCM_E_PENDING]
        arg Data: type=Dcm_Data200ByteType, direction=IN
        arg OpStatus: type=Dcm_OpStatusType, direction=IN
        arg ErrorCode: type=Dcm_NegativeResponseCodeType, direction=OUT
      error E_NOT_OK: error-code=1
      error DCM_E_PENDING: error-code=10
    DataServices_Data_22F186_Active_Diagnostic_Session
      operation ReadData: possible-error=[DataServices_Data_22F186_Active_Diagnostic_Session/E_NOT_OK, DataServices_Data_22F186_Active_Diagnostic_Session/DCM_E_PENDING]
        arg OpStatus: type=Dcm_OpStatusType, direction=IN
        arg Data: type=Dcm_Data3ByteType, direction=OUT
      error E_NOT_OK: error-code=1
      error DCM_E_PENDING: error-code=10
    ServiceRequestNotification
      operation Indication: possible-error=[ServiceRequestNotification/E_NOT_OK, E_REQUEST_NOT_ACCEPTED]
        6 x arg:
          SID: type=uint8, direction=IN
          RequestData: type=Dcm_Data5003ByteType, direction=IN
          DataSize: type=uint16, direction=IN
          ReqType: type=uint8, direction=IN
          SourceAddress: type=uint16, direction=IN
          ErrorCode: type=Dcm_NegativeResponseCodeType, direction=OUT
      operation Confirmation: possible-error=ServiceRequestNotification/E_NOT_OK
        4 x arg, all with direction=IN:
          SID: type=uint8
          ReqType: type=uint8
          SourceAddress: type=uint16
          ConfirmationStatus: type=Dcm_ConfirmationStatusType
      error E_NOT_OK: error-code=1
      error E_REQUEST_NOT_ACCEPTED: error-code=8
    RoutineServices_Routine_3101FE01_Calibration_Data_Reset_Start
      operation Start: possible-error=[RoutineServices_Routine_3101FE01_Calibration_Data_Reset_Start/E_NOT_OK, RoutineServices_Routine_3101FE01_Calibration_Data_Reset_Start/DCM_E_PENDING, RoutineServices_Routine_3101FE01_Calibration_Data_Reset_Start/DCM_E_FORCE_RCRRP]
        4 x arg:
          In_ReqData: type=Dcm_StartDataIn_Routine_3101FE01_Calibration_Data_Reset_Start_In_ReqDataType, direction=IN
          OpStatus: type=Dcm_OpStatusType, direction=IN
          Out_ResData: type=Dcm_StartDataOut_Routine_3101FE01_Calibration_Data_Reset_Start_Out_ResDataType, direction=OUT
          ErrorCode: type=Dcm_NegativeResponseCodeType, direction=OUT
      error E_NOT_OK: error-code=1
      error DCM_E_PENDING: error-code=10
      error DCM_E_FORCE_RCRRP: error-code=12
    RoutineServices_Routine_3101FE0E_Test_Pattern_Control_Start
      operation Start: possible-error=[RoutineServices_Routine_3101FE0E_Test_Pattern_Control_Start/E_NOT_OK, RoutineServices_Routine_3101FE0E_Test_Pattern_Control_Start/DCM_E_PENDING, RoutineServices_Routine_3101FE0E_Test_Pattern_Control_Start/DCM_E_FORCE_RCRRP]
        4 x arg:
          In_ReqData: type=Dcm_StartDataIn_Routine_3101FE0E_Test_Pattern_Control_Start_In_ReqDataType, direction=IN
          OpStatus: type=Dcm_OpStatusType, direction=IN
          Out_ResData: type=Dcm_StartDataOut_Routine_3101FE0E_Test_Pattern_Control_Start_Out_ResDataType, direction=OUT
          ErrorCode: type=Dcm_NegativeResponseCodeType, direction=OUT
      operation Stop: possible-error=[RoutineServices_Routine_3101FE0E_Test_Pattern_Control_Start/E_NOT_OK, RoutineServices_Routine_3101FE0E_Test_Pattern_Control_Start/DCM_E_PENDING, RoutineServices_Routine_3101FE0E_Test_Pattern_Control_Start/DCM_E_FORCE_RCRRP]
        arg OpStatus: type=Dcm_OpStatusType, direction=IN
        arg ErrorCode: type=Dcm_NegativeResponseCodeType, direction=OUT
      error E_NOT_OK: error-code=1
      error DCM_E_PENDING: error-code=10
      error DCM_E_FORCE_RCRRP: error-code=12
    RoutineServices_Routine_3101FF03_Test_Read_PMIC_Register_Start
      operation Start: possible-error=[RoutineServices_Routine_3101FF03_Test_Read_PMIC_Register_Start/E_NOT_OK, RoutineServices_Routine_3101FF03_Test_Read_PMIC_Register_Start/DCM_E_PENDING, RoutineServices_Routine_3101FF03_Test_Read_PMIC_Register_Start/DCM_E_FORCE_RCRRP]
        4 x arg:
          In_ReqData: type=Dcm_StartDataIn_Routine_3101FF03_Test_Read_PMIC_Register_Start_In_ReqDataType, direction=IN
          OpStatus: type=Dcm_OpStatusType, direction=IN
          Out_ResData: type=Dcm_StartDataOut_Routine_3101FF03_Test_Read_PMIC_Register_Start_Out_ResDataType, direction=OUT
          ErrorCode: type=Dcm_NegativeResponseCodeType, direction=OUT
      error E_NOT_OK: error-code=1
      error DCM_E_PENDING: error-code=10
      error DCM_E_FORCE_RCRRP: error-code=12
    DataServices_Data_22FD01_Previous_Camera_Calibration_Data
      operation ReadData: possible-error=[DataServices_Data_22FD01_Previous_Camera_Calibration_Data/E_NOT_OK, DataServices_Data_22FD01_Previous_Camera_Calibration_Data/DCM_E_PENDING]
        arg OpStatus: type=Dcm_OpStatusType, direction=IN
        arg Data: type=Dcm_Data50ByteType, direction=OUT
      error E_NOT_OK: error-code=1
      error DCM_E_PENDING: error-code=10
    DataServices_Data_22FD60_ECU_Software_Status_Read
      operation ReadData: possible-error=[DataServices_Data_22FD60_ECU_Software_Status_Read/E_NOT_OK, DataServices_Data_22FD60_ECU_Software_Status_Read/DCM_E_PENDING]
        arg OpStatus: type=Dcm_OpStatusType, direction=IN
        arg Data: type=Dcm_Data14ByteType, direction=OUT
      error E_NOT_OK: error-code=1
      error DCM_E_PENDING: error-code=10
    DataServices_Data_22FD14_FD14_Magna_Production_Date_Read
      operation ReadData: possible-error=[DataServices_Data_22FD14_FD14_Magna_Production_Date_Read/E_NOT_OK, DataServices_Data_22FD14_FD14_Magna_Production_Date_Read/DCM_E_PENDING]
        arg OpStatus: type=Dcm_OpStatusType, direction=IN
        arg Data: type=Dcm_Data5ByteType, direction=OUT
      error E_NOT_OK: error-code=1
      error DCM_E_PENDING: error-code=10
    DataServices_Data_22FD38_Programmed_Assembly
      operation ReadData: possible-error=[DataServices_Data_22FD38_Programmed_Assembly/E_NOT_OK, DataServices_Data_22FD38_Programmed_Assembly/DCM_E_PENDING]
        arg OpStatus: type=Dcm_OpStatusType, direction=IN
        arg Data: type=Dcm_Data16ByteType, direction=OUT
      error E_NOT_OK: error-code=1
      error DCM_E_PENDING: error-code=10
    DataServices_Data_22FD00_Plant_Camera_Calibration_Data
      operation ReadData: possible-error=[DataServices_Data_22FD00_Plant_Camera_Calibration_Data/E_NOT_OK, DataServices_Data_22FD00_Plant_Camera_Calibration_Data/DCM_E_PENDING]
        arg OpStatus: type=Dcm_OpStatusType, direction=IN
        arg Data: type=Dcm_Data54ByteType, direction=OUT
      operation WriteData: possible-error=[DataServices_Data_22FD00_Plant_Camera_Calibration_Data/E_NOT_OK, DataServices_Data_22FD00_Plant_Camera_Calibration_Data/DCM_E_PENDING]
        arg Data: type=Dcm_Data54ByteType, direction=IN
        arg OpStatus: type=Dcm_OpStatusType, direction=IN
        arg ErrorCode: type=Dcm_NegativeResponseCodeType, direction=OUT
      error E_NOT_OK: error-code=1
      error DCM_E_PENDING: error-code=10
    DataServices_Data_225305_SPM_Event_Abort_3_Read
      operation ReadData: possible-error=[DataServices_Data_225305_SPM_Event_Abort_3_Read/E_NOT_OK, DataServices_Data_225305_SPM_Event_Abort_3_Read/DCM_E_PENDING]
        arg OpStatus: type=Dcm_OpStatusType, direction=IN
        arg Data: type=Dcm_Data12ByteType, direction=OUT
      error E_NOT_OK: error-code=1
      error DCM_E_PENDING: error-code=10
    DataServices_Data_22FD1D_PCB_Serial_Number
      operation ReadData: possible-error=[DataServices_Data_22FD1D_PCB_Serial_Number/E_NOT_OK, DataServices_Data_22FD1D_PCB_Serial_Number/DCM_E_PENDING]
        arg OpStatus: type=Dcm_OpStatusType, direction=IN
        arg Data: type=Dcm_Data14ByteType, direction=OUT
      error E_NOT_OK: error-code=1
      error DCM_E_PENDING: error-code=10
    DataServices_Data_22FD13_Magna_Software_Version
      operation ReadData: possible-error=[DataServices_Data_22FD13_Magna_Software_Version/E_NOT_OK, DataServices_Data_22FD13_Magna_Software_Version/DCM_E_PENDING]
        arg OpStatus: type=Dcm_OpStatusType, direction=IN
        arg Data: type=Dcm_Data32ByteType, direction=OUT
      error E_NOT_OK: error-code=1
      error DCM_E_PENDING: error-code=10
    RoutineServices_Routine_31011000_USS_Debug_Signals_Enable_Disable_Start
      operation Start: possible-error=[RoutineServices_Routine_31011000_USS_Debug_Signals_Enable_Disable_Start/E_NOT_OK, RoutineServices_Routine_31011000_USS_Debug_Signals_Enable_Disable_Start/DCM_E_PENDING, RoutineServices_Routine_31011000_USS_Debug_Signals_Enable_Disable_Start/DCM_E_FORCE_RCRRP]
        4 x arg:
          In_ReqData: type=Dcm_StartDataIn_Routine_31011000_USS_Debug_Signals_Enable_Disable_Start_In_ReqDataType, direction=IN
          OpStatus: type=Dcm_OpStatusType, direction=IN
          Out_ResData: type=Dcm_StartDataOut_Routine_31011000_USS_Debug_Signals_Enable_Disable_Start_Out_ResDataType, direction=OUT
          ErrorCode: type=Dcm_NegativeResponseCodeType, direction=OUT
      error E_NOT_OK: error-code=1
      error DCM_E_PENDING: error-code=10
      error DCM_E_FORCE_RCRRP: error-code=12
    RoutineServices_Routine_31013000_XCP_Enable_Disable_Start
      operation Start: possible-error=[RoutineServices_Routine_31013000_XCP_Enable_Disable_Start/E_NOT_OK, RoutineServices_Routine_31013000_XCP_Enable_Disable_Start/DCM_E_PENDING, RoutineServices_Routine_31013000_XCP_Enable_Disable_Start/DCM_E_FORCE_RCRRP]
        4 x arg:
          In_ReqData: type=Dcm_StartDataIn_Routine_31013000_XCP_Enable_Disable_Start_In_ReqDataType, direction=IN
          OpStatus: type=Dcm_OpStatusType, direction=IN
          Out_ResData: type=Dcm_StartDataOut_Routine_31013000_XCP_Enable_Disable_Start_Out_ResDataType, direction=OUT
          ErrorCode: type=Dcm_NegativeResponseCodeType, direction=OUT
      error E_NOT_OK: error-code=1
      error DCM_E_PENDING: error-code=10
      error DCM_E_FORCE_RCRRP: error-code=12
    DataServices_Data_22F111_Public_Certificates_Regional_Support_Read
      operation ReadData: possible-error=[DataServices_Data_22F111_Public_Certificates_Regional_Support_Read/E_NOT_OK, DataServices_Data_22F111_Public_Certificates_Regional_Support_Read/DCM_E_PENDING]
        arg OpStatus: type=Dcm_OpStatusType, direction=IN
        arg Data: type=Dcm_Data1ByteType, direction=OUT
      error E_NOT_OK: error-code=1
      error DCM_E_PENDING: error-code=10
    DataServices_Data_222032_Secure_Log_Read
      operation ReadData: possible-error=[DataServices_Data_222032_Secure_Log_Read/E_NOT_OK, DataServices_Data_222032_Secure_Log_Read/DCM_E_PENDING]
        arg OpStatus: type=Dcm_OpStatusType, direction=IN
        arg Data: type=Dcm_Data1296ByteType, direction=OUT
      error E_NOT_OK: error-code=1
      error DCM_E_PENDING: error-code=10
    DataServices_Data_222959_Hosted_App_Firmware_Cal_Config_Data_Header_Info_Read
      operation ReadData: possible-error=[DataServices_Data_222959_Hosted_App_Firmware_Cal_Config_Data_Header_Info_Read/E_NOT_OK, DataServices_Data_222959_Hosted_App_Firmware_Cal_Config_Data_Header_Info_Read/DCM_E_PENDING]
        arg OpStatus: type=Dcm_OpStatusType, direction=IN
        arg Data: type=Dcm_Data352ByteType, direction=OUT
      error E_NOT_OK: error-code=1
      error DCM_E_PENDING: error-code=10
    DataServices_Data_22100C_Security_Status_Read
      operation ReadData: possible-error=[DataServices_Data_22100C_Security_Status_Read/E_NOT_OK, DataServices_Data_22100C_Security_Status_Read/DCM_E_PENDING]
        arg OpStatus: type=Dcm_OpStatusType, direction=IN
        arg Data: type=Dcm_Data5ByteType, direction=OUT
      error E_NOT_OK: error-code=1
      error DCM_E_PENDING: error-code=10
    DataServices_Data_222954_Policy_Type_Read
      operation ReadData: possible-error=[DataServices_Data_222954_Policy_Type_Read/E_NOT_OK, DataServices_Data_222954_Policy_Type_Read/DCM_E_PENDING]
        arg OpStatus: type=Dcm_OpStatusType, direction=IN
        arg Data: type=Dcm_Data1ByteType, direction=OUT
      error E_NOT_OK: error-code=1
      error DCM_E_PENDING: error-code=10
    DataServices_Data_222030_Authenticated_Diagnostic_Previous_Access_Read
      operation ReadData: possible-error=[DataServices_Data_222030_Authenticated_Diagnostic_Previous_Access_Read/E_NOT_OK, DataServices_Data_222030_Authenticated_Diagnostic_Previous_Access_Read/DCM_E_PENDING]
        arg OpStatus: type=Dcm_OpStatusType, direction=IN
        arg Data: type=Dcm_Data960ByteType, direction=OUT
      error E_NOT_OK: error-code=1
      error DCM_E_PENDING: error-code=10
    DataServices_Data_2EFD4E_Reset_NVM_Write
      operation WriteData: possible-error=[DataServices_Data_2EFD4E_Reset_NVM_Write/E_NOT_OK, DataServices_Data_2EFD4E_Reset_NVM_Write/DCM_E_PENDING]
        arg Data: type=Dcm_Data1ByteType, direction=IN
        arg OpStatus: type=Dcm_OpStatusType, direction=IN
        arg ErrorCode: type=Dcm_NegativeResponseCodeType, direction=OUT
      error E_NOT_OK: error-code=1
      error DCM_E_PENDING: error-code=10
    DataServices_Data_22FD64_ASIL_B_Fault_Status_Read
      operation ReadData: possible-error=[DataServices_Data_22FD64_ASIL_B_Fault_Status_Read/E_NOT_OK, DataServices_Data_22FD64_ASIL_B_Fault_Status_Read/DCM_E_PENDING]
        arg OpStatus: type=Dcm_OpStatusType, direction=IN
        arg Data: type=Dcm_Data138ByteType, direction=OUT
      error E_NOT_OK: error-code=1
      error DCM_E_PENDING: error-code=10
    DataServices_Data_220108_Authenticated_Diagnostics_Active_Role_Read
      operation ReadData: possible-error=[DataServices_Data_220108_Authenticated_Diagnostics_Active_Role_Read/E_NOT_OK, DataServices_Data_220108_Authenticated_Diagnostics_Active_Role_Read/DCM_E_PENDING]
        arg OpStatus: type=Dcm_OpStatusType, direction=IN
        arg Data: type=Dcm_Data4ByteType, direction=OUT
      error E_NOT_OK: error-code=1
      error DCM_E_PENDING: error-code=10
    DataServices_Data_22295F_DCL_and_Cerstore_Header_Info_Read
      operation ReadData: possible-error=[DataServices_Data_22295F_DCL_and_Cerstore_Header_Info_Read/E_NOT_OK, DataServices_Data_22295F_DCL_and_Cerstore_Header_Info_Read/DCM_E_PENDING]
        arg OpStatus: type=Dcm_OpStatusType, direction=IN
        arg Data: type=Dcm_Data176ByteType, direction=OUT
      error E_NOT_OK: error-code=1
      error DCM_E_PENDING: error-code=10
    DataServices_Data_222031_Disallowed_Certificate_List_Read
      operation ReadData: possible-error=[DataServices_Data_222031_Disallowed_Certificate_List_Read/E_NOT_OK, DataServices_Data_222031_Disallowed_Certificate_List_Read/DCM_E_PENDING]
        arg OpStatus: type=Dcm_OpStatusType, direction=IN
        arg Data: type=Dcm_Data3072ByteType, direction=OUT
      error E_NOT_OK: error-code=1
      error DCM_E_PENDING: error-code=10
    DataServices_Data_22295A_Hosted_App_Firmware_Cal_Config_Data_Header_UUID_Read
      operation ReadData: possible-error=[DataServices_Data_22295A_Hosted_App_Firmware_Cal_Config_Data_Header_UUID_Read/E_NOT_OK, DataServices_Data_22295A_Hosted_App_Firmware_Cal_Config_Data_Header_UUID_Read/DCM_E_PENDING]
        arg OpStatus: type=Dcm_OpStatusType, direction=IN
        arg Data: type=Dcm_Data32ByteType, direction=OUT
      error E_NOT_OK: error-code=1
      error DCM_E_PENDING: error-code=10
    DataServices_Data_222958_Hosted_App_firmware_Header_UUID_Read
      operation ReadData: possible-error=[DataServices_Data_222958_Hosted_App_firmware_Header_UUID_Read/E_NOT_OK, DataServices_Data_222958_Hosted_App_firmware_Header_UUID_Read/DCM_E_PENDING]
        arg OpStatus: type=Dcm_OpStatusType, direction=IN
        arg Data: type=Dcm_Data96ByteType, direction=OUT
      error E_NOT_OK: error-code=1
      error DCM_E_PENDING: error-code=10
    DataServices_Data_222957_Hosted_App_Firmware_Header_Info_Read
      operation ReadData: possible-error=[DataServices_Data_222957_Hosted_App_Firmware_Header_Info_Read/E_NOT_OK, DataServices_Data_222957_Hosted_App_Firmware_Header_Info_Read/DCM_E_PENDING]
        arg OpStatus: type=Dcm_OpStatusType, direction=IN
        arg Data: type=Dcm_Data1056ByteType, direction=OUT
      error E_NOT_OK: error-code=1
      error DCM_E_PENDING: error-code=10
    DataServices_Data_22FD62_ASIL_QM_Fault_Status_Read
      operation ReadData: possible-error=[DataServices_Data_22FD62_ASIL_QM_Fault_Status_Read/E_NOT_OK, DataServices_Data_22FD62_ASIL_QM_Fault_Status_Read/DCM_E_PENDING]
        arg OpStatus: type=Dcm_OpStatusType, direction=IN
        arg Data: type=Dcm_Data2ByteType, direction=OUT
      error E_NOT_OK: error-code=1
      error DCM_E_PENDING: error-code=10
    DataServices_Data_22FD86_Functional_Settings_Read
      operation ReadData: possible-error=[DataServices_Data_22FD86_Functional_Settings_Read/E_NOT_OK, DataServices_Data_22FD86_Functional_Settings_Read/DCM_E_PENDING]
        arg OpStatus: type=Dcm_OpStatusType, direction=IN
        arg Data: type=Dcm_Data6ByteType, direction=OUT
      operation WriteData: possible-error=[DataServices_Data_22FD86_Functional_Settings_Read/E_NOT_OK, DataServices_Data_22FD86_Functional_Settings_Read/DCM_E_PENDING]
        arg Data: type=Dcm_Data6ByteType, direction=IN
        arg OpStatus: type=Dcm_OpStatusType, direction=IN
        arg ErrorCode: type=Dcm_NegativeResponseCodeType, direction=OUT
      error E_NOT_OK: error-code=1
      error DCM_E_PENDING: error-code=10
    DataServices_Data_225109_Rear_Sensor_HealthBlockage_LiveDetection_Check_Read
      operation ReadData: possible-error=[DataServices_Data_225109_Rear_Sensor_HealthBlockage_LiveDetection_Check_Read/E_NOT_OK, DataServices_Data_225109_Rear_Sensor_HealthBlockage_LiveDetection_Check_Read/DCM_E_PENDING]
        arg OpStatus: type=Dcm_OpStatusType, direction=IN
        arg Data: type=Dcm_Data15ByteType, direction=OUT
      error E_NOT_OK: error-code=1
      error DCM_E_PENDING: error-code=10
    DataServices_Data_225107_Front_Sensor_HealthBlockage_LiveDetection_Check_Read
      operation ReadData: possible-error=[DataServices_Data_225107_Front_Sensor_HealthBlockage_LiveDetection_Check_Read/E_NOT_OK, DataServices_Data_225107_Front_Sensor_HealthBlockage_LiveDetection_Check_Read/DCM_E_PENDING]
        arg OpStatus: type=Dcm_OpStatusType, direction=IN
        arg Data: type=Dcm_Data15ByteType, direction=OUT
      error E_NOT_OK: error-code=1
      error DCM_E_PENDING: error-code=10
    DataServices_Data_22FD4A_Ultrasonic_Sensors_Power_supply_and_Current_Level_Read
      operation ReadData: possible-error=[DataServices_Data_22FD4A_Ultrasonic_Sensors_Power_supply_and_Current_Level_Read/E_NOT_OK, DataServices_Data_22FD4A_Ultrasonic_Sensors_Power_supply_and_Current_Level_Read/DCM_E_PENDING]
        arg OpStatus: type=Dcm_OpStatusType, direction=IN
        arg Data: type=Dcm_Data9ByteType, direction=OUT
      error E_NOT_OK: error-code=1
      error DCM_E_PENDING: error-code=10
    DataServices_Data_22FD65_FuSa_Module_Status_Read
      operation ReadData: possible-error=[DataServices_Data_22FD65_FuSa_Module_Status_Read/E_NOT_OK, DataServices_Data_22FD65_FuSa_Module_Status_Read/DCM_E_PENDING]
        arg OpStatus: type=Dcm_OpStatusType, direction=IN
        arg Data: type=Dcm_Data28ByteType, direction=OUT
      error E_NOT_OK: error-code=1
      error DCM_E_PENDING: error-code=10
    DataServices_Data_222951_Certificate_Store_UUID_Read
      operation ReadData: possible-error=[DataServices_Data_222951_Certificate_Store_UUID_Read/E_NOT_OK, DataServices_Data_222951_Certificate_Store_UUID_Read/DCM_E_PENDING]
        arg OpStatus: type=Dcm_OpStatusType, direction=IN
        arg Data: type=Dcm_Data16ByteType, direction=OUT
      error E_NOT_OK: error-code=1
      error DCM_E_PENDING: error-code=10
    DataServices_Data_22FD66_Camera_occlusion_and_low_light_status_Read
      operation ReadData: possible-error=[DataServices_Data_22FD66_Camera_occlusion_and_low_light_status_Read/E_NOT_OK, DataServices_Data_22FD66_Camera_occlusion_and_low_light_status_Read/DCM_E_PENDING]
        arg OpStatus: type=Dcm_OpStatusType, direction=IN
        arg Data: type=Dcm_Data9ByteType, direction=OUT
      error E_NOT_OK: error-code=1
      error DCM_E_PENDING: error-code=10
    DataServices_Data_22FD67_Camera_DLD_Status_Read
      operation ReadData: possible-error=[DataServices_Data_22FD67_Camera_DLD_Status_Read/E_NOT_OK, DataServices_Data_22FD67_Camera_DLD_Status_Read/DCM_E_PENDING]
        arg OpStatus: type=Dcm_OpStatusType, direction=IN
        arg Data: type=Dcm_Data4ByteType, direction=OUT
      error E_NOT_OK: error-code=1
      error DCM_E_PENDING: error-code=10
    DataServices_Data_22295B_HTA_Header_Info_Read
      operation ReadData: possible-error=[DataServices_Data_22295B_HTA_Header_Info_Read/E_NOT_OK, DataServices_Data_22295B_HTA_Header_Info_Read/DCM_E_PENDING]
        arg OpStatus: type=Dcm_OpStatusType, direction=IN
        arg Data: type=Dcm_Data176ByteType, direction=OUT
      error E_NOT_OK: error-code=1
      error DCM_E_PENDING: error-code=10
    DataServices_Data_22FD43_Active_Safe_State_Read
      operation ReadData: possible-error=[DataServices_Data_22FD43_Active_Safe_State_Read/E_NOT_OK, DataServices_Data_22FD43_Active_Safe_State_Read/DCM_E_PENDING]
        arg OpStatus: type=Dcm_OpStatusType, direction=IN
        arg Data: type=Dcm_Data14ByteType, direction=OUT
      error E_NOT_OK: error-code=1
      error DCM_E_PENDING: error-code=10
    DataServices_Data_22FD44_Error_Flags_Read
      operation ReadData: possible-error=[DataServices_Data_22FD44_Error_Flags_Read/E_NOT_OK, DataServices_Data_22FD44_Error_Flags_Read/DCM_E_PENDING]
        arg OpStatus: type=Dcm_OpStatusType, direction=IN
        arg Data: type=Dcm_Data4ByteType, direction=OUT
      error E_NOT_OK: error-code=1
      error DCM_E_PENDING: error-code=10
    DataServices_Data_22295E_DCL_Header_UUID_Read
      operation ReadData: possible-error=[DataServices_Data_22295E_DCL_Header_UUID_Read/E_NOT_OK, DataServices_Data_22295E_DCL_Header_UUID_Read/DCM_E_PENDING]
        arg OpStatus: type=Dcm_OpStatusType, direction=IN
        arg Data: type=Dcm_Data16ByteType, direction=OUT
      error E_NOT_OK: error-code=1
      error DCM_E_PENDING: error-code=10
    DataServices_Data_22295C_HTA_Header_UUID_Read
      operation ReadData: possible-error=[DataServices_Data_22295C_HTA_Header_UUID_Read/E_NOT_OK, DataServices_Data_22295C_HTA_Header_UUID_Read/DCM_E_PENDING]
        arg OpStatus: type=Dcm_OpStatusType, direction=IN
        arg Data: type=Dcm_Data16ByteType, direction=OUT
      error E_NOT_OK: error-code=1
      error DCM_E_PENDING: error-code=10
    DataServices_Data_22FD74_PHY_Tunning_Error_And_Buffer_Mark_Error_Read
      operation ReadData: possible-error=[DataServices_Data_22FD74_PHY_Tunning_Error_And_Buffer_Mark_Error_Read/E_NOT_OK, DataServices_Data_22FD74_PHY_Tunning_Error_And_Buffer_Mark_Error_Read/DCM_E_PENDING]
        arg OpStatus: type=Dcm_OpStatusType, direction=IN
        arg Data: type=Dcm_Data4ByteType, direction=OUT
      error E_NOT_OK: error-code=1
      error DCM_E_PENDING: error-code=10
    RoutineServices_Routine_31015502_TRSC_Trailer_Calibration_Memory_Clear_Start
      operation Start: possible-error=[RoutineServices_Routine_31015502_TRSC_Trailer_Calibration_Memory_Clear_Start/E_NOT_OK, RoutineServices_Routine_31015502_TRSC_Trailer_Calibration_Memory_Clear_Start/DCM_E_PENDING, RoutineServices_Routine_31015502_TRSC_Trailer_Calibration_Memory_Clear_Start/DCM_E_FORCE_RCRRP]
        arg OpStatus: type=Dcm_OpStatusType, direction=IN
        arg Out_ResData: type=Dcm_StartDataOut_Routine_31015502_TRSC_Trailer_Calibration_Memory_Clear_Start_Out_ResDataType, direction=OUT
        arg ErrorCode: type=Dcm_NegativeResponseCodeType, direction=OUT
      operation RequestResults: possible-error=[RoutineServices_Routine_31015502_TRSC_Trailer_Calibration_Memory_Clear_Start/E_NOT_OK, RoutineServices_Routine_31015502_TRSC_Trailer_Calibration_Memory_Clear_Start/DCM_E_PENDING, RoutineServices_Routine_31015502_TRSC_Trailer_Calibration_Memory_Clear_Start/DCM_E_FORCE_RCRRP]
        arg OpStatus: type=Dcm_OpStatusType, direction=IN
        arg Out_ResData: type=Dcm_RequestDataOut_Routine_31015502_TRSC_Trailer_Calibration_Memory_Clear_Start_Out_ResDataType, direction=OUT
        arg ErrorCode: type=Dcm_NegativeResponseCodeType, direction=OUT
      error E_NOT_OK: error-code=1
      error DCM_E_PENDING: error-code=10
      error DCM_E_FORCE_RCRRP: error-code=12
    DataServices_Data_22FDF7_Intrinsic_Camera_NvM_Data_Read
      operation ReadData: possible-error=[DataServices_Data_22FDF7_Intrinsic_Camera_NvM_Data_Read/E_NOT_OK, DataServices_Data_22FDF7_Intrinsic_Camera_NvM_Data_Read/DCM_E_PENDING]
        arg OpStatus: type=Dcm_OpStatusType, direction=IN
        arg Data: type=Dcm_Data44ByteType, direction=OUT
      error E_NOT_OK: error-code=1
      error DCM_E_PENDING: error-code=10
    DataServices_Data_22FDF6_RunTimeStatsData_Read
      operation ReadData: possible-error=[DataServices_Data_22FDF6_RunTimeStatsData_Read/E_NOT_OK, DataServices_Data_22FDF6_RunTimeStatsData_Read/DCM_E_PENDING]
        arg OpStatus: type=Dcm_OpStatusType, direction=IN
        arg Data: type=Dcm_Data306ByteType, direction=OUT
      error E_NOT_OK: error-code=1
      error DCM_E_PENDING: error-code=10
    DataServices_Data_22FD04_USS_Sensor_tuning_values_Read
      operation ReadData: possible-error=[DataServices_Data_22FD04_USS_Sensor_tuning_values_Read/E_NOT_OK, DataServices_Data_22FD04_USS_Sensor_tuning_values_Read/DCM_E_PENDING]
        arg OpStatus: type=Dcm_OpStatusType, direction=IN
        arg Data: type=Dcm_Data3072ByteType, direction=OUT
      operation ReadDataLength: possible-error=[DataServices_Data_22FD04_USS_Sensor_tuning_values_Read/E_NOT_OK, DataServices_Data_22FD04_USS_Sensor_tuning_values_Read/DCM_E_PENDING]
        arg OpStatus: type=Dcm_OpStatusType, direction=IN
        arg DataLength: type=uint16, direction=OUT
      operation WriteData: possible-error=[DataServices_Data_22FD04_USS_Sensor_tuning_values_Read/E_NOT_OK, DataServices_Data_22FD04_USS_Sensor_tuning_values_Read/DCM_E_PENDING]
        4 x arg:
          Data: type=Dcm_Data3072ByteType, direction=IN
          DataLength: type=uint16, direction=IN
          OpStatus: type=Dcm_OpStatusType, direction=IN
          ErrorCode: type=Dcm_NegativeResponseCodeType, direction=OUT
      error E_NOT_OK: error-code=1
      error DCM_E_PENDING: error-code=10
  mode switch interface Dcm_Read_ModeProgPreconditionCheck: is-service=true, service-kind=DIAGNOSTIC-COMMUNICATION-MANAGER
    mode group Dcm_Read_ModeProgPreconditionCheck: type=ProgPreconditionState
  client server interface DataServices_Data_22FDF8_StackUsage_Read: is-service=true, service-kind=DIAGNOSTIC-COMMUNICATION-MANAGER
    operation ReadData: possible-error=[DataServices_Data_22FDF8_StackUsage_Read/E_NOT_OK, DataServices_Data_22FDF8_StackUsage_Read/DCM_E_PENDING]
      arg OpStatus: type=Dcm_OpStatusType, direction=IN
      arg Data: type=Dcm_Data37ByteType, direction=OUT
    error E_NOT_OK: error-code=1
    error DCM_E_PENDING: error-code=10
  client server interface DataServices_Data_22FDF5_PerformanceStatEnable_Read: is-service=true, service-kind=DIAGNOSTIC-COMMUNICATION-MANAGER
    operation ReadData: possible-error=[DataServices_Data_22FDF5_PerformanceStatEnable_Read/E_NOT_OK, DataServices_Data_22FDF5_PerformanceStatEnable_Read/DCM_E_PENDING]
      arg OpStatus: type=Dcm_OpStatusType, direction=IN
      arg Data: type=Dcm_Data2ByteType, direction=OUT
    operation WriteData: possible-error=[DataServices_Data_22FDF5_PerformanceStatEnable_Read/E_NOT_OK, DataServices_Data_22FDF5_PerformanceStatEnable_Read/DCM_E_PENDING]
      arg Data: type=Dcm_Data2ByteType, direction=IN
      arg OpStatus: type=Dcm_OpStatusType, direction=IN
      arg ErrorCode: type=Dcm_NegativeResponseCodeType, direction=OUT
    error E_NOT_OK: error-code=1
    error DCM_E_PENDING: error-code=10
