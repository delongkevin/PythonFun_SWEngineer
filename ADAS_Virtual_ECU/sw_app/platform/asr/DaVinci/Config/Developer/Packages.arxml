AUTOSAR XML (schema 00050)
package /DataTypes/DataConstrs
  range Active_Park_Mode: raw 0..1
  range Altitude_RMSE_C2: phys 0..253, raw 0..255
  range APARequestSts: raw 0..1
  range ASCM_Stat: raw 0..15
  range ASCM_SysFail: raw 0..1
  range Backup_Cam_Delay: raw 0..1
  range Battery_Volt_1: phys 0..510, raw 0..511
  range Brk_Stat: raw 0..3
  range BSM_THA_Brk_Resp: raw 0..3
  range CameraDisplaySts2: raw 0..15
  range CM_TCH_STAT: raw 0..7
  range CM_TCH_X_COORD: phys 0..65535, raw 0..65535
  range CM_TCH_Y_COORD: phys 0..65535, raw 0..65535
  range CmdIgnSts: raw 0..7
  range CRC__BRAKE3: phys 0..255, raw 0..255
  range CRC__DRIVETRAIN3: phys 0..255, raw 0..255
  range CRC_ADAS_INFO_C2: phys 0..255, raw 0..255
  range CRC_AGSM2: phys 0..255, raw 0..255
  range CRC_BCM10: phys 0..255, raw 0..255
  range CRC_BCM12: phys 0..255, raw 0..255
  range CRC_BCM2: phys 0..255, raw 0..255
  range CRC_BCM27: phys 0..255, raw 0..255
  range CRC_BCM29: phys 0..255, raw 0..255
  range CRC_BCM9: phys 0..255, raw 0..255
  range CRC_BRAKE1: phys 0..255, raw 0..255
  range CRC_BRAKE2: phys 0..255, raw 0..255
  range CRC_BRAKE2_1: phys 0..255, raw 0..255
  range CRC_BRAKE4: phys 0..255, raw 0..255
  range CRC_BRAKE5: phys 0..255, raw 0..255
  range CRC_BRAKE7: phys 0..255, raw 0..255
  range CRC_ENGINE2: phys 0..255, raw 0..255
  range CRC_ENGINE5: phys 0..255, raw 0..255
  range CRC_ENGINE7: phys 0..255, raw 0..255
  range CRC_EPS1: phys 0..255, raw 0..255
  range CRC_EPS2: phys 0..255, raw 0..255
  range CRC_GLOB_NAV_C2: phys 0..255, raw 0..255
  range CRC_Telematic11: phys 0..255, raw 0..255
  range CRC_Telematic14: phys 0..255, raw 0..255
  range CRC_Telematic5: phys 0..255, raw 0..255
  range CRC_TRANSM1: phys 0..255, raw 0..255
  range CRC_TRANSM2: phys 0..255, raw 0..255
  range CRC_TRANSM4: phys 0..255, raw 0..255
  range CRC_TRSKM_FD_1: phys 0..255, raw 0..255
  range CurrentCanNMState_FD01_BCM: raw 0..15
  range CurrentCanNMState_FD01_SGW: raw 0..15
  range CurrentCanNMState_FD02_BCM: raw 0..15
  range CurrentCanNMState_FD02_BSM2: raw 0..15
  range CurrentCanNMState_FD02_CADM2: raw 0..15
  range CurrentCanNMState_FD02_EPS: raw 0..15
  range CurrentCanNMState_FD02_ORC: raw 0..15
  range CurrentCanNMState_FD02_SGW: raw 0..15
  range CurrentCanNMState_FD02_TRLR_REV: raw 0..15
  range CurrentCanNMState_FD03_BCM: raw 0..15
  range CurrentCanNMState_FD03_SGW: raw 0..15
  range CurrentCanNMState_FD04_BCM: raw 0..15
  range CurrentCanNMState_FD08_SGW: raw 0..15
  range CurrentCanNMState_FD11_SGW: raw 0..15
  range CurrentFailSts_FD01_BCM: raw 0..1
  range CurrentFailSts_FD01_SGW: raw 0..1
  range CurrentFailSts_FD02_BCM: raw 0..1
  range CurrentFailSts_FD02_BSM2: raw 0..1
  range CurrentFailSts_FD02_CADM2: raw 0..1
  range CurrentFailSts_FD02_EPS: raw 0..1
  range CurrentFailSts_FD02_ORC: raw 0..1
  range CurrentFailSts_FD02_SGW: raw 0..1
  range CurrentFailSts_FD02_TRLR_REV: raw 0..1
  range CurrentFailSts_FD03_BCM: raw 0..1
  range CurrentFailSts_FD03_SGW: raw 0..1
  range CurrentFailSts_FD04_BCM: raw 0..1
  range CurrentFailSts_FD08_SGW: raw 0..1
  range CurrentFailSts_FD11_SGW: raw 0..1
  range DeltaTimestamp_IMUdata: raw 0..255
  range DES_FD01_BCM: raw 0..3
  range DES_FD01_SGW: raw 0..3
  range DES_FD02_BCM: raw 0..3
  range DES_FD02_BSM2: raw 0..3
  range DES_FD02_CADM2: raw 0..3
  range DES_FD02_EPS: raw 0..3
  range DES_FD02_ORC: raw 0..3
  range DES_FD02_SGW: raw 0..3
  range DES_FD02_TRLR_REV: raw 0..3
  range DES_FD03_BCM: raw 0..3
  range DES_FD03_SGW: raw 0..3
  range DES_FD04_BCM: raw 0..3
  range DES_FD08_SGW: raw 0..3
  range DES_FD11_SGW: raw 0..3
  range Digit_{01..11}: phys 0..15, raw 0..15
  range DriverDoorSts: raw 0..1
  range DynamicGrid: raw 0..1
  range ECM_THA_Resp: raw 0..3
  range ECM_TRSC_Resp: raw 0..3
  range EngineSts_W: raw 0..3
  range EOL_FD01_BCM: raw 0..1
  range EOL_FD01_SGW: raw 0..1
  range EOL_FD02_BCM: raw 0..1
  range EOL_FD02_BSM2: raw 0..1
  range EOL_FD02_CADM2: raw 0..1
  range EOL_FD02_EPS: raw 0..1
  range EOL_FD02_ORC: raw 0..1
  range EOL_FD02_SGW: raw 0..1
  range EOL_FD02_TRLR_REV: raw 0..1
  range EOL_FD03_BCM: raw 0..1
  range EOL_FD03_SGW: raw 0..1
  range EOL_FD04_BCM: raw 0..1
  range EOL_FD08_SGW: raw 0..1
  range EOL_FD11_SGW: raw 0..1
  range EPBSts: raw 0..15
  range EPS_SteeringTouchStat: raw 0..1
  range EPS_SteeringTouq_Resp: raw 0..3
  range EPS_THA_DriverTorqueOverride: raw 0..3
  range EPS_THA_SteeringTorqueResp: raw 0..7
  range ESS_ENG_ST_W: raw 0..15
  range ExternalTemperature: phys 0..510, raw 0..511
  range FL_Lvl: phys 0..253, raw 0..255
  range FL_Lvl_Adj: raw 0..1
  range FR_Lvl: phys 0..253, raw 0..255
  range FR_Lvl_Adj: raw 0..1
  range FT_PAMRequestSts: raw 0..1
  range Fwrd_Cam_Guidelines: raw 0..1
  range GearEngaged: raw 0..15
  range GearEngagedForDisplay: raw 0..31
  range GenericFailSts_FD01_BCM: raw 0..1
  range GenericFailSts_FD01_SGW: raw 0..1
  range GenericFailSts_FD02_BCM: raw 0..1
  range GenericFailSts_FD02_BSM2: raw 0..1
  range GenericFailSts_FD02_CADM2: raw 0..1
  range GenericFailSts_FD02_EPS: raw 0..1
  range GenericFailSts_FD02_ORC: raw 0..1
  range GenericFailSts_FD02_SGW: raw 0..1
  range GenericFailSts_FD02_TRLR_REV: raw 0..1
  range GenericFailSts_FD03_BCM: raw 0..1
  range GenericFailSts_FD03_SGW: raw 0..1
  range GenericFailSts_FD04_BCM: raw 0..1
  range GenericFailSts_FD08_SGW: raw 0..1
  range GenericFailSts_FD11_SGW: raw 0..1
  range HAS_Status_C2: raw 0..3
  range Heading_Angle_C2: phys 0..36000, raw 0..65535
  range HU_TRSC_EnableBtn_Sts: raw 0..2
  range IgnitionOnCounter: phys 0..65535, raw 0..65535
  range ITBM_TrlrStat: raw 0..3
  range LanguageSelection: raw 0..255
  range LatAcceleration_BSM: phys 0..4094, raw 0..4095
  range LatAcceleration_C2: phys 0..4094, raw 0..4095
  range LatAccelerationOffset_BSM: phys 0..254, raw 0..255
  range Latitude_RMSE_C2: phys 0..253, raw 0..255
  range LHF_FastPulseCounter: raw 0..255
  range LHF_Spin: raw 0..3
  range LHFWheelSpeed: phys 0..8190, raw 0..8191
  range LHR_FastPulseCounter: raw 0..255
  range LHR_Spin: raw 0..3
  range LHRDoorSts: raw 0..1
  range LHRWheelSpeed: phys 0..8190, raw 0..8191
  range LongAcceleration_BSM: phys 0..4094, raw 0..4095
  range LongAcceleration_C2: phys 0..4094, raw 0..4095
  range LongAccelerationOffset_BSM: phys 0..254, raw 0..255
  range Longitude_RMSE_C2: phys 0..253, raw 0..255
  range LwsAngle: phys 0..14400, raw 0..65535
  range LwsAngleType: raw 0..3
  range LwsSpeed: phys 0..4094, raw 0..4095
  range MessageCounter_ADAS_INFO_C2: phys 0..15, raw 0..15
  range MessageCounter_AGSM2: phys 0..15, raw 0..15
  range MessageCounter_BCM10: phys 0..15, raw 0..15
  range MessageCounter_BCM12: phys 0..15, raw 0..15
  range MessageCounter_BCM2: phys 0..15, raw 0..15
  range MessageCounter_BCM27: phys 0..15, raw 0..15
  range MessageCounter_BCM29: phys 0..15, raw 0..15
  range MessageCounter_BCM9: phys 0..15, raw 0..15
  range MessageCounter_BRAKE1: phys 0..15, raw 0..15
  range MessageCounter_BRAKE2: phys 0..15, raw 0..15
  range MessageCounter_BRAKE2_1: phys 0..15, raw 0..15
  range MessageCounter_BRAKE{3..5}: phys 0..15, raw 0..15
  range MessageCounter_BRAKE7: phys 0..15, raw 0..15
  range MessageCounter_DRIVETRAIN3: phys 0..15, raw 0..15
  range MessageCounter_ENGINE2: phys 0..15, raw 0..15
  range MessageCounter_ENGINE5: phys 0..15, raw 0..15
  range MessageCounter_ENGINE7: phys 0..15, raw 0..15
  range MessageCounter_EPS1: phys 0..15, raw 0..15
  range MessageCounter_EPS2: phys 0..15, raw 0..15
  range MessageCounter_GLOB_NAV_C2: phys 0..15, raw 0..15
  range MessageCounter_Telematic11: phys 0..15, raw 0..15
  range MessageCounter_Telematic14: phys 0..15, raw 0..15
  range MessageCounter_Telematic5: phys 0..15, raw 0..15
  range MessageCounter_TRANSM1: phys 0..15, raw 0..15
  range MessageCounter_TRANSM2: phys 0..15, raw 0..15
  range MessageCounter_TRANSM4: phys 0..15, raw 0..15
  range MessageCounter_TRSKM_FD_1: phys 0..15, raw 0..15
  range MRM_STATUS_C2: raw 0..7
  range OperationalModeSts: raw 0..15
  range PamChimeVolumeFront: raw 0..3
  range PamChimeVolumeRear: raw 0..3
  range PAMRequestSts: raw 0..1
  range PdlPosActual: phys 0..250, raw 0..255
  range Pitch_RMSE_C2: phys 0..253, raw 0..255
  range PitchRate_C2: phys 0..4094, raw 0..4095
  range PreviousCanNMState_FD01_BCM: raw 0..15
  range PreviousCanNMState_FD01_SGW: raw 0..15
  range PreviousCanNMState_FD02_BCM: raw 0..15
  range PreviousCanNMState_FD02_BSM2: raw 0..15
  range PreviousCanNMState_FD02_CADM2: raw 0..15
  range PreviousCanNMState_FD02_EPS: raw 0..15
  range PreviousCanNMState_FD02_ORC: raw 0..15
  range PreviousCanNMState_FD02_SGW: raw 0..15
  range PreviousCanNMState_FD02_TRLR_REV: raw 0..15
  range PreviousCanNMState_FD03_BCM: raw 0..15
  range PreviousCanNMState_FD03_SGW: raw 0..15
  range PreviousCanNMState_FD04_BCM: raw 0..15
  range PreviousCanNMState_FD08_SGW: raw 0..15
  range PreviousCanNMState_FD11_SGW: raw 0..15
  range PsngrDoorSts: raw 0..1
  range Rear_Brk_Asst: raw 0..1
  range REF_VEH_SPEED: phys 0..1022, raw 0..1023
  range RemStActvSts: raw 0..1
  range RHatchSts: raw 0..1
  range RHF_FastPulseCounter: raw 0..255
  range RHF_Spin: raw 0..3
  range RHFWheelSpeed: phys 0..8190, raw 0..8191
  range RHR_FastPulseCounter: raw 0..255
  range RHR_Spin: raw 0..3
  range RHRDoorSts: raw 0..1
  range RHRWheelSpeed: phys 0..8190, raw 0..8191
  range RL_Lvl: phys 0..253, raw 0..255
  range RL_Lvl_Adj: raw 0..1
  range Roll_RMSE_C2: phys 0..253, raw 0..255
  range RollRate_C2: phys 0..4094, raw 0..4095
  range RR_Lvl: phys 0..253, raw 0..255
  range RR_Lvl_Adj: raw 0..1
  range SBR1RowDriverSeatSts: raw 0..3
  range Shifter_ADAS_Inhibit: raw 0..1
  range ShiftLeverPosition: raw 0..15
  range ShiftLeverPositionReq: raw 0..15
  range StaticGrid: raw 0..1
  range StayActiveSource_FD01_BCM: raw 0..18446744073709551615
  range StayActiveSource_FD01_SGW: phys 0..18446744073709551615, raw 0..18446744073709551615
  range StayActiveSource_FD02_BCM: raw 0..18446744073709551615
  range StayActiveSource_FD02_BSM2: phys 0..18446744073709551615, raw 0..18446744073709551615
  range StayActiveSource_FD02_CADM2: phys 0..18446744073709551615, raw 0..18446744073709551615
  range StayActiveSource_FD02_EPS: phys 0..18446744073709551615, raw 0..18446744073709551615
  range StayActiveSource_FD02_ORC: phys 0..18446744073709551615, raw 0..18446744073709551615
  range StayActiveSource_FD02_SGW: phys 0..18446744073709551615, raw 0..18446744073709551615
  range StayActiveSource_FD02_TRLR_REV: phys 0..18446744073709551615, raw 0..18446744073709551615
  range StayActiveSource_FD03_BCM: raw 0..18446744073709551615
  range StayActiveSource_FD03_SGW: phys 0..18446744073709551615, raw 0..18446744073709551615
  range StayActiveSource_FD04_BCM: raw 0..18446744073709551615
  range StayActiveSource_FD08_SGW: phys 0..18446744073709551615, raw 0..18446744073709551615
  range StayActiveSource_FD11_SGW: phys 0..18446744073709551615, raw 0..18446744073709551615
  range SVC_Guidelines: raw 0..1
  range TargetGear: raw 0..15
  range TCASERANGESTATUS: raw 0..3
  range TGW_CAMERA_DISP_STAT: raw 0..15
  range THA_SteeringTouchStat: raw 0..3
  range TotalOdometer: phys 0..1048575, raw 0..1048575
  range TrailerConnectionSts: raw 0..3
  range TRANS_ADAS_Inhibit: raw 0..1
  range TransmissionSailingSts: raw 0..15
  range TRSC_CenterBtn_Sts: raw 0..3
  range TRSC_EnableBtn_Sts: raw 0..3
  range TRSC_RawKnob: phys 0..511, raw 0..511
  range TurnIndicatorSts: raw 0..3
  range VehicleSpeedVSOSig: phys 0..8190, raw 0..8191
  range VehicleStandStillSts: raw 0..3
  range VerticalAcceleration_C2: phys 0..4094, raw 0..4095
  range VIN_DATA: phys 0..72057594037927896, raw 0..72057594037927896
  range VIN_MSG: raw 0..3
  range WakeupSource_FD01_ADCM: raw 0..255
  range WakeupSource_FD01_BCM: raw 0..255
  range WakeupSource_FD01_SGW: raw 0..255
  range WakeupSource_FD02_BCM: raw 0..255
  range WakeupSource_FD02_BSM2: raw 0..255
  range WakeupSource_FD02_CADM2: raw 0..255
  range WakeupSource_FD02_EPS: raw 0..255
  range WakeupSource_FD02_ORC: raw 0..255
  range WakeupSource_FD02_SGW: raw 0..255
  range WakeupSource_FD02_TRLR_REV: raw 0..255
  range WakeupSource_FD03_BCM: raw 0..255
  range WakeupSource_FD03_SGW: raw 0..255
  range WakeupSource_FD04_BCM: raw 0..255
  range WakeupSource_FD08_SGW: raw 0..255
  range WakeupSource_FD11_SGW: raw 0..255
  range YawRate_BSM: phys 0..4094, raw 0..4095
  range YawRate_C2: phys 0..4094, raw 0..4095
  range YawRate_RMSE_C2: phys 0..253, raw 0..255
