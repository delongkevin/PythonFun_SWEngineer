AUTOSAR XML (schema 00050)
package /MICROSAR/Dcm_swc
  mode declaration group VehicleSpeedCheck: category=ALPHABETIC_ORDER, initial-mode=VehicleSpeedCheck/VehicleSpeedZero
    mode VehicleSpeedNonZero
    mode VehicleSpeedZero
package /MICROSAR/Dcm_swc/Interfaces
  mode switch interface Dcm_Read_Mode: is-service=true, service-kind=DIAGNOSTIC-COMMUNICATION-MANAGER
    mode group Dcm_Read_Mode: type=Dcm_swc/VehicleSpeedCheck
package /CalDataProvider/PortInterfaces
  sender receiver interface IF_SWC_CalDataProvider_MCU1_0_Nvm_Data
    data CalData_mcu1_0: type=CalDataProvider_MCU_1_0_Def
  4 x client server interface:
    IF_SWC_CalDataProvider_SVSCamEOLCalibData
      operation WriteBlock: possible-error=IF_SWC_CalDataProvider_SVSCamEOLCalibData/E_NOT_OK
        arg v_SVSCamEOLCalibData: type=TbSVS_S_SVSCamEOLCalibDataToNVM_t, direction=IN, server-argument-impl-policy=USE-ARGUMENT-TYPE
      error E_NOT_OK: error-code=1
    IF_SWC_CalDataProvider_SVSCamSCCalibData
      operation WriteBlock: possible-error=IF_SWC_CalDataProvider_SVSCamSCCalibData/E_NOT_OK
        arg v_SVSCamSCCalibData: type=TbSVS_S_SVSCamSCCalibDataToNVM_t, direction=IN, server-argument-impl-policy=USE-ARGUMENT-TYPE
      error E_NOT_OK: error-code=1
    IF_SWC_CalDataProvider_SVSCamOCCalibData
      operation WriteBlock: possible-error=IF_SWC_CalDataProvider_SVSCamOCCalibData/E_NOT_OK
        arg v_SVSCamOCCalibData: type=TbSVS_S_SVSCamOCCalibDataToNVM_t, direction=IN, server-argument-impl-policy=USE-ARGUMENT-TYPE
      error E_NOT_OK: error-code=1
    IF_SWC_CalDataProvider_SVSCamCurrentCalibData
      operation WriteBlock: possible-error=IF_SWC_CalDataProvider_SVSCamCurrentCalibData/E_NOT_OK
        arg v_SVSCamCurrentCalibData: type=TbSVS_S_SVSCamCurrentCalibDataToNVM_t, direction=IN, server-argument-impl-policy=USE-ARGUMENT-TYPE
      error E_NOT_OK: error-code=1
package /FCADT/PortInterfaces
  sender receiver interface IF_TemperatureVal
    data GetTemperatureVal: type=uint8
  sender receiver interface IF_VoltageChannelStatus
    data BatteryVoltageStatus: type=udtBatteryVoltageStatus
  client server interface IF_ReadVoltInfo
    operation GetVoltageInfo
      arg Channel_ID: type=VoltMgr_Enum_VoltageMON, direction=IN, server-argument-impl-policy=USE-ARGUMENT-TYPE
      arg Voltage: type=float32, direction=OUT, server-argument-impl-policy=USE-ARGUMENT-TYPE
  sender receiver interface IF_VINData
    4 x data:
      VINLockStatus: type=uint8
      VINOdoCounter: type=uint8
      VINCurrentData: type=VINlData_Arr
      VINOriginalData: type=VINlData_Arr
  sender receiver interface IF_ProxiConfigData
    data ProxiData: type=ME_Hydra2defs_S_CodingTableExt_t
  sender receiver interface IF_VariantData
    data Variant: type=uint8
  client server interface IF_MCUDeviceRegReadWrite
    operation MCUReadDeviceReg: possible-error=[IF_MCUDeviceRegReadWrite/E_NOT_OK, IF_MCUDeviceRegReadWrite/E_NOT_OK]
      arg DeviceAdd: type=DeviceAddress, direction=IN, server-argument-impl-policy=USE-ARGUMENT-TYPE
      arg RegAddress: type=uint16, direction=IN, server-argument-impl-policy=USE-ARGUMENT-TYPE
    operation MCUReadDeviceRegData: possible-error=[IF_MCUDeviceRegReadWrite/E_NOT_OK, IF_MCUDeviceRegReadWrite/E_NOT_OK]
      arg DeviceAdd: type=DeviceAddress, direction=IN, server-argument-impl-policy=USE-ARGUMENT-TYPE
      arg RegAddress: type=uint16, direction=OUT, server-argument-impl-policy=USE-ARGUMENT-TYPE
    operation MCUWriteDeviceReg: possible-error=[IF_MCUDeviceRegReadWrite/E_NOT_OK, IF_MCUDeviceRegReadWrite/E_NOT_OK]
      arg DeviceAdd: type=DeviceAddress, direction=IN, server-argument-impl-policy=USE-ARGUMENT-TYPE
      arg RegAddress: type=uint16, direction=IN, server-argument-impl-policy=USE-ARGUMENT-TYPE
      arg RegData: type=uint16, direction=IN, server-argument-impl-policy=USE-ARGUMENT-TYPE
    error E_NOT_OK: error-code=1
  sender receiver interface IF_ECUTimeSince_IGON
    data ECUTimeStamp_IGON: type=uint32
  sender receiver interface IF_ECUTimeStamp
    data ECUTimeStamp: type=uint32
  sender receiver interface IF_IGON_Counter
    data IGCounter: type=uint32
  client server interface IF_E2EServices
    operation ME_E2E_Check: possible-error=[ME_E2E_E_INPUTERR_NULL, ME_E2E_E_INPUTERR_WRONG, ME_E2E_E_INTERR, ME_E2E_E_WRONGSTATE, ME_E2E_E_INPUTERR_NULL, ME_E2E_E_INPUTERR_WRONG, ME_E2E_E_INTERR, ME_E2E_E_WRONGSTATE]
      arg ConfigPtr: type=E2E_MEP_ConfigType, direction=OUT, server-argument-impl-policy=USE-ARGUMENT-TYPE
      arg StatePtr: type=E2E_MEP_CheckStateType, direction=OUT, server-argument-impl-policy=USE-ARGUMENT-TYPE
      arg DataPtr: type=uint8, direction=OUT, server-argument-impl-policy=USE-ARGUMENT-TYPE
    operation ME_E2E_Protect: possible-error=[ME_E2E_E_INPUTERR_NULL, ME_E2E_E_INTERR, ME_E2E_E_WRONGSTATE, ME_E2E_E_INPUTERR_WRONG, ME_E2E_E_INPUTERR_NULL, ME_E2E_E_INTERR, ME_E2E_E_WRONGSTATE, ME_E2E_E_INPUTERR_WRONG, ME_E2E_E_INPUTERR_NULL, ME_E2E_E_INTERR, ME_E2E_E_WRONGSTATE, ME_E2E_E_INPUTERR_WRONG]
      arg ConfigPtr: type=E2E_MEP_ConfigType, direction=OUT, server-argument-impl-policy=USE-ARGUMENT-TYPE
      arg StatePtr: type=E2E_MEP_ProtectStateType, direction=OUT, server-argument-impl-policy=USE-ARGUMENT-TYPE
      arg DataPtr: type=uint8, direction=OUT, server-argument-impl-policy=USE-ARGUMENT-TYPE
    4 x error:
      ME_E2E_E_INPUTERR_NULL: error-code=19
      ME_E2E_E_INPUTERR_WRONG: error-code=23
      ME_E2E_E_INTERR: error-code=25
      ME_E2E_E_WRONGSTATE: error-code=26
  sender receiver interface IF_GearPosition
    data GearValue: type=uint8
    data ShortTermAdjActiveFlag_b: type=boolean
  sender receiver interface IF_SnsrFnctnlTstFlg
    data SensorFunctionalTestFlag: type=boolean
package /IPC_SWC/PortInterfaces
  29 x sender receiver interface:
    IF_SvsToVCAN
      data SvsToVCAN_t: type=SvsToVCAN_t
    IF_SVSCamSCCalib
      data TbSVS_S_SVSCamSCCalibDataToNVM_t: type=TbSVS_S_SVSCamSCCalibDataToNVM_t
    IF_VCActuatorOut
      data TbAP_VCActuatorOut_t: type=TbAP_VCActuatorOut_t
    IF_EPS
      data VehInpAdapter_opVehSignals: type=VehInpAdapter_opVehSignals
    IF_SVSCamEOLCalib
      data TbSVS_S_SVSCamEOLCalibDataToNVM_t: type=TbSVS_S_SVSCamEOLCalibDataToNVM_t
    IF_DrverSecuBltAlrmSts
      data TeVBII_e_DrverSecuBltAlrmSts: type=TeVBII_e_DrverSecuBltAlrmSts
    IF_SVStoTRSC
      data SVStoTRSC_t: type=SVStoTRSC_t
    IF_NVMCamCalibSM
      data TbSVS_e_SVSOutputToNVMCamCalibSM_t: type=TbSVS_e_SVSOutputToNVMCamCalibSM_t
    IF_CVPAMFDData
      data IFOD_Outputs_CVPAMFDData_t: type=IFOD_Outputs_CVPAMFDData_t
    IF_APSMPAOut
      data TbAP_APSMPAOut_t: type=TbAP_APSMPAOut_t
    IF_DriveAssistStatOut
      data TbAP_DriveAssistStatOut_t: type=TbAP_DriveAssistStatOut_t
    IF_CVPAMFDData2
      data LMD_Outputs_CVPAMFDData2_t: type=LMD_Outputs_CVPAMFDData2_t
    IF_TRSC
      data ME_VehOut_TRSC_t: type=ME_VehOut_TRSC_t
    IF_FeatureOutputsTHA
      data TbTHASmVc_FeatureOutputs_t: type=TbTHASmVc_FeatureOutputs_t
    IF_RPAWarnOut
      data TbAP_RPAWarnOut_t: type=TbAP_RPAWarnOut_t
    IF_SMDAInternal
      data TbAP_SMDAInternalOut_t: type=TbAP_SMDAInternalOut_t
    IF_VCState
      data TbAP_VCStateOut_t: type=TbAP_VCStateOut_t
    IF_SnrDirEcho
      data US_S_SnrDirEcho_t: type=US_S_SnrDirEcho_t
    IF_USSConstantData
      data US_S_USSConstantData_t: type=US_S_USSConstantData_t
    IF_PAStateOut
      data TbAP_PAStateOut_t: type=TbAP_PAStateOut_t
    IF_USSPeriodDiagData
      data US_S_USSPeriodDiagData_t: type=US_S_USSPeriodDiagData_t
    IF_USSErrorDiagData
      data US_S_USSErrorDiagData_t: type=US_S_USSErrorDiagData_t
    IF_CamEepromData
      data Svs_CamEepromDataArray_t: type=Svs_CamEepromDataArray_t
    IF_FPAWarnOut
      data TbAP_FPAWarnOut_t: type=TbAP_FPAWarnOut_t
    IF_SVSToDiag
      data SVSToDiag_t: type=SVSToDiag_t
    IF_ScreenResponse
      data ScreenResponse_t: type=ScreenResponse_t
    IF_SVSOutputToDiagMgr
      data TbSVS_e_SVSOutputToDiagMgrCamCalib_t: type=TbSVS_e_SVSOutputToDiagMgrCamCalib_t
    IF_SVSCamCurrentCalib
      data TbSVS_S_SVSCamCurrentCalibDataToNVM_t: type=TbSVS_S_SVSCamCurrentCalibDataToNVM_t
    IF_SVSCamOCCalib
      data TbSVS_S_SVSCamOCCalibDataToNVM_t: type=TbSVS_S_SVSCamOCCalibDataToNVM_t
  client server interface IF_IpcTxData
    operation IPC_Write_v
      arg b_TxData_pv: type=dtRef_VOID, direction=IN, server-argument-impl-policy=USE-ARGUMENT-TYPE
      arg i_IpcMsgId_u16: type=uint16, direction=IN, server-argument-impl-policy=USE-ARGUMENT-TYPE
      arg i_IpcMsgSize_u16: type=uint16, direction=IN, server-argument-impl-policy=USE-ARGUMENT-TYPE
  47 x sender receiver interface:
    IF_CamCsData
      data CAM_CS_Curr_Monitor_t: type=CAM_CS_Curr_Monitor_t
    IF_UssMrrgData
      data US_S_MarriageSensorIDs_t: type=US_S_MarriageSensorIDs_t
    IF_TrailerDetectOP
      data TrailerDetection_Output_DID_t: type=TrailerDetection_Output_DID_t
    IF_TrscToDiag
      data TRSCtoDiagMgr_t: type=TRSCtoDiagMgr_t
    IF_JobFPAData
      data IJobFPAOutput_t: type=IJobFPAOutput_t
    IF_JobPLDData
      data IJobPLDOutput_t: type=IJobPLDOutput_t
    IF_USSBlockageBit
      data US_S_BlockageBit_t: type=US_S_BlockageBit_t
    IF_ScreenRequest
      data ScreenRequest_t: type=ScreenRequest_t
    IF_UssZoneInfo
      data US_S_ZoneInfo_t: type=US_S_ZoneInfo_t
    IF_UssPointMapGrp
      data US_S_PointMapGroup_t: type=US_S_PointMapGroup_t
    IF_UssDataCollection
      data US_S_USSDataCollectionData_t: type=US_S_USSDataCollectionData_t
    IF_TrscTrlrDet
      data TRSC_Inputs_from_TrailerDetection_t: type=TRSC_Inputs_from_TrailerDetection_t
    IF_TrscSmvctoSvs
      data TRSCSMVCtoSVS_t: type=TRSCSMVCtoSVS_t
    IF_PpDetInpTrsc
      data Detection_Inputs_from_TRSC_t: type=Detection_Inputs_from_TRSC_t
    IF_PointDistOpBuff
      data US_S_PointDistOutputBuff_t: type=US_S_PointDistOutputBuff_t
    IF_JobTHADetOutput
      data JobTHADetOutput_t: type=JobTHADetOutput_t
    IF_CpuLoadMcu2_1
      data CpuLoadMcu2_1_t: type=CpuLoadMcu2_1_t
    IF_CpuLoadMcu2_0
      data CpuLoadMcu2_0_t: type=CpuLoadMcu2_0_t
    IF_DebCurReqOverlay
      data Debug_HMI_Curr_Requested_Overlays: type=Debug_HMI_Curr_Requested_Overlays
    IF_DebCurrDispOverlay
      data Debug_HMI_Curr_Displayed_Overlays: type=Debug_HMI_Curr_Displayed_Overlays
    IF_DebCurrDispProxiCfg
      data Debug_HMI_Curr_Displayed_ProxiConfig: type=Debug_HMI_Curr_Displayed_ProxiConfig
    IF_DebCurrReqProxiCfg
      data Debug_HMI_Curr_Requested_ProxiConfig: type=Debug_HMI_Curr_Requested_ProxiConfig
    IF_DebHmiInput
      data Debug_HMI_Input_Data_t: type=Debug_HMI_Input_Data_t
    IF_DebHmiInternal
      data Debug_HMI_Internal_Data_t: type=Debug_HMI_Internal_Data_t
    IF_DebHmiTrailViews
      data Debug_HMI_Trailer_Views_Data_t: type=Debug_HMI_Trailer_Views_Data_t
    IF_IJobUSSObjOp
      data IJobUSSObjectMapOutput_t: type=IJobUSSObjectMapOutput_t
    IF_NFCDOutput
      data NFCD_Output: type=NFCD_Output
    IF_NVMSignMgr
      data NVMSignalManager_t: type=NVMSignalManager_t
    IF_TbAPDebugOut
      data TbAP_DebugOut: type=TbAP_DebugOut
    IF_TbAPSMPAOut
      data TbAP_SMPAInternalOut_t: type=TbAP_SMPAInternalOut_t
    IF_SvsToTHA
      data SvsToTHA_t: type=SvsToTHA_t
    IF_LMDLaneOp
      data LMD_Lane_Outputs_s: type=LMD_Lane_Outputs_s
    IF_TbTHASmVcDiag
      data TbTHASmVc_DiagMgr_t: type=TbTHASmVc_DiagMgr_t
    IF_IDebugFODObject
      data IDebug_FODObject_t: type=IDebug_FODObject_t
    IF_IFODOpArbitration
      data IFOD_Outputs_Arbitration_t: type=IFOD_Outputs_Arbitration_t
    IF_MEProxi
      data ME_Proxi_MPU1_0_to_MCU1_0_t: type=ME_Proxi_MPU1_0_to_MCU1_0_t
    IF_TbFAResetKM
      data TbFA_ResetKM_t: type=TbFA_ResetKM_t
    IF_CamSerENStat
      data Cam_and_Ser_EN_Status_t: type=Cam_and_Ser_EN_Status_t
    IF_DLDOutput
      data JobDLDOutput_t: type=JobDLDOutput_t
    IF_KeepAliveResponse
      data KeepAliveResponse_t: type=KeepAliveResponse_t
    IF_TRSCSMVCtoDebug
      data TRSCSMVCtoDebugCAN_t: type=TRSCSMVCtoDebugCAN_t
    IF_UsCsmStatCngRsn
      data US_S_CsmStateChangeReason_Type: type=US_S_CsmStateChangeReason_Type
    IF_UssDebugMsg
      data US_S_DebugMsg_t: type=US_S_DebugMsg_t
    IF_CAMSelInfo
      data CAM_select_info_t: type=CAM_select_info_t
    IF_ErrFltMcu2_0
      data Error_Fault_MCU2_0_t: type=Error_Fault_MCU2_0_t
    IF_ErrFltMcu2_1
      data Error_Fault_MCU2_1_t: type=Error_Fault_MCU2_1_t
    IF_ErrFltMpu1_0
      data Error_Fault_MPU1_0_t: type=Error_Fault_MPU1_0_t
package /Pkg_DegManager_B/PortInterfaces
  sender receiver interface P_FID_Output_B_SR  # Output
    data FID_B: type=FIDOutputArr_B
  sender receiver interface P_RES_Output_B_SR  # Output
    data RES_B: type=RESOutputArr_B
package /Pkg_DegManager_QM/PortInterfaces
  sender receiver interface P_FID_Output_QM_SR  # Output
    data FID_QM: type=FIDOutputArr_QM
  sender receiver interface P_RES_Output_QM_SR  # Output
    data RES_QM: type=RESOutputArr_QM
package /Pkg_ErrorMgrAgg_1_0_B/PortInterfaces
  4 x sender receiver interface:
    R_SatError_SR  # Comments
      4 x data:
        Data_ErrorMgr_ErrorCommPack_1_0_B: type=ErrorMgr_ErrorCommPack_1_0_B
        Data_ErrorMgr_ErrorCommPack_2_0_B: type=ErrorMgr_ErrorCommPack_2_0_B
        Data_ErrorMgr_ErrorCommPack_2_1_B: type=ErrorMgr_ErrorCommPack_2_1_B
        Data_ErrorMgr_ErrorCommPack_QNX_B: type=ErrorMgr_ErrorCommPack_QNX_B
    P_SafeState_SR  # Safe State Outputs
      data SafeStateOp: type=SafeStateOpDef
    P_Errors_B_SR  # Status of Errors
      data Errors_B: type=ErrorListArr_B
    P_DtcData_SR  # Port for reading DTC Data
      data Data_DtcStatus_B: type=DtcStatus_B
      data Data_DtcAddData_B: type=DtcAddData_B
package /Pkg_ErrorMgrAgg_1_0_QM/PortInterfaces
  4 x sender receiver interface:
    R_SatError_SR  # Comments
      4 x data:
        Data_ErrorMgr_ErrorCommPack_1_0_QM: type=ErrorMgr_ErrorCommPack_1_0_QM
        Data_ErrorMgr_ErrorCommPack_2_0_QM: type=ErrorMgr_ErrorCommPack_2_0_QM
        Data_ErrorMgr_ErrorCommPack_2_1_QM: type=ErrorMgr_ErrorCommPack_2_1_QM
        Data_ErrorMgr_ErrorCommPack_QNX_QM: type=ErrorMgr_ErrorCommPack_QNX_QM
    P_SafeState_SR  # Safe State Outputs
      data SafeStateOp: type=SafeStateOpDef
    P_Errors_QM_SR  # Status of Errors
      data Errors_QM: type=ErrorListArr_QM
    P_DtcData_SR  # Port for reading DTC Data
      data Data_DtcStatus_QM: type=DtcStatus_QM
      data Data_DtcAddData_QM: type=DtcAddData_QM
package /Pkg_ErrorMgrSat_1_0_B/PortInterfaces
  client server interface P_Error_CS
    operation ReportErrorStatus1_0_B: possible-error=P_Error_CS/E_NOK
      arg err: type=ErrorMgr_enErrorNo, direction=IN, server-argument-impl-policy=USE-ARGUMENT-TYPE
      arg errStatus: type=ErrorMgr_enErrorStatus, direction=IN, server-argument-impl-policy=USE-ARGUMENT-TYPE
      arg addData: type=ErrorMgr_stAddData, direction=IN, server-argument-impl-policy=USE-ARGUMENT-TYPE
    error E_NOK: error-code=1
package /Pkg_ErrorMgrSat_1_0_QM/PortInterfaces
  client server interface P_Error_CS
    operation ReportErrorStatus1_0_QM: possible-error=P_Error_CS/E_NOK
      arg err: type=ErrorMgr_enErrorNo, direction=IN, server-argument-impl-policy=USE-ARGUMENT-TYPE
      arg errStatus: type=ErrorMgr_enErrorStatus, direction=IN, server-argument-impl-policy=USE-ARGUMENT-TYPE
      arg addData: type=ErrorMgr_stAddData, direction=IN, server-argument-impl-policy=USE-ARGUMENT-TYPE
    error E_NOK: error-code=1
package /SSM_Master/PortInterfaces
  sender receiver interface R_SSM_QNXState_SR  # Input
    data State_QNX: type=SSM_QNX_CoreStatus
  sender receiver interface R_SSM_2_State_SR  # Input
    data State_2_0: type=SSM_2_0_CoreStatus
    data State_2_1: type=SSM_2_1_CoreStatus
  sender receiver interface P_SystemState_SR  # Output
    data SystemState: type=SSM_SystemState
package /SSM_Slave_1_0/PortInterfaces
  sender receiver interface P_SSM_1_0_State_SR  # Output
    data State_1_0: type=SSM_1_0_CoreStatus
package /Predefined_DEV/PortInterfaces
  22 x client server interface, all with is-service=true:
    NvMAdministration
      operation SetBlockProtection: possible-error=NvMAdministration/E_NOT_OK
        arg ProtectionEnabled: type=boolean, direction=IN, server-argument-impl-policy=USE-ARGUMENT-TYPE
      error E_NOT_OK: error-code=1
    NvMNotifyInitBlock
      operation InitBlock
    NvMNotifyJobFinished
      operation JobFinished
        arg ServiceId: type=NvM_ServiceIdType, direction=IN, server-argument-impl-policy=USE-ARGUMENT-TYPE
        arg JobResult: type=NvM_RequestResultType, direction=IN, server-argument-impl-policy=USE-ARGUMENT-TYPE
    NvMService
      operation GetErrorStatus: possible-error=NvMService/E_NOT_OK
        arg ErrorStatus: type=NvM_RequestResultType, direction=OUT, server-argument-impl-policy=USE-ARGUMENT-TYPE
      error E_NOT_OK: error-code=1
    NvMService_AC2
      operation GetErrorStatus: possible-error=NvMService_AC2/E_NOT_OK
        arg ErrorStatus: type=NvM_RequestResultType, direction=OUT, server-argument-impl-policy=USE-ARGUMENT-TYPE
      operation ReadBlock: possible-error=NvMService_AC2/E_NOT_OK
        arg DstPtr: type=dtRef_VOID, direction=IN, server-argument-impl-policy=USE-ARGUMENT-TYPE
      operation WriteBlock: possible-error=NvMService_AC2/E_NOT_OK
        arg SrcPtr: type=dtRef_const_VOID, direction=IN, server-argument-impl-policy=USE-ARGUMENT-TYPE
      error E_NOT_OK: error-code=1
    NvMService_AC2_Defs
      4 x operation, all with possible-error=NvMService_AC2_Defs/E_NOT_OK:
        GetErrorStatus
          arg ErrorStatus: type=NvM_RequestResultType, direction=OUT, server-argument-impl-policy=USE-ARGUMENT-TYPE
        ReadBlock
          arg DstPtr: type=dtRef_VOID, direction=IN, server-argument-impl-policy=USE-ARGUMENT-TYPE
        RestoreBlockDefaults
          arg DstPtr: type=dtRef_VOID, direction=IN, server-argument-impl-policy=USE-ARGUMENT-TYPE
        WriteBlock
          arg SrcPtr: type=dtRef_const_VOID, direction=IN, server-argument-impl-policy=USE-ARGUMENT-TYPE
      error E_NOT_OK: error-code=1
    NvMService_AC2_DS
      5 x operation, all with possible-error=NvMService_AC2_DS/E_NOT_OK:
        GetDataIndex
          arg DataIndex: type=uint8, direction=OUT, server-argument-impl-policy=USE-ARGUMENT-TYPE
        GetErrorStatus
          arg ErrorStatus: type=NvM_RequestResultType, direction=OUT, server-argument-impl-policy=USE-ARGUMENT-TYPE
        ReadBlock
          arg DstPtr: type=dtRef_VOID, direction=IN, server-argument-impl-policy=USE-ARGUMENT-TYPE
        SetDataIndex
          arg DataIndex: type=uint8, direction=IN, server-argument-impl-policy=USE-ARGUMENT-TYPE
        WriteBlock
          arg SrcPtr: type=dtRef_const_VOID, direction=IN, server-argument-impl-policy=USE-ARGUMENT-TYPE
      error E_NOT_OK: error-code=1
    NvMService_AC2_DS_Defs
      6 x operation, all with possible-error=NvMService_AC2_DS_Defs/E_NOT_OK:
        GetDataIndex
          arg DataIndex: type=uint8, direction=OUT, server-argument-impl-policy=USE-ARGUMENT-TYPE
        GetErrorStatus
          arg ErrorStatus: type=NvM_RequestResultType, direction=OUT, server-argument-impl-policy=USE-ARGUMENT-TYPE
        ReadBlock
          arg DstPtr: type=dtRef_VOID, direction=IN, server-argument-impl-policy=USE-ARGUMENT-TYPE
        RestoreBlockDefaults
          arg DstPtr: type=dtRef_VOID, direction=IN, server-argument-impl-policy=USE-ARGUMENT-TYPE
        SetDataIndex
          arg DataIndex: type=uint8, direction=IN, server-argument-impl-policy=USE-ARGUMENT-TYPE
        WriteBlock
          arg SrcPtr: type=dtRef_const_VOID, direction=IN, server-argument-impl-policy=USE-ARGUMENT-TYPE
      error E_NOT_OK: error-code=1
    NvMService_AC2_SRBS
      4 x operation, all with possible-error=NvMService_AC2_SRBS/E_NOT_OK:
        GetErrorStatus
          arg ErrorStatus: type=NvM_RequestResultType, direction=OUT, server-argument-impl-policy=USE-ARGUMENT-TYPE
        ReadBlock
          arg DstPtr: type=dtRef_VOID, direction=IN, server-argument-impl-policy=USE-ARGUMENT-TYPE
        SetRamBlockStatus
          arg RamBlockStatus: type=boolean, direction=IN, server-argument-impl-policy=USE-ARGUMENT-TYPE
        WriteBlock
          arg SrcPtr: type=dtRef_const_VOID, direction=IN, server-argument-impl-policy=USE-ARGUMENT-TYPE
      error E_NOT_OK: error-code=1
    NvMService_AC2_SRBS_Defs
      5 x operation, all with possible-error=NvMService_AC2_SRBS_Defs/E_NOT_OK:
        GetErrorStatus
          arg ErrorStatus: type=NvM_RequestResultType, direction=OUT, server-argument-impl-policy=USE-ARGUMENT-TYPE
        ReadBlock
          arg DstPtr: type=dtRef_VOID, direction=IN, server-argument-impl-policy=USE-ARGUMENT-TYPE
        RestoreBlockDefaults
          arg DstPtr: type=dtRef_VOID, direction=IN, server-argument-impl-policy=USE-ARGUMENT-TYPE
        SetRamBlockStatus
          arg RamBlockStatus: type=boolean, direction=IN, server-argument-impl-policy=USE-ARGUMENT-TYPE
        WriteBlock
          arg SrcPtr: type=dtRef_const_VOID, direction=IN, server-argument-impl-policy=USE-ARGUMENT-TYPE
      error E_NOT_OK: error-code=1
    NvMService_AC2_SRBS_DS
      6 x operation, all with possible-error=NvMService_AC2_SRBS_DS/E_NOT_OK:
        GetDataIndex
          arg DataIndex: type=uint8, direction=OUT, server-argument-impl-policy=USE-ARGUMENT-TYPE
        GetErrorStatus
          arg ErrorStatus: type=NvM_RequestResultType, direction=OUT, server-argument-impl-policy=USE-ARGUMENT-TYPE
        ReadBlock
          arg DstPtr: type=dtRef_VOID, direction=IN, server-argument-impl-policy=USE-ARGUMENT-TYPE
        SetDataIndex
          arg DataIndex: type=uint8, direction=IN, server-argument-impl-policy=USE-ARGUMENT-TYPE
        SetRamBlockStatus
          arg RamBlockStatus: type=boolean, direction=IN, server-argument-impl-policy=USE-ARGUMENT-TYPE
        WriteBlock
          arg SrcPtr: type=dtRef_const_VOID, direction=IN, server-argument-impl-policy=USE-ARGUMENT-TYPE
      error E_NOT_OK: error-code=1
    NvMService_AC2_SRBS_DS_Defs
      7 x operation, all with possible-error=NvMService_AC2_SRBS_DS_Defs/E_NOT_OK:
        GetDataIndex
          arg DataIndex: type=uint8, direction=OUT, server-argument-impl-policy=USE-ARGUMENT-TYPE
        GetErrorStatus
          arg ErrorStatus: type=NvM_RequestResultType, direction=OUT, server-argument-impl-policy=USE-ARGUMENT-TYPE
        ReadBlock
          arg DstPtr: type=dtRef_VOID, direction=IN, server-argument-impl-policy=USE-ARGUMENT-TYPE
        RestoreBlockDefaults
          arg DstPtr: type=dtRef_VOID, direction=IN, server-argument-impl-policy=USE-ARGUMENT-TYPE
        SetDataIndex
          arg DataIndex: type=uint8, direction=IN, server-argument-impl-policy=USE-ARGUMENT-TYPE
        SetRamBlockStatus
          arg RamBlockStatus: type=boolean, direction=IN, server-argument-impl-policy=USE-ARGUMENT-TYPE
        WriteBlock
          arg SrcPtr: type=dtRef_const_VOID, direction=IN, server-argument-impl-policy=USE-ARGUMENT-TYPE
      error E_NOT_OK: error-code=1
    NvMService_AC3
      5 x operation, all with possible-error=NvMService_AC3/E_NOT_OK:
        EraseBlock
        GetErrorStatus
          arg ErrorStatus: type=NvM_RequestResultType, direction=OUT, server-argument-impl-policy=USE-ARGUMENT-TYPE
        InvalidateNvBlock
        ReadBlock
          arg DstPtr: type=dtRef_VOID, direction=IN, server-argument-impl-policy=USE-ARGUMENT-TYPE
        WriteBlock
          arg SrcPtr: type=dtRef_const_VOID, direction=IN, server-argument-impl-policy=USE-ARGUMENT-TYPE
      error E_NOT_OK: error-code=1
    NvMService_AC3_Defs
      6 x operation, all with possible-error=NvMService_AC3_Defs/E_NOT_OK:
        EraseBlock
        GetErrorStatus
          arg ErrorStatus: type=NvM_RequestResultType, direction=OUT, server-argument-impl-policy=USE-ARGUMENT-TYPE
        InvalidateNvBlock
        ReadBlock
          arg DstPtr: type=dtRef_VOID, direction=IN, server-argument-impl-policy=USE-ARGUMENT-TYPE
        RestoreBlockDefaults
          arg DstPtr: type=dtRef_VOID, direction=IN, server-argument-impl-policy=USE-ARGUMENT-TYPE
        WriteBlock
          arg SrcPtr: type=dtRef_const_VOID, direction=IN, server-argument-impl-policy=USE-ARGUMENT-TYPE
      error E_NOT_OK: error-code=1
    NvMService_AC3_DS
      7 x operation, all with possible-error=NvMService_AC3_DS/E_NOT_OK:
        EraseBlock
        GetDataIndex
          arg DataIndex: type=uint8, direction=OUT, server-argument-impl-policy=USE-ARGUMENT-TYPE
        GetErrorStatus
          arg ErrorStatus: type=NvM_RequestResultType, direction=OUT, server-argument-impl-policy=USE-ARGUMENT-TYPE
        InvalidateNvBlock
        ReadBlock
          arg DstPtr: type=dtRef_VOID, direction=IN, server-argument-impl-policy=USE-ARGUMENT-TYPE
        SetDataIndex
          arg DataIndex: type=uint8, direction=IN, server-argument-impl-policy=USE-ARGUMENT-TYPE
        WriteBlock
          arg SrcPtr: type=dtRef_const_VOID, direction=IN, server-argument-impl-policy=USE-ARGUMENT-TYPE
      error E_NOT_OK: error-code=1
    NvMService_AC3_DS_Defs
      8 x operation, all with possible-error=NvMService_AC3_DS_Defs/E_NOT_OK:
        EraseBlock
        GetDataIndex
          arg DataIndex: type=uint8, direction=OUT, server-argument-impl-policy=USE-ARGUMENT-TYPE
        GetErrorStatus
          arg ErrorStatus: type=NvM_RequestResultType, direction=OUT, server-argument-impl-policy=USE-ARGUMENT-TYPE
        InvalidateNvBlock
        ReadBlock
          arg DstPtr: type=dtRef_VOID, direction=IN, server-argument-impl-policy=USE-ARGUMENT-TYPE
        RestoreBlockDefaults
          arg DstPtr: type=dtRef_VOID, direction=IN, server-argument-impl-policy=USE-ARGUMENT-TYPE
        SetDataIndex
          arg DataIndex: type=uint8, direction=IN, server-argument-impl-policy=USE-ARGUMENT-TYPE
        WriteBlock
          arg SrcPtr: type=dtRef_const_VOID, direction=IN, server-argument-impl-policy=USE-ARGUMENT-TYPE
      error E_NOT_OK: error-code=1
    NvMService_AC3_SRBS
      6 x operation, all with possible-error=NvMService_AC3_SRBS/E_NOT_OK:
        EraseBlock
        GetErrorStatus
          arg ErrorStatus: type=NvM_RequestResultType, direction=OUT, server-argument-impl-policy=USE-ARGUMENT-TYPE
        InvalidateNvBlock
        ReadBlock
          arg DstPtr: type=dtRef_VOID, direction=IN, server-argument-impl-policy=USE-ARGUMENT-TYPE
        SetRamBlockStatus
          arg RamBlockStatus: type=boolean, direction=IN, server-argument-impl-policy=USE-ARGUMENT-TYPE
        WriteBlock
          arg SrcPtr: type=dtRef_const_VOID, direction=IN, server-argument-impl-policy=USE-ARGUMENT-TYPE
      error E_NOT_OK: error-code=1
    NvMService_AC3_SRBS_Defs
      7 x operation, all with possible-error=NvMService_AC3_SRBS_Defs/E_NOT_OK:
        EraseBlock
        GetErrorStatus
          arg ErrorStatus: type=NvM_RequestResultType, direction=OUT, server-argument-impl-policy=USE-ARGUMENT-TYPE
        InvalidateNvBlock
        ReadBlock
          arg DstPtr: type=dtRef_VOID, direction=IN, server-argument-impl-policy=USE-ARGUMENT-TYPE
        RestoreBlockDefaults
          arg DstPtr: type=dtRef_VOID, direction=IN, server-argument-impl-policy=USE-ARGUMENT-TYPE
        SetRamBlockStatus
          arg RamBlockStatus: type=boolean, direction=IN, server-argument-impl-policy=USE-ARGUMENT-TYPE
        WriteBlock
          arg SrcPtr: type=dtRef_const_VOID, direction=IN, server-argument-impl-policy=USE-ARGUMENT-TYPE
      error E_NOT_OK: error-code=1
    NvMService_AC3_SRBS_DS
      8 x operation, all with possible-error=NvMService_AC3_SRBS_DS/E_NOT_OK:
        EraseBlock
        GetDataIndex
          arg DataIndex: type=uint8, direction=OUT, server-argument-impl-policy=USE-ARGUMENT-TYPE
        GetErrorStatus
          arg ErrorStatus: type=NvM_RequestResultType, direction=OUT, server-argument-impl-policy=USE-ARGUMENT-TYPE
        InvalidateNvBlock
        ReadBlock
          arg DstPtr: type=dtRef_VOID, direction=IN, server-argument-impl-policy=USE-ARGUMENT-TYPE
        SetDataIndex
          arg DataIndex: type=uint8, direction=IN, server-argument-impl-policy=USE-ARGUMENT-TYPE
        SetRamBlockStatus
          arg RamBlockStatus: type=boolean, direction=IN, server-argument-impl-policy=USE-ARGUMENT-TYPE
        WriteBlock
          arg SrcPtr: type=dtRef_const_VOID, direction=IN, server-argument-impl-policy=USE-ARGUMENT-TYPE
      error E_NOT_OK: error-code=1
    NvMService_AC3_SRBS_DS_Defs
      9 x operation, all with possible-error=NvMService_AC3_SRBS_DS_Defs/E_NOT_OK:
        EraseBlock
        GetDataIndex
          arg DataIndex: type=uint8, direction=OUT, server-argument-impl-policy=USE-ARGUMENT-TYPE
        GetErrorStatus
          arg ErrorStatus: type=NvM_RequestResultType, direction=OUT, server-argument-impl-policy=USE-ARGUMENT-TYPE
        InvalidateNvBlock
        ReadBlock
          arg DstPtr: type=dtRef_VOID, direction=IN, server-argument-impl-policy=USE-ARGUMENT-TYPE
        RestoreBlockDefaults
          arg DstPtr: type=dtRef_VOID, direction=IN, server-argument-impl-policy=USE-ARGUMENT-TYPE
        SetDataIndex
          arg DataIndex: type=uint8, direction=IN, server-argument-impl-policy=USE-ARGUMENT-TYPE
        SetRamBlockStatus
          arg RamBlockStatus: type=boolean, direction=IN, server-argument-impl-policy=USE-ARGUMENT-TYPE
        WriteBlock
          arg SrcPtr: type=dtRef_const_VOID, direction=IN, server-argument-impl-policy=USE-ARGUMENT-TYPE
      error E_NOT_OK: error-code=1
    NvMService_SRBS
      operation GetErrorStatus: possible-error=NvMService_SRBS/E_NOT_OK
        arg ErrorStatus: type=NvM_RequestResultType, direction=OUT, server-argument-impl-policy=USE-ARGUMENT-TYPE
      operation SetRamBlockStatus: possible-error=NvMService_SRBS/E_NOT_OK
        arg RamBlockStatus: type=boolean, direction=IN, server-argument-impl-policy=USE-ARGUMENT-TYPE
      error E_NOT_OK: error-code=1
    CallbackDTCStatusChange: service-kind=DIAGNOSTIC-EVENT-MANAGER
      operation DTCStatusChanged: possible-error=CallbackDTCStatusChange/E_NOT_OK
        arg DTC: type=uint32, direction=IN, server-argument-impl-policy=USE-ARGUMENT-TYPE
        arg DTCStatusOld: type=Dem_UdsStatusByteType, direction=IN, server-argument-impl-policy=USE-ARGUMENT-TYPE
        arg DTCStatusNew: type=Dem_UdsStatusByteType, direction=IN, server-argument-impl-policy=USE-ARGUMENT-TYPE
      error E_NOT_OK: error-code=1
package /ModeDclrGroups
  7 x mode declaration group:
    NM_State: category=EXPLICIT_ORDER, initial-mode=NM_STATE_BUS_SLEEP, on-transition-value=6
      6 x mode:
        NM_UINIT: value=0
        NM_STATE_BUS_SLEEP: value=1
        NM_STATE_NORMAL: value=4
        NM_STATE_PREPARE_SLEEP: value=2
        NM_STATE_READY_SLEEP: value=3
        NM_STATE_REPEAT: value=5
    MDG_CmdIgnitionState: category=EXPLICIT_ORDER, initial-mode=CmdIgnitionState_INVALID, on-transition-value=2
      mode CmdIgnitionState_OFF: value=0
      mode CmdIgnitionState_ON: value=1
      mode CmdIgnitionState_INVALID: value=255
    VehicleSpeedCheck: category=ALPHABETIC_ORDER, initial-mode=VehicleSpeedCheck/VehicleSpeedZero, on-transition-value=2
      mode VehicleSpeedNonZero: value=1
      mode VehicleSpeedZero: value=0
    SYSModeRequestType: category=EXPLICIT_ORDER, initial-mode=SYS_REQ_INIT, on-transition-value=4
      4 x mode:
        SYS_REQ_HARDRESET: value=1
        SYS_REQ_INIT: value=0
        SYS_REQ_INVALID: value=3
        SYS_REQ_JUMPTOBOOT: value=2
    SSM_SystemState_Mode: category=ALPHABETIC_ORDER, initial-mode=SSM_STATE_BOOTING, on-transition-value=10
      10 x mode:
        SSM_STATE_BOOTING: value=0
        SSM_STATE_BOOT_ERROR: value=1
        SSM_STATE_DEGRADED: value=2
        SSM_STATE_IPCREADY: value=3
        SSM_STATE_MASTERCORE_SHUTDOWNJOBSEXECUTE: value=4
        SSM_STATE_MAX: value=5
        SSM_STATE_OFF: value=6
        SSM_STATE_RUNNING: value=7
        SSM_STATE_SHUTTINGDOWN_REMOTECORES: value=8
        SSM_STATE_SLAVECORES_STARTSHUTDOWNCLEANUP: value=9
    SafetyGuard_BSWM_SafeMode: category=ALPHABETIC_ORDER, initial-mode=SAFETTYGUARD_SAFASTATE_NORMAL, on-transition-value=2
      mode SAFETTYGUARD_SAFASTATE_NORMAL: value=0
      mode SAFETYGUARD_SAFESTATE_2_RESET: value=1
    ProgPreconditionState: category=ALPHABETIC_ORDER, initial-mode=StateOK, on-transition-value=2
      mode StateNotOK: value=0
      mode StateOK: value=1
package /PortInterfaces
  4 x mode switch interface, all with is-service=true:
    IF_CmdIgnitionStatus
      mode group Current_CmdIgnition: type=MDG_CmdIgnitionState
    IF_Mode_VehicleSpeedCheck
      mode group Mode: type=ModeDclrGroups/VehicleSpeedCheck
    IF_DiagRequestNtfy
      mode group SYSModeRequestType: type=SYSModeRequestType
    IF_NM_State
      mode group Mode: type=NM_State
  4 x sender receiver interface:
    IF_GetFirstDTCStatus
      data DeFirstDTCStatus: type=boolean
    IF_PpUSSConstantData
      data US_S_USSConstantData_t: type=US_S_USSConstantData_t
    IF_PpUSSPeriodDiagData
      data US_S_USSPeriodDiagData_t: type=US_S_USSPeriodDiagData_t
    IF_SystemStateManager
      data SysM_State: type=SystemState
  client server interface IF_SVSCamCalibReset
    operation WriteBlock: possible-error=[IF_SVSCamCalibReset/E_NOT_OK, IF_SVSCamCalibReset/E_NOT_OK]
      arg v_SVSCamCalibReset: type=TbSVS_S_SVSCamCalibReset_t, direction=IN, server-argument-impl-policy=USE-ARGUMENT-TYPE
    error E_NOT_OK: error-code=1
  sender receiver interface IF_FailsafeDebug
    data Debugflag: type=uint8
  sender receiver interface IF_ProxiToSWC
    8 x data:
      TyreSz_u16: type=uint16
      SurroundViewCam_u8: type=uint8
      Fullautomaticparking: type=uint8
      Pamtuningset: type=uint8
      PAMConfig_u8: type=uint8
      Trailerhitchassist_u8: type=uint8
      Parkwithstop_u8: type=uint8
      PRX_CanNod27_b: type=boolean
  client server interface IF_CryptoArray
    operation CryptoArray
      arg CertPtr: type=uint8, direction=OUT, server-argument-impl-policy=USE-ARGUMENT-TYPE
      arg CertLen: type=uint16, direction=IN, server-argument-impl-policy=USE-ARGUMENT-TYPE
  7 x sender receiver interface:
    IF_Can14DbgRoutine
      data Can14DbgRoutine: type=CanDebugMode_t
    IF_TbFAArbiterOutput
      data TbFA_ArbiterOutput_t: type=TbFA_ArbiterOutput_t
    IF_SVSNVMData
      data SVS_NVMData_t: type=SVS_NVMData_t
    IF_WdgCheckpointStatus
      data WdgCheckpointStatus_t: type=WdgCheckpointStatus_t
    IF_APVarTunParam
      data TbAP_VrntTunParam_t: type=TbAP_VrntTunParam_t
    IF_UssPowerData
      data UssPower: sw-calibration-access=READ-WRITE, type=UssPowerSense
    IF_SleepProcessState
      data status: type=uint8
  client server interface IF_2023_ProxiData
    operation WriteData
      arg Data: type=Proxi_255byte, direction=IN, server-argument-impl-policy=USE-ARGUMENT-TYPE
      arg Datalength: type=uint16, direction=IN, server-argument-impl-policy=USE-ARGUMENT-TYPE
      arg Errorcode: type=Dcm_NegativeResponseCodeType, direction=OUT, server-argument-impl-policy=USE-ARGUMENT-TYPE
  sender receiver interface IF_PlantMode
    data Status: type=uint8
  sender receiver interface IF_ProxiErrorData
    data Error: type=ME_Hydra2defs_S_PROXI_error_Data_t
  mode switch interface IF_SSM_SystemState: is-service=true
    mode group Mode: type=SSM_SystemState_Mode
  16 x sender receiver interface:
    IF_FromComSafeFD02Rx
      69 x data:
        CameraDisplaySts2: type=CameraDisplaySts2
        CM_TCH_STAT: type=CM_TCH_STAT
        CM_TCH_X_COORD: type=CM_TCH_X_COORD
        CM_TCH_Y_COORD: type=CM_TCH_Y_COORD
        ITBM_TrlrStat: type=ITBM_TrlrStat
        Shifter_ADAS_Inhibit: type=Shifter_ADAS_Inhibit
        ShiftLeverPositionReq: type=ShiftLeverPositionReq
        EPS_SteeringTouchStat: type=EPS_SteeringTouchStat
        EPS_SteeringTouq_Resp: type=EPS_SteeringTouq_Resp
        EPS_THA_DriverTorqueOverride: type=EPS_THA_DriverTorqueOverride
        EPS_THA_SteeringTorqueResp: type=EPS_THA_SteeringTorqueResp
        THA_SteeringTouchStat: type=THA_SteeringTouchStat
        PdlPosActual: type=PdlPosActual_adt
        ASCM_Stat: type=ASCM_Stat
        ASCM_SysFail: type=ASCM_SysFail
        ECM_THA_Resp: type=ECM_THA_Resp
        ECM_TRSC_Resp: type=ECM_TRSC_Resp
        EngineSts_W: type=EngineSts_W
        ESS_ENG_ST_W: type=ESS_ENG_ST_W
        FL_Lvl: type=FL_Lvl_adt
        FL_Lvl_Adj: type=FL_Lvl_Adj
        FR_Lvl: type=FR_Lvl_adt
        FR_Lvl_Adj: type=FR_Lvl_Adj
        GearEngagedForDisplay: type=GearEngagedForDisplay
        HU_TRSC_EnableBtn_Sts: type=HU_TRSC_EnableBtn_Sts
        RL_Lvl: type=RL_Lvl_adt
        RL_Lvl_Adj: type=RL_Lvl_Adj
        RR_Lvl: type=RR_Lvl_adt
        RR_Lvl_Adj: type=RR_Lvl_Adj
        VIN_DATA: type=VIN_DATA
        VIN_MSG: type=VIN_MSG
        Active_Park_Mode: type=Active_Park_Mode
        Active_Park_Prox_Chime: type=Active_Park_Prox_Chime
        APARequestSts: type=APARequestSts
        Backup_Cam_Delay: type=Backup_Cam_Delay
        Brk_Stat: type=Brk_Stat
        CmdIgnSts: type=CmdIgnSts
        DriverDoorSts: type=DriverDoorSts
        DynamicGrid: type=DynamicGrid
        ExternalTemperature: type=ExternalTemperature_adt
        FT_PAMRequestSts: type=FT_PAMRequestSts
        Fwrd_Cam_Guidelines: type=Fwrd_Cam_Guidelines
        GearEngaged: type=GearEngaged
        HAS_Status_C2: type=HAS_Status_C2
        LanguageSelection: type=LanguageSelection
        LatAcceleration_BSM: type=LatAcceleration_BSM_adt
        LHRDoorSts: type=LHRDoorSts
        LongAcceleration_BSM: type=LongAcceleration_BSM_adt
        LwsAngle: type=LwsAngle_adt
        LwsAngleType: type=LwsAngleType
        LwsSpeed: type=LwsSpeed_adt
        MRM_STATUS_C2: type=MRM_STATUS_C2
        PamChimeVolumeFront: type=PamChimeVolumeFront
        PamChimeVolumeRear: type=PamChimeVolumeRear
        PAMRequestSts: type=PAMRequestSts
        PsngrDoorSts: type=PsngrDoorSts
        Rear_Brk_Asst: type=Rear_Brk_Asst
        RHatchSts: type=RHatchSts
        RHRDoorSts: type=RHRDoorSts
        ShiftLeverPosition: type=ShiftLeverPosition
        SVC_Guidelines: type=SVC_Guidelines
        TargetGear: type=TargetGear
        TCASERANGESTATUS: type=TCASERANGESTATUS
        TGW_CAMERA_DISP_STAT: type=TGW_CAMERA_DISP_STAT
        TrailerConnectionSts: type=TrailerConnectionSts
        TRANS_ADAS_Inhibit: type=TRANS_ADAS_Inhibit
        TransmissionSailingSts: type=TransmissionSailingSts
        VehicleSpeedVSOSig: type=VehicleSpeedVSOSig_adt
        YawRate_BSM: type=YawRate_BSM_adt
    IF_FromComFD02Rx
      166 x data:
        Altitude_RMSE_C2: type=Altitude_RMSE_C2_adt
        Battery_Volt_1: type=Battery_Volt_1_adt
        BSM_THA_Brk_Resp: type=BSM_THA_Brk_Resp
        CurrentCanNMState_FD01_BCM: type=CurrentCanNMState_FD01_BCM
        CurrentCanNMState_FD01_SGW: type=CurrentCanNMState_FD01_SGW
        CurrentCanNMState_FD02_BCM: type=CurrentCanNMState_FD02_BCM
        CurrentCanNMState_FD02_BSM2: type=CurrentCanNMState_FD02_BSM2
        CurrentCanNMState_FD02_CADM2: type=CurrentCanNMState_FD02_CADM2
        CurrentCanNMState_FD02_EPS: type=CurrentCanNMState_FD02_EPS
        CurrentCanNMState_FD02_ORC: type=CurrentCanNMState_FD02_ORC
        CurrentCanNMState_FD02_SGW: type=CurrentCanNMState_FD02_SGW
        CurrentCanNMState_FD02_TRLR_REV: type=CurrentCanNMState_FD02_TRLR_REV
        CurrentCanNMState_FD03_BCM: type=CurrentCanNMState_FD03_BCM
        CurrentCanNMState_FD03_SGW: type=CurrentCanNMState_FD03_SGW
        CurrentCanNMState_FD04_BCM: type=CurrentCanNMState_FD04_BCM
        CurrentCanNMState_FD08_SGW: type=CurrentCanNMState_FD08_SGW
        CurrentCanNMState_FD11_SGW: type=CurrentCanNMState_FD11_SGW
        CurrentFailSts_FD01_BCM: type=CurrentFailSts_FD01_BCM
        CurrentFailSts_FD01_SGW: type=CurrentFailSts_FD01_SGW
        CurrentFailSts_FD02_BCM: type=CurrentFailSts_FD02_BCM
        CurrentFailSts_FD02_BSM2: type=CurrentFailSts_FD02_BSM2
        CurrentFailSts_FD02_CADM2: type=CurrentFailSts_FD02_CADM2
        CurrentFailSts_FD02_EPS: type=CurrentFailSts_FD02_EPS
        CurrentFailSts_FD02_ORC: type=CurrentFailSts_FD02_ORC
        CurrentFailSts_FD02_SGW: type=CurrentFailSts_FD02_SGW
        CurrentFailSts_FD02_TRLR_REV: type=CurrentFailSts_FD02_TRLR_REV
        CurrentFailSts_FD03_BCM: type=CurrentFailSts_FD03_BCM
        CurrentFailSts_FD03_SGW: type=CurrentFailSts_FD03_SGW
        CurrentFailSts_FD04_BCM: type=CurrentFailSts_FD04_BCM
        CurrentFailSts_FD08_SGW: type=CurrentFailSts_FD08_SGW
        CurrentFailSts_FD11_SGW: type=CurrentFailSts_FD11_SGW
        DeltaTimestamp_IMUdata: type=DeltaTimestamp_IMUdata
        DES_FD01_BCM: type=DES_FD01_BCM
        DES_FD01_SGW: type=DES_FD01_SGW
        DES_FD02_BCM: type=DES_FD02_BCM
        DES_FD02_BSM2: type=DES_FD02_BSM2
        DES_FD02_CADM2: type=DES_FD02_CADM2
        DES_FD02_EPS: type=DES_FD02_EPS
        DES_FD02_ORC: type=DES_FD02_ORC
        DES_FD02_SGW: type=DES_FD02_SGW
        DES_FD02_TRLR_REV: type=DES_FD02_TRLR_REV
        DES_FD03_BCM: type=DES_FD03_BCM
        DES_FD03_SGW: type=DES_FD03_SGW
        DES_FD04_BCM: type=DES_FD04_BCM
        DES_FD08_SGW: type=DES_FD08_SGW
        DES_FD11_SGW: type=DES_FD11_SGW
        Digit_{01..11}: type=Digit_{01..11}
        EOL_FD01_BCM: type=EOL_FD01_BCM
        EOL_FD01_SGW: type=EOL_FD01_SGW
        EOL_FD02_BCM: type=EOL_FD02_BCM
        EOL_FD02_BSM2: type=EOL_FD02_BSM2
        EOL_FD02_CADM2: type=EOL_FD02_CADM2
        EOL_FD02_EPS: type=EOL_FD02_EPS
        EOL_FD02_ORC: type=EOL_FD02_ORC
        EOL_FD02_SGW: type=EOL_FD02_SGW
        EOL_FD02_TRLR_REV: type=EOL_FD02_TRLR_REV
        EOL_FD03_BCM: type=EOL_FD03_BCM
        EOL_FD03_SGW: type=EOL_FD03_SGW
        EOL_FD04_BCM: type=EOL_FD04_BCM
        EOL_FD08_SGW: type=EOL_FD08_SGW
        EOL_FD11_SGW: type=EOL_FD11_SGW
        EPBSts: type=EPBSts
        GenericFailSts_FD01_BCM: type=GenericFailSts_FD01_BCM
        GenericFailSts_FD01_SGW: type=GenericFailSts_FD01_SGW
        GenericFailSts_FD02_BCM: type=GenericFailSts_FD02_BCM
        GenericFailSts_FD02_BSM2: type=GenericFailSts_FD02_BSM2
        GenericFailSts_FD02_CADM2: type=GenericFailSts_FD02_CADM2
        GenericFailSts_FD02_EPS: type=GenericFailSts_FD02_EPS
        GenericFailSts_FD02_ORC: type=GenericFailSts_FD02_ORC
        GenericFailSts_FD02_SGW: type=GenericFailSts_FD02_SGW
        GenericFailSts_FD02_TRLR_REV: type=GenericFailSts_FD02_TRLR_REV
        GenericFailSts_FD03_BCM: type=GenericFailSts_FD03_BCM
        GenericFailSts_FD03_SGW: type=GenericFailSts_FD03_SGW
        GenericFailSts_FD04_BCM: type=GenericFailSts_FD04_BCM
        GenericFailSts_FD08_SGW: type=GenericFailSts_FD08_SGW
        GenericFailSts_FD11_SGW: type=GenericFailSts_FD11_SGW
        Heading_Angle_C2: type=Heading_Angle_C2_adt
        IgnitionOnCounter: type=IgnitionOnCounter
        LatAcceleration_C2: type=LatAcceleration_C2_adt
        LatAccelerationOffset_BSM: type=LatAccelerationOffset_BSM_adt
        Latitude_RMSE_C2: type=Latitude_RMSE_C2_adt
        LHF_FastPulseCounter: type=LHF_FastPulseCounter
        LHF_Spin: type=LHF_Spin
        LHFWheelSpeed: type=LHFWheelSpeed_adt
        LHR_FastPulseCounter: type=LHR_FastPulseCounter
        LHR_Spin: type=LHR_Spin
        LHRWheelSpeed: type=LHRWheelSpeed_adt
        LongAcceleration_C2: type=LongAcceleration_C2_adt
        LongAccelerationOffset_BSM: type=LongAccelerationOffset_BSM_adt
        Longitude_RMSE_C2: type=Longitude_RMSE_C2_adt
        OperationalModeSts: type=OperationalModeSts
        Pitch_RMSE_C2: type=Pitch_RMSE_C2_adt
        PitchRate_C2: type=PitchRate_C2_adt
        PreviousCanNMState_FD01_BCM: type=PreviousCanNMState_FD01_BCM
        PreviousCanNMState_FD01_SGW: type=PreviousCanNMState_FD01_SGW
        PreviousCanNMState_FD02_BCM: type=PreviousCanNMState_FD02_BCM
        PreviousCanNMState_FD02_BSM2: type=PreviousCanNMState_FD02_BSM2
        PreviousCanNMState_FD02_CADM2: type=PreviousCanNMState_FD02_CADM2
        PreviousCanNMState_FD02_EPS: type=PreviousCanNMState_FD02_EPS
        PreviousCanNMState_FD02_ORC: type=PreviousCanNMState_FD02_ORC
        PreviousCanNMState_FD02_SGW: type=PreviousCanNMState_FD02_SGW
        PreviousCanNMState_FD02_TRLR_REV: type=PreviousCanNMState_FD02_TRLR_REV
        PreviousCanNMState_FD03_BCM: type=PreviousCanNMState_FD03_BCM
        PreviousCanNMState_FD03_SGW: type=PreviousCanNMState_FD03_SGW
        PreviousCanNMState_FD04_BCM: type=PreviousCanNMState_FD04_BCM
        PreviousCanNMState_FD08_SGW: type=PreviousCanNMState_FD08_SGW
        PreviousCanNMState_FD11_SGW: type=PreviousCanNMState_FD11_SGW
        REF_VEH_SPEED: type=REF_VEH_SPEED_adt
        RemStActvSts: type=RemStActvSts
        RHF_FastPulseCounter: type=RHF_FastPulseCounter
        RHF_Spin: type=RHF_Spin
        RHFWheelSpeed: type=RHFWheelSpeed_adt
        RHR_FastPulseCounter: type=RHR_FastPulseCounter
        RHR_Spin: type=RHR_Spin
        RHRWheelSpeed: type=RHRWheelSpeed_adt
        Roll_RMSE_C2: type=Roll_RMSE_C2_adt
        RollRate_C2: type=RollRate_C2_adt
        SBR1RowDriverSeatSts: type=SBR1RowDriverSeatSts
        StayActiveSource_FD01_BCM: type=FD01_BCM_64
        StayActiveSource_FD01_SGW: type=FD01_SGW_64
        StayActiveSource_FD02_BCM: type=FD02_BCM_64
        StayActiveSource_FD02_BSM2: type=FD02_BSM2_64
        StayActiveSource_FD02_CADM2: type=FD02_CADM2_64
        StayActiveSource_FD02_EPS: type=FD02_EPS_64
        StayActiveSource_FD02_ORC: type=FD02_ORC_64
        StayActiveSource_FD02_SGW: type=FD02_SGW_64
        StayActiveSource_FD02_TRLR_REV: type=FD02_TRLR_REV_64
        StayActiveSource_FD03_BCM: type=FD03_BCM_64
        StayActiveSource_FD03_SGW: type=FD03_SGW_64
        StayActiveSource_FD04_BCM: type=FD04_BCM_64
        StayActiveSource_FD08_SGW: type=FD08_SGW_64
        StayActiveSource_FD11_SGW: type=FD11_SGW_64
        TotalOdometer: type=TotalOdometer
        TRSC_CenterBtn_Sts: type=TRSC_CenterBtn_Sts
        TRSC_EnableBtn_Sts: type=TRSC_EnableBtn_Sts
        TRSC_RawKnob: type=TRSC_RawKnob
        TurnIndicatorSts: type=TurnIndicatorSts
        VehicleStandStillSts: type=VehicleStandStillSts
        VerticalAcceleration_C2: type=VerticalAcceleration_C2_adt
        WakeupSource_FD01_ADCM: type=WakeupSource_FD01_ADCM
        WakeupSource_FD01_BCM: type=WakeupSource_FD01_BCM
        WakeupSource_FD01_SGW: type=WakeupSource_FD01_SGW
        WakeupSource_FD02_BCM: type=WakeupSource_FD02_BCM
        WakeupSource_FD02_BSM2: type=WakeupSource_FD02_BSM2
        WakeupSource_FD02_CADM2: type=WakeupSource_FD02_CADM2
        WakeupSource_FD02_EPS: type=WakeupSource_FD02_EPS
        WakeupSource_FD02_ORC: type=WakeupSource_FD02_ORC
        WakeupSource_FD02_SGW: type=WakeupSource_FD02_SGW
        WakeupSource_FD02_TRLR_REV: type=WakeupSource_FD02_TRLR_REV
        WakeupSource_FD03_BCM: type=WakeupSource_FD03_BCM
        WakeupSource_FD03_SGW: type=WakeupSource_FD03_SGW
        WakeupSource_FD04_BCM: type=WakeupSource_FD04_BCM
        WakeupSource_FD08_SGW: type=WakeupSource_FD08_SGW
        WakeupSource_FD11_SGW: type=WakeupSource_FD11_SGW
        YawRate_C2: type=YawRate_C2_adt
        YawRate_RMSE_C2: type=YawRate_RMSE_C2_adt
    IF_FromComSafeFD14Rx
      58 x data:
        FD14_EPS_SteeringTouchStat: type=FD14_EPS_SteeringTouchStat
        FD14_EPS_SteeringTouq_Resp: type=FD14_EPS_SteeringTouq_Resp
        FD14_EPS_THA_DriverTorqueOverride: type=FD14_EPS_THA_DriverTorqueOverride
        FD14_EPS_THA_SteeringTorqueResp: type=FD14_EPS_THA_SteeringTorqueResp
        FD14_THA_SteeringTouchStat: type=FD14_THA_SteeringTouchStat
        FD14_PdlPosActual: type=FD14_PdlPosActual_adt
        FD14_ECM_THA_Resp: type=FD14_ECM_THA_Resp
        FD14_ECM_TRSC_Resp: type=FD14_ECM_TRSC_Resp
        FD14_EngineSts_W: type=FD14_EngineSts_W
        FD14_ESS_ENG_ST_W: type=FD14_ESS_ENG_ST_W
        FD14_ACC_Systemsts: type=FD14_ACC_Systemsts
        FD14_Brk_Stat: type=FD14_Brk_Stat
        FD14_BrkPdl_Stat: type=FD14_BrkPdl_Stat
        FD14_BrkTrq: type=FD14_BrkTrq_adt
        FD14_BrkTrq_Driver: type=FD14_BrkTrq_Driver_adt
        FD14_BSM_THA_Brk_Resp: type=FD14_BSM_THA_Brk_Resp
        FD14_EPBSts: type=FD14_EPBSts
        FD14_EPS_HandsOnRecognition: type=FD14_EPS_HandsOnRecognition
        FD14_ESC_TRSC_Brk_Resp: type=FD14_ESC_TRSC_Brk_Resp
        FD14_ExternalBrkRequestsDisabled: type=FD14_ExternalBrkRequestsDisabled
        FD14_HAS_Status: type=FD14_HAS_Status
        FD14_LatAcceleration_BSM: type=FD14_LatAcceleration_BSM_adt
        FD14_LatAccelerationFailSts_BSM: type=FD14_LatAccelerationFailSts_BSM
        FD14_LatAccelerationOffset_BSM: type=FD14_LatAccelerationOffset_BSM_adt
        FD14_LHF_FastPulseCounter: type=FD14_LHF_FastPulseCounter
        FD14_LHF_Spin: type=FD14_LHF_Spin
        FD14_LHF_WheelSensorFailSts: type=FD14_LHF_WheelSensorFailSts
        FD14_LHFWheelSpeed: type=FD14_LHFWheelSpeed_adt
        FD14_LHR_FastPulseCounter: type=FD14_LHR_FastPulseCounter
        FD14_LHR_Spin: type=FD14_LHR_Spin
        FD14_LHR_WheelSensorFailSts: type=FD14_LHR_WheelSensorFailSts
        FD14_LHRWheelSpeed: type=FD14_LHRWheelSpeed_adt
        FD14_LongAcceleration_BSM: type=FD14_LongAcceleration_BSM_adt
        FD14_LongAccelerationFailSts_BSM: type=FD14_LongAccelerationFailSts_BSM
        FD14_LongAccelerationOffset_BSM: type=FD14_LongAccelerationOffset_BSM_adt
        FD14_LwsAngle: type=FD14_LwsAngle_adt
        FD14_LwsAngleType: type=FD14_LwsAngleType
        FD14_LwsSpeed: type=FD14_LwsSpeed_adt
        FD14_PAM_Brk_Rq_RspSts: type=FD14_PAM_Brk_Rq_RspSts
        FD14_ParkingGearShiftReq_BSM: type=FD14_ParkingGearShiftReq_BSM
        FD14_ParkingInterventionSts: type=FD14_ParkingInterventionSts
        FD14_REF_VEH_SPEED: type=FD14_REF_VEH_SPEED_adt
        FD14_RHF_FastPulseCounter: type=FD14_RHF_FastPulseCounter
        FD14_RHF_Spin: type=FD14_RHF_Spin
        FD14_RHF_WheelSensorFailSts: type=FD14_RHF_WheelSensorFailSts
        FD14_RHFWheelSpeed: type=FD14_RHFWheelSpeed_adt
        FD14_RHR_FastPulseCounter: type=FD14_RHR_FastPulseCounter
        FD14_RHR_Spin: type=FD14_RHR_Spin
        FD14_RHR_WheelSensorFailSts: type=FD14_RHR_WheelSensorFailSts
        FD14_RHRWheelSpeed: type=FD14_RHRWheelSpeed_adt
        FD14_Slope: type=FD14_Slope_adt
        FD14_SPM_Lat_Ctrl_ResponseSts: type=FD14_SPM_Lat_Ctrl_ResponseSts
        FD14_Steering_Column_Torque: type=FD14_Steering_Column_Torque_adt
        FD14_VehicleSpeedVSOSig: type=FD14_VehicleSpeedVSOSig_adt
        FD14_VehicleSpeedVSOSig_B2: type=FD14_VehicleSpeedVSOSig_B2_adt
        FD14_VehicleStandStillSts: type=FD14_VehicleStandStillSts
        FD14_YawRate_BSM: type=FD14_YawRate_BSM_adt
        FD14_YawRateFailSts_BSM: type=FD14_YawRateFailSts_BSM
    IF_FromComFD14Rx
      data FD14_Accel_Pedal_Override: type=FD14_Accel_Pedal_Override
      data FD14_DriverReq_AxleTrq_Enabled_BSM: type=FD14_DriverReq_AxleTrq_Enabled_BSM
      data FD14_PPPA_TrqEnblRq_Allowed: type=FD14_PPPA_TrqEnblRq_Allowed
    IF_FromComDbgFD14Rx
      data FD14_RawPntDebugSignal: type=FD14_RawPntDebugSignal
      data FD14_UssParkingModeSignal: type=FD14_UssParkingModeSignal
    IF_ToComSafeFD02Tx
      134 x data:
        Reserved_for_functional_safety: type=Reserved_for_functional_safety
        Segment_1_Confidence: type=Segment_1_Confidence
        Segment_1_ID: type=Segment_1_ID
        Segment_1_X1: type=Segment_1_X1
        Segment_1_X2: type=Segment_1_X2
        Segment_1_Y1: type=Segment_1_Y1
        Segment_1_Y2: type=Segment_1_Y2
        Segment_2_Confidence: type=Segment_2_Confidence
        Segment_2_ID: type=Segment_2_ID
        Segment_2_X1: type=Segment_2_X1
        Segment_2_X2: type=Segment_2_X2
        Segment_2_Y1: type=Segment_2_Y1
        Segment_2_Y2: type=Segment_2_Y2
        Segment_3_Confidence: type=Segment_3_Confidence
        Segment_3_ID: type=Segment_3_ID
        Segment_3_X1: type=Segment_3_X1
        Segment_3_X2: type=Segment_3_X2
        Segment_3_Y1: type=Segment_3_Y1
        Segment_3_Y2: type=Segment_3_Y2
        Segment_4_Confidence: type=Segment_4_Confidence
        Segment_4_ID: type=Segment_4_ID
        Segment_4_X1: type=Segment_4_X1
        Segment_4_X2: type=Segment_4_X2
        Segment_4_Y1: type=Segment_4_Y1
        Segment_4_Y2: type=Segment_4_Y2
        Segment_5_Confidence: type=Segment_5_Confidence
        Segment_5_ID: type=Segment_5_ID
        Segment_5_X1: type=Segment_5_X1
        Segment_5_X2: type=Segment_5_X2
        Segment_5_Y1: type=Segment_5_Y1
        Segment_5_Y2: type=Segment_5_Y2
        Segment_6_Confidence: type=Segment_6_Confidence
        Segment_6_ID: type=Segment_6_ID
        Segment_6_X1: type=Segment_6_X1
        Segment_6_X2: type=Segment_6_X2
        Segment_6_Y1: type=Segment_6_Y1
        Segment_6_Y2: type=Segment_6_Y2
        Segment_7_Confidence: type=Segment_7_Confidence
        Segment_7_ID: type=Segment_7_ID
        Segment_7_X1: type=Segment_7_X1
        Segment_7_X2: type=Segment_7_X2
        Segment_7_Y1: type=Segment_7_Y1
        Segment_7_Y2: type=Segment_7_Y2
        Segment_8_Confidence: type=Segment_8_Confidence
        Segment_8_ID: type=Segment_8_ID
        Segment_8_X1: type=Segment_8_X1
        Segment_8_X2: type=Segment_8_X2
        Segment_8_Y1: type=Segment_8_Y1
        Segment_8_Y2: type=Segment_8_Y2
        Camera_Status: type=Camera_Status
        Cntr_ADAS_FD_LANES_1: type=Cntr_ADAS_FD_LANES_1
        Cntr_ADAS_FD_LANES_2: type=Cntr_ADAS_FD_LANES_2
        FOD_Confidence: type=FOD_Confidence
        Frame_Index_Lanes_1: type=Frame_Index_Lanes_1
        Frame_Index_Lanes_2: type=Frame_Index_Lanes_2
        Health_Front_Object_Detection: type=Health_Front_Object_Detection
        Health_Lane_Detection: type=Health_Lane_Detection
        Line_1_Confidence: type=Line_1_Confidence
        Line_1_Curvature: type=Line_1_Curvature
        Line_1_Curvature_Rate: type=Line_1_Curvature_Rate
        Line_1_End_Range: type=Line_1_End_Range
        Line_1_Heading: type=Line_1_Heading
        Line_1_Offset: type=Line_1_Offset
        Line_1_Start_Range: type=Line_1_Start_Range
        Line_1_Type: type=Line_1_Type
        Line_2_Confidence: type=Line_2_Confidence
        Line_2_Curvature: type=Line_2_Curvature
        Line_2_Curvature_Rate: type=Line_2_Curvature_Rate
        Line_2_End_Range: type=Line_2_End_Range
        Line_2_Heading: type=Line_2_Heading
        Line_2_Offset: type=Line_2_Offset
        Line_2_Start_Range: type=Line_2_Start_Range
        Line_2_Type: type=Line_2_Type
        Line_3_Confidence: type=Line_3_Confidence
        Line_3_Curvature: type=Line_3_Curvature
        Line_3_Curvature_Rate: type=Line_3_Curvature_Rate
        Line_3_End_Range: type=Line_3_End_Range
        Line_3_Heading: type=Line_3_Heading
        Line_3_Offset: type=Line_3_Offset
        Line_3_Start_Range: type=Line_3_Start_Range
        Line_3_Type: type=Line_3_Type
        Line_4_Confidence: type=Line_4_Confidence
        Line_4_Curvature: type=Line_4_Curvature
        Line_4_Curvature_Rate: type=Line_4_Curvature_Rate
        Line_4_End_Range: type=Line_4_End_Range
        Line_4_Heading: type=Line_4_Heading
        Line_4_Offset: type=Line_4_Offset
        Line_4_Start_Range: type=Line_4_Start_Range
        Line_4_Type: type=Line_4_Type
        MAC_ADAS_FD_LANES_1: type=MAC_ADAS_FD_LANES_1
        MAC_ADAS_FD_LANES_2: type=MAC_ADAS_FD_LANES_2
        Alert_CHF: type=Alert_CHF
        Alert_CHR: type=Alert_CHR
        Alert_LHF: type=Alert_LHF
        Alert_LHR: type=Alert_LHR
        Alert_RHF: type=Alert_RHF
        Alert_RHR: type=Alert_RHR
        AUXCamsRQSts: type=AUXCamsRQSts
        ChimeActivation_LHF: type=ChimeActivation_LHF
        ChimeActivation_LHR: type=ChimeActivation_LHR
        ChimeActivation_RHF: type=ChimeActivation_RHF
        ChimeActivation_RHR: type=ChimeActivation_RHR
        DisplayView2: type=DisplayView2
        FrontSensorSts: type=FrontSensorSts
        FT_PAM_LedControlSts: type=FT_PAM_LedControlSts
        Graphic_CHF: type=Graphic_CHF
        Graphic_CHR: type=Graphic_CHR
        Graphic_LHF: type=Graphic_LHF
        Graphic_LHR: type=Graphic_LHR
        Graphic_RHF: type=Graphic_RHF
        Graphic_RHR: type=Graphic_RHR
        HMICode: type=HMICode
        ImageDefeatRQSts: type=ImageDefeatRQSts
        MoreCamsRQSts: type=MoreCamsRQSts
        PAM_CHIME_REP_RATESts: type=PAM_CHIME_REP_RATESts
        PAM_CHIME_TYPE: type=PAM_CHIME_TYPE
        PAM_LedControlSts: type=PAM_LedControlSts
        PAM_Off_Status: type=PAM_Off_Status
        PAM_Off_Status_2BT: type=PAM_Off_Status_2BT
        PAM_PopUpRqst: type=PAM_PopUpRqst
        PAM_Volume: type=PAM_Volume
        PAMSystemFault: type=PAMSystemFault
        ParkingManeuverActive: type=ParkingManeuverActive
        PPPA_TurnIndicatorRqst: type=PPPA_TurnIndicatorRqst
        RearSensorSts: type=RearSensorSts
        RR_PAM_Brk_RqSts: type=RR_PAM_Brk_RqSts
        RR_PAM_Dist: type=RR_PAM_Dist
        RR_PAM_StopControlSts: type=RR_PAM_StopControlSts
        SPM_LedControlSts: type=SPM_LedControlSts
        SPM_Screen_Rqst: type=SPM_Screen_Rqst
        SPMControlSts: type=SPMControlSts
        SPMFailSts: type=SPMFailSts
        SPMSystemFault: type=SPMSystemFault
        TRSC_LED_Stat: type=TRSC_LED_Stat
    IF_ToComFD02Tx
      40 x data:
        CurrentCanNMState_FD02_PAM: type=CurrentCanNMState_FD02_PAM
        CurrentFailSts_FD02_PAM: type=CurrentFailSts_FD02_PAM
        DES_FD02_PAM: type=DES_FD02_PAM
        Digit_{01..11}_PAM: type=Digit_{01..11}_PAM
        EOL_FD02_PAM: type=EOL_FD02_PAM
        GenericFailSts_FD02_PAM: type=GenericFailSts_FD02_PAM
        N_PDU: type=N_PDU
        PreviousCanNMState_FD02_PAM: type=PreviousCanNMState_FD02_PAM
        StayActiveSource_FD02_PAM: type=StayActiveSource_FD02_PAM
        THA_EPB_Req: type=THA_EPB_Req
        THA_Speed_Limit: type=THA_Speed_Limit
        THA_SpeedLimit_Req: type=THA_SpeedLimit_Req
        THA_STAT: type=THA_STAT
        THA_SteeringDamping: type=THA_SteeringDamping_adt
        THA_SteeringTorqueInfo: type=THA_SteeringTorqueInfo_adt
        THA_SteeringTorqueReq: type=THA_SteeringTorqueReq
        Trailer_Angle: type=Trailer_Angle
        Trailer_Angle_Sign: type=Trailer_Angle_Sign
        Trailer_Calibration: type=Trailer_Calibration
        TrlrHitchLight_Cntrl: type=TrlrHitchLight_Cntrl
        TRSC_PopupDisp_Info: type=TRSC_PopupDisp_Info
        TRSC_SpeedLimit_Req: type=TRSC_SpeedLimit_Req
        TRSC_STAT: type=TRSC_STAT
        TRSC_SteeringDamping: type=TRSC_SteeringDamping_adt
        TRSC_SteeringTorqueInfo: type=TRSC_SteeringTorqueInfo_adt
        TRSC_SteeringTorqueReq: type=TRSC_SteeringTorqueReq
        TRSC_VehicleStop_Req: type=TRSC_VehicleStop_Req
        TRSCMoreCamRQSts: type=TRSCMoreCamRQSts
        WakeupSource_FD02_PAM: type=WakeupSource_FD02_PAM
        TRSC_PopupDisp_Info2: type=TRSC_PopupDisp_Info2
    IF_ToComFD14Tx
      13 x data:
        FD14_THA_EPB_Req: type=FD14_THA_EPB_Req
        FD14_THA_Speed_Limit: type=FD14_THA_Speed_Limit
        FD14_THA_SpeedLimit_Req: type=FD14_THA_SpeedLimit_Req
        FD14_THA_STAT: type=FD14_THA_STAT
        FD14_THA_SteeringDamping: type=FD14_THA_SteeringDamping
        FD14_THA_SteeringTorqueInfo: type=FD14_THA_SteeringTorqueInfo
        FD14_THA_SteeringTorqueReq: type=FD14_THA_SteeringTorqueReq
        FD14_TRSC_SpeedLimit_Req: type=FD14_TRSC_SpeedLimit_Req
        FD14_TRSC_STAT: type=FD14_TRSC_STAT
        FD14_TRSC_SteeringDamping: type=FD14_TRSC_SteeringDamping
        FD14_TRSC_SteeringTorqueInfo: type=FD14_TRSC_SteeringTorqueInfo
        FD14_TRSC_SteeringTorqueReq: type=FD14_TRSC_SteeringTorqueReq
        FD14_TRSC_VehicleStop_Req: type=FD14_TRSC_VehicleStop_Req
    IF_ToComDbgFD14Tx
      1789 x data:
        FD14_MeTRSC_cnt_TRSCAliveCounter: type=FD14_MeTRSC_cnt_TRSCAliveCounter
        FD14_MeTRSC_deg_TADAngleSMVC: type=FD14_MeTRSC_deg_TADAngleSMVC
        FD14_MeTRSC_e_TrlrCalInfoSMVC: type=FD14_MeTRSC_e_TrlrCalInfoSMVC
        FD14_MeTRSC_s_TRSCPeriodicity: type=FD14_MeTRSC_s_TRSCPeriodicity
        FD14_MeTRSC_s_TRSCTimeTaken: type=FD14_MeTRSC_s_TRSCTimeTaken
        FD14_ReservedSignal1: type=FD14_ReservedSignal1
        FD14_ReservedSignal2: type=FD14_ReservedSignal2
        FD14_ReservedTRSCSig1: type=FD14_ReservedTRSCSig1
        FD14_ReservedTRSCSig2: type=FD14_ReservedTRSCSig2
        FD14_averageIllumination: type=FD14_averageIllumination
        FD14_CsmLocalErrOrEventId: type=FD14_CsmLocalErrOrEventId
        FD14_CsmLocalErrOrEventState: type=FD14_CsmLocalErrOrEventState
        FD14_CsmLocalModuleId: type=FD14_CsmLocalModuleId
        FD14_CsmLocalModuleInstanceId: type=FD14_CsmLocalModuleInstanceId
        FD14_CsmStateCurrent: type=FD14_CsmStateCurrent
        FD14_CsmStatePrevious: type=FD14_CsmStatePrevious
        FD14_hitchCalibrationAngle: type=FD14_hitchCalibrationAngle
        FD14_leftCalibrationAngle: type=FD14_leftCalibrationAngle
        FD14_MeTRSC_b_OTBLReset: type=FD14_MeTRSC_b_OTBLReset
        FD14_MeTRSC_b_TBLComputationDone: type=FD14_MeTRSC_b_TBLComputationDone
        FD14_MeTRSC_deg_StrCMD: type=FD14_MeTRSC_deg_StrCMD
        FD14_rightCalibrationAngle: type=FD14_rightCalibrationAngle
        FD14__JackKnifeAngle: type=FD14__JackKnifeAngle
        FD14_AOL_Blockage: type=FD14_AOL_Blockage
        FD14_AOL_comm_Fault: type=FD14_AOL_comm_Fault
        FD14_AOL_CommUnknown: type=FD14_AOL_CommUnknown
        FD14_AOL_hardware_Fault: type=FD14_AOL_hardware_Fault
        FD14_AOL_MinDistance: type=FD14_AOL_MinDistance
        FD14_AOL_overTemp_Fault: type=FD14_AOL_overTemp_Fault
        FD14_AOR_Blockage: type=FD14_AOR_Blockage
        FD14_AOR_comm_Fault: type=FD14_AOR_comm_Fault
        FD14_AOR_CommUnknown: type=FD14_AOR_CommUnknown
        FD14_AOR_hardware_Fault: type=FD14_AOR_hardware_Fault
        FD14_AOR_MinDistance: type=FD14_AOR_MinDistance
        FD14_AOR_overTemp_Fault: type=FD14_AOR_overTemp_Fault
        FD14_AutoParkInitializedStatus_b: type=FD14_AutoParkInitializedStatus_b
        FD14_AuxCamButton1NoSelect_b: type=FD14_AuxCamButton1NoSelect_b
        FD14_AuxCamButton1Select_b: type=FD14_AuxCamButton1Select_b
        FD14_AuxCamButton2NoSelect_b: type=FD14_AuxCamButton2NoSelect_b
        FD14_AuxCamButton2Select_b: type=FD14_AuxCamButton2Select_b
        FD14_BackCam_NA_b: type=FD14_BackCam_NA_b
        FD14_BackDoorOpen_Icon_b: type=FD14_BackDoorOpen_Icon_b
        FD14_BackupRearCamButtonNoSelect_b: type=FD14_BackupRearCamButtonNoSelect_b
        FD14_BackupRearCamButtonSelect_b: type=FD14_BackupRearCamButtonSelect_b
        FD14_BOL_Blockage: type=FD14_BOL_Blockage
        FD14_BOL_comm_Fault: type=FD14_BOL_comm_Fault
        FD14_BOL_CommUnknown: type=FD14_BOL_CommUnknown
        FD14_BOL_hardware_Fault: type=FD14_BOL_hardware_Fault
        FD14_BOL_MinDistance: type=FD14_BOL_MinDistance
        FD14_BOL_overTemp_Fault: type=FD14_BOL_overTemp_Fault
        FD14_BOR_Blockage: type=FD14_BOR_Blockage
        FD14_BOR_comm_Fault: type=FD14_BOR_comm_Fault
        FD14_BOR_CommUnknown: type=FD14_BOR_CommUnknown
        FD14_BOR_hardware_Fault: type=FD14_BOR_hardware_Fault
        FD14_BOR_MinDistance: type=FD14_BOR_MinDistance
        FD14_BOR_overTemp_Fault: type=FD14_BOR_overTemp_Fault
        FD14_BumberStatus_Front: type=FD14_BumberStatus_Front
        FD14_BumberStatus_Left_Side: type=FD14_BumberStatus_Left_Side
        FD14_BumberStatus_Rear: type=FD14_BumberStatus_Rear
        FD14_BumberStatus_Right_Side: type=FD14_BumberStatus_Right_Side
        FD14_calibrationCompleted: type=FD14_calibrationCompleted
        FD14_calibrationSubState: type=FD14_calibrationSubState
        FD14_CalibStatus_STM_Current_Front: type=FD14_CalibStatus_STM_Current_Front
        FD14_CalibStatus_STM_Current_Left: type=FD14_CalibStatus_STM_Current_Left
        FD14_CalibStatus_STM_Current_Rear: type=FD14_CalibStatus_STM_Current_Rear
        FD14_CalibStatus_STM_Current_Right: type=FD14_CalibStatus_STM_Current_Right
        FD14_CalibStatus_STM_EOL_Front: type=FD14_CalibStatus_STM_EOL_Front
        FD14_CalibStatus_STM_EOL_Left: type=FD14_CalibStatus_STM_EOL_Left
        FD14_CalibStatus_STM_EOL_Rear: type=FD14_CalibStatus_STM_EOL_Rear
        FD14_CalibStatus_STM_EOL_Right: type=FD14_CalibStatus_STM_EOL_Right
        FD14_CalibStatus_STM_OC_Front: type=FD14_CalibStatus_STM_OC_Front
        FD14_CalibStatus_STM_OC_Left: type=FD14_CalibStatus_STM_OC_Left
        FD14_CalibStatus_STM_OC_Rear: type=FD14_CalibStatus_STM_OC_Rear
        FD14_CalibStatus_STM_OC_Right: type=FD14_CalibStatus_STM_OC_Right
        FD14_CalibStatus_STM_SC_Front: type=FD14_CalibStatus_STM_SC_Front
        FD14_CalibStatus_STM_SC_Left: type=FD14_CalibStatus_STM_SC_Left
        FD14_CalibStatus_STM_SC_Rear: type=FD14_CalibStatus_STM_SC_Rear
        FD14_CalibStatus_STM_SC_Right: type=FD14_CalibStatus_STM_SC_Right
        FD14_CAM_NA_Bitfield_u8: type=FD14_CAM_NA_Bitfield_u8
        FD14_CameraDisplaySts2_e: type=FD14_CameraDisplaySts2_e
        FD14_cntrCvpamFdData1_u16: type=FD14_cntrCvpamFdData1_u16
        FD14_crcCvpamFdData1_u8: type=FD14_crcCvpamFdData1_u8
        FD14_Curr_DisplayedViewByAcore_e: type=FD14_Curr_DisplayedViewByAcore_e
        FD14_Curr_RequestedViewByHmiM_e: type=FD14_Curr_RequestedViewByHmiM_e
        FD14_Curr_SystemState_e: type=FD14_Curr_SystemState_e
        FD14_Curr_TRG_Stat: type=FD14_Curr_TRG_Stat
        FD14_Current_Firing_Sequence: type=FD14_Current_Firing_Sequence
        FD14_CurrentTrailer_ID: type=FD14_CurrentTrailer_ID
        FD14_curState: type=FD14_curState
        FD14_Debug_Signal_{1..8}: type=FD14_Debug_Signal_{1..8}
        FD14_DynOvl_Error_e: type=FD14_DynOvl_Error_e
        FD14_EOL_ModuleState_STM_Front: type=FD14_EOL_ModuleState_STM_Front
        FD14_EOL_ModuleState_STM_Left: type=FD14_EOL_ModuleState_STM_Left
        FD14_EOL_ModuleState_STM_Rear: type=FD14_EOL_ModuleState_STM_Rear
        FD14_EOL_ModuleState_STM_Right: type=FD14_EOL_ModuleState_STM_Right
        FD14_Err_Code_EOL_Front: type=FD14_Err_Code_EOL_Front
        FD14_Err_Code_EOL_Left: type=FD14_Err_Code_EOL_Left
        FD14_Err_Code_EOL_Rear: type=FD14_Err_Code_EOL_Rear
        FD14_Err_Code_EOL_Rear_Copy_1: type=FD14_Err_Code_EOL_Rear_Copy_1
        FD14_Err_Code_OC_Front: type=FD14_Err_Code_OC_Front
        FD14_Err_Code_OC_Left: type=FD14_Err_Code_OC_Left
        FD14_Err_Code_OC_Rear: type=FD14_Err_Code_OC_Rear
        FD14_Err_Code_OC_Right: type=FD14_Err_Code_OC_Right
        FD14_Err_Code_SC_Front: type=FD14_Err_Code_SC_Front
        FD14_Err_Code_SC_Left: type=FD14_Err_Code_SC_Left
        FD14_Err_Code_SC_Rear: type=FD14_Err_Code_SC_Rear
        FD14_Err_Code_SC_Right: type=FD14_Err_Code_SC_Right
        FD14_FFCV_BTN_PRESSED_b: type=FD14_FFCV_BTN_PRESSED_b
        FD14_FIL_Blockage: type=FD14_FIL_Blockage
        FD14_FIL_comm_Fault: type=FD14_FIL_comm_Fault
        FD14_FIL_CommUnknown: type=FD14_FIL_CommUnknown
        FD14_FIL_hardware_Fault: type=FD14_FIL_hardware_Fault
        FD14_FIL_MinDistance: type=FD14_FIL_MinDistance
        FD14_FIL_overTemp_Fault: type=FD14_FIL_overTemp_Fault
        FD14_FIR_Blockage: type=FD14_FIR_Blockage
        FD14_FIR_comm_Fault: type=FD14_FIR_comm_Fault
        FD14_FIR_CommUnknown: type=FD14_FIR_CommUnknown
        FD14_FIR_hardware_Fault: type=FD14_FIR_hardware_Fault
        FD14_FIR_MinDistance: type=FD14_FIR_MinDistance
        FD14_FIR_overTemp_Fault: type=FD14_FIR_overTemp_Fault
        FD14_Firing_Mode_Seq: type=FD14_Firing_Mode_Seq
        FD14_Firing_Sensor: type=FD14_Firing_Sensor
        FD14_Firing_Sensor_Info_F: type=FD14_Firing_Sensor_Info_F
        FD14_Firing_Sensor_Info_R: type=FD14_Firing_Sensor_Info_R
        FD14_FiringMode_TimeStamp: type=FD14_FiringMode_TimeStamp
        FD14_FiringSnr_TimeStamp: type=FD14_FiringSnr_TimeStamp
        FD14_FOL_Blockage: type=FD14_FOL_Blockage
        FD14_FOL_comm_Fault: type=FD14_FOL_comm_Fault
        FD14_FOL_CommUnknown: type=FD14_FOL_CommUnknown
        FD14_FOL_hardware_Fault: type=FD14_FOL_hardware_Fault
        FD14_FOL_MinDistance: type=FD14_FOL_MinDistance
        FD14_FOL_overTemp_Fault: type=FD14_FOL_overTemp_Fault
        FD14_FOR_Blockage: type=FD14_FOR_Blockage
        FD14_FOR_comm_Fault: type=FD14_FOR_comm_Fault
        FD14_FOR_CommUnknown: type=FD14_FOR_CommUnknown
        FD14_FOR_hardware_Fault: type=FD14_FOR_hardware_Fault
        FD14_FOR_MinDistance: type=FD14_FOR_MinDistance
        FD14_FOR_overTemp_Fault: type=FD14_FOR_overTemp_Fault
        FD14_Frame_Index_Lanes__1: type=FD14_Frame_Index_Lanes__1
        FD14_Frameset1AndTopFrontText_b: type=FD14_Frameset1AndTopFrontText_b
        FD14_Frameset1AndTopRearText_b: type=FD14_Frameset1AndTopRearText_b
        FD14_Frameset2AndFrontCrossText_b: type=FD14_Frameset2AndFrontCrossText_b
        FD14_Frameset2AndRearCrossText_b: type=FD14_Frameset2AndRearCrossText_b
        FD14_FRONT_CROSS_BTN_PRESSED_b: type=FD14_FRONT_CROSS_BTN_PRESSED_b
        FD14_FRONT_TOP_BTN_PRESSED_b: type=FD14_FRONT_TOP_BTN_PRESSED_b
        FD14_FrontCam_NA_b: type=FD14_FrontCam_NA_b
        FD14_FrontCrossButtonNoSelect_b: type=FD14_FrontCrossButtonNoSelect_b
        FD14_FrontCrossButtonSelect_b: type=FD14_FrontCrossButtonSelect_b
        FD14_FrontFaceCamButtonNoSelect_b: type=FD14_FrontFaceCamButtonNoSelect_b
        FD14_FrontFaceCamButtonSelect_b: type=FD14_FrontFaceCamButtonSelect_b
        FD14_FrontSensorDetHealth_e: type=FD14_FrontSensorDetHealth_e
        FD14_FrontTireTracks_b: type=FD14_FrontTireTracks_b
        FD14_FrontViewDynamics_b: type=FD14_FrontViewDynamics_b
        FD14_FSL_Blockage: type=FD14_FSL_Blockage
        FD14_FSL_comm_Fault: type=FD14_FSL_comm_Fault
        FD14_FSL_CommUnknown: type=FD14_FSL_CommUnknown
        FD14_FSL_hardware_Fault: type=FD14_FSL_hardware_Fault
        FD14_FSL_MinDistance: type=FD14_FSL_MinDistance
        FD14_FSL_overTemp_Fault: type=FD14_FSL_overTemp_Fault
        FD14_FSR_Blockage: type=FD14_FSR_Blockage
        FD14_FSR_comm_Fault: type=FD14_FSR_comm_Fault
        FD14_FSR_CommUnknown: type=FD14_FSR_CommUnknown
        FD14_FSR_hardware_Fault: type=FD14_FSR_hardware_Fault
        FD14_FSR_MinDistance: type=FD14_FSR_MinDistance
        FD14_FSR_overTemp_Fault: type=FD14_FSR_overTemp_Fault
        FD14_GW_C_I6_timeout_b: type=FD14_GW_C_I6_timeout_b
        FD14_hitchLength: type=FD14_hitchLength
        FD14_IeAP_b_MnvPosOk: type=FD14_IeAP_b_MnvPosOk
        FD14_IeAP_cm_FrntCenterMinXDist: type=FD14_IeAP_cm_FrntCenterMinXDist
        FD14_IeAP_cm_FrntCenterMinXDist_KPI: type=FD14_IeAP_cm_FrntCenterMinXDist_KPI
        FD14_IeAP_cm_FrntLeftMinXDist: type=FD14_IeAP_cm_FrntLeftMinXDist
        FD14_IeAP_cm_FrntLeftMinXDist_KPI: type=FD14_IeAP_cm_FrntLeftMinXDist_KPI
        FD14_IeAP_cm_FrntRightMinXDist: type=FD14_IeAP_cm_FrntRightMinXDist
        FD14_IeAP_cm_FrntRightMinXDist_KPI: type=FD14_IeAP_cm_FrntRightMinXDist_KPI
        FD14_IeAP_cm_RearCenterMinXDist: type=FD14_IeAP_cm_RearCenterMinXDist
        FD14_IeAP_cm_RearCenterMinXDist_KPI: type=FD14_IeAP_cm_RearCenterMinXDist_KPI
        FD14_IeAP_cm_RearLeftMinXDist: type=FD14_IeAP_cm_RearLeftMinXDist
        FD14_IeAP_cm_RearLeftMinXDist_KPI: type=FD14_IeAP_cm_RearLeftMinXDist_KPI
        FD14_IeAP_cm_RearRightMinXDist: type=FD14_IeAP_cm_RearRightMinXDist
        FD14_IeAP_cm_RearRightMinXDist_KPI: type=FD14_IeAP_cm_RearRightMinXDist_KPI
        FD14_IeAP_cnt_CurrentVehSweep: type=FD14_IeAP_cnt_CurrentVehSweep
        FD14_IeAP_e_AbortCon: type=FD14_IeAP_e_AbortCon
        FD14_IeAP_e_AutoParkStatus: type=FD14_IeAP_e_AutoParkStatus
        FD14_IeAutoPark_e_AlgoState: type=FD14_IeAutoPark_e_AlgoState
        FD14_IeLMD_e_CameraStatus: type=FD14_IeLMD_e_CameraStatus
        FD14_IeTHA_b_ChimeActvLhf: type=FD14_IeTHA_b_ChimeActvLhf
        FD14_IeTHA_b_ChimeActvRhf: type=FD14_IeTHA_b_ChimeActvRhf
        FD14_IeTHA_e_PamChimeTyp: type=FD14_IeTHA_e_PamChimeTyp
        FD14_IeTHA_e_PamVol: type=FD14_IeTHA_e_PamVol
        FD14_IeTRSC_cnt_KnobPos: type=FD14_IeTRSC_cnt_KnobPos
        FD14_IeTRSC_cnt_TrlrCalibFailCnt: type=FD14_IeTRSC_cnt_TrlrCalibFailCnt
        FD14_IeTRSC_cnt_TrlrCalibFailCntCurr: type=FD14_IeTRSC_cnt_TrlrCalibFailCntCurr
        FD14_IeTRSC_cnt_TrlrCalibPassCnt: type=FD14_IeTRSC_cnt_TrlrCalibPassCnt
        FD14_IeTRSC_cnt_TrlrCalibPassCntCurr: type=FD14_IeTRSC_cnt_TrlrCalibPassCntCurr
        FD14_IeTRSC_deg_FrntWhlAng: type=FD14_IeTRSC_deg_FrntWhlAng
        FD14_IeTRSC_deg_JackknifeThrAngle: type=FD14_IeTRSC_deg_JackknifeThrAngle
        FD14_IeTRSC_deg_TADAngle: type=FD14_IeTRSC_deg_TADAngle
        FD14_IeTRSC_deg_TrlrAngKnob: type=FD14_IeTRSC_deg_TrlrAngKnob
        FD14_IeTRSC_e_CamBlockSts: type=FD14_IeTRSC_e_CamBlockSts
        FD14_IeTRSC_e_GearShiftSts: type=FD14_IeTRSC_e_GearShiftSts
        FD14_IeTRSC_e_TrailerID: type=FD14_IeTRSC_e_TrailerID
        FD14_IeTRSC_e_TrlrAngGrapOverSts: type=FD14_IeTRSC_e_TrlrAngGrapOverSts
        FD14_IeTRSC_e_TrlrCalibFailReas: type=FD14_IeTRSC_e_TrlrCalibFailReas
        FD14_IeTRSC_e_TrlrCalibManState: type=FD14_IeTRSC_e_TrlrCalibManState
        FD14_IeTRSC_e_TrlrCalibSts: type=FD14_IeTRSC_e_TrlrCalibSts
        FD14_IeTRSC_e_TrlrPrsntFailReas: type=FD14_IeTRSC_e_TrlrPrsntFailReas
        FD14_IeTRSC_e_TrlrPrsntSts: type=FD14_IeTRSC_e_TrlrPrsntSts
        FD14_IeTRSC_e_TrlrRecogInfo: type=FD14_IeTRSC_e_TrlrRecogInfo
        FD14_IeTRSC_e_TRSCAbortReas: type=FD14_IeTRSC_e_TRSCAbortReas
        FD14_IeTRSC_e_TRSCUnavailReas: type=FD14_IeTRSC_e_TRSCUnavailReas
        FD14_IeTRSC_e_TRSKMBtnSts: type=FD14_IeTRSC_e_TRSKMBtnSts
        FD14_IeTRSC_e_TRSKMCenBtnSts: type=FD14_IeTRSC_e_TRSKMCenBtnSts
        FD14_IeTRSC_e_TRSKMSts: type=FD14_IeTRSC_e_TRSKMSts
        FD14_IeTRSC_kph_VehSpeedVSOSig: type=FD14_IeTRSC_kph_VehSpeedVSOSig
        FD14_IeTRSC_m_TrlrWhlBaseEff: type=FD14_IeTRSC_m_TrlrWhlBaseEff
        FD14_IeTRSC_M_TRSCStrTrq: type=FD14_IeTRSC_M_TRSCStrTrq
        FD14_IeTRSC_pct_TrlrDetConf: type=FD14_IeTRSC_pct_TrlrDetConf
        FD14_IeTRSC_pct_TrlrRecogConf: type=FD14_IeTRSC_pct_TrlrRecogConf
        FD14_IeTRSC_pct_TrlrTrackConf: type=FD14_IeTRSC_pct_TrlrTrackConf
        FD14_IeVBII_nfcd_MinDisToCollisionObj: type=FD14_IeVBII_nfcd_MinDisToCollisionObj
        FD14_ignitionStatus_e: type=FD14_ignitionStatus_e
        FD14_IgnoredFeatures_Front_u32: type=FD14_IgnoredFeatures_Front_u32
        FD14_IgnoredFeatures_Left_u32: type=FD14_IgnoredFeatures_Left_u32
        FD14_IgnoredFeatures_Rear_u32: type=FD14_IgnoredFeatures_Rear_u32
        FD14_IgnoredFeatures_Right_u32: type=FD14_IgnoredFeatures_Right_u32
        FD14_IgnoreVehicleOffSpeed: type=FD14_IgnoreVehicleOffSpeed
        FD14_ImageDefeat_Error_e: type=FD14_ImageDefeat_Error_e
        FD14_InvalidFeatures_Front_u32: type=FD14_InvalidFeatures_Front_u32
        FD14_InvalidFeatures_Left_u32: type=FD14_InvalidFeatures_Left_u32
        FD14_InvalidFeatures_Rear_u32: type=FD14_InvalidFeatures_Rear_u32
        FD14_InvalidFeatures_Right_u32: type=FD14_InvalidFeatures_Right_u32
        FD14_IsBackSftbtnSel: type=FD14_IsBackSftbtnSel
        FD14_IsExitSftBtnSel: type=FD14_IsExitSftBtnSel
        FD14_IsParkSftBtnSel: type=FD14_IsParkSftBtnSel
        FD14_isPLDInitSuccess_b: type=FD14_isPLDInitSuccess_b
        FD14_IsSlotSel: type=FD14_IsSlotSel
        FD14_isUSSInitSuccess_b: type=FD14_isUSSInitSuccess_b
        FD14_ItbmTrailerStatus: type=FD14_ItbmTrailerStatus
        FD14_JackknifeAngle: type=FD14_JackknifeAngle
        FD14_JackknifeThrAngle: type=FD14_JackknifeThrAngle
        FD14_KnobAngle: type=FD14_KnobAngle
        FD14_LanguageSelection_u8: type=FD14_LanguageSelection_u8
        FD14_LastViewBeforeTestPattern_e: type=FD14_LastViewBeforeTestPattern_e
        FD14_LeftCam_NA_b: type=FD14_LeftCam_NA_b
        FD14_LeftDoorFrontClose_Icon_b: type=FD14_LeftDoorFrontClose_Icon_b
        FD14_LeftDoorFrontOpen_Icon_b: type=FD14_LeftDoorFrontOpen_Icon_b
        FD14_LeftDoorRearClose_Icon_b: type=FD14_LeftDoorRearClose_Icon_b
        FD14_LeftDoorRearOpen_Icon_b: type=FD14_LeftDoorRearOpen_Icon_b
        FD14_leLMD_e_HealthStatus: type=FD14_leLMD_e_HealthStatus
        FD14_LMD_e_Line_{1..4}_Type: type=FD14_LMD_e_Line_{1..4}_Type
        FD14_LMD_e_Segment_{1..8}_ID: type=FD14_LMD_e_Segment_{1..8}_ID
        FD14_LMD_m_Line_1_End_Range: type=FD14_LMD_m_Line_1_End_Range
        FD14_LMD_m_Line_1_Offset: type=FD14_LMD_m_Line_1_Offset
        FD14_LMD_m_Line_1_Start_Range: type=FD14_LMD_m_Line_1_Start_Range
        FD14_LMD_m_Line_2_End_Range: type=FD14_LMD_m_Line_2_End_Range
        FD14_LMD_m_Line_2_Offset: type=FD14_LMD_m_Line_2_Offset
        FD14_LMD_m_Line_2_Start_Range: type=FD14_LMD_m_Line_2_Start_Range
        FD14_LMD_m_Line_3_End_Range: type=FD14_LMD_m_Line_3_End_Range
        FD14_LMD_m_Line_3_Offset: type=FD14_LMD_m_Line_3_Offset
        FD14_LMD_m_Line_3_Start_Range: type=FD14_LMD_m_Line_3_Start_Range
        FD14_LMD_m_Line_4_End_Range: type=FD14_LMD_m_Line_4_End_Range
        FD14_LMD_m_Line_4_Offset: type=FD14_LMD_m_Line_4_Offset
        FD14_LMD_m_Line_4_Start_Range: type=FD14_LMD_m_Line_4_Start_Range
        FD14_LMD_m_Segment_1_X1: type=FD14_LMD_m_Segment_1_X1
        FD14_LMD_m_Segment_1_X2: type=FD14_LMD_m_Segment_1_X2
        FD14_LMD_m_Segment_1_Y1: type=FD14_LMD_m_Segment_1_Y1
        FD14_LMD_m_Segment_1_Y2: type=FD14_LMD_m_Segment_1_Y2
        FD14_LMD_m_Segment_2_X1: type=FD14_LMD_m_Segment_2_X1
        FD14_LMD_m_Segment_2_X2: type=FD14_LMD_m_Segment_2_X2
        FD14_LMD_m_Segment_2_Y1: type=FD14_LMD_m_Segment_2_Y1
        FD14_LMD_m_Segment_2_Y2: type=FD14_LMD_m_Segment_2_Y2
        FD14_LMD_m_Segment_3_X1: type=FD14_LMD_m_Segment_3_X1
        FD14_LMD_m_Segment_3_X2: type=FD14_LMD_m_Segment_3_X2
        FD14_LMD_m_Segment_3_Y1: type=FD14_LMD_m_Segment_3_Y1
        FD14_LMD_m_Segment_3_Y2: type=FD14_LMD_m_Segment_3_Y2
        FD14_LMD_m_Segment_4_X1: type=FD14_LMD_m_Segment_4_X1
        FD14_LMD_m_Segment_4_X2: type=FD14_LMD_m_Segment_4_X2
        FD14_LMD_m_Segment_4_Y1: type=FD14_LMD_m_Segment_4_Y1
        FD14_LMD_m_Segment_4_Y2: type=FD14_LMD_m_Segment_4_Y2
        FD14_LMD_m_Segment_5_X1: type=FD14_LMD_m_Segment_5_X1
        FD14_LMD_m_Segment_5_X2: type=FD14_LMD_m_Segment_5_X2
        FD14_LMD_m_Segment_5_Y1: type=FD14_LMD_m_Segment_5_Y1
        FD14_LMD_m_Segment_5_Y2: type=FD14_LMD_m_Segment_5_Y2
        FD14_LMD_m_Segment_6_X1: type=FD14_LMD_m_Segment_6_X1
        FD14_LMD_m_Segment_6_X2: type=FD14_LMD_m_Segment_6_X2
        FD14_LMD_m_Segment_6_Y1: type=FD14_LMD_m_Segment_6_Y1
        FD14_LMD_m_Segment_6_Y2: type=FD14_LMD_m_Segment_6_Y2
        FD14_LMD_m_Segment_7_X1: type=FD14_LMD_m_Segment_7_X1
        FD14_LMD_m_Segment_7_X2: type=FD14_LMD_m_Segment_7_X2
        FD14_LMD_m_Segment_7_Y1: type=FD14_LMD_m_Segment_7_Y1
        FD14_LMD_m_Segment_7_Y2: type=FD14_LMD_m_Segment_7_Y2
        FD14_LMD_m_Segment_8_X1: type=FD14_LMD_m_Segment_8_X1
        FD14_LMD_m_Segment_8_X2: type=FD14_LMD_m_Segment_8_X2
        FD14_LMD_m_Segment_8_Y1: type=FD14_LMD_m_Segment_8_Y1
        FD14_LMD_m_Segment_8_Y2: type=FD14_LMD_m_Segment_8_Y2
        FD14_LMD_pct_Line_{1..4}_Confidence: type=FD14_LMD_pct_Line_{1..4}_Confidence
        FD14_LMD_pct_Segment_{1..8}_Confidence: type=FD14_LMD_pct_Segment_{1..8}_Confidence
        FD14_LMD_px_Line_{1..4}_Curvature: type=FD14_LMD_px_Line_{1..4}_Curvature
        FD14_LMD_rad_Line_{1..4}_Heading: type=FD14_LMD_rad_Line_{1..4}_Heading
        FD14_Log_Sensor_Temperature: type=FD14_Log_Sensor_Temperature
        FD14_Log_SnrMeasData_{1..7}: type=FD14_Log_SnrMeasData_{1..7}
        FD14_lrwsST_e: type=FD14_lrwsST_e
        FD14_M_BURV_Memory_e: type=FD14_M_BURV_Memory_e
        FD14_M_CONFIRM_BTN_PRESSED_b: type=FD14_M_CONFIRM_BTN_PRESSED_b
        FD14_M_Cplr_Htch_Distance: type=FD14_M_Cplr_Htch_Distance
        FD14_M_CPLR_POS_X_u: type=FD14_M_CPLR_POS_X_u
        FD14_M_CPLR_POS_Y_u: type=FD14_M_CPLR_POS_Y_u
        FD14_M_Current_THA_State_On_Screen: type=FD14_M_Current_THA_State_On_Screen
        FD14_M_Current_THA_State_On_Zync: type=FD14_M_Current_THA_State_On_Zync
        FD14_M_FFClatch_e: type=FD14_M_FFClatch_e
        FD14_m_FPAInfoToPLDSlotID: type=FD14_m_FPAInfoToPLDSlotID
        FD14_m_FPAInfoToUSSOMSlotID: type=FD14_m_FPAInfoToUSSOMSlotID
        FD14_m_FpaInfoToVCParkOutStyle: type=FD14_m_FpaInfoToVCParkOutStyle
        FD14_m_FPAToNVMParkInStyle: type=FD14_m_FPAToNVMParkInStyle
        FD14_m_FPAToNVMReadNVMParam_b: type=FD14_m_FPAToNVMReadNVMParam_b
        FD14_m_FPAToNVMWriteNVMParam_b: type=FD14_m_FPAToNVMWriteNVMParam_b
        FD14_M_Maneuver_Initial_Run: type=FD14_M_Maneuver_Initial_Run
        FD14_M_Progress_Bar_Distance: type=FD14_M_Progress_Bar_Distance
        FD14_M_Progress_Bar_Percentage: type=FD14_M_Progress_Bar_Percentage
        FD14_m_QM_FID_TRSC_ASCMDef: type=FD14_m_QM_FID_TRSC_ASCMDef
        FD14_m_QM_FID_TRSC_CAM_CAL_ABORT: type=FD14_m_QM_FID_TRSC_CAM_CAL_ABORT
        FD14_m_QM_FID_TRSC_DISABLED: type=FD14_m_QM_FID_TRSC_DISABLED
        FD14_m_QM_FID_TRSC_LIMITED_DefView: type=FD14_m_QM_FID_TRSC_LIMITED_DefView
        FD14_m_QM_FID_TRSC_LIMITED_View: type=FD14_m_QM_FID_TRSC_LIMITED_View
        FD14_M_Requested_THA_State: type=FD14_M_Requested_THA_State
        FD14_M_START_BTN_PRESSED_b: type=FD14_M_START_BTN_PRESSED_b
        FD14_M_THA_SFT_BTN_PRESSED_b: type=FD14_M_THA_SFT_BTN_PRESSED_b
        FD14_M_VIEW_SCRN_TCH_STS_b: type=FD14_M_VIEW_SCRN_TCH_STS_b
        FD14_M_VIEW_ZOOM_STS_b: type=FD14_M_VIEW_ZOOM_STS_b
        FD14_MaAP_m_ParkSpot1FrntStreetX: type=FD14_MaAP_m_ParkSpot1FrntStreetX
        FD14_MaAP_m_ParkSpot1FrntStreetY: type=FD14_MaAP_m_ParkSpot1FrntStreetY
        FD14_MaAP_m_ParkSpot2FrntBorderX: type=FD14_MaAP_m_ParkSpot2FrntBorderX
        FD14_MaAP_m_ParkSpot2FrntBorderY: type=FD14_MaAP_m_ParkSpot2FrntBorderY
        FD14_MaAP_m_ParkSpot3RearBorderX: type=FD14_MaAP_m_ParkSpot3RearBorderX
        FD14_MaAP_m_ParkSpot3RearBorderY: type=FD14_MaAP_m_ParkSpot3RearBorderY
        FD14_MaAP_m_ParkSpot4RearStreetX: type=FD14_MaAP_m_ParkSpot4RearStreetX
        FD14_MaAP_m_ParkSpot4RearStreetY: type=FD14_MaAP_m_ParkSpot4RearStreetY
        FD14_macCvpamFdData1_u64: type=FD14_macCvpamFdData1_u64
        FD14_MAGNIFIER_BTN_PRESSED_b: type=FD14_MAGNIFIER_BTN_PRESSED_b
        FD14_MaxTadAngle: type=FD14_MaxTadAngle
        FD14_MeAP_a_BrkCmd: type=FD14_MeAP_a_BrkCmd
        FD14_MeAP_a_ThrtlCmd: type=FD14_MeAP_a_ThrtlCmd
        FD14_MeAP_b_APInitSts: type=FD14_MeAP_b_APInitSts
        FD14_MeAP_b_BSMHandshakeActv: type=FD14_MeAP_b_BSMHandshakeActv
        FD14_MeAP_b_BSMInterfaceTimeout: type=FD14_MeAP_b_BSMInterfaceTimeout
        FD14_MeAP_b_CamHandshakeTimeout: type=FD14_MeAP_b_CamHandshakeTimeout
        FD14_MeAP_b_DriverOverride: type=FD14_MeAP_b_DriverOverride
        FD14_MeAP_b_EPSInterfaceTimeout: type=FD14_MeAP_b_EPSInterfaceTimeout
        FD14_MeAP_b_FeatureEnbl: type=FD14_MeAP_b_FeatureEnbl
        FD14_MeAP_b_FPADisable: type=FD14_MeAP_b_FPADisable
        FD14_MeAP_b_FPAStatus: type=FD14_MeAP_b_FPAStatus
        FD14_MeAP_b_FPAVolDefMed: type=FD14_MeAP_b_FPAVolDefMed
        FD14_MeAP_b_GearShiftWaitTimeout: type=FD14_MeAP_b_GearShiftWaitTimeout
        FD14_MeAP_b_ManeuverAbort: type=FD14_MeAP_b_ManeuverAbort
        FD14_MeAP_b_ManeuverSuccess: type=FD14_MeAP_b_ManeuverSuccess
        FD14_MeAP_b_ObjInPathTimeout: type=FD14_MeAP_b_ObjInPathTimeout
        FD14_MeAP_b_PARBActv4LOW: type=FD14_MeAP_b_PARBActv4LOW
        FD14_MeAP_b_PARBActvTrlr: type=FD14_MeAP_b_PARBActvTrlr
        FD14_MeAP_b_PARBDisable: type=FD14_MeAP_b_PARBDisable
        FD14_MeAP_b_PausedPressBtnTimeout: type=FD14_MeAP_b_PausedPressBtnTimeout
        FD14_MeAP_b_PAVolDefMed: type=FD14_MeAP_b_PAVolDefMed
        FD14_MeAP_b_PosMet: type=FD14_MeAP_b_PosMet
        FD14_MeAP_b_PPPAActv4LOW: type=FD14_MeAP_b_PPPAActv4LOW
        FD14_MeAP_b_PPPAActvTrlr: type=FD14_MeAP_b_PPPAActvTrlr
        FD14_MeAP_b_PPPADefEng: type=FD14_MeAP_b_PPPADefEng
        FD14_MeAP_b_PPPADisable: type=FD14_MeAP_b_PPPADisable
        FD14_MeAP_b_RPAActvTrlr: type=FD14_MeAP_b_RPAActvTrlr
        FD14_MeAP_b_RPADisable: type=FD14_MeAP_b_RPADisable
        FD14_MeAP_b_RPAStatus: type=FD14_MeAP_b_RPAStatus
        FD14_MeAP_b_RPAVolDefMed: type=FD14_MeAP_b_RPAVolDefMed
        FD14_MeAP_b_RPAwithBrkStatus: type=FD14_MeAP_b_RPAwithBrkStatus
        FD14_MeAP_b_SeekSpdExceedTimeout: type=FD14_MeAP_b_SeekSpdExceedTimeout
        FD14_MeAP_b_StandStill: type=FD14_MeAP_b_StandStill
        FD14_MeAP_b_SteerActionReq: type=FD14_MeAP_b_SteerActionReq
        FD14_MeAP_b_VCOpPaused: type=FD14_MeAP_b_VCOpPaused
        FD14_MeAP_b_VehCndSts: type=FD14_MeAP_b_VehCndSts
        FD14_MeAP_cm_FrntCenterMinXDist: type=FD14_MeAP_cm_FrntCenterMinXDist
        FD14_MeAP_cm_FrntLeftMinXDist: type=FD14_MeAP_cm_FrntLeftMinXDist
        FD14_MeAP_cm_FrntRightMinXDist: type=FD14_MeAP_cm_FrntRightMinXDist
        FD14_MeAP_cm_RearCenterMinXDist: type=FD14_MeAP_cm_RearCenterMinXDist
        FD14_MeAP_cm_RearLeftMinXDist: type=FD14_MeAP_cm_RearLeftMinXDist
        FD14_MeAP_cm_RearRightMinXDist: type=FD14_MeAP_cm_RearRightMinXDist
        FD14_MeAP_cnt_StateDebugVar: type=FD14_MeAP_cnt_StateDebugVar
        FD14_MeAP_cnt_TransDebugVar: type=FD14_MeAP_cnt_TransDebugVar
        FD14_MeAP_cnt_TransDebugVar_Copy_1: type=FD14_MeAP_cnt_TransDebugVar_Copy_1
        FD14_MeAP_deg_StrCmd: type=FD14_MeAP_deg_StrCmd
        FD14_MeAP_e_Park_state: type=FD14_MeAP_e_Park_state
        FD14_MeAP_e_ParkAssistStatus: type=FD14_MeAP_e_ParkAssistStatus
        FD14_MeAP_e_PP_state: type=FD14_MeAP_e_PP_state
        FD14_MePRX_b_AuxTrlrCam: type=FD14_MePRX_b_AuxTrlrCam
        FD14_MePRX_b_CanNode27: type=FD14_MePRX_b_CanNode27
        FD14_MePRX_b_CANNode95: type=FD14_MePRX_b_CANNode95
        FD14_MePRX_b_FrwFacingCam: type=FD14_MePRX_b_FrwFacingCam
        FD14_MePRX_b_SurroundViewCamera: type=FD14_MePRX_b_SurroundViewCamera
        FD14_MePRX_b_TRGPresence: type=FD14_MePRX_b_TRGPresence
        FD14_MePRX_b_TRSCPresence: type=FD14_MePRX_b_TRSCPresence
        FD14_MePRX_e_AutonomyLvl: type=FD14_MePRX_e_AutonomyLvl
        FD14_MePRX_e_MirrorType: type=FD14_MePRX_e_MirrorType
        FD14_MePRX_e_PAMTunSet: type=FD14_MePRX_e_PAMTunSet
        FD14_MePRX_e_RadDispType: type=FD14_MePRX_e_RadDispType
        FD14_MePRX_e_SteerRatRackPinionType: type=FD14_MePRX_e_SteerRatRackPinionType
        FD14_MePRX_e_VariantID: type=FD14_MePRX_e_VariantID
        FD14_MePRX_e_VehLineCfg: type=FD14_MePRX_e_VehLineCfg
        FD14_MePRX_e_Wheelbase: type=FD14_MePRX_e_Wheelbase
        FD14_MeSVS_b_MoreCamReqSts: type=FD14_MeSVS_b_MoreCamReqSts
        FD14_MeSVS_e_DispView2Info: type=FD14_MeSVS_e_DispView2Info
        FD14_MeTHA_b_EnblRearParkAsstTrg: type=FD14_MeTHA_b_EnblRearParkAsstTrg
        FD14_MeTHA_b_THAAbortStatus: type=FD14_MeTHA_b_THAAbortStatus
        FD14_MeTHA_b_TrlrCplrStatus: type=FD14_MeTHA_b_TrlrCplrStatus
        FD14_MeTHA_b_UsrCplrSelCnfm: type=FD14_MeTHA_b_UsrCplrSelCnfm
        FD14_MeTHA_b_UsrHitchCnfm: type=FD14_MeTHA_b_UsrHitchCnfm
        FD14_MeTHA_deg_CplrAng: type=FD14_MeTHA_deg_CplrAng
        FD14_MeTHA_deg_RoadWhlAng: type=FD14_MeTHA_deg_RoadWhlAng
        FD14_MeTHA_e_CplrDetctStatus: type=FD14_MeTHA_e_CplrDetctStatus
        FD14_MeTHA_e_HitchDetctStatus: type=FD14_MeTHA_e_HitchDetctStatus
        FD14_MeTHA_e_RearBrkSupprInfo: type=FD14_MeTHA_e_RearBrkSupprInfo
        FD14_MeTHA_e_ScreenRequest: type=FD14_MeTHA_e_ScreenRequest
        FD14_MeTHA_e_THAStateInfo: type=FD14_MeTHA_e_THAStateInfo
        FD14_MeTHA_pct_CplrDetConf: type=FD14_MeTHA_pct_CplrDetConf
        FD14_MeTHA_pct_CplrTrckConf: type=FD14_MeTHA_pct_CplrTrckConf
        FD14_MeTHA_px_CplrPntX: type=FD14_MeTHA_px_CplrPntX
        FD14_MeTHA_px_CplrPntY: type=FD14_MeTHA_px_CplrPntY
        FD14_MeTHA_px_HitchCplrPixDiffLat: type=FD14_MeTHA_px_HitchCplrPixDiffLat
        FD14_MeTHA_px_HitchCplrPixDiffLong: type=FD14_MeTHA_px_HitchCplrPixDiffLong
        FD14_MeTHA_px_HitchPntX: type=FD14_MeTHA_px_HitchPntX
        FD14_MeTHA_px_HitchPntY: type=FD14_MeTHA_px_HitchPntY
        FD14_MeTRSC_b_MoreCamSoftButtEnbl: type=FD14_MeTRSC_b_MoreCamSoftButtEnbl
        FD14_MeTRSC_b_OBTLRecalibrate: type=FD14_MeTRSC_b_OBTLRecalibrate
        FD14_MeTRSC_b_TrlrCalibDelayInfo: type=FD14_MeTRSC_b_TrlrCalibDelayInfo
        FD14_MeTRSC_b_TrlrCalibPopInfo: type=FD14_MeTRSC_b_TrlrCalibPopInfo
        FD14_MeTRSC_b_TrlrRevSteeringStsInfo: type=FD14_MeTRSC_b_TrlrRevSteeringStsInfo
        FD14_MeTRSC_b_TRSCSwitchPressed: type=FD14_MeTRSC_b_TRSCSwitchPressed
        FD14_MeTRSC_cnt_TrlrCalibFailCntInfo: type=FD14_MeTRSC_cnt_TrlrCalibFailCntInfo
        FD14_MeTRSC_deg_DetJackKnifeAngle: type=FD14_MeTRSC_deg_DetJackKnifeAngle
        FD14_MeTRSC_deg_DetJackknifeThrAngle: type=FD14_MeTRSC_deg_DetJackknifeThrAngle
        FD14_MeTRSC_deg_JackKnifeAngle: type=FD14_MeTRSC_deg_JackKnifeAngle
        FD14_MeTRSC_deg_JackknifeThrAngle: type=FD14_MeTRSC_deg_JackknifeThrAngle
        FD14_MeTRSC_deg_KnobAngle: type=FD14_MeTRSC_deg_KnobAngle
        FD14_MeTRSC_deg_MaxAllowedTADAngle: type=FD14_MeTRSC_deg_MaxAllowedTADAngle
        FD14_MeTRSC_deg_TADAngle: type=FD14_MeTRSC_deg_TADAngle
        FD14_MeTRSC_deg_TADAngleRate: type=FD14_MeTRSC_deg_TADAngleRate
        FD14_MeTRSC_e_CalFail: type=FD14_MeTRSC_e_CalFail
        FD14_MeTRSC_e_TADCalibrationSubstate: type=FD14_MeTRSC_e_TADCalibrationSubstate
        FD14_MeTRSC_e_TADState: type=FD14_MeTRSC_e_TADState
        FD14_MeTRSC_e_TrailerID: type=FD14_MeTRSC_e_TrailerID
        FD14_MeTRSC_e_TrlrAngSign: type=FD14_MeTRSC_e_TrlrAngSign
        FD14_MeTRSC_e_TrlrCalInfo: type=FD14_MeTRSC_e_TrlrCalInfo
        FD14_MeTRSC_e_TrlrPrsntInfo: type=FD14_MeTRSC_e_TrlrPrsntInfo
        FD14_MeTRSC_e_TrlrPrsntInfoCAN: type=FD14_MeTRSC_e_TrlrPrsntInfoCAN
        FD14_MeTRSC_e_TrlrRecogInfo: type=FD14_MeTRSC_e_TrlrRecogInfo
        FD14_MeTRSC_e_TRSCStat: type=FD14_MeTRSC_e_TRSCStat
        FD14_MeTRSC_e_TurnAroundSubState: type=FD14_MeTRSC_e_TurnAroundSubState
        FD14_MeTRSC_m_DetTrailerBeamLen: type=FD14_MeTRSC_m_DetTrailerBeamLen
        FD14_MeTRSC_m_HitchLength: type=FD14_MeTRSC_m_HitchLength
        FD14_MeTRSC_M_SteeringTorqInfo: type=FD14_MeTRSC_M_SteeringTorqInfo
        FD14_MeTRSC_m_TrailerBeamLen: type=FD14_MeTRSC_m_TrailerBeamLen
        FD14_MinDistance_TimeStamp: type=FD14_MinDistance_TimeStamp
        FD14_MoreCamsButton1NoSelect_b: type=FD14_MoreCamsButton1NoSelect_b
        FD14_MoreCamsButton1Select_b: type=FD14_MoreCamsButton1Select_b
        FD14_MoreCamsButton2NoSelect_b: type=FD14_MoreCamsButton2NoSelect_b
        FD14_MoreCamsButton2Select_b: type=FD14_MoreCamsButton2Select_b
        FD14_MoreCamsIconFullScreenNoSelect_b: type=FD14_MoreCamsIconFullScreenNoSelect_b
        FD14_MOT_ClosestPntDist_0_{0..9}: type=FD14_MOT_ClosestPntDist_0_{0..9}
        FD14_MOT_ClosestPntDist_1_{0..9}: type=FD14_MOT_ClosestPntDist_1_{0..9}
        FD14_MOT_ObjectDimensions_0_{0..9}: type=FD14_MOT_ObjectDimensions_0_{0..9}
        FD14_MOT_ObjectDimensions_1_{0..9}: type=FD14_MOT_ObjectDimensions_1_{0..9}
        FD14_MOT_ObjValid_{0..9}: type=FD14_MOT_ObjValid_{0..9}
        FD14_MOT_ObjVelX_{0..9}: type=FD14_MOT_ObjVelX_{0..9}
        FD14_MOT_ObjVelY_{0..9}: type=FD14_MOT_ObjVelY_{0..9}
        FD14_msgcntrCvpamFdData1_u8: type=FD14_msgcntrCvpamFdData1_u8
        FD14_NetCfg_TRSCM_e: type=FD14_NetCfg_TRSCM_e
        FD14_NFCD_DistanceToClosestPoint_0_{0..9}: type=FD14_NFCD_DistanceToClosestPoint_0_{0..9}
        FD14_NFCD_DistanceToClosestPoint_1_{0..9}: type=FD14_NFCD_DistanceToClosestPoint_1_{0..9}
        FD14_NFCD_ObjValid_{0..9}: type=FD14_NFCD_ObjValid_{0..9}
        FD14_obj_Pos_Lat: type=FD14_obj_Pos_Lat
        FD14_obj_Pos_Longi: type=FD14_obj_Pos_Longi
        FD14_objConf_e: type=FD14_objConf_e
        FD14_OBTLRecalibrate: type=FD14_OBTLRecalibrate
        FD14_OC_ModuleState_STM_Front: type=FD14_OC_ModuleState_STM_Front
        FD14_OC_ModuleState_STM_Left: type=FD14_OC_ModuleState_STM_Left
        FD14_OC_ModuleState_STM_Rear: type=FD14_OC_ModuleState_STM_Rear
        FD14_OC_ModuleState_STM_Right: type=FD14_OC_ModuleState_STM_Right
        FD14_OFFRD_ABSNT_AUXCAM_BTN_PRESSED_b: type=FD14_OFFRD_ABSNT_AUXCAM_BTN_PRESSED_b
        FD14_OFFRD_PRSNT_AUXCAM_BTN_PRESSED_b: type=FD14_OFFRD_PRSNT_AUXCAM_BTN_PRESSED_b
        FD14_OFFROAD_ABSNT_MC_BTN_PRESSED_b: type=FD14_OFFROAD_ABSNT_MC_BTN_PRESSED_b
        FD14_OFFROAD_PRSNT_MC_BTN_PRESSED_b: type=FD14_OFFROAD_PRSNT_MC_BTN_PRESSED_b
        FD14_parkExtSideSel: type=FD14_parkExtSideSel
        FD14_parkingDirection: type=FD14_parkingDirection
        FD14_parkingSlotType: type=FD14_parkingSlotType
        FD14_PDC_FrontCenter_Red_b: type=FD14_PDC_FrontCenter_Red_b
        FD14_PDC_FrontCenter_Yellow_b: type=FD14_PDC_FrontCenter_Yellow_b
        FD14_PDC_FrontLeft_Red_b: type=FD14_PDC_FrontLeft_Red_b
        FD14_PDC_FrontLeft_Yellow_b: type=FD14_PDC_FrontLeft_Yellow_b
        FD14_PDC_FrontRight_Red_b: type=FD14_PDC_FrontRight_Red_b
        FD14_PDC_FrontRight_Yellow_b: type=FD14_PDC_FrontRight_Yellow_b
        FD14_PDC_RearCenter_Red_b: type=FD14_PDC_RearCenter_Red_b
        FD14_PDC_RearCenter_Yellow_b: type=FD14_PDC_RearCenter_Yellow_b
        FD14_PDC_RearLeft_Red_b: type=FD14_PDC_RearLeft_Red_b
        FD14_PDC_RearLeft_Yellow_b: type=FD14_PDC_RearLeft_Yellow_b
        FD14_PDC_RearRight_Red_b: type=FD14_PDC_RearRight_Red_b
        FD14_PDC_RearRight_Yellow_b: type=FD14_PDC_RearRight_Yellow_b
        FD14_perpParkDirectionSel: type=FD14_perpParkDirectionSel
        FD14_Pitch_f32_Current_Rear: type=FD14_Pitch_f32_Current_Rear
        FD14_Pitch_f32_Current_Right: type=FD14_Pitch_f32_Current_Right
        FD14_Pitch_f32_EOL_Front: type=FD14_Pitch_f32_EOL_Front
        FD14_Pitch_f32_EOL_Left: type=FD14_Pitch_f32_EOL_Left
        FD14_Pitch_f32_EOL_Rear: type=FD14_Pitch_f32_EOL_Rear
        FD14_Pitch_f32_EOL_Right: type=FD14_Pitch_f32_EOL_Right
        FD14_Pitch_f32_OC_Front: type=FD14_Pitch_f32_OC_Front
        FD14_Pitch_f32_OC_Left: type=FD14_Pitch_f32_OC_Left
        FD14_Pitch_f32_OC_Rear: type=FD14_Pitch_f32_OC_Rear
        FD14_Pitch_f32_OC_Right: type=FD14_Pitch_f32_OC_Right
        FD14_Pitch_f32_SC_Front: type=FD14_Pitch_f32_SC_Front
        FD14_Pitch_f32_SC_Left: type=FD14_Pitch_f32_SC_Left
        FD14_Pitch_f32_SC_Rear: type=FD14_Pitch_f32_SC_Rear
        FD14_Pitch_f32_SC_Right: type=FD14_Pitch_f32_SC_Right
        FD14_Pntdebugdata_{0..3}: type=FD14_Pntdebugdata_{0..3}
        FD14_Point_Map_Age_0: type=FD14_Point_Map_Age_0
        FD14_Point_Map_Age_1: type=FD14_Point_Map_Age_1
        FD14_Point_Map_Age_{10..19}: type=FD14_Point_Map_Age_{10..19}
        FD14_Point_Map_Age_2: type=FD14_Point_Map_Age_2
        FD14_Point_Map_Age_{20..29}: type=FD14_Point_Map_Age_{20..29}
        FD14_Point_Map_Age_3: type=FD14_Point_Map_Age_3
        FD14_Point_Map_Age_{30..39}: type=FD14_Point_Map_Age_{30..39}
        FD14_Point_Map_Age_4: type=FD14_Point_Map_Age_4
        FD14_Point_Map_Age_{40..49}: type=FD14_Point_Map_Age_{40..49}
        FD14_Point_Map_Age_5: type=FD14_Point_Map_Age_5
        FD14_Point_Map_Age_{50..59}: type=FD14_Point_Map_Age_{50..59}
        FD14_Point_Map_Age_6: type=FD14_Point_Map_Age_6
        FD14_Point_Map_Age_{60..69}: type=FD14_Point_Map_Age_{60..69}
        FD14_Point_Map_Age_7: type=FD14_Point_Map_Age_7
        FD14_Point_Map_Age_{70..79}: type=FD14_Point_Map_Age_{70..79}
        FD14_Point_Map_Age_8: type=FD14_Point_Map_Age_8
        FD14_Point_Map_Age_{80..89}: type=FD14_Point_Map_Age_{80..89}
        FD14_Point_Map_Age_9: type=FD14_Point_Map_Age_9
        FD14_Point_Map_Age_{90..95}: type=FD14_Point_Map_Age_{90..95}
        FD14_Point_Map_Confidence_0: type=FD14_Point_Map_Confidence_0
        FD14_Point_Map_Confidence_1: type=FD14_Point_Map_Confidence_1
        FD14_Point_Map_Confidence_{10..19}: type=FD14_Point_Map_Confidence_{10..19}
        FD14_Point_Map_Confidence_2: type=FD14_Point_Map_Confidence_2
        FD14_Point_Map_Confidence_{20..29}: type=FD14_Point_Map_Confidence_{20..29}
        FD14_Point_Map_Confidence_3: type=FD14_Point_Map_Confidence_3
        FD14_Point_Map_Confidence_{30..39}: type=FD14_Point_Map_Confidence_{30..39}
        FD14_Point_Map_Confidence_4: type=FD14_Point_Map_Confidence_4
        FD14_Point_Map_Confidence_{40..49}: type=FD14_Point_Map_Confidence_{40..49}
        FD14_Point_Map_Confidence_5: type=FD14_Point_Map_Confidence_5
        FD14_Point_Map_Confidence_{50..59}: type=FD14_Point_Map_Confidence_{50..59}
        FD14_Point_Map_Confidence_6: type=FD14_Point_Map_Confidence_6
        FD14_Point_Map_Confidence_{60..69}: type=FD14_Point_Map_Confidence_{60..69}
        FD14_Point_Map_Confidence_7: type=FD14_Point_Map_Confidence_7
        FD14_Point_Map_Confidence_{70..79}: type=FD14_Point_Map_Confidence_{70..79}
        FD14_Point_Map_Confidence_8: type=FD14_Point_Map_Confidence_8
        FD14_Point_Map_Confidence_{80..89}: type=FD14_Point_Map_Confidence_{80..89}
        FD14_Point_Map_Confidence_9: type=FD14_Point_Map_Confidence_9
        FD14_Point_Map_Confidence_{90..95}: type=FD14_Point_Map_Confidence_{90..95}
        FD14_Point_Map_Cruising_Age_0: type=FD14_Point_Map_Cruising_Age_0
        FD14_Point_Map_Cruising_Age_1: type=FD14_Point_Map_Cruising_Age_1
        FD14_Point_Map_Cruising_Age_{10..19}: type=FD14_Point_Map_Cruising_Age_{10..19}
        FD14_Point_Map_Cruising_Age_2: type=FD14_Point_Map_Cruising_Age_2
        FD14_Point_Map_Cruising_Age_{20..29}: type=FD14_Point_Map_Cruising_Age_{20..29}
        FD14_Point_Map_Cruising_Age_3: type=FD14_Point_Map_Cruising_Age_3
        FD14_Point_Map_Cruising_Age_{30..39}: type=FD14_Point_Map_Cruising_Age_{30..39}
        FD14_Point_Map_Cruising_Age_4: type=FD14_Point_Map_Cruising_Age_4
        FD14_Point_Map_Cruising_Age_{40..49}: type=FD14_Point_Map_Cruising_Age_{40..49}
        FD14_Point_Map_Cruising_Age_5: type=FD14_Point_Map_Cruising_Age_5
        FD14_Point_Map_Cruising_Age_{50..59}: type=FD14_Point_Map_Cruising_Age_{50..59}
        FD14_Point_Map_Cruising_Age_6: type=FD14_Point_Map_Cruising_Age_6
        FD14_Point_Map_Cruising_Age_{60..69}: type=FD14_Point_Map_Cruising_Age_{60..69}
        FD14_Point_Map_Cruising_Age_7: type=FD14_Point_Map_Cruising_Age_7
        FD14_Point_Map_Cruising_Age_{70..79}: type=FD14_Point_Map_Cruising_Age_{70..79}
        FD14_Point_Map_Cruising_Age_8: type=FD14_Point_Map_Cruising_Age_8
        FD14_Point_Map_Cruising_Age_{80..89}: type=FD14_Point_Map_Cruising_Age_{80..89}
        FD14_Point_Map_Cruising_Age_9: type=FD14_Point_Map_Cruising_Age_9
        FD14_Point_Map_Cruising_Age_{90..95}: type=FD14_Point_Map_Cruising_Age_{90..95}
        FD14_Point_Map_Height_0: type=FD14_Point_Map_Height_0
        FD14_Point_Map_Height_1: type=FD14_Point_Map_Height_1
        FD14_Point_Map_Height_{10..19}: type=FD14_Point_Map_Height_{10..19}
        FD14_Point_Map_Height_2: type=FD14_Point_Map_Height_2
        FD14_Point_Map_Height_{20..29}: type=FD14_Point_Map_Height_{20..29}
        FD14_Point_Map_Height_3: type=FD14_Point_Map_Height_3
        FD14_Point_Map_Height_{30..39}: type=FD14_Point_Map_Height_{30..39}
        FD14_Point_Map_Height_4: type=FD14_Point_Map_Height_4
        FD14_Point_Map_Height_{40..49}: type=FD14_Point_Map_Height_{40..49}
        FD14_Point_Map_Height_5: type=FD14_Point_Map_Height_5
        FD14_Point_Map_Height_{50..59}: type=FD14_Point_Map_Height_{50..59}
        FD14_Point_Map_Height_6: type=FD14_Point_Map_Height_6
        FD14_Point_Map_Height_{60..69}: type=FD14_Point_Map_Height_{60..69}
        FD14_Point_Map_Height_7: type=FD14_Point_Map_Height_7
        FD14_Point_Map_Height_{70..79}: type=FD14_Point_Map_Height_{70..79}
        FD14_Point_Map_Height_8: type=FD14_Point_Map_Height_8
        FD14_Point_Map_Height_{80..89}: type=FD14_Point_Map_Height_{80..89}
        FD14_Point_Map_Height_9: type=FD14_Point_Map_Height_9
        FD14_Point_Map_Height_{90..95}: type=FD14_Point_Map_Height_{90..95}
        FD14_Point_Map_Reserved_0: type=FD14_Point_Map_Reserved_0
        FD14_Point_Map_Reserved_1: type=FD14_Point_Map_Reserved_1
        FD14_Point_Map_Reserved_{10..19}: type=FD14_Point_Map_Reserved_{10..19}
        FD14_Point_Map_Reserved_2: type=FD14_Point_Map_Reserved_2
        FD14_Point_Map_Reserved_{20..29}: type=FD14_Point_Map_Reserved_{20..29}
        FD14_Point_Map_Reserved_3: type=FD14_Point_Map_Reserved_3
        FD14_Point_Map_Reserved_{30..39}: type=FD14_Point_Map_Reserved_{30..39}
        FD14_Point_Map_Reserved_4: type=FD14_Point_Map_Reserved_4
        FD14_Point_Map_Reserved_{40..49}: type=FD14_Point_Map_Reserved_{40..49}
        FD14_Point_Map_Reserved_5: type=FD14_Point_Map_Reserved_5
        FD14_Point_Map_Reserved_{50..59}: type=FD14_Point_Map_Reserved_{50..59}
        FD14_Point_Map_Reserved_6: type=FD14_Point_Map_Reserved_6
        FD14_Point_Map_Reserved_{60..69}: type=FD14_Point_Map_Reserved_{60..69}
        FD14_Point_Map_Reserved_7: type=FD14_Point_Map_Reserved_7
        FD14_Point_Map_Reserved_{70..79}: type=FD14_Point_Map_Reserved_{70..79}
        FD14_Point_Map_Reserved_8: type=FD14_Point_Map_Reserved_8
        FD14_Point_Map_Reserved_{80..89}: type=FD14_Point_Map_Reserved_{80..89}
        FD14_Point_Map_Reserved_9: type=FD14_Point_Map_Reserved_9
        FD14_Point_Map_Reserved_{90..95}: type=FD14_Point_Map_Reserved_{90..95}
        FD14_Point_Map_X_0: type=FD14_Point_Map_X_0
        FD14_Point_Map_X_1: type=FD14_Point_Map_X_1
        FD14_Point_Map_X_{10..19}: type=FD14_Point_Map_X_{10..19}
        FD14_Point_Map_X_2: type=FD14_Point_Map_X_2
        FD14_Point_Map_X_{20..29}: type=FD14_Point_Map_X_{20..29}
        FD14_Point_Map_X_3: type=FD14_Point_Map_X_3
        FD14_Point_Map_X_{30..39}: type=FD14_Point_Map_X_{30..39}
        FD14_Point_Map_X_4: type=FD14_Point_Map_X_4
        FD14_Point_Map_X_{40..49}: type=FD14_Point_Map_X_{40..49}
        FD14_Point_Map_X_5: type=FD14_Point_Map_X_5
        FD14_Point_Map_X_{50..59}: type=FD14_Point_Map_X_{50..59}
        FD14_Point_Map_X_6: type=FD14_Point_Map_X_6
        FD14_Point_Map_X_{60..69}: type=FD14_Point_Map_X_{60..69}
        FD14_Point_Map_X_7: type=FD14_Point_Map_X_7
        FD14_Point_Map_X_{70..79}: type=FD14_Point_Map_X_{70..79}
        FD14_Point_Map_X_8: type=FD14_Point_Map_X_8
        FD14_Point_Map_X_{80..89}: type=FD14_Point_Map_X_{80..89}
        FD14_Point_Map_X_9: type=FD14_Point_Map_X_9
        FD14_Point_Map_X_{90..95}: type=FD14_Point_Map_X_{90..95}
        FD14_Point_Map_Y_0: type=FD14_Point_Map_Y_0
        FD14_Point_Map_Y_1: type=FD14_Point_Map_Y_1
        FD14_Point_Map_Y_{10..19}: type=FD14_Point_Map_Y_{10..19}
        FD14_Point_Map_Y_2: type=FD14_Point_Map_Y_2
        FD14_Point_Map_Y_{20..29}: type=FD14_Point_Map_Y_{20..29}
        FD14_Point_Map_Y_3: type=FD14_Point_Map_Y_3
        FD14_Point_Map_Y_{30..39}: type=FD14_Point_Map_Y_{30..39}
        FD14_Point_Map_Y_4: type=FD14_Point_Map_Y_4
        FD14_Point_Map_Y_{40..49}: type=FD14_Point_Map_Y_{40..49}
        FD14_Point_Map_Y_5: type=FD14_Point_Map_Y_5
        FD14_Point_Map_Y_{50..59}: type=FD14_Point_Map_Y_{50..59}
        FD14_Point_Map_Y_6: type=FD14_Point_Map_Y_6
        FD14_Point_Map_Y_{60..69}: type=FD14_Point_Map_Y_{60..69}
        FD14_Point_Map_Y_7: type=FD14_Point_Map_Y_7
        FD14_Point_Map_Y_{70..79}: type=FD14_Point_Map_Y_{70..79}
        FD14_Point_Map_Y_8: type=FD14_Point_Map_Y_8
        FD14_Point_Map_Y_{80..89}: type=FD14_Point_Map_Y_{80..89}
        FD14_Point_Map_Y_9: type=FD14_Point_Map_Y_9
        FD14_Point_Map_Y_{90..95}: type=FD14_Point_Map_Y_{90..95}
        FD14_Presentinfo: type=FD14_Presentinfo
        FD14_Prev_DisplayedViewByAcore_e: type=FD14_Prev_DisplayedViewByAcore_e
        FD14_Prev_RequestedViewByHmiM_e: type=FD14_Prev_RequestedViewByHmiM_e
        FD14_Prev_SystemState_e: type=FD14_Prev_SystemState_e
        FD14_Prev_TRG_Stat: type=FD14_Prev_TRG_Stat
        FD14_prndStatus_e: type=FD14_prndStatus_e
        FD14_REAR_CROSS_BTN_PRESSED_b: type=FD14_REAR_CROSS_BTN_PRESSED_b
        FD14_REAR_TOP_BTN_PRESSED_b: type=FD14_REAR_TOP_BTN_PRESSED_b
        FD14_RearCrossButtonNoSelect_b: type=FD14_RearCrossButtonNoSelect_b
        FD14_RearCrossButtonSelect_b: type=FD14_RearCrossButtonSelect_b
        FD14_RearViewDynamics_b: type=FD14_RearViewDynamics_b
        FD14_RecognitionInfo: type=FD14_RecognitionInfo
        FD14_Reserved0_b: type=FD14_Reserved0_b
        FD14_Reserved08_b: type=FD14_Reserved08_b
        FD14_Reserved09_b: type=FD14_Reserved09_b
        FD14_Reserved1_b: type=FD14_Reserved1_b
        FD14_Reserved{10..13}_b: type=FD14_Reserved{10..13}_b
        FD14_Reserved2_b: type=FD14_Reserved2_b
        FD14_Reserved3_b: type=FD14_Reserved3_b
        FD14_revGear_e: type=FD14_revGear_e
        FD14_RightCam_NA_b: type=FD14_RightCam_NA_b
        FD14_RightDoorFrontClose_Icon_b: type=FD14_RightDoorFrontClose_Icon_b
        FD14_RightDoorFrontOpen_Icon_b: type=FD14_RightDoorFrontOpen_Icon_b
        FD14_RightDoorRearClose_Icon_b: type=FD14_RightDoorRearClose_Icon_b
        FD14_RightDoorRearOpen_Icon_b: type=FD14_RightDoorRearOpen_Icon_b
        FD14_RIL_Blockage: type=FD14_RIL_Blockage
        FD14_RIL_comm_Fault: type=FD14_RIL_comm_Fault
        FD14_RIL_CommUnknown: type=FD14_RIL_CommUnknown
        FD14_RIL_hardware_Fault: type=FD14_RIL_hardware_Fault
        FD14_RIL_MinDistance: type=FD14_RIL_MinDistance
        FD14_RIL_overTemp_Fault: type=FD14_RIL_overTemp_Fault
        FD14_RIR_Blockage: type=FD14_RIR_Blockage
        FD14_RIR_comm_Fault: type=FD14_RIR_comm_Fault
        FD14_RIR_CommUnknown: type=FD14_RIR_CommUnknown
        FD14_RIR_hardware_Fault: type=FD14_RIR_hardware_Fault
        FD14_RIR_MinDistance: type=FD14_RIR_MinDistance
        FD14_RIR_overTemp_Fault: type=FD14_RIR_overTemp_Fault
        FD14_ROL_Blockage: type=FD14_ROL_Blockage
        FD14_ROL_comm_Fault: type=FD14_ROL_comm_Fault
        FD14_ROL_CommUnknown: type=FD14_ROL_CommUnknown
        FD14_ROL_hardware_Fault: type=FD14_ROL_hardware_Fault
        FD14_ROL_MinDistance: type=FD14_ROL_MinDistance
        FD14_ROL_overTemp_Fault: type=FD14_ROL_overTemp_Fault
        FD14_Roll_f32_Current_Rear: type=FD14_Roll_f32_Current_Rear
        FD14_Roll_f32_Current_Right: type=FD14_Roll_f32_Current_Right
        FD14_Roll_f32_EOL_Front: type=FD14_Roll_f32_EOL_Front
        FD14_Roll_f32_EOL_Left: type=FD14_Roll_f32_EOL_Left
        FD14_Roll_f32_EOL_Rear: type=FD14_Roll_f32_EOL_Rear
        FD14_Roll_f32_EOL_Right: type=FD14_Roll_f32_EOL_Right
        FD14_Roll_f32_OC_Front: type=FD14_Roll_f32_OC_Front
        FD14_Roll_f32_OC_Left: type=FD14_Roll_f32_OC_Left
        FD14_Roll_f32_OC_Rear: type=FD14_Roll_f32_OC_Rear
        FD14_Roll_f32_OC_Right: type=FD14_Roll_f32_OC_Right
        FD14_Roll_f32_SC_Front: type=FD14_Roll_f32_SC_Front
        FD14_Roll_f32_SC_Left: type=FD14_Roll_f32_SC_Left
        FD14_Roll_f32_SC_Rear: type=FD14_Roll_f32_SC_Rear
        FD14_Roll_f32_SC_Right: type=FD14_Roll_f32_SC_Right
        FD14_ROR_Blockage: type=FD14_ROR_Blockage
        FD14_ROR_comm_Fault: type=FD14_ROR_comm_Fault
        FD14_ROR_CommUnknown: type=FD14_ROR_CommUnknown
        FD14_ROR_hardware_Fault: type=FD14_ROR_hardware_Fault
        FD14_ROR_MinDistance: type=FD14_ROR_MinDistance
        FD14_ROR_overTemp_Fault: type=FD14_ROR_overTemp_Fault
        FD14_RSL_Blockage: type=FD14_RSL_Blockage
        FD14_RSL_comm_Fault: type=FD14_RSL_comm_Fault
        FD14_RSL_CommUnknown: type=FD14_RSL_CommUnknown
        FD14_RSL_hardware_Fault: type=FD14_RSL_hardware_Fault
        FD14_RSL_MinDistance: type=FD14_RSL_MinDistance
        FD14_RSL_overTemp_Fault: type=FD14_RSL_overTemp_Fault
        FD14_RSR_Blockage: type=FD14_RSR_Blockage
        FD14_RSR_comm_Fault: type=FD14_RSR_comm_Fault
        FD14_RSR_CommUnknown: type=FD14_RSR_CommUnknown
        FD14_RSR_hardware_Fault: type=FD14_RSR_hardware_Fault
        FD14_RSR_MinDistance: type=FD14_RSR_MinDistance
        FD14_RSR_overTemp_Fault: type=FD14_RSR_overTemp_Fault
        FD14_RVCONLY_BTN_PRESSED_b: type=FD14_RVCONLY_BTN_PRESSED_b
        FD14_SC_ModuleState_STM_Front: type=FD14_SC_ModuleState_STM_Front
        FD14_SC_ModuleState_STM_Left: type=FD14_SC_ModuleState_STM_Left
        FD14_SC_ModuleState_STM_Rear: type=FD14_SC_ModuleState_STM_Rear
        FD14_SC_ModuleState_STM_Right: type=FD14_SC_ModuleState_STM_Right
        FD14_slotSide: type=FD14_slotSide
        FD14_SnrDat_FIL_Dir1_cm: type=FD14_SnrDat_FIL_Dir1_cm
        FD14_SnrDat_FIL_Dir2_cm: type=FD14_SnrDat_FIL_Dir2_cm
        FD14_SnrDat_FIR_Dir1_cm: type=FD14_SnrDat_FIR_Dir1_cm
        FD14_SnrDat_FIR_Dir2_cm: type=FD14_SnrDat_FIR_Dir2_cm
        FD14_SnrDat_FOL_Dir1_cm: type=FD14_SnrDat_FOL_Dir1_cm
        FD14_SnrDat_FOL_Dir2_cm: type=FD14_SnrDat_FOL_Dir2_cm
        FD14_SnrDat_FOR_Dir1_cm: type=FD14_SnrDat_FOR_Dir1_cm
        FD14_SnrDat_FOR_Dir2_cm: type=FD14_SnrDat_FOR_Dir2_cm
        FD14_SnrDat_FSL_Dir1_cm: type=FD14_SnrDat_FSL_Dir1_cm
        FD14_SnrDat_FSL_Dir2_cm: type=FD14_SnrDat_FSL_Dir2_cm
        FD14_SnrDat_FSR_Dir1_cm: type=FD14_SnrDat_FSR_Dir1_cm
        FD14_SnrDat_FSR_Dir2_cm: type=FD14_SnrDat_FSR_Dir2_cm
        FD14_SnrDat_RIL_Dir1_cm: type=FD14_SnrDat_RIL_Dir1_cm
        FD14_SnrDat_RIL_Dir2_cm: type=FD14_SnrDat_RIL_Dir2_cm
        FD14_SnrDat_RIR_Dir1_cm: type=FD14_SnrDat_RIR_Dir1_cm
        FD14_SnrDat_RIR_Dir2_cm: type=FD14_SnrDat_RIR_Dir2_cm
        FD14_SnrDat_ROL_Dir1_cm: type=FD14_SnrDat_ROL_Dir1_cm
        FD14_SnrDat_ROL_Dir2_cm: type=FD14_SnrDat_ROL_Dir2_cm
        FD14_SnrDat_ROR_Dir1_cm: type=FD14_SnrDat_ROR_Dir1_cm
        FD14_SnrDat_ROR_Dir2_cm: type=FD14_SnrDat_ROR_Dir2_cm
        FD14_SnrDat_RSL_Dir1_cm: type=FD14_SnrDat_RSL_Dir1_cm
        FD14_SnrDat_RSL_Dir2_cm: type=FD14_SnrDat_RSL_Dir2_cm
        FD14_SnrDat_RSR_Dir1_cm: type=FD14_SnrDat_RSR_Dir1_cm
        FD14_SnrDat_RSR_Dir2_cm: type=FD14_SnrDat_RSR_Dir2_cm
        FD14_SnrDat_sFIL_Indir_FIR_cm: type=FD14_SnrDat_sFIL_Indir_FIR_cm
        FD14_SnrDat_sFIL_Indir_FOL_cm: type=FD14_SnrDat_sFIL_Indir_FOL_cm
        FD14_SnrDat_sFIR_Indir_FIL_cm: type=FD14_SnrDat_sFIR_Indir_FIL_cm
        FD14_SnrDat_sFIR_Indir_FOR_cm: type=FD14_SnrDat_sFIR_Indir_FOR_cm
        FD14_SnrDat_sFOL_Indir_FIL_cm: type=FD14_SnrDat_sFOL_Indir_FIL_cm
        FD14_SnrDat_sFOL_Indir_FSL_cm: type=FD14_SnrDat_sFOL_Indir_FSL_cm
        FD14_SnrDat_sFOR_Indir_FIR_cm: type=FD14_SnrDat_sFOR_Indir_FIR_cm
        FD14_SnrDat_sFOR_Indir_FSR_cm: type=FD14_SnrDat_sFOR_Indir_FSR_cm
        FD14_SnrDat_sFSL_Indir_FOL_cm: type=FD14_SnrDat_sFSL_Indir_FOL_cm
        FD14_SnrDat_sFSR_Indir_FOR_cm: type=FD14_SnrDat_sFSR_Indir_FOR_cm
        FD14_SnrDat_sRIL_Indir_RIR_cm: type=FD14_SnrDat_sRIL_Indir_RIR_cm
        FD14_SnrDat_sRIL_Indir_ROL_cm: type=FD14_SnrDat_sRIL_Indir_ROL_cm
        FD14_SnrDat_sRIR_Indir_RIL_cm: type=FD14_SnrDat_sRIR_Indir_RIL_cm
        FD14_SnrDat_sRIR_Indir_ROR_cm: type=FD14_SnrDat_sRIR_Indir_ROR_cm
        FD14_SnrDat_sROL_Indir_RIL_cm: type=FD14_SnrDat_sROL_Indir_RIL_cm
        FD14_SnrDat_sROL_Indir_RSL_cm: type=FD14_SnrDat_sROL_Indir_RSL_cm
        FD14_SnrDat_sROR_Indir_RIR_cm: type=FD14_SnrDat_sROR_Indir_RIR_cm
        FD14_SnrDat_sROR_Indir_RSR_cm: type=FD14_SnrDat_sROR_Indir_RSR_cm
        FD14_SnrDat_sRSL_Indir_ROL_cm: type=FD14_SnrDat_sRSL_Indir_ROL_cm
        FD14_SnrDat_sRSR_Indir_ROR_cm: type=FD14_SnrDat_sRSR_Indir_ROR_cm
        FD14_SnrMeasDataChecksum: type=FD14_SnrMeasDataChecksum
        FD14_SoftBtn_Error_e: type=FD14_SoftBtn_Error_e
        FD14_SrvCamIndBaNok_b: type=FD14_SrvCamIndBaNok_b
        FD14_SrvCamIndBaNone_b: type=FD14_SrvCamIndBaNone_b
        FD14_SrvCamIndBaOk_b: type=FD14_SrvCamIndBaOk_b
        FD14_SrvCamIndBaPend_b: type=FD14_SrvCamIndBaPend_b
        FD14_SrvCamIndFrNok_b: type=FD14_SrvCamIndFrNok_b
        FD14_SrvCamIndFrNone_b: type=FD14_SrvCamIndFrNone_b
        FD14_SrvCamIndFrOk_b: type=FD14_SrvCamIndFrOk_b
        FD14_SrvCamIndFrPend_b: type=FD14_SrvCamIndFrPend_b
        FD14_SrvCamIndLeNok_b: type=FD14_SrvCamIndLeNok_b
        FD14_SrvCamIndLeNone_b: type=FD14_SrvCamIndLeNone_b
        FD14_SrvCamIndLeOk_b: type=FD14_SrvCamIndLeOk_b
        FD14_SrvCamIndLePend_b: type=FD14_SrvCamIndLePend_b
        FD14_SrvCamIndRiNok_b: type=FD14_SrvCamIndRiNok_b
        FD14_SrvCamIndRiNone_b: type=FD14_SrvCamIndRiNone_b
        FD14_SrvCamIndRiOk_b: type=FD14_SrvCamIndRiOk_b
        FD14_SrvCamIndRiPend_b: type=FD14_SrvCamIndRiPend_b
        FD14_SrvChkIndCondNok_b: type=FD14_SrvChkIndCondNok_b
        FD14_SrvChkIndNok_b: type=FD14_SrvChkIndNok_b
        FD14_SrvChkIndOk_b: type=FD14_SrvChkIndOk_b
        FD14_SrvChkIndRun_b: type=FD14_SrvChkIndRun_b
        FD14_SrvLayout_b: type=FD14_SrvLayout_b
        FD14_SrvPrgBar0Per_b: type=FD14_SrvPrgBar0Per_b
        FD14_SrvPrgBar100Per_b: type=FD14_SrvPrgBar100Per_b
        FD14_SrvPrgBar20Per_b: type=FD14_SrvPrgBar20Per_b
        FD14_SrvPrgBar40Per_b: type=FD14_SrvPrgBar40Per_b
        FD14_SrvPrgBar60Per_b: type=FD14_SrvPrgBar60Per_b
        FD14_SrvPrgBar80Per_b: type=FD14_SrvPrgBar80Per_b
        FD14_SrvSpOmIndNok_b: type=FD14_SrvSpOmIndNok_b
        FD14_SrvSpOmIndOk_b: type=FD14_SrvSpOmIndOk_b
        FD14_SrvStAngIndNok_b: type=FD14_SrvStAngIndNok_b
        FD14_SrvStAngIndOk_b: type=FD14_SrvStAngIndOk_b
        FD14_steeringWheelAngle_f32: type=FD14_steeringWheelAngle_f32
        FD14_stFPAInfoToHMISlot{1..6}Valid: type=FD14_stFPAInfoToHMISlot{1..6}Valid
        FD14_stFPAInfoToVCLockedSlotFrntLeftX: type=FD14_stFPAInfoToVCLockedSlotFrntLeftX
        FD14_stFPAInfoToVCLockedSlotFrntLeftY: type=FD14_stFPAInfoToVCLockedSlotFrntLeftY
        FD14_stFPAInfoToVCLockedSlotID: type=FD14_stFPAInfoToVCLockedSlotID
        FD14_stFPAInfoToVCLockedSlotRearRghtX: type=FD14_stFPAInfoToVCLockedSlotRearRghtX
        FD14_stFPAInfoToVCLockedSlotRearRghtY: type=FD14_stFPAInfoToVCLockedSlotRearRghtY
        FD14_stFPAInfoToVCLockedSlotSide: type=FD14_stFPAInfoToVCLockedSlotSide
        FD14_stFPAInfoToVCLockedSlotType: type=FD14_stFPAInfoToVCLockedSlotType
        FD14_stFPAInfoToVCLockedSlotValid: type=FD14_stFPAInfoToVCLockedSlotValid
        FD14_stLeftObjectList{1..4}Valid: type=FD14_stLeftObjectList{1..4}Valid
        FD14_STM_v_TRGAUTO_BTN_PRESSED_b: type=FD14_STM_v_TRGAUTO_BTN_PRESSED_b
        FD14_STM_v_TRGLEFT_BTN_PRESSED_b: type=FD14_STM_v_TRGLEFT_BTN_PRESSED_b
        FD14_STM_v_TRGRIGHT_BTN_PRESSED_b: type=FD14_STM_v_TRGRIGHT_BTN_PRESSED_b
        FD14_stnumPointsL: type=FD14_stnumPointsL
        FD14_stnumPointsR: type=FD14_stnumPointsR
        FD14_stPLDLockedSlotDataFrontLeftX: type=FD14_stPLDLockedSlotDataFrontLeftX
        FD14_stPLDLockedSlotDataFrontLeftY: type=FD14_stPLDLockedSlotDataFrontLeftY
        FD14_stPLDLockedSlotDataRearRightX: type=FD14_stPLDLockedSlotDataRearRightX
        FD14_stPLDLockedSlotDataRearRightY: type=FD14_stPLDLockedSlotDataRearRightY
        FD14_stPLDLockedSlotDataSlotID: type=FD14_stPLDLockedSlotDataSlotID
        FD14_stPLDLockedSlotDataSlotSide: type=FD14_stPLDLockedSlotDataSlotSide
        FD14_stPLDLockedSlotDataSlotType: type=FD14_stPLDLockedSlotDataSlotType
        FD14_stPLDLockedSlotDataSlotValid: type=FD14_stPLDLockedSlotDataSlotValid
        FD14_stPLDParkingSlot1DataSlotID: type=FD14_stPLDParkingSlot1DataSlotID
        FD14_stPLDParkingSlot1DataSlotSide: type=FD14_stPLDParkingSlot1DataSlotSide
        FD14_stPLDParkingSlot1FrontLeftX: type=FD14_stPLDParkingSlot1FrontLeftX
        FD14_stPLDParkingSlot1FrontLeftY: type=FD14_stPLDParkingSlot1FrontLeftY
        FD14_stPLDParkingSlot1RearRightX: type=FD14_stPLDParkingSlot1RearRightX
        FD14_stPLDParkingSlot1RearRightY: type=FD14_stPLDParkingSlot1RearRightY
        FD14_stPLDParkingSlot1SlotType: type=FD14_stPLDParkingSlot1SlotType
        FD14_stPLDParkingSlot{1..3}SlotValid: type=FD14_stPLDParkingSlot{1..3}SlotValid
        FD14_stPLDParkingSlot4DataSlotID: type=FD14_stPLDParkingSlot4DataSlotID
        FD14_stPLDParkingSlot4DataSlotSide: type=FD14_stPLDParkingSlot4DataSlotSide
        FD14_stPLDParkingSlot4FrontLeftX: type=FD14_stPLDParkingSlot4FrontLeftX
        FD14_stPLDParkingSlot4FrontLeftY: type=FD14_stPLDParkingSlot4FrontLeftY
        FD14_stPLDParkingSlot4RearRightX: type=FD14_stPLDParkingSlot4RearRightX
        FD14_stPLDParkingSlot4RearRightY: type=FD14_stPLDParkingSlot4RearRightY
        FD14_stPLDParkingSlot4SlotType: type=FD14_stPLDParkingSlot4SlotType
        FD14_stPLDParkingSlot{4..6}SlotValid: type=FD14_stPLDParkingSlot{4..6}SlotValid
        FD14_stRightObjectList{1..4}Valid: type=FD14_stRightObjectList{1..4}Valid
        FD14_stUSSLockedSlotDataFrontLeftX: type=FD14_stUSSLockedSlotDataFrontLeftX
        FD14_stUSSLockedSlotDataFrontLeftY: type=FD14_stUSSLockedSlotDataFrontLeftY
        FD14_stUSSLockedSlotDataRearRightX: type=FD14_stUSSLockedSlotDataRearRightX
        FD14_stUSSLockedSlotDataRearRightY: type=FD14_stUSSLockedSlotDataRearRightY
        FD14_stUSSLockedSlotDataSlotID: type=FD14_stUSSLockedSlotDataSlotID
        FD14_stUSSLockedSlotDataSlotSide: type=FD14_stUSSLockedSlotDataSlotSide
        FD14_stUSSLockedSlotDataSlotType: type=FD14_stUSSLockedSlotDataSlotType
        FD14_stUSSLockedSlotDataSlotValid: type=FD14_stUSSLockedSlotDataSlotValid
        FD14_stUSSParkingSlot1DataSlotID: type=FD14_stUSSParkingSlot1DataSlotID
        FD14_stUSSParkingSlot1DataSlotSide: type=FD14_stUSSParkingSlot1DataSlotSide
        FD14_stUSSParkingSlot1FrontLeftX: type=FD14_stUSSParkingSlot1FrontLeftX
        FD14_stUSSParkingSlot1FrontLeftY: type=FD14_stUSSParkingSlot1FrontLeftY
        FD14_stUSSParkingSlot1RearRightX: type=FD14_stUSSParkingSlot1RearRightX
        FD14_stUSSParkingSlot1RearRightY: type=FD14_stUSSParkingSlot1RearRightY
        FD14_stUSSParkingSlot1SlotType: type=FD14_stUSSParkingSlot1SlotType
        FD14_stUSSParkingSlot{1..3}SlotValid: type=FD14_stUSSParkingSlot{1..3}SlotValid
        FD14_stUSSParkingSlot4DataSlotSide: type=FD14_stUSSParkingSlot4DataSlotSide
        FD14_stUSSParkingSlot4FrontLeftX: type=FD14_stUSSParkingSlot4FrontLeftX
        FD14_stUSSParkingSlot4FrontLeftY: type=FD14_stUSSParkingSlot4FrontLeftY
        FD14_stUSSParkingSlot4RearRightX: type=FD14_stUSSParkingSlot4RearRightX
        FD14_stUSSParkingSlot4RearRightY: type=FD14_stUSSParkingSlot4RearRightY
        FD14_stUSSParkingSlot4SlotType: type=FD14_stUSSParkingSlot4SlotType
        FD14_stUSSParkingSlot{4..6}SlotValid: type=FD14_stUSSParkingSlot{4..6}SlotValid
        FD14_SVC_Delay_Feature_b: type=FD14_SVC_Delay_Feature_b
        FD14_SVC_Dynamic_Gridlines_Feature_b: type=FD14_SVC_Dynamic_Gridlines_Feature_b
        FD14_SVC_FFCV_Gridlines_Feature_b: type=FD14_SVC_FFCV_Gridlines_Feature_b
        FD14_SVC_Static_Gridlines_Feature_b: type=FD14_SVC_Static_Gridlines_Feature_b
        FD14_SystemMode: type=FD14_SystemMode
        FD14_SystemStatus: type=FD14_SystemStatus
        FD14_TadAngle: type=FD14_TadAngle
        FD14_TADAngleRate: type=FD14_TADAngleRate
        FD14_TargetDetectLeftFront_Front_s8: type=FD14_TargetDetectLeftFront_Front_s8
        FD14_TargetDetectLeftFront_Left_s8: type=FD14_TargetDetectLeftFront_Left_s8
        FD14_TargetDetectLeftFront_Rear_s8: type=FD14_TargetDetectLeftFront_Rear_s8
        FD14_TargetDetectLeftFront_Right_s8: type=FD14_TargetDetectLeftFront_Right_s8
        FD14_TargetDetectLeftRear_Front_s8: type=FD14_TargetDetectLeftRear_Front_s8
        FD14_TargetDetectLeftRear_Rear_s8: type=FD14_TargetDetectLeftRear_Rear_s8
        FD14_TargetDetectLeftRear_Right_s8: type=FD14_TargetDetectLeftRear_Right_s8
        FD14_TargetDetectRightFront_Front_s8: type=FD14_TargetDetectRightFront_Front_s8
        FD14_TargetDetectRightFront_Left_s8: type=FD14_TargetDetectRightFront_Left_s8
        FD14_TargetDetectRightFront_Rear_s8: type=FD14_TargetDetectRightFront_Rear_s8
        FD14_TargetDetectRightFront_Right_s8: type=FD14_TargetDetectRightFront_Right_s8
        FD14_TargetDetectRightRear_Front_s8: type=FD14_TargetDetectRightRear_Front_s8
        FD14_TargetDetectRightRear_Left_s8: type=FD14_TargetDetectRightRear_Left_s8
        FD14_TargetDetectRightRear_Rear_s8: type=FD14_TargetDetectRightRear_Rear_s8
        FD14_TargetDetectRightRear_Right_s8: type=FD14_TargetDetectRightRear_Right_s8
        FD14_TargetInit_Front_s8: type=FD14_TargetInit_Front_s8
        FD14_TargetInit_Left_s8: type=FD14_TargetInit_Left_s8
        FD14_TargetInit_Rear_s8: type=FD14_TargetInit_Rear_s8
        FD14_TargetInit_Right_s8: type=FD14_TargetInit_Right_s8
        FD14_TargetLimitFront_Front_s8: type=FD14_TargetLimitFront_Front_s8
        FD14_TargetLimitFront_Left_s8: type=FD14_TargetLimitFront_Left_s8
        FD14_TargetLimitFront_Rear_s8: type=FD14_TargetLimitFront_Rear_s8
        FD14_TargetLimitFront_Right_s8: type=FD14_TargetLimitFront_Right_s8
        FD14_TargetLimitRear_Front_s8: type=FD14_TargetLimitRear_Front_s8
        FD14_TargetLimitRear_Left_s8: type=FD14_TargetLimitRear_Left_s8
        FD14_TargetLimitRear_Rear_s8: type=FD14_TargetLimitRear_Rear_s8
        FD14_TargetLimitRear_Right_s8: type=FD14_TargetLimitRear_Right_s8
        FD14_tchScrnCoord_s_X_u16: type=FD14_tchScrnCoord_s_X_u16
        FD14_tchScrnCoord_s_Y_u16: type=FD14_tchScrnCoord_s_Y_u16
        FD14_tchScrnStatus_e: type=FD14_tchScrnStatus_e
        FD14_tgwDispStatus_e: type=FD14_tgwDispStatus_e
        FD14_THAButtonGrey: type=FD14_THAButtonGrey
        FD14_THAButtonSelectable: type=FD14_THAButtonSelectable
        FD14_THAConfirmButton: type=FD14_THAConfirmButton
        FD14_THACouplerBulletIcon: type=FD14_THACouplerBulletIcon
        FD14_THAProgressBar: type=FD14_THAProgressBar
        FD14_THAStartButton: type=FD14_THAStartButton
        FD14_THATriangleOverlay: type=FD14_THATriangleOverlay
        FD14_TimeStamp_SystemStatus: type=FD14_TimeStamp_SystemStatus
        FD14_TopFrontButtonNoSelect_b: type=FD14_TopFrontButtonNoSelect_b
        FD14_TopFrontButtonSelect_b: type=FD14_TopFrontButtonSelect_b
        FD14_TopRearButtonNoSelect_b: type=FD14_TopRearButtonNoSelect_b
        FD14_TopRearButtonSelect_b: type=FD14_TopRearButtonSelect_b
        FD14_TopVideoBlanked_b: type=FD14_TopVideoBlanked_b
        FD14_TopViewBlack_b: type=FD14_TopViewBlack_b
        FD14_TopViewFrontDynamics_b: type=FD14_TopViewFrontDynamics_b
        FD14_TopViewRearDynamics_b: type=FD14_TopViewRearDynamics_b
        FD14_Total_lines_count: type=FD14_Total_lines_count
        FD14_Trailer_Recognition_Confidence: type=FD14_Trailer_Recognition_Confidence
        FD14_Trailer_tracking_confidence: type=FD14_Trailer_tracking_confidence
        FD14_trailerAngle: type=FD14_trailerAngle
        FD14_TrailerAngleSign: type=FD14_TrailerAngleSign
        FD14_TrailerCalFailInfo: type=FD14_TrailerCalFailInfo
        FD14_trailerCalibrationCount: type=FD14_trailerCalibrationCount
        FD14_trailerCalibrationDelay: type=FD14_trailerCalibrationDelay
        FD14_TrailerCalibrationStatus: type=FD14_TrailerCalibrationStatus
        FD14_Trailercalinfo: type=FD14_Trailercalinfo
        FD14_TrailerConnectionStatus: type=FD14_TrailerConnectionStatus
        FD14_TrailerWheelBase: type=FD14_TrailerWheelBase
        FD14_transEquipped_e: type=FD14_transEquipped_e
        FD14_TrscJackKnifeOrange: type=FD14_TrscJackKnifeOrange
        FD14_TrscJackKnifeRed: type=FD14_TrscJackKnifeRed
        FD14_TrscOvl: type=FD14_TrscOvl
        FD14_trscStat_e: type=FD14_trscStat_e
        FD14_TrscStatus: type=FD14_TrscStatus
        FD14_TrscTrailerRed: type=FD14_TrscTrailerRed
        FD14_Tstr_SD_FIL_DrvFreq: type=FD14_Tstr_SD_FIL_DrvFreq
        FD14_Tstr_SD_FIL_EchoHeight_adc: type=FD14_Tstr_SD_FIL_EchoHeight_adc
        FD14_Tstr_SD_FIL_RingFreq: type=FD14_Tstr_SD_FIL_RingFreq
        FD14_Tstr_SD_FIL_Ringtime_us: type=FD14_Tstr_SD_FIL_Ringtime_us
        FD14_Tstr_SD_FIL_SensorBlkgClrCounter: type=FD14_Tstr_SD_FIL_SensorBlkgClrCounter
        FD14_Tstr_SD_FIL_SensorBlkgSetCounter: type=FD14_Tstr_SD_FIL_SensorBlkgSetCounter
        FD14_Tstr_SD_FIL_Unfiltered_DirDist1: type=FD14_Tstr_SD_FIL_Unfiltered_DirDist1
        FD14_Tstr_SD_FIL_Unfiltered_DirDist2: type=FD14_Tstr_SD_FIL_Unfiltered_DirDist2
        FD14_Tstr_SD_FIR_DrvFreq: type=FD14_Tstr_SD_FIR_DrvFreq
        FD14_Tstr_SD_FIR_EchoHeight_adc: type=FD14_Tstr_SD_FIR_EchoHeight_adc
        FD14_Tstr_SD_FIR_RingFreq: type=FD14_Tstr_SD_FIR_RingFreq
        FD14_Tstr_SD_FIR_Ringtime_us: type=FD14_Tstr_SD_FIR_Ringtime_us
        FD14_Tstr_SD_FIR_SensorBlkgClrCounter: type=FD14_Tstr_SD_FIR_SensorBlkgClrCounter
        FD14_Tstr_SD_FIR_SensorBlkgSetCounter: type=FD14_Tstr_SD_FIR_SensorBlkgSetCounter
        FD14_Tstr_SD_FIR_Unfiltered_DirDist1: type=FD14_Tstr_SD_FIR_Unfiltered_DirDist1
        FD14_Tstr_SD_FIR_Unfiltered_DirDist2: type=FD14_Tstr_SD_FIR_Unfiltered_DirDist2
        FD14_Tstr_SD_FOL_DrvFreq: type=FD14_Tstr_SD_FOL_DrvFreq
        FD14_Tstr_SD_FOL_EchoHeight_adc: type=FD14_Tstr_SD_FOL_EchoHeight_adc
        FD14_Tstr_SD_FOL_RingFreq: type=FD14_Tstr_SD_FOL_RingFreq
        FD14_Tstr_SD_FOL_Ringtime_us: type=FD14_Tstr_SD_FOL_Ringtime_us
        FD14_Tstr_SD_FOL_SensorBlkgClrCounter: type=FD14_Tstr_SD_FOL_SensorBlkgClrCounter
        FD14_Tstr_SD_FOL_SensorBlkgSetCounter: type=FD14_Tstr_SD_FOL_SensorBlkgSetCounter
        FD14_Tstr_SD_FOL_Unfiltered_DirDist1: type=FD14_Tstr_SD_FOL_Unfiltered_DirDist1
        FD14_Tstr_SD_FOL_Unfiltered_DirDist2: type=FD14_Tstr_SD_FOL_Unfiltered_DirDist2
        FD14_Tstr_SD_FOR_DrvFreq: type=FD14_Tstr_SD_FOR_DrvFreq
        FD14_Tstr_SD_FOR_EchoHeight_adc: type=FD14_Tstr_SD_FOR_EchoHeight_adc
        FD14_Tstr_SD_FOR_RingFreq: type=FD14_Tstr_SD_FOR_RingFreq
        FD14_Tstr_SD_FOR_Ringtime_us: type=FD14_Tstr_SD_FOR_Ringtime_us
        FD14_Tstr_SD_FOR_SensorBlkgClrCounter: type=FD14_Tstr_SD_FOR_SensorBlkgClrCounter
        FD14_Tstr_SD_FOR_SensorBlkgSetCounter: type=FD14_Tstr_SD_FOR_SensorBlkgSetCounter
        FD14_Tstr_SD_FOR_Unfiltered_DirDist1: type=FD14_Tstr_SD_FOR_Unfiltered_DirDist1
        FD14_Tstr_SD_FOR_Unfiltered_DirDist2: type=FD14_Tstr_SD_FOR_Unfiltered_DirDist2
        FD14_Tstr_SD_FSL_DrvFreq: type=FD14_Tstr_SD_FSL_DrvFreq
        FD14_Tstr_SD_FSL_EchoHeight_adc: type=FD14_Tstr_SD_FSL_EchoHeight_adc
        FD14_Tstr_SD_FSL_RingFreq: type=FD14_Tstr_SD_FSL_RingFreq
        FD14_Tstr_SD_FSL_Ringtime_us: type=FD14_Tstr_SD_FSL_Ringtime_us
        FD14_Tstr_SD_FSL_SensorBlkgClrCounter: type=FD14_Tstr_SD_FSL_SensorBlkgClrCounter
        FD14_Tstr_SD_FSL_SensorBlkgSetCounter: type=FD14_Tstr_SD_FSL_SensorBlkgSetCounter
        FD14_Tstr_SD_FSL_Unfiltered_DirDist1: type=FD14_Tstr_SD_FSL_Unfiltered_DirDist1
        FD14_Tstr_SD_FSL_Unfiltered_DirDist2: type=FD14_Tstr_SD_FSL_Unfiltered_DirDist2
        FD14_Tstr_SD_FSR_DrvFreq: type=FD14_Tstr_SD_FSR_DrvFreq
        FD14_Tstr_SD_FSR_EchoHeight_adc: type=FD14_Tstr_SD_FSR_EchoHeight_adc
        FD14_Tstr_SD_FSR_RingFreq: type=FD14_Tstr_SD_FSR_RingFreq
        FD14_Tstr_SD_FSR_Ringtime_us: type=FD14_Tstr_SD_FSR_Ringtime_us
        FD14_Tstr_SD_FSR_SensorBlkgClrCounter: type=FD14_Tstr_SD_FSR_SensorBlkgClrCounter
        FD14_Tstr_SD_FSR_SensorBlkgSetCounter: type=FD14_Tstr_SD_FSR_SensorBlkgSetCounter
        FD14_Tstr_SD_FSR_Unfiltered_DirDist1: type=FD14_Tstr_SD_FSR_Unfiltered_DirDist1
        FD14_Tstr_SD_FSR_Unfiltered_DirDist2: type=FD14_Tstr_SD_FSR_Unfiltered_DirDist2
        FD14_Tstr_SD_RIL_DrvFreq: type=FD14_Tstr_SD_RIL_DrvFreq
        FD14_Tstr_SD_RIL_EchoHeight_adc: type=FD14_Tstr_SD_RIL_EchoHeight_adc
        FD14_Tstr_SD_RIL_RingFreq: type=FD14_Tstr_SD_RIL_RingFreq
        FD14_Tstr_SD_RIL_Ringtime_us: type=FD14_Tstr_SD_RIL_Ringtime_us
        FD14_Tstr_SD_RIL_SensorBlkgClrCounter: type=FD14_Tstr_SD_RIL_SensorBlkgClrCounter
        FD14_Tstr_SD_RIL_SensorBlkgSetCounter: type=FD14_Tstr_SD_RIL_SensorBlkgSetCounter
        FD14_Tstr_SD_RIL_Unfiltered_DirDist1: type=FD14_Tstr_SD_RIL_Unfiltered_DirDist1
        FD14_Tstr_SD_RIL_Unfiltered_DirDist2: type=FD14_Tstr_SD_RIL_Unfiltered_DirDist2
        FD14_Tstr_SD_RIR_DrvFreq: type=FD14_Tstr_SD_RIR_DrvFreq
        FD14_Tstr_SD_RIR_EchoHeight_adc: type=FD14_Tstr_SD_RIR_EchoHeight_adc
        FD14_Tstr_SD_RIR_RingFreq: type=FD14_Tstr_SD_RIR_RingFreq
        FD14_Tstr_SD_RIR_Ringtime_us: type=FD14_Tstr_SD_RIR_Ringtime_us
        FD14_Tstr_SD_RIR_SensorBlkgClrCounter: type=FD14_Tstr_SD_RIR_SensorBlkgClrCounter
        FD14_Tstr_SD_RIR_SensorBlkgSetCounter: type=FD14_Tstr_SD_RIR_SensorBlkgSetCounter
        FD14_Tstr_SD_RIR_Unfiltered_DirDist1: type=FD14_Tstr_SD_RIR_Unfiltered_DirDist1
        FD14_Tstr_SD_RIR_Unfiltered_DirDist2: type=FD14_Tstr_SD_RIR_Unfiltered_DirDist2
        FD14_Tstr_SD_ROL_DrvFreq: type=FD14_Tstr_SD_ROL_DrvFreq
        FD14_Tstr_SD_ROL_EchoHeight_adc: type=FD14_Tstr_SD_ROL_EchoHeight_adc
        FD14_Tstr_SD_ROL_RingFreq: type=FD14_Tstr_SD_ROL_RingFreq
        FD14_Tstr_SD_ROL_Ringtime_us: type=FD14_Tstr_SD_ROL_Ringtime_us
        FD14_Tstr_SD_ROL_SensorBlkgClrCounter: type=FD14_Tstr_SD_ROL_SensorBlkgClrCounter
        FD14_Tstr_SD_ROL_SensorBlkgSetCounter: type=FD14_Tstr_SD_ROL_SensorBlkgSetCounter
        FD14_Tstr_SD_ROL_Unfiltered_DirDist1: type=FD14_Tstr_SD_ROL_Unfiltered_DirDist1
        FD14_Tstr_SD_ROL_Unfiltered_DirDist2: type=FD14_Tstr_SD_ROL_Unfiltered_DirDist2
        FD14_Tstr_SD_ROR_DrvFreq: type=FD14_Tstr_SD_ROR_DrvFreq
        FD14_Tstr_SD_ROR_EchoHeight_adc: type=FD14_Tstr_SD_ROR_EchoHeight_adc
        FD14_Tstr_SD_ROR_RingFreq: type=FD14_Tstr_SD_ROR_RingFreq
        FD14_Tstr_SD_ROR_Ringtime_us: type=FD14_Tstr_SD_ROR_Ringtime_us
        FD14_Tstr_SD_ROR_SensorBlkgClrCounter: type=FD14_Tstr_SD_ROR_SensorBlkgClrCounter
        FD14_Tstr_SD_ROR_SensorBlkgSetCounter: type=FD14_Tstr_SD_ROR_SensorBlkgSetCounter
        FD14_Tstr_SD_ROR_Unfiltered_DirDist1: type=FD14_Tstr_SD_ROR_Unfiltered_DirDist1
        FD14_Tstr_SD_ROR_Unfiltered_DirDist2: type=FD14_Tstr_SD_ROR_Unfiltered_DirDist2
        FD14_Tstr_SD_RSL_DrvFreq: type=FD14_Tstr_SD_RSL_DrvFreq
        FD14_Tstr_SD_RSL_EchoHeight_adc: type=FD14_Tstr_SD_RSL_EchoHeight_adc
        FD14_Tstr_SD_RSL_RingFreq: type=FD14_Tstr_SD_RSL_RingFreq
        FD14_Tstr_SD_RSL_Ringtime_us: type=FD14_Tstr_SD_RSL_Ringtime_us
        FD14_Tstr_SD_RSL_SensorBlkgClrCounter: type=FD14_Tstr_SD_RSL_SensorBlkgClrCounter
        FD14_Tstr_SD_RSL_SensorBlkgSetCounter: type=FD14_Tstr_SD_RSL_SensorBlkgSetCounter
        FD14_Tstr_SD_RSL_Unfiltered_DirDist1: type=FD14_Tstr_SD_RSL_Unfiltered_DirDist1
        FD14_Tstr_SD_RSL_Unfiltered_DirDist2: type=FD14_Tstr_SD_RSL_Unfiltered_DirDist2
        FD14_Tstr_SD_RSR_DrvFreq: type=FD14_Tstr_SD_RSR_DrvFreq
        FD14_Tstr_SD_RSR_EchoHeight_adc: type=FD14_Tstr_SD_RSR_EchoHeight_adc
        FD14_Tstr_SD_RSR_RingFreq: type=FD14_Tstr_SD_RSR_RingFreq
        FD14_Tstr_SD_RSR_Ringtime_us: type=FD14_Tstr_SD_RSR_Ringtime_us
        FD14_Tstr_SD_RSR_SensorBlkgClrCounter: type=FD14_Tstr_SD_RSR_SensorBlkgClrCounter
        FD14_Tstr_SD_RSR_SensorBlkgSetCounter: type=FD14_Tstr_SD_RSR_SensorBlkgSetCounter
        FD14_Tstr_SD_RSR_Unfiltered_DirDist1: type=FD14_Tstr_SD_RSR_Unfiltered_DirDist1
        FD14_Tstr_SD_RSR_Unfiltered_DirDist2: type=FD14_Tstr_SD_RSR_Unfiltered_DirDist2
        FD14_turnaroundSubState: type=FD14_turnaroundSubState
        FD14_USS_MPAZoneB{00..03}: type=FD14_USS_MPAZoneB{00..03}
        FD14_USS_MPAZoneF{00..03}: type=FD14_USS_MPAZoneF{00..03}
        FD14_ValidFeatures_Front_u32: type=FD14_ValidFeatures_Front_u32
        FD14_ValidFeatures_Left_u32: type=FD14_ValidFeatures_Left_u32
        FD14_ValidFeatures_Rear_u32: type=FD14_ValidFeatures_Rear_u32
        FD14_ValidFeatures_Right_u32: type=FD14_ValidFeatures_Right_u32
        FD14_vehicleLine_e: type=FD14_vehicleLine_e
        FD14_vehicleSpeed_f32: type=FD14_vehicleSpeed_f32
        FD14_View_Error_e: type=FD14_View_Error_e
        FD14_X_BTN_PRESSED_b: type=FD14_X_BTN_PRESSED_b
        FD14_X_f32_Current_Rear: type=FD14_X_f32_Current_Rear
        FD14_X_f32_Current_Right: type=FD14_X_f32_Current_Right
        FD14_X_f32_EOL_Front: type=FD14_X_f32_EOL_Front
        FD14_X_f32_EOL_Left: type=FD14_X_f32_EOL_Left
        FD14_X_f32_EOL_Rear: type=FD14_X_f32_EOL_Rear
        FD14_X_f32_EOL_Right: type=FD14_X_f32_EOL_Right
        FD14_XIcon_b: type=FD14_XIcon_b
        FD14_Y_f32_Current_Rear: type=FD14_Y_f32_Current_Rear
        FD14_Y_f32_Current_Right: type=FD14_Y_f32_Current_Right
        FD14_Y_f32_EOL_Front: type=FD14_Y_f32_EOL_Front
        FD14_Y_f32_EOL_Left: type=FD14_Y_f32_EOL_Left
        FD14_Y_f32_EOL_Rear: type=FD14_Y_f32_EOL_Rear
        FD14_Y_f32_EOL_Right: type=FD14_Y_f32_EOL_Right
        FD14_Yaw_f32_Current_Rear: type=FD14_Yaw_f32_Current_Rear
        FD14_Yaw_f32_Current_Right: type=FD14_Yaw_f32_Current_Right
        FD14_Yaw_f32_EOL_Front: type=FD14_Yaw_f32_EOL_Front
        FD14_Yaw_f32_EOL_Left: type=FD14_Yaw_f32_EOL_Left
        FD14_Yaw_f32_EOL_Rear: type=FD14_Yaw_f32_EOL_Rear
        FD14_Yaw_f32_EOL_Right: type=FD14_Yaw_f32_EOL_Right
        FD14_Yaw_f32_OC_Front: type=FD14_Yaw_f32_OC_Front
        FD14_Yaw_f32_OC_Left: type=FD14_Yaw_f32_OC_Left
        FD14_Yaw_f32_OC_Rear: type=FD14_Yaw_f32_OC_Rear
        FD14_Yaw_f32_OC_Right: type=FD14_Yaw_f32_OC_Right
        FD14_Yaw_f32_SC_Front: type=FD14_Yaw_f32_SC_Front
        FD14_Yaw_f32_SC_Left: type=FD14_Yaw_f32_SC_Left
        FD14_Yaw_f32_SC_Rear: type=FD14_Yaw_f32_SC_Rear
        FD14_Yaw_f32_SC_Right: type=FD14_Yaw_f32_SC_Right
        FD14_Z_f32_Current_Rear: type=FD14_Z_f32_Current_Rear
        FD14_Z_f32_Current_Right: type=FD14_Z_f32_Current_Right
        FD14_Z_f32_EOL_Front: type=FD14_Z_f32_EOL_Front
        FD14_Z_f32_EOL_Left: type=FD14_Z_f32_EOL_Left
        FD14_Z_f32_EOL_Rear: type=FD14_Z_f32_EOL_Rear
        FD14_Z_f32_EOL_Right: type=FD14_Z_f32_EOL_Right
        FD14_ZoomButtonDisable_b: type=FD14_ZoomButtonDisable_b
        FD14_ZoomFactor_u8: type=FD14_ZoomFactor_u8
        FD14_ZoomMinusIcon_b: type=FD14_ZoomMinusIcon_b
        FD14_ZoomPlusIcon_b: type=FD14_ZoomPlusIcon_b
    IF_ToSwcFD02Tx
      40 x data:
        CurrentCanNMState_FD02_PAM: type=CurrentCanNMState_FD02_PAM
        CurrentFailSts_FD02_PAM: type=CurrentFailSts_FD02_PAM
        DES_FD02_PAM: type=DES_FD02_PAM
        Digit_{01..11}_PAM: type=Digit_{01..11}_PAM
        EOL_FD02_PAM: type=EOL_FD02_PAM
        GenericFailSts_FD02_PAM: type=GenericFailSts_FD02_PAM
        N_PDU: type=N_PDU
        PreviousCanNMState_FD02_PAM: type=PreviousCanNMState_FD02_PAM
        StayActiveSource_FD02_PAM: type=StayActiveSource_FD02_PAM
        THA_EPB_Req: type=THA_EPB_Req
        THA_Speed_Limit: type=THA_Speed_Limit
        THA_SpeedLimit_Req: type=THA_SpeedLimit_Req
        THA_STAT: type=THA_STAT
        THA_SteeringDamping: type=THA_SteeringDamping_adt
        THA_SteeringTorqueInfo: type=THA_SteeringTorqueInfo_adt
        THA_SteeringTorqueReq: type=THA_SteeringTorqueReq
        Trailer_Angle: type=Trailer_Angle
        Trailer_Angle_Sign: type=Trailer_Angle_Sign
        Trailer_Calibration: type=Trailer_Calibration
        TrlrHitchLight_Cntrl: type=TrlrHitchLight_Cntrl
        TRSC_PopupDisp_Info: type=TRSC_PopupDisp_Info
        TRSC_SpeedLimit_Req: type=TRSC_SpeedLimit_Req
        TRSC_STAT: type=TRSC_STAT
        TRSC_SteeringDamping: type=TRSC_SteeringDamping_adt
        TRSC_SteeringTorqueInfo: type=TRSC_SteeringTorqueInfo_adt
        TRSC_SteeringTorqueReq: type=TRSC_SteeringTorqueReq
        TRSC_VehicleStop_Req: type=TRSC_VehicleStop_Req
        TRSCMoreCamRQSts: type=TRSCMoreCamRQSts
        WakeupSource_FD02_PAM: type=WakeupSource_FD02_PAM
        TRSC_PopupDisp_Info2: type=TRSC_PopupDisp_Info2
    IF_ToSwcFD14Tx
      13 x data:
        FD14_THA_EPB_Req: type=FD14_THA_EPB_Req
        FD14_THA_Speed_Limit: type=FD14_THA_Speed_Limit
        FD14_THA_SpeedLimit_Req: type=FD14_THA_SpeedLimit_Req
        FD14_THA_STAT: type=FD14_THA_STAT
        FD14_THA_SteeringDamping: type=FD14_THA_SteeringDamping
        FD14_THA_SteeringTorqueInfo: type=FD14_THA_SteeringTorqueInfo
        FD14_THA_SteeringTorqueReq: type=FD14_THA_SteeringTorqueReq
        FD14_TRSC_SpeedLimit_Req: type=FD14_TRSC_SpeedLimit_Req
        FD14_TRSC_STAT: type=FD14_TRSC_STAT
        FD14_TRSC_SteeringDamping: type=FD14_TRSC_SteeringDamping
        FD14_TRSC_SteeringTorqueInfo: type=FD14_TRSC_SteeringTorqueInfo
        FD14_TRSC_SteeringTorqueReq: type=FD14_TRSC_SteeringTorqueReq
        FD14_TRSC_VehicleStop_Req: type=FD14_TRSC_VehicleStop_Req
    IF_ToSwcSafeFD02Tx
      134 x data:
        Reserved_for_functional_safety: type=Reserved_for_functional_safety
        Segment_1_Confidence: type=Segment_1_Confidence
        Segment_1_ID: type=Segment_1_ID
        Segment_1_X1: type=Segment_1_X1
        Segment_1_X2: type=Segment_1_X2
        Segment_1_Y1: type=Segment_1_Y1
        Segment_1_Y2: type=Segment_1_Y2
        Segment_2_Confidence: type=Segment_2_Confidence
        Segment_2_ID: type=Segment_2_ID
        Segment_2_X1: type=Segment_2_X1
        Segment_2_X2: type=Segment_2_X2
        Segment_2_Y1: type=Segment_2_Y1
        Segment_2_Y2: type=Segment_2_Y2
        Segment_3_Confidence: type=Segment_3_Confidence
        Segment_3_ID: type=Segment_3_ID
        Segment_3_X1: type=Segment_3_X1
        Segment_3_X2: type=Segment_3_X2
        Segment_3_Y1: type=Segment_3_Y1
        Segment_3_Y2: type=Segment_3_Y2
        Segment_4_Confidence: type=Segment_4_Confidence
        Segment_4_ID: type=Segment_4_ID
        Segment_4_X1: type=Segment_4_X1
        Segment_4_X2: type=Segment_4_X2
        Segment_4_Y1: type=Segment_4_Y1
        Segment_4_Y2: type=Segment_4_Y2
        Segment_5_Confidence: type=Segment_5_Confidence
        Segment_5_ID: type=Segment_5_ID
        Segment_5_X1: type=Segment_5_X1
        Segment_5_X2: type=Segment_5_X2
        Segment_5_Y1: type=Segment_5_Y1
        Segment_5_Y2: type=Segment_5_Y2
        Segment_6_Confidence: type=Segment_6_Confidence
        Segment_6_ID: type=Segment_6_ID
        Segment_6_X1: type=Segment_6_X1
        Segment_6_X2: type=Segment_6_X2
        Segment_6_Y1: type=Segment_6_Y1
        Segment_6_Y2: type=Segment_6_Y2
        Segment_7_Confidence: type=Segment_7_Confidence
        Segment_7_ID: type=Segment_7_ID
        Segment_7_X1: type=Segment_7_X1
        Segment_7_X2: type=Segment_7_X2
        Segment_7_Y1: type=Segment_7_Y1
        Segment_7_Y2: type=Segment_7_Y2
        Segment_8_Confidence: type=Segment_8_Confidence
        Segment_8_ID: type=Segment_8_ID
        Segment_8_X1: type=Segment_8_X1
        Segment_8_X2: type=Segment_8_X2
        Segment_8_Y1: type=Segment_8_Y1
        Segment_8_Y2: type=Segment_8_Y2
        Camera_Status: type=Camera_Status
        Cntr_ADAS_FD_LANES_1: type=Cntr_ADAS_FD_LANES_1
        Cntr_ADAS_FD_LANES_2: type=Cntr_ADAS_FD_LANES_2
        FOD_Confidence: type=FOD_Confidence
        Frame_Index_Lanes_1: type=Frame_Index_Lanes_1
        Frame_Index_Lanes_2: type=Frame_Index_Lanes_2
        Health_Front_Object_Detection: type=Health_Front_Object_Detection
        Health_Lane_Detection: type=Health_Lane_Detection
        Line_1_Confidence: type=Line_1_Confidence
        Line_1_Curvature: type=Line_1_Curvature
        Line_1_Curvature_Rate: type=Line_1_Curvature_Rate
        Line_1_End_Range: type=Line_1_End_Range
        Line_1_Heading: type=Line_1_Heading
        Line_1_Offset: type=Line_1_Offset
        Line_1_Start_Range: type=Line_1_Start_Range
        Line_1_Type: type=Line_1_Type
        Line_2_Confidence: type=Line_2_Confidence
        Line_2_Curvature: type=Line_2_Curvature
        Line_2_Curvature_Rate: type=Line_2_Curvature_Rate
        Line_2_End_Range: type=Line_2_End_Range
        Line_2_Heading: type=Line_2_Heading
        Line_2_Offset: type=Line_2_Offset
        Line_2_Start_Range: type=Line_2_Start_Range
        Line_2_Type: type=Line_2_Type
        Line_3_Confidence: type=Line_3_Confidence
        Line_3_Curvature: type=Line_3_Curvature
        Line_3_Curvature_Rate: type=Line_3_Curvature_Rate
        Line_3_End_Range: type=Line_3_End_Range
        Line_3_Heading: type=Line_3_Heading
        Line_3_Offset: type=Line_3_Offset
        Line_3_Start_Range: type=Line_3_Start_Range
        Line_3_Type: type=Line_3_Type
        Line_4_Confidence: type=Line_4_Confidence
        Line_4_Curvature: type=Line_4_Curvature
        Line_4_Curvature_Rate: type=Line_4_Curvature_Rate
        Line_4_End_Range: type=Line_4_End_Range
        Line_4_Heading: type=Line_4_Heading
        Line_4_Offset: type=Line_4_Offset
        Line_4_Start_Range: type=Line_4_Start_Range
        Line_4_Type: type=Line_4_Type
        MAC_ADAS_FD_LANES_1: type=MAC_ADAS_FD_LANES_1
        MAC_ADAS_FD_LANES_2: type=MAC_ADAS_FD_LANES_2
        Alert_CHF: type=Alert_CHF
        Alert_CHR: type=Alert_CHR
        Alert_LHF: type=Alert_LHF
        Alert_LHR: type=Alert_LHR
        Alert_RHF: type=Alert_RHF
        Alert_RHR: type=Alert_RHR
        AUXCamsRQSts: type=AUXCamsRQSts
        ChimeActivation_LHF: type=ChimeActivation_LHF
        ChimeActivation_LHR: type=ChimeActivation_LHR
        ChimeActivation_RHF: type=ChimeActivation_RHF
        ChimeActivation_RHR: type=ChimeActivation_RHR
        DisplayView2: type=DisplayView2
        FrontSensorSts: type=FrontSensorSts
        FT_PAM_LedControlSts: type=FT_PAM_LedControlSts
        Graphic_CHF: type=Graphic_CHF
        Graphic_CHR: type=Graphic_CHR
        Graphic_LHF: type=Graphic_LHF
        Graphic_LHR: type=Graphic_LHR
        Graphic_RHF: type=Graphic_RHF
        Graphic_RHR: type=Graphic_RHR
        HMICode: type=HMICode
        ImageDefeatRQSts: type=ImageDefeatRQSts
        MoreCamsRQSts: type=MoreCamsRQSts
        PAM_CHIME_REP_RATESts: type=PAM_CHIME_REP_RATESts
        PAM_CHIME_TYPE: type=PAM_CHIME_TYPE
        PAM_LedControlSts: type=PAM_LedControlSts
        PAM_Off_Status: type=PAM_Off_Status
        PAM_Off_Status_2BT: type=PAM_Off_Status_2BT
        PAM_PopUpRqst: type=PAM_PopUpRqst
        PAM_Volume: type=PAM_Volume
        PAMSystemFault: type=PAMSystemFault
        ParkingManeuverActive: type=ParkingManeuverActive
        PPPA_TurnIndicatorRqst: type=PPPA_TurnIndicatorRqst
        RearSensorSts: type=RearSensorSts
        RR_PAM_Brk_RqSts: type=RR_PAM_Brk_RqSts
        RR_PAM_Dist: type=RR_PAM_Dist
        RR_PAM_StopControlSts: type=RR_PAM_StopControlSts
        SPM_LedControlSts: type=SPM_LedControlSts
        SPM_Screen_Rqst: type=SPM_Screen_Rqst
        SPMControlSts: type=SPMControlSts
        SPMFailSts: type=SPMFailSts
        SPMSystemFault: type=SPMSystemFault
        TRSC_LED_Stat: type=TRSC_LED_Stat
    IF_ToComSafeFD14Tx
      110 x data:
        FD14_Camera_Status: type=FD14_Camera_Status
        FD14_Cntr_ADAS_FD_LANES_1: type=FD14_Cntr_ADAS_FD_LANES_1
        FD14_Cntr_ADAS_FD_LANES_2: type=FD14_Cntr_ADAS_FD_LANES_2
        FD14_FOD_Confidence: type=FD14_FOD_Confidence
        FD14_Frame_Index_Lanes_1: type=FD14_Frame_Index_Lanes_1
        FD14_Frame_Index_Lanes_2: type=FD14_Frame_Index_Lanes_2
        FD14_Health_Front_Object_Detection: type=FD14_Health_Front_Object_Detection
        FD14_Health_Lane_Detection: type=FD14_Health_Lane_Detection
        FD14_Line_1_Confidence: type=FD14_Line_1_Confidence
        FD14_Line_1_Curvature: type=FD14_Line_1_Curvature
        FD14_Line_1_Curvature_Rate: type=FD14_Line_1_Curvature_Rate
        FD14_Line_1_End_Range: type=FD14_Line_1_End_Range
        FD14_Line_1_Heading: type=FD14_Line_1_Heading
        FD14_Line_1_Offset: type=FD14_Line_1_Offset
        FD14_Line_1_Start_Range: type=FD14_Line_1_Start_Range
        FD14_Line_1_Type: type=FD14_Line_1_Type
        FD14_Line_2_Confidence: type=FD14_Line_2_Confidence
        FD14_Line_2_Curvature: type=FD14_Line_2_Curvature
        FD14_Line_2_Curvature_Rate: type=FD14_Line_2_Curvature_Rate
        FD14_Line_2_End_Range: type=FD14_Line_2_End_Range
        FD14_Line_2_Heading: type=FD14_Line_2_Heading
        FD14_Line_2_Offset: type=FD14_Line_2_Offset
        FD14_Line_2_Start_Range: type=FD14_Line_2_Start_Range
        FD14_Line_2_Type: type=FD14_Line_2_Type
        FD14_Line_3_Confidence: type=FD14_Line_3_Confidence
        FD14_Line_3_Curvature: type=FD14_Line_3_Curvature
        FD14_Line_3_Curvature_Rate: type=FD14_Line_3_Curvature_Rate
        FD14_Line_3_End_Range: type=FD14_Line_3_End_Range
        FD14_Line_3_Heading: type=FD14_Line_3_Heading
        FD14_Line_3_Offset: type=FD14_Line_3_Offset
        FD14_Line_3_Start_Range: type=FD14_Line_3_Start_Range
        FD14_Line_3_Type: type=FD14_Line_3_Type
        FD14_Line_4_Confidence: type=FD14_Line_4_Confidence
        FD14_Line_4_Curvature: type=FD14_Line_4_Curvature
        FD14_Line_4_Curvature_Rate: type=FD14_Line_4_Curvature_Rate
        FD14_Line_4_End_Range: type=FD14_Line_4_End_Range
        FD14_Line_4_Heading: type=FD14_Line_4_Heading
        FD14_Line_4_Offset: type=FD14_Line_4_Offset
        FD14_Line_4_Start_Range: type=FD14_Line_4_Start_Range
        FD14_Line_4_Type: type=FD14_Line_4_Type
        FD14_MAC_ADAS_FD_LANES_1: type=FD14_MAC_ADAS_FD_LANES_1
        FD14_MAC_ADAS_FD_LANES_2: type=FD14_MAC_ADAS_FD_LANES_2
        FD14_ParkingManeuverActive: type=FD14_ParkingManeuverActive
        FD14_Reserved_for_functional_safety: type=FD14_Reserved_for_functional_safety
        FD14_Segment_1_Confidence: type=FD14_Segment_1_Confidence
        FD14_Segment_1_ID: type=FD14_Segment_1_ID
        FD14_Segment_1_X1: type=FD14_Segment_1_X1
        FD14_Segment_1_X2: type=FD14_Segment_1_X2
        FD14_Segment_1_Y1: type=FD14_Segment_1_Y1
        FD14_Segment_1_Y2: type=FD14_Segment_1_Y2
        FD14_Segment_2_Confidence: type=FD14_Segment_2_Confidence
        FD14_Segment_2_ID: type=FD14_Segment_2_ID
        FD14_Segment_2_X1: type=FD14_Segment_2_X1
        FD14_Segment_2_X2: type=FD14_Segment_2_X2
        FD14_Segment_2_Y1: type=FD14_Segment_2_Y1
        FD14_Segment_2_Y2: type=FD14_Segment_2_Y2
        FD14_Segment_3_Confidence: type=FD14_Segment_3_Confidence
        FD14_Segment_3_ID: type=FD14_Segment_3_ID
        FD14_Segment_3_X1: type=FD14_Segment_3_X1
        FD14_Segment_3_X2: type=FD14_Segment_3_X2
        FD14_Segment_3_Y1: type=FD14_Segment_3_Y1
        FD14_Segment_3_Y2: type=FD14_Segment_3_Y2
        FD14_Segment_4_Confidence: type=FD14_Segment_4_Confidence
        FD14_Segment_4_ID: type=FD14_Segment_4_ID
        FD14_Segment_4_X1: type=FD14_Segment_4_X1
        FD14_Segment_4_X2: type=FD14_Segment_4_X2
        FD14_Segment_4_Y1: type=FD14_Segment_4_Y1
        FD14_Segment_4_Y2: type=FD14_Segment_4_Y2
        FD14_Segment_5_Confidence: type=FD14_Segment_5_Confidence
        FD14_Segment_5_ID: type=FD14_Segment_5_ID
        FD14_Segment_5_X1: type=FD14_Segment_5_X1
        FD14_Segment_5_X2: type=FD14_Segment_5_X2
        FD14_Segment_5_Y1: type=FD14_Segment_5_Y1
        FD14_Segment_5_Y2: type=FD14_Segment_5_Y2
        FD14_Segment_6_Confidence: type=FD14_Segment_6_Confidence
        FD14_Segment_6_ID: type=FD14_Segment_6_ID
        FD14_Segment_6_X1: type=FD14_Segment_6_X1
        FD14_Segment_6_X2: type=FD14_Segment_6_X2
        FD14_Segment_6_Y1: type=FD14_Segment_6_Y1
        FD14_Segment_6_Y2: type=FD14_Segment_6_Y2
        FD14_Segment_7_Confidence: type=FD14_Segment_7_Confidence
        FD14_Segment_7_ID: type=FD14_Segment_7_ID
        FD14_Segment_7_X1: type=FD14_Segment_7_X1
        FD14_Segment_7_X2: type=FD14_Segment_7_X2
        FD14_Segment_7_Y1: type=FD14_Segment_7_Y1
        FD14_Segment_7_Y2: type=FD14_Segment_7_Y2
        FD14_Segment_8_Confidence: type=FD14_Segment_8_Confidence
        FD14_Segment_8_ID: type=FD14_Segment_8_ID
        FD14_Segment_8_X1: type=FD14_Segment_8_X1
        FD14_Segment_8_X2: type=FD14_Segment_8_X2
        FD14_Segment_8_Y1: type=FD14_Segment_8_Y1
        FD14_Segment_8_Y2: type=FD14_Segment_8_Y2
        FD14_ManoeuvrePhase: type=FD14_ManoeuvrePhase
        FD14_ParkingGearShiftReq: type=FD14_ParkingGearShiftReq
        FD14_PPPA_AccelMax: type=FD14_PPPA_AccelMax
        FD14_PPPA_AccelMin: type=FD14_PPPA_AccelMin
        FD14_PPPA_DecelMax: type=FD14_PPPA_DecelMax
        FD14_PPPA_DecelMin: type=FD14_PPPA_DecelMin
        FD14_PPPA_Interface_BSM: type=FD14_PPPA_Interface_BSM
        FD14_PPPA_JerkAccelMax: type=FD14_PPPA_JerkAccelMax
        FD14_PPPA_JerkAccelMin: type=FD14_PPPA_JerkAccelMin
        FD14_PPPA_JerkDecelMax: type=FD14_PPPA_JerkDecelMax
        FD14_PPPA_JerkDecelMin: type=FD14_PPPA_JerkDecelMin
        FD14_PPPA_MaxSpeed: type=FD14_PPPA_MaxSpeed
        FD14_PPPA_StandstillRqst: type=FD14_PPPA_StandstillRqst
        FD14_PPPA_TargetDistance: type=FD14_PPPA_TargetDistance
        FD14_RR_PAM_Brk_RqSts: type=FD14_RR_PAM_Brk_RqSts
        FD14_RR_PAM_Dist: type=FD14_RR_PAM_Dist
        FD14_SPM_Lat_Ctrl_RequestSts: type=FD14_SPM_Lat_Ctrl_RequestSts
        FD14_TorqueOverlaySteeringReq_SPM: type=FD14_TorqueOverlaySteeringReq_SPM
    IF_ToSwcSafeFD14Tx
      110 x data:
        FD14_Camera_Status: type=FD14_Camera_Status
        FD14_Cntr_ADAS_FD_LANES_1: type=FD14_Cntr_ADAS_FD_LANES_1
        FD14_Cntr_ADAS_FD_LANES_2: type=FD14_Cntr_ADAS_FD_LANES_2
        FD14_FOD_Confidence: type=FD14_FOD_Confidence
        FD14_Frame_Index_Lanes_1: type=FD14_Frame_Index_Lanes_1
        FD14_Frame_Index_Lanes_2: type=FD14_Frame_Index_Lanes_2
        FD14_Health_Front_Object_Detection: type=FD14_Health_Front_Object_Detection
        FD14_Health_Lane_Detection: type=FD14_Health_Lane_Detection
        FD14_Line_1_Confidence: type=FD14_Line_1_Confidence
        FD14_Line_1_Curvature: type=FD14_Line_1_Curvature
        FD14_Line_1_Curvature_Rate: type=FD14_Line_1_Curvature_Rate
        FD14_Line_1_End_Range: type=FD14_Line_1_End_Range
        FD14_Line_1_Heading: type=FD14_Line_1_Heading
        FD14_Line_1_Offset: type=FD14_Line_1_Offset
        FD14_Line_1_Start_Range: type=FD14_Line_1_Start_Range
        FD14_Line_1_Type: type=FD14_Line_1_Type
        FD14_Line_2_Confidence: type=FD14_Line_2_Confidence
        FD14_Line_2_Curvature: type=FD14_Line_2_Curvature
        FD14_Line_2_Curvature_Rate: type=FD14_Line_2_Curvature_Rate
        FD14_Line_2_End_Range: type=FD14_Line_2_End_Range
        FD14_Line_2_Heading: type=FD14_Line_2_Heading
        FD14_Line_2_Offset: type=FD14_Line_2_Offset
        FD14_Line_2_Start_Range: type=FD14_Line_2_Start_Range
        FD14_Line_2_Type: type=FD14_Line_2_Type
        FD14_Line_3_Confidence: type=FD14_Line_3_Confidence
        FD14_Line_3_Curvature: type=FD14_Line_3_Curvature
        FD14_Line_3_Curvature_Rate: type=FD14_Line_3_Curvature_Rate
        FD14_Line_3_End_Range: type=FD14_Line_3_End_Range
        FD14_Line_3_Heading: type=FD14_Line_3_Heading
        FD14_Line_3_Offset: type=FD14_Line_3_Offset
        FD14_Line_3_Start_Range: type=FD14_Line_3_Start_Range
        FD14_Line_3_Type: type=FD14_Line_3_Type
        FD14_Line_4_Confidence: type=FD14_Line_4_Confidence
        FD14_Line_4_Curvature: type=FD14_Line_4_Curvature
        FD14_Line_4_Curvature_Rate: type=FD14_Line_4_Curvature_Rate
        FD14_Line_4_End_Range: type=FD14_Line_4_End_Range
        FD14_Line_4_Heading: type=FD14_Line_4_Heading
        FD14_Line_4_Offset: type=FD14_Line_4_Offset
        FD14_Line_4_Start_Range: type=FD14_Line_4_Start_Range
        FD14_Line_4_Type: type=FD14_Line_4_Type
        FD14_MAC_ADAS_FD_LANES_1: type=FD14_MAC_ADAS_FD_LANES_1
        FD14_MAC_ADAS_FD_LANES_2: type=FD14_MAC_ADAS_FD_LANES_2
        FD14_ParkingManeuverActive: type=FD14_ParkingManeuverActive
        FD14_Reserved_for_functional_safety: type=FD14_Reserved_for_functional_safety
        FD14_Segment_1_Confidence: type=FD14_Segment_1_Confidence
        FD14_Segment_1_ID: type=FD14_Segment_1_ID
        FD14_Segment_1_X1: type=FD14_Segment_1_X1
        FD14_Segment_1_X2: type=FD14_Segment_1_X2
        FD14_Segment_1_Y1: type=FD14_Segment_1_Y1
        FD14_Segment_1_Y2: type=FD14_Segment_1_Y2
        FD14_Segment_2_Confidence: type=FD14_Segment_2_Confidence
        FD14_Segment_2_ID: type=FD14_Segment_2_ID
        FD14_Segment_2_X1: type=FD14_Segment_2_X1
        FD14_Segment_2_X2: type=FD14_Segment_2_X2
        FD14_Segment_2_Y1: type=FD14_Segment_2_Y1
        FD14_Segment_2_Y2: type=FD14_Segment_2_Y2
        FD14_Segment_3_Confidence: type=FD14_Segment_3_Confidence
        FD14_Segment_3_ID: type=FD14_Segment_3_ID
        FD14_Segment_3_X1: type=FD14_Segment_3_X1
        FD14_Segment_3_X2: type=FD14_Segment_3_X2
        FD14_Segment_3_Y1: type=FD14_Segment_3_Y1
        FD14_Segment_3_Y2: type=FD14_Segment_3_Y2
        FD14_Segment_4_Confidence: type=FD14_Segment_4_Confidence
        FD14_Segment_4_ID: type=FD14_Segment_4_ID
        FD14_Segment_4_X1: type=FD14_Segment_4_X1
        FD14_Segment_4_X2: type=FD14_Segment_4_X2
        FD14_Segment_4_Y1: type=FD14_Segment_4_Y1
        FD14_Segment_4_Y2: type=FD14_Segment_4_Y2
        FD14_Segment_5_Confidence: type=FD14_Segment_5_Confidence
        FD14_Segment_5_ID: type=FD14_Segment_5_ID
        FD14_Segment_5_X1: type=FD14_Segment_5_X1
        FD14_Segment_5_X2: type=FD14_Segment_5_X2
        FD14_Segment_5_Y1: type=FD14_Segment_5_Y1
        FD14_Segment_5_Y2: type=FD14_Segment_5_Y2
        FD14_Segment_6_Confidence: type=FD14_Segment_6_Confidence
        FD14_Segment_6_ID: type=FD14_Segment_6_ID
        FD14_Segment_6_X1: type=FD14_Segment_6_X1
        FD14_Segment_6_X2: type=FD14_Segment_6_X2
        FD14_Segment_6_Y1: type=FD14_Segment_6_Y1
        FD14_Segment_6_Y2: type=FD14_Segment_6_Y2
        FD14_Segment_7_Confidence: type=FD14_Segment_7_Confidence
        FD14_Segment_7_ID: type=FD14_Segment_7_ID
        FD14_Segment_7_X1: type=FD14_Segment_7_X1
        FD14_Segment_7_X2: type=FD14_Segment_7_X2
        FD14_Segment_7_Y1: type=FD14_Segment_7_Y1
        FD14_Segment_7_Y2: type=FD14_Segment_7_Y2
        FD14_Segment_8_Confidence: type=FD14_Segment_8_Confidence
        FD14_Segment_8_ID: type=FD14_Segment_8_ID
        FD14_Segment_8_X1: type=FD14_Segment_8_X1
        FD14_Segment_8_X2: type=FD14_Segment_8_X2
        FD14_Segment_8_Y1: type=FD14_Segment_8_Y1
        FD14_Segment_8_Y2: type=FD14_Segment_8_Y2
        FD14_ManoeuvrePhase: type=FD14_ManoeuvrePhase
        FD14_ParkingGearShiftReq: type=FD14_ParkingGearShiftReq
        FD14_PPPA_AccelMax: type=FD14_PPPA_AccelMax
        FD14_PPPA_AccelMin: type=FD14_PPPA_AccelMin
        FD14_PPPA_DecelMax: type=FD14_PPPA_DecelMax
        FD14_PPPA_DecelMin: type=FD14_PPPA_DecelMin
        FD14_PPPA_Interface_BSM: type=FD14_PPPA_Interface_BSM
        FD14_PPPA_JerkAccelMax: type=FD14_PPPA_JerkAccelMax
        FD14_PPPA_JerkAccelMin: type=FD14_PPPA_JerkAccelMin
        FD14_PPPA_JerkDecelMax: type=FD14_PPPA_JerkDecelMax
        FD14_PPPA_JerkDecelMin: type=FD14_PPPA_JerkDecelMin
        FD14_PPPA_MaxSpeed: type=FD14_PPPA_MaxSpeed
        FD14_PPPA_StandstillRqst: type=FD14_PPPA_StandstillRqst
        FD14_PPPA_TargetDistance: type=FD14_PPPA_TargetDistance
        FD14_RR_PAM_Brk_RqSts: type=FD14_RR_PAM_Brk_RqSts
        FD14_RR_PAM_Dist: type=FD14_RR_PAM_Dist
        FD14_SPM_Lat_Ctrl_RequestSts: type=FD14_SPM_Lat_Ctrl_RequestSts
        FD14_TorqueOverlaySteeringReq_SPM: type=FD14_TorqueOverlaySteeringReq_SPM
    IF_ProxiReset
      data ProxiDataflag_b: type=boolean
    IF_FailSafeReaction
      data State: type=boolean
  client server interface IF_ClearDTCSettingStatus
    operation ClearDTCSettingStatus
  4 x sender receiver interface:
    IF_MPUFaultStatus
      data Sts: type=MpuFltSts
    IF_SDLFaultstatus
      data Sts: type=Status
    IF_PMICFaultstatus
      data Sts: type=PmicStatus
    IF_WDGFaultStatus
      data Sts: type=WdgFltSts
  mode switch interface IF_SafetyGuard_SafeState_Mode: is-service=true
    mode group Mode: type=SafetyGuard_BSWM_SafeMode
  client server interface IF_NVM_Write_ProxiConfigTable
    operation ProxiconfigTable_Nvm_write_confirmation
  client server interface IF_SecureAuthenticationStatus
    operation Get_ADAStatus
      arg ADAStatus: type=ADAStatusType, direction=INOUT, server-argument-impl-policy=USE-ARGUMENT-TYPE
  14 x sender receiver interface:
    IF_VcanRxQM
      data ME_VehInp_to_IpcSignals_QM_t: type=ME_VehInp_to_IpcSignals_QM_t
    IF_FailsafeAction
      data FailSafe_State: type=uint8
    IF_SafeState2Reason
      data FaultEnum_u16: type=uint16
    IF_CalibRoutineTrigger
      data routine_b: type=boolean
    IF_FlashSts
      data v_FlashSts_u16: type=uint16
    IF_ResetNvmFlag
      data V_ResetNvmFlag_b: type=boolean
    IF_ToComDbgSafeFD14Tx
      63 x data:
        FD14_1_AliveCntr_MCU2_0: type=FD14_1_AliveCntr_MCU2_0
        FD14_1_AliveCntr_MCU2_1: type=FD14_1_AliveCntr_MCU2_1
        FD14_1_AliveCntr_MPU1_0: type=FD14_1_AliveCntr_MPU1_0
        FD14_1_OsRegMCU_ADFSR: type=FD14_1_OsRegMCU_ADFSR
        FD14_1_OsRegMCU_AIFSR: type=FD14_1_OsRegMCU_AIFSR
        FD14_1_OsRegMCU_DFAR: type=FD14_1_OsRegMCU_DFAR
        FD14_1_OsRegMCU_DFSR: type=FD14_1_OsRegMCU_DFSR
        FD14_1_OsRegMCU_IFAR: type=FD14_1_OsRegMCU_IFAR
        FD14_1_OsRegMCU_IFSR: type=FD14_1_OsRegMCU_IFSR
        FD14_1_OsRegMCU_Link: type=FD14_1_OsRegMCU_Link
        FD14_1_OsRegMCU_SPSR: type=FD14_1_OsRegMCU_SPSR
        FD14_1_OsRegMCU_Stack{0..9}: type=FD14_1_OsRegMCU_Stack{0..9}
        FD14_1_SSM_SystemStateReq: type=FD14_1_SSM_SystemStateReq
        FD14_1_TimeSincePowerON: type=FD14_1_TimeSincePowerON
        FD14_1_Err_FaultInfo_MCU1_0: type=FD14_1_Err_FaultInfo_MCU1_0
        FD14_1_Err_FaultInfo_MCU2_1: type=FD14_1_Err_FaultInfo_MCU2_1
        FD14_1_Err_FaultInfo_MPU1_0: type=FD14_1_Err_FaultInfo_MPU1_0
        FD14_1_Err_FaultNum_MCU1_0: type=FD14_1_Err_FaultNum_MCU1_0
        FD14_1_Err_FaultNum_MCU2_0: type=FD14_1_Err_FaultNum_MCU2_0
        FD14_1_Err_FaultNum_MCU2_1: type=FD14_1_Err_FaultNum_MCU2_1
        FD14_1_Err_FaultNum_MPU1_0: type=FD14_1_Err_FaultNum_MPU1_0
        FD14_1_ErrFaultInfo_MCU2_0: type=FD14_1_ErrFaultInfo_MCU2_0
        FD14_1_Reserved_MCU1_0: type=FD14_1_Reserved_MCU1_0
        FD14_1_Reserved_MCU2_0: type=FD14_1_Reserved_MCU2_0
        FD14_1_Reserved_MCU2_1: type=FD14_1_Reserved_MCU2_1
        FD14_1_Reserved_MPU1_0: type=FD14_1_Reserved_MPU1_0
        FD14_1_SDL_Fault_MCU1_0: type=FD14_1_SDL_Fault_MCU1_0
        FD14_1_SSM_FltData1_MCU1_0: type=FD14_1_SSM_FltData1_MCU1_0
        FD14_1_SSM_FltData{10..18}_MCU1_0: type=FD14_1_SSM_FltData{10..18}_MCU1_0
        FD14_1_SSM_FltData{2..9}_MCU1_0: type=FD14_1_SSM_FltData{2..9}_MCU1_0
        FD14_1_WDG_Error_ID_MCU1_0: type=FD14_1_WDG_Error_ID_MCU1_0
        FD14_1_Hook_actTsk_MCU1_0: type=FD14_1_Hook_actTsk_MCU1_0
        FD14_1_Hook_DtErr_MCU1_0: type=FD14_1_Hook_DtErr_MCU1_0
        FD14_1_Hook_Error_MCU1_0: type=FD14_1_Hook_Error_MCU1_0
        FD14_1_Hook_fatalErr_MCU1_0: type=FD14_1_Hook_fatalErr_MCU1_0
        FD14_1_Hook_PresentPtr_MCU1_0: type=FD14_1_Hook_PresentPtr_MCU1_0
        FD14_1_Hook_Reserved_MCU1_0: type=FD14_1_Hook_Reserved_MCU1_0
        FD14_1_Hook_Service_MCU1_0: type=FD14_1_Hook_Service_MCU1_0
        FD14_1_Hook_Type_MCU1_0: type=FD14_1_Hook_Type_MCU1_0
    IF_BusOffIndication
      data V_BusOffIndicationFlagRte_u8: type=uint8
    IF_DtcB12852AData
      data v_DtcData_u8: type=uint8
    IF_NmStateInfo
      data v_IsNmStateNormal_b: type=boolean
    IF_PlantOdoData
      data PlantOdoData: type=uint16
    IF_VIN_MessageFault
      data VIN_MissingMessageFlag: type=boolean
      data VIN_InvalidValueFlag: type=boolean
    IF_CalibRoutineType
      data value: type=uint8
    BswM_SRI_BswM_MSI_CalDataProSCCalStatus_BswM_MDGP_CalDataProSCCalStatus: is-service=true
      data requestedMode: type=BswM_CalDataProSCCalStatus
  client server interface IF_IntrinsicCameraSN
    operation Readblock: possible-error=[E_OK, IF_IntrinsicCameraSN/E_NOT_OK, E_OK, IF_IntrinsicCameraSN/E_NOT_OK]
      arg CamNvmData: type=IntrinsicCamID, direction=OUT, server-argument-impl-policy=USE-ARGUMENT-TYPE
      arg NvmCamSts: type=CamNvmReadSts, direction=OUT, server-argument-impl-policy=USE-ARGUMENT-TYPE
    error E_OK: error-code=0
    error E_NOT_OK: error-code=1
  client server interface IF_RunTimeStat_CSData
    operation Cdd_RunTimeStatQM_GetData
      arg runTimeDataVoid: type=RunTimeStatData, direction=OUT, server-argument-impl-policy=USE-ARGUMENT-TYPE
  5 x sender receiver interface:
    IF_PerformanceStatsEnable
      data RunTimeStatsEnable: type=boolean
      data StackUsageStatsEnable: type=boolean
    IF_RunTimeStats_MCU2_0
      data RunTimeStats_MCU2_0_t: type=RunTimeStats_MCU2_0_t
    IF_RunTimeStats_MPU1_0
      data RunTimeStats_MPU1_0_t: type=RunTimeStats_MPU1_0_t
    IF_RunTimeStats_MCU2_1
      data RunTimeStats_MCU2_1_t: type=RunTimeStats_MCU2_1_t
    IF_UssTunningData_mcu2_1
      data UssTunningData_mcu2_1_t: type=UssTunningData_mcu2_1_t
  mode switch interface IF_ModeProgPreconditionCheck: is-service=true
    mode group ModeProgPreconditionCheck: type=ProgPreconditionState
  sender receiver interface IF_PreviousCamData
    data Data: type=CDP_TbSVS_S_SVSCamCurrentCalibData_t
  client server interface IF_GetTaskStackUsage
    operation Data
      arg Stackusage: type=StackData_MCU1_0, direction=OUT, server-argument-impl-policy=USE-ARGUMENT-TYPE
  sender receiver interface IF_StackUsage_MCU2_1
    data StackUsage_MCU2_1_t: type=StackUsage_MCU2_1_t
  sender receiver interface IF_StackUsage_MCU2_0
    data StackUsage_MCU2_0_t: type=StackUsage_MCU2_0_t
  sender receiver interface IF_PAM2BTIpcTxStatus
    data IpcTxDone: type=boolean
