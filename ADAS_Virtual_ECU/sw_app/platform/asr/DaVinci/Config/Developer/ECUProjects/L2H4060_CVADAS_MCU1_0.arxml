[part 1 of 2: package /VehicleProject]
AUTOSAR XML (schema 00050)
package /VehicleProject
  system System
    system mapping System_MPPNG
      data-mappings:
        data-element=RpFromComSafeFD02Rx.PdlPosActual, system-signal=PdlPosActual
        data-element=RpFromComSafeFD02Rx.ASCM_Stat, system-signal=ASCM_Stat
        data-element=RpFromComSafeFD02Rx.ASCM_SysFail, system-signal=ASCM_SysFail
        data-element=RpFromComSafeFD02Rx.ECM_THA_Resp, system-signal=ECM_THA_Resp
        data-element=RpFromComSafeFD02Rx.ECM_TRSC_Resp, system-signal=ECM_TRSC_Resp
        data-element=RpFromComSafeFD02Rx.EngineSts_W, system-signal=EngineSts_W
        data-element=RpFromComSafeFD02Rx.ESS_ENG_ST_W, system-signal=ESS_ENG_ST_W
        data-element=RpFromComSafeFD02Rx.FL_Lvl, system-signal=FL_Lvl
        data-element=RpFromComSafeFD02Rx.FL_Lvl_Adj, system-signal=FL_Lvl_Adj
        data-element=RpFromComSafeFD02Rx.FR_Lvl, system-signal=FR_Lvl
        data-element=RpFromComSafeFD02Rx.FR_Lvl_Adj, system-signal=FR_Lvl_Adj
        data-element=RpFromComSafeFD02Rx.GearEngagedForDisplay, system-signal=GearEngagedForDisplay
        data-element=RpFromComSafeFD02Rx.HU_TRSC_EnableBtn_Sts, system-signal=HU_TRSC_EnableBtn_Sts
        data-element=RpFromComSafeFD02Rx.RL_Lvl, system-signal=RL_Lvl
        data-element=RpFromComSafeFD02Rx.RL_Lvl_Adj, system-signal=RL_Lvl_Adj
        data-element=RpFromComSafeFD02Rx.RR_Lvl, system-signal=RR_Lvl
        data-element=RpFromComSafeFD02Rx.RR_Lvl_Adj, system-signal=RR_Lvl_Adj
        data-element=RpFromComSafeFD02Rx.VIN_DATA, system-signal=VIN_DATA
        data-element=RpFromComSafeFD02Rx.VIN_MSG, system-signal=VIN_MSG
        data-element=RpFromComSafeFD02Rx.Active_Park_Mode, system-signal=Active_Park_Mode
        data-element=RpFromComSafeFD02Rx.Active_Park_Prox_Chime, system-signal=Active_Park_Prox_Chime
        data-element=RpFromComSafeFD02Rx.APARequestSts, system-signal=APARequestSts
        data-element=RpFromComSafeFD02Rx.Backup_Cam_Delay, system-signal=Backup_Cam_Delay
        data-element=RpFromComSafeFD02Rx.Brk_Stat, system-signal=Brk_Stat
        data-element=RpFromComSafeFD02Rx.CmdIgnSts, system-signal=CmdIgnSts
        data-element=RpFromComSafeFD02Rx.DriverDoorSts, system-signal=DriverDoorSts
        data-element=RpFromComSafeFD02Rx.DynamicGrid, system-signal=DynamicGrid
        data-element=RpFromComSafeFD02Rx.ExternalTemperature, system-signal=ExternalTemperature
        data-element=RpFromComSafeFD02Rx.FT_PAMRequestSts, system-signal=FT_PAMRequestSts
        data-element=RpFromComSafeFD02Rx.Fwrd_Cam_Guidelines, system-signal=Fwrd_Cam_Guidelines
        data-element=RpFromComSafeFD02Rx.GearEngaged, system-signal=GearEngaged
        data-element=RpFromComSafeFD02Rx.HAS_Status_C2, system-signal=HAS_Status_C2
        data-element=RpFromComSafeFD02Rx.LanguageSelection, system-signal=LanguageSelection
        data-element=RpFromComSafeFD02Rx.LatAcceleration_BSM, system-signal=LatAcceleration_BSM
        data-element=RpFromComSafeFD02Rx.LHRDoorSts, system-signal=LHRDoorSts
        data-element=RpFromComSafeFD02Rx.LongAcceleration_BSM, system-signal=LongAcceleration_BSM
        data-element=RpFromComSafeFD02Rx.LwsAngle, system-signal=LwsAngle
        data-element=RpFromComSafeFD02Rx.LwsAngleType, system-signal=LwsAngleType
        data-element=RpFromComSafeFD02Rx.LwsSpeed, system-signal=LwsSpeed
        data-element=RpFromComSafeFD02Rx.MRM_STATUS_C2, system-signal=MRM_STATUS_C2
        data-element=RpFromComSafeFD02Rx.PamChimeVolumeFront, system-signal=PamChimeVolumeFront
        data-element=RpFromComSafeFD02Rx.PamChimeVolumeRear, system-signal=PamChimeVolumeRear
        data-element=RpFromComSafeFD02Rx.PAMRequestSts, system-signal=PAMRequestSts
        data-element=RpFromComSafeFD02Rx.PsngrDoorSts, system-signal=PsngrDoorSts
        data-element=RpFromComSafeFD02Rx.Rear_Brk_Asst, system-signal=Rear_Brk_Asst
        data-element=RpFromComSafeFD02Rx.RHatchSts, system-signal=RHatchSts
        data-element=RpFromComSafeFD02Rx.RHRDoorSts, system-signal=RHRDoorSts
        data-element=RpFromComSafeFD02Rx.ShiftLeverPosition, system-signal=ShiftLeverPosition
        data-element=RpFromComSafeFD02Rx.SVC_Guidelines, system-signal=SVC_Guidelines
        data-element=RpFromComSafeFD02Rx.TargetGear, system-signal=TargetGear
        data-element=RpFromComSafeFD02Rx.TCASERANGESTATUS, system-signal=TCASERANGESTATUS
        data-element=RpFromComSafeFD02Rx.TGW_CAMERA_DISP_STAT, system-signal=TGW_CAMERA_DISP_STAT
        data-element=RpFromComSafeFD02Rx.TrailerConnectionSts, system-signal=TrailerConnectionSts
        data-element=RpFromComSafeFD02Rx.TRANS_ADAS_Inhibit, system-signal=TRANS_ADAS_Inhibit
        data-element=RpFromComSafeFD02Rx.TransmissionSailingSts, system-signal=TransmissionSailingSts
        data-element=RpFromComSafeFD02Rx.VehicleSpeedVSOSig, system-signal=VehicleSpeedVSOSig
        data-element=RpFromComSafeFD02Rx.YawRate_BSM, system-signal=YawRate_BSM
        data-element=RpFromComSafeFD02Rx.CameraDisplaySts2, system-signal=CameraDisplaySts2
        data-element=RpFromComSafeFD02Rx.CM_TCH_STAT, system-signal=CM_TCH_STAT
        data-element=RpFromComSafeFD02Rx.CM_TCH_X_COORD, system-signal=CM_TCH_X_COORD
        data-element=RpFromComSafeFD02Rx.CM_TCH_Y_COORD, system-signal=CM_TCH_Y_COORD
        data-element=RpFromComSafeFD02Rx.ITBM_TrlrStat, system-signal=ITBM_TrlrStat
        data-element=RpFromComSafeFD02Rx.Shifter_ADAS_Inhibit, system-signal=Shifter_ADAS_Inhibit
        data-element=RpFromComSafeFD02Rx.ShiftLeverPositionReq, system-signal=ShiftLeverPositionReq
        data-element=RpFromComSafeFD02Rx.EPS_SteeringTouchStat, system-signal=EPS_SteeringTouchStat
        data-element=RpFromComSafeFD02Rx.EPS_SteeringTouq_Resp, system-signal=EPS_SteeringTouq_Resp
        data-element=RpFromComSafeFD02Rx.EPS_THA_DriverTorqueOverride, system-signal=EPS_THA_DriverTorqueOverride
        data-element=RpFromComSafeFD02Rx.EPS_THA_SteeringTorqueResp, system-signal=EPS_THA_SteeringTorqueResp
        data-element=RpFromComSafeFD02Rx.THA_SteeringTouchStat, system-signal=THA_SteeringTouchStat
        data-element=RpFromComFD02Rx.Altitude_RMSE_C2, system-signal=Altitude_RMSE_C2
        data-element=RpFromComFD02Rx.Battery_Volt_1, system-signal=Battery_Volt_1
        data-element=RpFromComFD02Rx.BSM_THA_Brk_Resp, system-signal=BSM_THA_Brk_Resp
        data-element=RpFromComFD02Rx.CurrentCanNMState_FD01_BCM, system-signal=CurrentCanNMState_FD01_BCM
        data-element=RpFromComFD02Rx.CurrentCanNMState_FD01_SGW, system-signal=CurrentCanNMState_FD01_SGW
        data-element=RpFromComFD02Rx.CurrentCanNMState_FD02_BCM, system-signal=CurrentCanNMState_FD02_BCM
        data-element=RpFromComFD02Rx.CurrentCanNMState_FD02_BSM2, system-signal=CurrentCanNMState_FD02_BSM2
        data-element=RpFromComFD02Rx.CurrentCanNMState_FD02_CADM2, system-signal=CurrentCanNMState_FD02_CADM2
        data-element=RpFromComFD02Rx.CurrentCanNMState_FD02_EPS, system-signal=CurrentCanNMState_FD02_EPS
        data-element=RpFromComFD02Rx.CurrentCanNMState_FD02_ORC, system-signal=CurrentCanNMState_FD02_ORC
        data-element=RpFromComFD02Rx.CurrentCanNMState_FD02_SGW, system-signal=CurrentCanNMState_FD02_SGW
        data-element=RpFromComFD02Rx.CurrentCanNMState_FD02_TRLR_REV, system-signal=CurrentCanNMState_FD02_TRLR_REV
        data-element=RpFromComFD02Rx.CurrentCanNMState_FD03_BCM, system-signal=CurrentCanNMState_FD03_BCM
        data-element=RpFromComFD02Rx.CurrentCanNMState_FD03_SGW, system-signal=CurrentCanNMState_FD03_SGW
        data-element=RpFromComFD02Rx.CurrentCanNMState_FD04_BCM, system-signal=CurrentCanNMState_FD04_BCM
        data-element=RpFromComFD02Rx.CurrentCanNMState_FD08_SGW, system-signal=CurrentCanNMState_FD08_SGW
        data-element=RpFromComFD02Rx.CurrentCanNMState_FD11_SGW, system-signal=CurrentCanNMState_FD11_SGW
        data-element=RpFromComFD02Rx.CurrentFailSts_FD01_BCM, system-signal=CurrentFailSts_FD01_BCM
        data-element=RpFromComFD02Rx.CurrentFailSts_FD01_SGW, system-signal=CurrentFailSts_FD01_SGW
        data-element=RpFromComFD02Rx.CurrentFailSts_FD02_BCM, system-signal=CurrentFailSts_FD02_BCM
        data-element=RpFromComFD02Rx.CurrentFailSts_FD02_BSM2, system-signal=CurrentFailSts_FD02_BSM2
        data-element=RpFromComFD02Rx.CurrentFailSts_FD02_CADM2, system-signal=CurrentFailSts_FD02_CADM2
        data-element=RpFromComFD02Rx.CurrentFailSts_FD02_EPS, system-signal=CurrentFailSts_FD02_EPS
        data-element=RpFromComFD02Rx.CurrentFailSts_FD02_ORC, system-signal=CurrentFailSts_FD02_ORC
        data-element=RpFromComFD02Rx.CurrentFailSts_FD02_SGW, system-signal=CurrentFailSts_FD02_SGW
        data-element=RpFromComFD02Rx.CurrentFailSts_FD02_TRLR_REV, system-signal=CurrentFailSts_FD02_TRLR_REV
        data-element=RpFromComFD02Rx.CurrentFailSts_FD03_BCM, system-signal=CurrentFailSts_FD03_BCM
        data-element=RpFromComFD02Rx.CurrentFailSts_FD03_SGW, system-signal=CurrentFailSts_FD03_SGW
        data-element=RpFromComFD02Rx.CurrentFailSts_FD04_BCM, system-signal=CurrentFailSts_FD04_BCM
        data-element=RpFromComFD02Rx.CurrentFailSts_FD08_SGW, system-signal=CurrentFailSts_FD08_SGW
        data-element=RpFromComFD02Rx.CurrentFailSts_FD11_SGW, system-signal=CurrentFailSts_FD11_SGW
        data-element=RpFromComFD02Rx.DeltaTimestamp_IMUdata, system-signal=DeltaTimestamp_IMUdata
        data-element=RpFromComFD02Rx.DES_FD01_BCM, system-signal=DES_FD01_BCM
        data-element=RpFromComFD02Rx.DES_FD01_SGW, system-signal=DES_FD01_SGW
        data-element=RpFromComFD02Rx.DES_FD02_BCM, system-signal=DES_FD02_BCM
        data-element=RpFromComFD02Rx.DES_FD02_BSM2, system-signal=DES_FD02_BSM2
        data-element=RpFromComFD02Rx.DES_FD02_CADM2, system-signal=DES_FD02_CADM2
        data-element=RpFromComFD02Rx.DES_FD02_EPS, system-signal=DES_FD02_EPS
        data-element=RpFromComFD02Rx.DES_FD02_ORC, system-signal=DES_FD02_ORC
        data-element=RpFromComFD02Rx.DES_FD02_SGW, system-signal=DES_FD02_SGW
        data-element=RpFromComFD02Rx.DES_FD02_TRLR_REV, system-signal=DES_FD02_TRLR_REV
        data-element=RpFromComFD02Rx.DES_FD03_BCM, system-signal=DES_FD03_BCM
        data-element=RpFromComFD02Rx.DES_FD03_SGW, system-signal=DES_FD03_SGW
        data-element=RpFromComFD02Rx.DES_FD04_BCM, system-signal=DES_FD04_BCM
        data-element=RpFromComFD02Rx.DES_FD08_SGW, system-signal=DES_FD08_SGW
        data-element=RpFromComFD02Rx.DES_FD11_SGW, system-signal=DES_FD11_SGW
        data-element=RpFromComFD02Rx.Digit_{01..11}, system-signal=Digit_{01..11}
        data-element=RpFromComFD02Rx.EOL_FD01_BCM, system-signal=EOL_FD01_BCM
        data-element=RpFromComFD02Rx.EOL_FD01_SGW, system-signal=EOL_FD01_SGW
        data-element=RpFromComFD02Rx.EOL_FD02_BCM, system-signal=EOL_FD02_BCM
        data-element=RpFromComFD02Rx.EOL_FD02_BSM2, system-signal=EOL_FD02_BSM2
        data-element=RpFromComFD02Rx.EOL_FD02_CADM2, system-signal=EOL_FD02_CADM2
        data-element=RpFromComFD02Rx.EOL_FD02_EPS, system-signal=EOL_FD02_EPS
        data-element=RpFromComFD02Rx.EOL_FD02_ORC, system-signal=EOL_FD02_ORC
        data-element=RpFromComFD02Rx.EOL_FD02_SGW, system-signal=EOL_FD02_SGW
        data-element=RpFromComFD02Rx.EOL_FD02_TRLR_REV, system-signal=EOL_FD02_TRLR_REV
        data-element=RpFromComFD02Rx.EOL_FD03_BCM, system-signal=EOL_FD03_BCM
        data-element=RpFromComFD02Rx.EOL_FD03_SGW, system-signal=EOL_FD03_SGW
        data-element=RpFromComFD02Rx.EOL_FD04_BCM, system-signal=EOL_FD04_BCM
        data-element=RpFromComFD02Rx.EOL_FD08_SGW, system-signal=EOL_FD08_SGW
        data-element=RpFromComFD02Rx.EOL_FD11_SGW, system-signal=EOL_FD11_SGW
        data-element=RpFromComFD02Rx.EPBSts, system-signal=EPBSts
        data-element=RpFromComFD02Rx.GenericFailSts_FD01_BCM, system-signal=GenericFailSts_FD01_BCM
        data-element=RpFromComFD02Rx.GenericFailSts_FD01_SGW, system-signal=GenericFailSts_FD01_SGW
        data-element=RpFromComFD02Rx.GenericFailSts_FD02_BCM, system-signal=GenericFailSts_FD02_BCM
        data-element=RpFromComFD02Rx.GenericFailSts_FD02_BSM2, system-signal=GenericFailSts_FD02_BSM2
        data-element=RpFromComFD02Rx.GenericFailSts_FD02_CADM2, system-signal=GenericFailSts_FD02_CADM2
        data-element=RpFromComFD02Rx.GenericFailSts_FD02_EPS, system-signal=GenericFailSts_FD02_EPS
        data-element=RpFromComFD02Rx.GenericFailSts_FD02_ORC, system-signal=GenericFailSts_FD02_ORC
        data-element=RpFromComFD02Rx.GenericFailSts_FD02_SGW, system-signal=GenericFailSts_FD02_SGW
        data-element=RpFromComFD02Rx.GenericFailSts_FD02_TRLR_REV, system-signal=GenericFailSts_FD02_TRLR_REV
        data-element=RpFromComFD02Rx.GenericFailSts_FD03_BCM, system-signal=GenericFailSts_FD03_BCM
        data-element=RpFromComFD02Rx.GenericFailSts_FD03_SGW, system-signal=GenericFailSts_FD03_SGW
        data-element=RpFromComFD02Rx.GenericFailSts_FD04_BCM, system-signal=GenericFailSts_FD04_BCM
        data-element=RpFromComFD02Rx.GenericFailSts_FD08_SGW, system-signal=GenericFailSts_FD08_SGW
        data-element=RpFromComFD02Rx.GenericFailSts_FD11_SGW, system-signal=GenericFailSts_FD11_SGW
        data-element=RpFromComFD02Rx.Heading_Angle_C2, system-signal=Heading_Angle_C2
        data-element=RpFromComFD02Rx.IgnitionOnCounter, system-signal=IgnitionOnCounter
        data-element=RpFromComFD02Rx.LatAcceleration_C2, system-signal=LatAcceleration_C2
        data-element=RpFromComFD02Rx.LatAccelerationOffset_BSM, system-signal=LatAccelerationOffset_BSM
        data-element=RpFromComFD02Rx.Latitude_RMSE_C2, system-signal=Latitude_RMSE_C2
        data-element=RpFromComFD02Rx.LHF_FastPulseCounter, system-signal=LHF_FastPulseCounter
        data-element=RpFromComFD02Rx.LHF_Spin, system-signal=LHF_Spin
        data-element=RpFromComFD02Rx.LHFWheelSpeed, system-signal=LHFWheelSpeed
        data-element=RpFromComFD02Rx.LHR_FastPulseCounter, system-signal=LHR_FastPulseCounter
        data-element=RpFromComFD02Rx.LHR_Spin, system-signal=LHR_Spin
        data-element=RpFromComFD02Rx.LHRWheelSpeed, system-signal=LHRWheelSpeed
        data-element=RpFromComFD02Rx.LongAcceleration_C2, system-signal=LongAcceleration_C2
        data-element=RpFromComFD02Rx.LongAccelerationOffset_BSM, system-signal=LongAccelerationOffset_BSM
        data-element=RpFromComFD02Rx.Longitude_RMSE_C2, system-signal=Longitude_RMSE_C2
        data-element=RpFromComFD02Rx.OperationalModeSts, system-signal=OperationalModeSts
        data-element=RpFromComFD02Rx.Pitch_RMSE_C2, system-signal=Pitch_RMSE_C2
        data-element=RpFromComFD02Rx.PitchRate_C2, system-signal=PitchRate_C2
        data-element=RpFromComFD02Rx.PreviousCanNMState_FD01_BCM, system-signal=PreviousCanNMState_FD01_BCM
        data-element=RpFromComFD02Rx.PreviousCanNMState_FD01_SGW, system-signal=PreviousCanNMState_FD01_SGW
        data-element=RpFromComFD02Rx.PreviousCanNMState_FD02_BCM, system-signal=PreviousCanNMState_FD02_BCM
        data-element=RpFromComFD02Rx.PreviousCanNMState_FD02_BSM2, system-signal=PreviousCanNMState_FD02_BSM2
        data-element=RpFromComFD02Rx.PreviousCanNMState_FD02_CADM2, system-signal=PreviousCanNMState_FD02_CADM2
        data-element=RpFromComFD02Rx.PreviousCanNMState_FD02_EPS, system-signal=PreviousCanNMState_FD02_EPS
        data-element=RpFromComFD02Rx.PreviousCanNMState_FD02_ORC, system-signal=PreviousCanNMState_FD02_ORC
        data-element=RpFromComFD02Rx.PreviousCanNMState_FD02_SGW, system-signal=PreviousCanNMState_FD02_SGW
        data-element=RpFromComFD02Rx.PreviousCanNMState_FD02_TRLR_REV, system-signal=PreviousCanNMState_FD02_TRLR_REV
        data-element=RpFromComFD02Rx.PreviousCanNMState_FD03_BCM, system-signal=PreviousCanNMState_FD03_BCM
        data-element=RpFromComFD02Rx.PreviousCanNMState_FD03_SGW, system-signal=PreviousCanNMState_FD03_SGW
        data-element=RpFromComFD02Rx.PreviousCanNMState_FD04_BCM, system-signal=PreviousCanNMState_FD04_BCM
        data-element=RpFromComFD02Rx.PreviousCanNMState_FD08_SGW, system-signal=PreviousCanNMState_FD08_SGW
        data-element=RpFromComFD02Rx.PreviousCanNMState_FD11_SGW, system-signal=PreviousCanNMState_FD11_SGW
        data-element=RpFromComFD02Rx.REF_VEH_SPEED, system-signal=REF_VEH_SPEED
        data-element=RpFromComFD02Rx.RemStActvSts, system-signal=RemStActvSts
        data-element=RpFromComFD02Rx.RHF_FastPulseCounter, system-signal=RHF_FastPulseCounter
        data-element=RpFromComFD02Rx.RHF_Spin, system-signal=RHF_Spin
        data-element=RpFromComFD02Rx.RHFWheelSpeed, system-signal=RHFWheelSpeed
        data-element=RpFromComFD02Rx.RHR_FastPulseCounter, system-signal=RHR_FastPulseCounter
        data-element=RpFromComFD02Rx.RHR_Spin, system-signal=RHR_Spin
        data-element=RpFromComFD02Rx.RHRWheelSpeed, system-signal=RHRWheelSpeed
        data-element=RpFromComFD02Rx.Roll_RMSE_C2, system-signal=Roll_RMSE_C2
        data-element=RpFromComFD02Rx.RollRate_C2, system-signal=RollRate_C2
        data-element=RpFromComFD02Rx.SBR1RowDriverSeatSts, system-signal=SBR1RowDriverSeatSts
        data-element=RpFromComFD02Rx.StayActiveSource_FD01_BCM, system-signal=StayActiveSource_FD01_BCM
        data-element=RpFromComFD02Rx.StayActiveSource_FD01_SGW, system-signal=StayActiveSource_FD01_SGW
        data-element=RpFromComFD02Rx.StayActiveSource_FD02_BCM, system-signal=StayActiveSource_FD02_BCM
        data-element=RpFromComFD02Rx.StayActiveSource_FD02_BSM2, system-signal=StayActiveSource_FD02_BSM2
        data-element=RpFromComFD02Rx.StayActiveSource_FD02_CADM2, system-signal=StayActiveSource_FD02_CADM2
        data-element=RpFromComFD02Rx.StayActiveSource_FD02_EPS, system-signal=StayActiveSource_FD02_EPS
        data-element=RpFromComFD02Rx.StayActiveSource_FD02_ORC, system-signal=StayActiveSource_FD02_ORC
        data-element=RpFromComFD02Rx.StayActiveSource_FD02_SGW, system-signal=StayActiveSource_FD02_SGW
        data-element=RpFromComFD02Rx.StayActiveSource_FD02_TRLR_REV, system-signal=StayActiveSource_FD02_TRLR_REV
        data-element=RpFromComFD02Rx.StayActiveSource_FD03_BCM, system-signal=StayActiveSource_FD03_BCM
        data-element=RpFromComFD02Rx.StayActiveSource_FD03_SGW, system-signal=StayActiveSource_FD03_SGW
        data-element=RpFromComFD02Rx.StayActiveSource_FD04_BCM, system-signal=StayActiveSource_FD04_BCM
        data-element=RpFromComFD02Rx.StayActiveSource_FD08_SGW, system-signal=StayActiveSource_FD08_SGW
        data-element=RpFromComFD02Rx.StayActiveSource_FD11_SGW, system-signal=StayActiveSource_FD11_SGW
        data-element=RpFromComFD02Rx.TotalOdometer, system-signal=TotalOdometer
        data-element=RpFromComFD02Rx.TRSC_CenterBtn_Sts, system-signal=TRSC_CenterBtn_Sts
        data-element=RpFromComFD02Rx.TRSC_EnableBtn_Sts, system-signal=TRSC_EnableBtn_Sts
        data-element=RpFromComFD02Rx.TRSC_RawKnob, system-signal=TRSC_RawKnob
        data-element=RpFromComFD02Rx.TurnIndicatorSts, system-signal=TurnIndicatorSts
        data-element=RpFromComFD02Rx.VehicleStandStillSts, system-signal=VehicleStandStillSts
        data-element=RpFromComFD02Rx.VerticalAcceleration_C2, system-signal=VerticalAcceleration_C2
        data-element=RpFromComFD02Rx.WakeupSource_FD01_ADCM, system-signal=WakeupSource_FD01_ADCM
        data-element=RpFromComFD02Rx.WakeupSource_FD01_BCM, system-signal=WakeupSource_FD01_BCM
        data-element=RpFromComFD02Rx.WakeupSource_FD01_SGW, system-signal=WakeupSource_FD01_SGW
        data-element=RpFromComFD02Rx.WakeupSource_FD02_BCM, system-signal=WakeupSource_FD02_BCM
        data-element=RpFromComFD02Rx.WakeupSource_FD02_BSM2, system-signal=WakeupSource_FD02_BSM2
        data-element=RpFromComFD02Rx.WakeupSource_FD02_CADM2, system-signal=WakeupSource_FD02_CADM2
        data-element=RpFromComFD02Rx.WakeupSource_FD02_EPS, system-signal=WakeupSource_FD02_EPS
        data-element=RpFromComFD02Rx.WakeupSource_FD02_ORC, system-signal=WakeupSource_FD02_ORC
        data-element=RpFromComFD02Rx.WakeupSource_FD02_SGW, system-signal=WakeupSource_FD02_SGW
        data-element=RpFromComFD02Rx.WakeupSource_FD02_TRLR_REV, system-signal=WakeupSource_FD02_TRLR_REV
        data-element=RpFromComFD02Rx.WakeupSource_FD03_BCM, system-signal=WakeupSource_FD03_BCM
        data-element=RpFromComFD02Rx.WakeupSource_FD03_SGW, system-signal=WakeupSource_FD03_SGW
        data-element=RpFromComFD02Rx.WakeupSource_FD04_BCM, system-signal=WakeupSource_FD04_BCM
        data-element=RpFromComFD02Rx.WakeupSource_FD08_SGW, system-signal=WakeupSource_FD08_SGW
        data-element=RpFromComFD02Rx.WakeupSource_FD11_SGW, system-signal=WakeupSource_FD11_SGW
        data-element=RpFromComFD02Rx.YawRate_C2, system-signal=YawRate_C2
        data-element=RpFromComFD02Rx.YawRate_RMSE_C2, system-signal=YawRate_RMSE_C2
        data-element=RpFromComSafeFD14Rx.FD14_ECM_THA_Resp, system-signal=FD14_ECM_THA_Resp
        data-element=RpFromComSafeFD14Rx.FD14_ECM_TRSC_Resp, system-signal=FD14_ECM_TRSC_Resp
        data-element=RpFromComSafeFD14Rx.FD14_EngineSts_W, system-signal=FD14_EngineSts_W
        data-element=RpFromComSafeFD14Rx.FD14_ESS_ENG_ST_W, system-signal=FD14_ESS_ENG_ST_W
        data-element=RpFromComSafeFD14Rx.FD14_ACC_Systemsts, system-signal=FD14_ACC_Systemsts
        data-element=RpFromComSafeFD14Rx.FD14_Brk_Stat, system-signal=FD14_Brk_Stat
        data-element=RpFromComSafeFD14Rx.FD14_BrkPdl_Stat, system-signal=FD14_BrkPdl_Stat
        data-element=RpFromComSafeFD14Rx.FD14_BrkTrq, system-signal=FD14_BrkTrq
        data-element=RpFromComSafeFD14Rx.FD14_BrkTrq_Driver, system-signal=FD14_BrkTrq_Driver
        data-element=RpFromComSafeFD14Rx.FD14_BSM_THA_Brk_Resp, system-signal=FD14_BSM_THA_Brk_Resp
        data-element=RpFromComSafeFD14Rx.FD14_EPBSts, system-signal=FD14_EPBSts
        data-element=RpFromComSafeFD14Rx.FD14_EPS_HandsOnRecognition, system-signal=FD14_EPS_HandsOnRecognition
        data-element=RpFromComSafeFD14Rx.FD14_ESC_TRSC_Brk_Resp, system-signal=FD14_ESC_TRSC_Brk_Resp
        data-element=RpFromComSafeFD14Rx.FD14_ExternalBrkRequestsDisabled, system-signal=FD14_ExternalBrkRequestsDisabled
        data-element=RpFromComSafeFD14Rx.FD14_HAS_Status, system-signal=FD14_HAS_Status
        data-element=RpFromComSafeFD14Rx.FD14_LatAcceleration_BSM, system-signal=FD14_LatAcceleration_BSM
        data-element=RpFromComSafeFD14Rx.FD14_LatAccelerationFailSts_BSM, system-signal=FD14_LatAccelerationFailSts_BSM
        data-element=RpFromComSafeFD14Rx.FD14_LatAccelerationOffset_BSM, system-signal=FD14_LatAccelerationOffset_BSM
        data-element=RpFromComSafeFD14Rx.FD14_LHF_FastPulseCounter, system-signal=FD14_LHF_FastPulseCounter
        data-element=RpFromComSafeFD14Rx.FD14_LHF_Spin, system-signal=FD14_LHF_Spin
        data-element=RpFromComSafeFD14Rx.FD14_LHF_WheelSensorFailSts, system-signal=FD14_LHF_WheelSensorFailSts
        data-element=RpFromComSafeFD14Rx.FD14_LHFWheelSpeed, system-signal=FD14_LHFWheelSpeed
        data-element=RpFromComSafeFD14Rx.FD14_LHR_FastPulseCounter, system-signal=FD14_LHR_FastPulseCounter
        data-element=RpFromComSafeFD14Rx.FD14_LHR_Spin, system-signal=FD14_LHR_Spin
        data-element=RpFromComSafeFD14Rx.FD14_LHR_WheelSensorFailSts, system-signal=FD14_LHR_WheelSensorFailSts
        data-element=RpFromComSafeFD14Rx.FD14_LHRWheelSpeed, system-signal=FD14_LHRWheelSpeed
        data-element=RpFromComSafeFD14Rx.FD14_LongAcceleration_BSM, system-signal=FD14_LongAcceleration_BSM
        data-element=RpFromComSafeFD14Rx.FD14_LongAccelerationFailSts_BSM, system-signal=FD14_LongAccelerationFailSts_BSM
        data-element=RpFromComSafeFD14Rx.FD14_LongAccelerationOffset_BSM, system-signal=FD14_LongAccelerationOffset_BSM
        data-element=RpFromComSafeFD14Rx.FD14_LwsAngle, system-signal=FD14_LwsAngle
        data-element=RpFromComSafeFD14Rx.FD14_LwsAngleType, system-signal=FD14_LwsAngleType
        data-element=RpFromComSafeFD14Rx.FD14_LwsSpeed, system-signal=FD14_LwsSpeed
        data-element=RpFromComSafeFD14Rx.FD14_PAM_Brk_Rq_RspSts, system-signal=FD14_PAM_Brk_Rq_RspSts
        data-element=RpFromComSafeFD14Rx.FD14_ParkingGearShiftReq_BSM, system-signal=FD14_ParkingGearShiftReq_BSM
        data-element=RpFromComSafeFD14Rx.FD14_ParkingInterventionSts, system-signal=FD14_ParkingInterventionSts
        data-element=RpFromComSafeFD14Rx.FD14_REF_VEH_SPEED, system-signal=FD14_REF_VEH_SPEED
        data-element=RpFromComSafeFD14Rx.FD14_RHF_FastPulseCounter, system-signal=FD14_RHF_FastPulseCounter
        data-element=RpFromComSafeFD14Rx.FD14_RHF_Spin, system-signal=FD14_RHF_Spin
        data-element=RpFromComSafeFD14Rx.FD14_RHF_WheelSensorFailSts, system-signal=FD14_RHF_WheelSensorFailSts
        data-element=RpFromComSafeFD14Rx.FD14_RHFWheelSpeed, system-signal=FD14_RHFWheelSpeed
        data-element=RpFromComSafeFD14Rx.FD14_RHR_FastPulseCounter, system-signal=FD14_RHR_FastPulseCounter
        data-element=RpFromComSafeFD14Rx.FD14_RHR_Spin, system-signal=FD14_RHR_Spin
        data-element=RpFromComSafeFD14Rx.FD14_RHR_WheelSensorFailSts, system-signal=FD14_RHR_WheelSensorFailSts
        data-element=RpFromComSafeFD14Rx.FD14_RHRWheelSpeed, system-signal=FD14_RHRWheelSpeed
        data-element=RpFromComSafeFD14Rx.FD14_Slope, system-signal=FD14_Slope
        data-element=RpFromComSafeFD14Rx.FD14_SPM_Lat_Ctrl_ResponseSts, system-signal=FD14_SPM_Lat_Ctrl_ResponseSts
        data-element=RpFromComSafeFD14Rx.FD14_Steering_Column_Torque, system-signal=FD14_Steering_Column_Torque
        data-element=RpFromComSafeFD14Rx.FD14_VehicleSpeedVSOSig, system-signal=FD14_VehicleSpeedVSOSig
        data-element=RpFromComSafeFD14Rx.FD14_VehicleSpeedVSOSig_B2, system-signal=FD14_VehicleSpeedVSOSig_B2
        data-element=RpFromComSafeFD14Rx.FD14_VehicleStandStillSts, system-signal=FD14_VehicleStandStillSts
        data-element=RpFromComSafeFD14Rx.FD14_YawRate_BSM, system-signal=FD14_YawRate_BSM
        data-element=RpFromComSafeFD14Rx.FD14_YawRateFailSts_BSM, system-signal=FD14_YawRateFailSts_BSM
        data-element=RpFromComSafeFD14Rx.FD14_PdlPosActual, system-signal=FD14_PdlPosActual
        data-element=RpFromComSafeFD14Rx.FD14_EPS_SteeringTouchStat, system-signal=FD14_EPS_SteeringTouchStat
        data-element=RpFromComSafeFD14Rx.FD14_EPS_SteeringTouq_Resp, system-signal=FD14_EPS_SteeringTouq_Resp
        data-element=RpFromComSafeFD14Rx.FD14_EPS_THA_DriverTorqueOverride, system-signal=FD14_EPS_THA_DriverTorqueOverride
        data-element=RpFromComSafeFD14Rx.FD14_EPS_THA_SteeringTorqueResp, system-signal=FD14_EPS_THA_SteeringTorqueResp
        data-element=RpFromComSafeFD14Rx.FD14_THA_SteeringTouchStat, system-signal=FD14_THA_SteeringTouchStat
        data-element=RpFromComFD14Rx.FD14_Accel_Pedal_Override, system-signal=FD14_Accel_Pedal_Override
        data-element=RpFromComFD14Rx.FD14_DriverReq_AxleTrq_Enabled_BSM, system-signal=FD14_DriverReq_AxleTrq_Enabled_BSM
        data-element=RpFromComFD14Rx.FD14_PPPA_TrqEnblRq_Allowed, system-signal=FD14_PPPA_TrqEnblRq_Allowed
        data-element=RpFromComDbgFD14Rx.FD14_RawPntDebugSignal, system-signal=FD14_RawPntDebugSignal
        data-element=RpFromComDbgFD14Rx.FD14_UssParkingModeSignal, system-signal=FD14_UssParkingModeSignal
        data-element=PpToComSafeFD02Tx.Alert_CHF, system-signal=Alert_CHF
        data-element=PpToComSafeFD02Tx.Alert_CHR, system-signal=Alert_CHR
        data-element=PpToComSafeFD02Tx.Alert_LHF, system-signal=Alert_LHF
        data-element=PpToComSafeFD02Tx.Alert_LHR, system-signal=Alert_LHR
        data-element=PpToComSafeFD02Tx.Alert_RHF, system-signal=Alert_RHF
        data-element=PpToComSafeFD02Tx.Alert_RHR, system-signal=Alert_RHR
        data-element=PpToComSafeFD02Tx.AUXCamsRQSts, system-signal=AUXCamsRQSts
        data-element=PpToComSafeFD02Tx.ChimeActivation_LHF, system-signal=ChimeActivation_LHF
        data-element=PpToComSafeFD02Tx.ChimeActivation_LHR, system-signal=ChimeActivation_LHR
        data-element=PpToComSafeFD02Tx.ChimeActivation_RHF, system-signal=ChimeActivation_RHF
        data-element=PpToComSafeFD02Tx.ChimeActivation_RHR, system-signal=ChimeActivation_RHR
        data-element=PpToComSafeFD02Tx.DisplayView2, system-signal=DisplayView2
        data-element=PpToComSafeFD02Tx.FrontSensorSts, system-signal=FrontSensorSts
        data-element=PpToComSafeFD02Tx.FT_PAM_LedControlSts, system-signal=FT_PAM_LedControlSts
        data-element=PpToComSafeFD02Tx.Graphic_CHF, system-signal=Graphic_CHF
        data-element=PpToComSafeFD02Tx.Graphic_CHR, system-signal=Graphic_CHR
        data-element=PpToComSafeFD02Tx.Graphic_LHF, system-signal=Graphic_LHF
        data-element=PpToComSafeFD02Tx.Graphic_LHR, system-signal=Graphic_LHR
        data-element=PpToComSafeFD02Tx.Graphic_RHF, system-signal=Graphic_RHF
        data-element=PpToComSafeFD02Tx.Graphic_RHR, system-signal=Graphic_RHR
        data-element=PpToComSafeFD02Tx.HMICode, system-signal=HMICode
        data-element=PpToComSafeFD02Tx.ImageDefeatRQSts, system-signal=ImageDefeatRQSts
        data-element=PpToComSafeFD02Tx.MoreCamsRQSts, system-signal=MoreCamsRQSts
        data-element=PpToComSafeFD02Tx.PAM_CHIME_REP_RATESts, system-signal=PAM_CHIME_REP_RATESts
        data-element=PpToComSafeFD02Tx.PAM_CHIME_TYPE, system-signal=PAM_CHIME_TYPE
        data-element=PpToComSafeFD02Tx.PAM_LedControlSts, system-signal=PAM_LedControlSts
        data-element=PpToComSafeFD02Tx.PAM_Off_Status, system-signal=PAM_Off_Status
        data-element=PpToComSafeFD02Tx.PAM_Off_Status_2BT, system-signal=PAM_Off_Status_2BT
        data-element=PpToComSafeFD02Tx.PAM_PopUpRqst, system-signal=PAM_PopUpRqst
        data-element=PpToComSafeFD02Tx.PAM_Volume, system-signal=PAM_Volume
        data-element=PpToComSafeFD02Tx.PAMSystemFault, system-signal=PAMSystemFault
        data-element=PpToComSafeFD02Tx.ParkingManeuverActive, system-signal=ParkingManeuverActive
        data-element=PpToComSafeFD02Tx.PPPA_TurnIndicatorRqst, system-signal=PPPA_TurnIndicatorRqst
        data-element=PpToComSafeFD02Tx.RearSensorSts, system-signal=RearSensorSts
        data-element=PpToComSafeFD02Tx.RR_PAM_Brk_RqSts, system-signal=RR_PAM_Brk_RqSts
        data-element=PpToComSafeFD02Tx.RR_PAM_Dist, system-signal=RR_PAM_Dist
        data-element=PpToComSafeFD02Tx.RR_PAM_StopControlSts, system-signal=RR_PAM_StopControlSts
        data-element=PpToComSafeFD02Tx.SPM_LedControlSts, system-signal=SPM_LedControlSts
        data-element=PpToComSafeFD02Tx.SPM_Screen_Rqst, system-signal=SPM_Screen_Rqst
        data-element=PpToComSafeFD02Tx.SPMControlSts, system-signal=SPMControlSts
        data-element=PpToComSafeFD02Tx.SPMFailSts, system-signal=SPMFailSts
        data-element=PpToComSafeFD02Tx.SPMSystemFault, system-signal=SPMSystemFault
        data-element=PpToComSafeFD02Tx.TRSC_LED_Stat, system-signal=TRSC_LED_Stat
        data-element=PpToComSafeFD02Tx.Camera_Status, system-signal=Camera_Status
        data-element=PpToComSafeFD02Tx.Cntr_ADAS_FD_LANES_1, system-signal=Cntr_ADAS_FD_LANES_1
        data-element=PpToComSafeFD02Tx.Cntr_ADAS_FD_LANES_2, system-signal=Cntr_ADAS_FD_LANES_2
        data-element=PpToComSafeFD02Tx.FOD_Confidence, system-signal=FOD_Confidence
        data-element=PpToComSafeFD02Tx.Frame_Index_Lanes_1, system-signal=Frame_Index_Lanes_1
        data-element=PpToComSafeFD02Tx.Frame_Index_Lanes_2, system-signal=Frame_Index_Lanes_2
        data-element=PpToComSafeFD02Tx.Health_Front_Object_Detection, system-signal=Health_Front_Object_Detection
        data-element=PpToComSafeFD02Tx.Health_Lane_Detection, system-signal=Health_Lane_Detection
        data-element=PpToComSafeFD02Tx.Line_1_Confidence, system-signal=Line_1_Confidence
        data-element=PpToComSafeFD02Tx.Line_1_Curvature, system-signal=Line_1_Curvature
        data-element=PpToComSafeFD02Tx.Line_1_Curvature_Rate, system-signal=Line_1_Curvature_Rate
        data-element=PpToComSafeFD02Tx.Line_1_End_Range, system-signal=Line_1_End_Range
        data-element=PpToComSafeFD02Tx.Line_1_Heading, system-signal=Line_1_Heading
        data-element=PpToComSafeFD02Tx.Line_1_Offset, system-signal=Line_1_Offset
        data-element=PpToComSafeFD02Tx.Line_1_Start_Range, system-signal=Line_1_Start_Range
        data-element=PpToComSafeFD02Tx.Line_1_Type, system-signal=Line_1_Type
        data-element=PpToComSafeFD02Tx.Line_2_Confidence, system-signal=Line_2_Confidence
        data-element=PpToComSafeFD02Tx.Line_2_Curvature, system-signal=Line_2_Curvature
        data-element=PpToComSafeFD02Tx.Line_2_Curvature_Rate, system-signal=Line_2_Curvature_Rate
        data-element=PpToComSafeFD02Tx.Line_2_End_Range, system-signal=Line_2_End_Range
        data-element=PpToComSafeFD02Tx.Line_2_Heading, system-signal=Line_2_Heading
        data-element=PpToComSafeFD02Tx.Line_2_Offset, system-signal=Line_2_Offset
        data-element=PpToComSafeFD02Tx.Line_2_Start_Range, system-signal=Line_2_Start_Range
        data-element=PpToComSafeFD02Tx.Line_2_Type, system-signal=Line_2_Type
        data-element=PpToComSafeFD02Tx.Line_3_Confidence, system-signal=Line_3_Confidence
        data-element=PpToComSafeFD02Tx.Line_3_Curvature, system-signal=Line_3_Curvature
        data-element=PpToComSafeFD02Tx.Line_3_Curvature_Rate, system-signal=Line_3_Curvature_Rate
        data-element=PpToComSafeFD02Tx.Line_3_End_Range, system-signal=Line_3_End_Range
        data-element=PpToComSafeFD02Tx.Line_3_Heading, system-signal=Line_3_Heading
        data-element=PpToComSafeFD02Tx.Line_3_Offset, system-signal=Line_3_Offset
        data-element=PpToComSafeFD02Tx.Line_3_Start_Range, system-signal=Line_3_Start_Range
        data-element=PpToComSafeFD02Tx.Line_3_Type, system-signal=Line_3_Type
        data-element=PpToComSafeFD02Tx.Line_4_Confidence, system-signal=Line_4_Confidence
        data-element=PpToComSafeFD02Tx.Line_4_Curvature, system-signal=Line_4_Curvature
        data-element=PpToComSafeFD02Tx.Line_4_Curvature_Rate, system-signal=Line_4_Curvature_Rate
        data-element=PpToComSafeFD02Tx.Line_4_End_Range, system-signal=Line_4_End_Range
        data-element=PpToComSafeFD02Tx.Line_4_Heading, system-signal=Line_4_Heading
        data-element=PpToComSafeFD02Tx.Line_4_Offset, system-signal=Line_4_Offset
        data-element=PpToComSafeFD02Tx.Line_4_Start_Range, system-signal=Line_4_Start_Range
        data-element=PpToComSafeFD02Tx.Line_4_Type, system-signal=Line_4_Type
        data-element=PpToComSafeFD02Tx.MAC_ADAS_FD_LANES_1, system-signal=MAC_ADAS_FD_LANES_1
        data-element=PpToComSafeFD02Tx.MAC_ADAS_FD_LANES_2, system-signal=MAC_ADAS_FD_LANES_2
        data-element=PpToComSafeFD02Tx.Reserved_for_functional_safety, system-signal=Reserved_for_functional_safety
        data-element=PpToComSafeFD02Tx.Segment_1_Confidence, system-signal=Segment_1_Confidence
        data-element=PpToComSafeFD02Tx.Segment_1_ID, system-signal=Segment_1_ID
        data-element=PpToComSafeFD02Tx.Segment_1_X1, system-signal=Segment_1_X1
        data-element=PpToComSafeFD02Tx.Segment_1_X2, system-signal=Segment_1_X2
        data-element=PpToComSafeFD02Tx.Segment_1_Y1, system-signal=Segment_1_Y1
        data-element=PpToComSafeFD02Tx.Segment_1_Y2, system-signal=Segment_1_Y2
        data-element=PpToComSafeFD02Tx.Segment_2_Confidence, system-signal=Segment_2_Confidence
        data-element=PpToComSafeFD02Tx.Segment_2_ID, system-signal=Segment_2_ID
        data-element=PpToComSafeFD02Tx.Segment_2_X1, system-signal=Segment_2_X1
        data-element=PpToComSafeFD02Tx.Segment_2_X2, system-signal=Segment_2_X2
        data-element=PpToComSafeFD02Tx.Segment_2_Y1, system-signal=Segment_2_Y1
        data-element=PpToComSafeFD02Tx.Segment_2_Y2, system-signal=Segment_2_Y2
        data-element=PpToComSafeFD02Tx.Segment_3_Confidence, system-signal=Segment_3_Confidence
        data-element=PpToComSafeFD02Tx.Segment_3_ID, system-signal=Segment_3_ID
        data-element=PpToComSafeFD02Tx.Segment_3_X1, system-signal=Segment_3_X1
        data-element=PpToComSafeFD02Tx.Segment_3_X2, system-signal=Segment_3_X2
        data-element=PpToComSafeFD02Tx.Segment_3_Y1, system-signal=Segment_3_Y1
        data-element=PpToComSafeFD02Tx.Segment_3_Y2, system-signal=Segment_3_Y2
        data-element=PpToComSafeFD02Tx.Segment_4_Confidence, system-signal=Segment_4_Confidence
        data-element=PpToComSafeFD02Tx.Segment_4_ID, system-signal=Segment_4_ID
        data-element=PpToComSafeFD02Tx.Segment_4_X1, system-signal=Segment_4_X1
        data-element=PpToComSafeFD02Tx.Segment_4_X2, system-signal=Segment_4_X2
        data-element=PpToComSafeFD02Tx.Segment_4_Y1, system-signal=Segment_4_Y1
        data-element=PpToComSafeFD02Tx.Segment_4_Y2, system-signal=Segment_4_Y2
        data-element=PpToComSafeFD02Tx.Segment_5_Confidence, system-signal=Segment_5_Confidence
        data-element=PpToComSafeFD02Tx.Segment_5_ID, system-signal=Segment_5_ID
        data-element=PpToComSafeFD02Tx.Segment_5_X1, system-signal=Segment_5_X1
        data-element=PpToComSafeFD02Tx.Segment_5_X2, system-signal=Segment_5_X2
        data-element=PpToComSafeFD02Tx.Segment_5_Y1, system-signal=Segment_5_Y1
        data-element=PpToComSafeFD02Tx.Segment_5_Y2, system-signal=Segment_5_Y2
        data-element=PpToComSafeFD02Tx.Segment_6_Confidence, system-signal=Segment_6_Confidence
        data-element=PpToComSafeFD02Tx.Segment_6_ID, system-signal=Segment_6_ID
        data-element=PpToComSafeFD02Tx.Segment_6_X1, system-signal=Segment_6_X1
        data-element=PpToComSafeFD02Tx.Segment_6_X2, system-signal=Segment_6_X2
        data-element=PpToComSafeFD02Tx.Segment_6_Y1, system-signal=Segment_6_Y1
        data-element=PpToComSafeFD02Tx.Segment_6_Y2, system-signal=Segment_6_Y2
        data-element=PpToComSafeFD02Tx.Segment_7_Confidence, system-signal=Segment_7_Confidence
        data-element=PpToComSafeFD02Tx.Segment_7_ID, system-signal=Segment_7_ID
        data-element=PpToComSafeFD02Tx.Segment_7_X1, system-signal=Segment_7_X1
        data-element=PpToComSafeFD02Tx.Segment_7_X2, system-signal=Segment_7_X2
        data-element=PpToComSafeFD02Tx.Segment_7_Y1, system-signal=Segment_7_Y1
        data-element=PpToComSafeFD02Tx.Segment_7_Y2, system-signal=Segment_7_Y2
        data-element=PpToComSafeFD02Tx.Segment_8_Confidence, system-signal=Segment_8_Confidence
        data-element=PpToComSafeFD02Tx.Segment_8_ID, system-signal=Segment_8_ID
        data-element=PpToComSafeFD02Tx.Segment_8_X1, system-signal=Segment_8_X1
        data-element=PpToComSafeFD02Tx.Segment_8_X2, system-signal=Segment_8_X2
        data-element=PpToComSafeFD02Tx.Segment_8_Y1, system-signal=Segment_8_Y1
        data-element=PpToComSafeFD02Tx.Segment_8_Y2, system-signal=Segment_8_Y2
        data-element=PpToComFD02Tx.CurrentCanNMState_FD02_PAM, system-signal=CurrentCanNMState_FD02_PAM
        data-element=PpToComFD02Tx.CurrentFailSts_FD02_PAM, system-signal=CurrentFailSts_FD02_PAM
        data-element=PpToComFD02Tx.DES_FD02_PAM, system-signal=DES_FD02_PAM
        data-element=PpToComFD02Tx.Digit_{01..11}_PAM, system-signal=Digit_{01..11}_PAM
        data-element=PpToComFD02Tx.EOL_FD02_PAM, system-signal=EOL_FD02_PAM
        data-element=PpToComFD02Tx.GenericFailSts_FD02_PAM, system-signal=GenericFailSts_FD02_PAM
        data-element=PpToComFD02Tx.N_PDU, system-signal=N_PDU
        data-element=PpToComFD02Tx.PreviousCanNMState_FD02_PAM, system-signal=PreviousCanNMState_FD02_PAM
        data-element=PpToComFD02Tx.StayActiveSource_FD02_PAM, system-signal=StayActiveSource_FD02_PAM
        data-element=PpToComFD02Tx.THA_EPB_Req, system-signal=THA_EPB_Req
        data-element=PpToComFD02Tx.THA_Speed_Limit, system-signal=THA_Speed_Limit
        data-element=PpToComFD02Tx.THA_SpeedLimit_Req, system-signal=THA_SpeedLimit_Req
        data-element=PpToComFD02Tx.THA_STAT, system-signal=THA_STAT
        data-element=PpToComFD02Tx.THA_SteeringDamping, system-signal=THA_SteeringDamping
        data-element=PpToComFD02Tx.THA_SteeringTorqueInfo, system-signal=THA_SteeringTorqueInfo
        data-element=PpToComFD02Tx.THA_SteeringTorqueReq, system-signal=THA_SteeringTorqueReq
        data-element=PpToComFD02Tx.Trailer_Angle, system-signal=Trailer_Angle
        data-element=PpToComFD02Tx.Trailer_Angle_Sign, system-signal=Trailer_Angle_Sign
        data-element=PpToComFD02Tx.Trailer_Calibration, system-signal=Trailer_Calibration
        data-element=PpToComFD02Tx.TrlrHitchLight_Cntrl, system-signal=TrlrHitchLight_Cntrl
        data-element=PpToComFD02Tx.TRSC_PopupDisp_Info, system-signal=TRSC_PopupDisp_Info
        data-element=PpToComFD02Tx.TRSC_SpeedLimit_Req, system-signal=TRSC_SpeedLimit_Req
        data-element=PpToComFD02Tx.TRSC_STAT, system-signal=TRSC_STAT
        data-element=PpToComFD02Tx.TRSC_SteeringDamping, system-signal=TRSC_SteeringDamping
        data-element=PpToComFD02Tx.TRSC_SteeringTorqueInfo, system-signal=TRSC_SteeringTorqueInfo
        data-element=PpToComFD02Tx.TRSC_SteeringTorqueReq, system-signal=TRSC_SteeringTorqueReq
        data-element=PpToComFD02Tx.TRSC_VehicleStop_Req, system-signal=TRSC_VehicleStop_Req
        data-element=PpToComFD02Tx.TRSCMoreCamRQSts, system-signal=TRSCMoreCamRQSts
        data-element=PpToComFD02Tx.WakeupSource_FD02_PAM, system-signal=WakeupSource_FD02_PAM
        data-element=PpToComFD14Tx.FD14_THA_EPB_Req, system-signal=FD14_THA_EPB_Req
        data-element=PpToComFD14Tx.FD14_THA_Speed_Limit, system-signal=FD14_THA_Speed_Limit
        data-element=PpToComFD14Tx.FD14_THA_SpeedLimit_Req, system-signal=FD14_THA_SpeedLimit_Req
        data-element=PpToComFD14Tx.FD14_THA_STAT, system-signal=FD14_THA_STAT
        data-element=PpToComFD14Tx.FD14_THA_SteeringDamping, system-signal=FD14_THA_SteeringDamping
        data-element=PpToComFD14Tx.FD14_THA_SteeringTorqueInfo, system-signal=FD14_THA_SteeringTorqueInfo
        data-element=PpToComFD14Tx.FD14_THA_SteeringTorqueReq, system-signal=FD14_THA_SteeringTorqueReq
        data-element=PpToComFD14Tx.FD14_TRSC_SpeedLimit_Req, system-signal=FD14_TRSC_SpeedLimit_Req
        data-element=PpToComFD14Tx.FD14_TRSC_STAT, system-signal=FD14_TRSC_STAT
        data-element=PpToComFD14Tx.FD14_TRSC_SteeringDamping, system-signal=FD14_TRSC_SteeringDamping
        data-element=PpToComFD14Tx.FD14_TRSC_SteeringTorqueInfo, system-signal=FD14_TRSC_SteeringTorqueInfo
        data-element=PpToComFD14Tx.FD14_TRSC_SteeringTorqueReq, system-signal=FD14_TRSC_SteeringTorqueReq
        data-element=PpToComFD14Tx.FD14_TRSC_VehicleStop_Req, system-signal=FD14_TRSC_VehicleStop_Req
        data-element=PpToComDbgFD14Tx.FD14_averageIllumination, system-signal=FD14_averageIllumination
        data-element=PpToComDbgFD14Tx.FD14_CsmLocalErrOrEventId, system-signal=FD14_CsmLocalErrOrEventId
        data-element=PpToComDbgFD14Tx.FD14_CsmLocalErrOrEventState, system-signal=FD14_CsmLocalErrOrEventState
        data-element=PpToComDbgFD14Tx.FD14_CsmLocalModuleId, system-signal=FD14_CsmLocalModuleId
        data-element=PpToComDbgFD14Tx.FD14_CsmLocalModuleInstanceId, system-signal=FD14_CsmLocalModuleInstanceId
        data-element=PpToComDbgFD14Tx.FD14_CsmStateCurrent, system-signal=FD14_CsmStateCurrent
        data-element=PpToComDbgFD14Tx.FD14_CsmStatePrevious, system-signal=FD14_CsmStatePrevious
        data-element=PpToComDbgFD14Tx.FD14_hitchCalibrationAngle, system-signal=FD14_hitchCalibrationAngle
        data-element=PpToComDbgFD14Tx.FD14_leftCalibrationAngle, system-signal=FD14_leftCalibrationAngle
        data-element=PpToComDbgFD14Tx.FD14_MeTRSC_b_OTBLReset, system-signal=FD14_MeTRSC_b_OTBLReset
        data-element=PpToComDbgFD14Tx.FD14_MeTRSC_b_TBLComputationDone, system-signal=FD14_MeTRSC_b_TBLComputationDone
        data-element=PpToComDbgFD14Tx.FD14_MeTRSC_deg_StrCMD, system-signal=FD14_MeTRSC_deg_StrCMD
        data-element=PpToComDbgFD14Tx.FD14_rightCalibrationAngle, system-signal=FD14_rightCalibrationAngle
        data-element=PpToComDbgFD14Tx.FD14__JackKnifeAngle, system-signal=FD14__JackKnifeAngle
        data-element=PpToComDbgFD14Tx.FD14_AOL_Blockage, system-signal=FD14_AOL_Blockage
        data-element=PpToComDbgFD14Tx.FD14_AOL_comm_Fault, system-signal=FD14_AOL_comm_Fault
        data-element=PpToComDbgFD14Tx.FD14_AOL_CommUnknown, system-signal=FD14_AOL_CommUnknown
        data-element=PpToComDbgFD14Tx.FD14_AOL_hardware_Fault, system-signal=FD14_AOL_hardware_Fault
        data-element=PpToComDbgFD14Tx.FD14_AOL_MinDistance, system-signal=FD14_AOL_MinDistance
        data-element=PpToComDbgFD14Tx.FD14_AOL_overTemp_Fault, system-signal=FD14_AOL_overTemp_Fault
        data-element=PpToComDbgFD14Tx.FD14_AOR_Blockage, system-signal=FD14_AOR_Blockage
        data-element=PpToComDbgFD14Tx.FD14_AOR_comm_Fault, system-signal=FD14_AOR_comm_Fault
        data-element=PpToComDbgFD14Tx.FD14_AOR_CommUnknown, system-signal=FD14_AOR_CommUnknown
        data-element=PpToComDbgFD14Tx.FD14_AOR_hardware_Fault, system-signal=FD14_AOR_hardware_Fault
        data-element=PpToComDbgFD14Tx.FD14_AOR_MinDistance, system-signal=FD14_AOR_MinDistance
        data-element=PpToComDbgFD14Tx.FD14_AOR_overTemp_Fault, system-signal=FD14_AOR_overTemp_Fault
        data-element=PpToComDbgFD14Tx.FD14_AutoParkInitializedStatus_b, system-signal=FD14_AutoParkInitializedStatus_b
        data-element=PpToComDbgFD14Tx.FD14_AuxCamButton1NoSelect_b, system-signal=FD14_AuxCamButton1NoSelect_b
        data-element=PpToComDbgFD14Tx.FD14_AuxCamButton1Select_b, system-signal=FD14_AuxCamButton1Select_b
        data-element=PpToComDbgFD14Tx.FD14_AuxCamButton2NoSelect_b, system-signal=FD14_AuxCamButton2NoSelect_b
        data-element=PpToComDbgFD14Tx.FD14_AuxCamButton2Select_b, system-signal=FD14_AuxCamButton2Select_b
        data-element=PpToComDbgFD14Tx.FD14_BackCam_NA_b, system-signal=FD14_BackCam_NA_b
        data-element=PpToComDbgFD14Tx.FD14_BackDoorOpen_Icon_b, system-signal=FD14_BackDoorOpen_Icon_b
        data-element=PpToComDbgFD14Tx.FD14_BackupRearCamButtonNoSelect_b, system-signal=FD14_BackupRearCamButtonNoSelect_b
        data-element=PpToComDbgFD14Tx.FD14_BackupRearCamButtonSelect_b, system-signal=FD14_BackupRearCamButtonSelect_b
        data-element=PpToComDbgFD14Tx.FD14_BOL_Blockage, system-signal=FD14_BOL_Blockage
        data-element=PpToComDbgFD14Tx.FD14_BOL_comm_Fault, system-signal=FD14_BOL_comm_Fault
        data-element=PpToComDbgFD14Tx.FD14_BOL_CommUnknown, system-signal=FD14_BOL_CommUnknown
        data-element=PpToComDbgFD14Tx.FD14_BOL_hardware_Fault, system-signal=FD14_BOL_hardware_Fault
        data-element=PpToComDbgFD14Tx.FD14_BOL_MinDistance, system-signal=FD14_BOL_MinDistance
        data-element=PpToComDbgFD14Tx.FD14_BOL_overTemp_Fault, system-signal=FD14_BOL_overTemp_Fault
        data-element=PpToComDbgFD14Tx.FD14_BOR_Blockage, system-signal=FD14_BOR_Blockage
        data-element=PpToComDbgFD14Tx.FD14_BOR_comm_Fault, system-signal=FD14_BOR_comm_Fault
        data-element=PpToComDbgFD14Tx.FD14_BOR_CommUnknown, system-signal=FD14_BOR_CommUnknown
        data-element=PpToComDbgFD14Tx.FD14_BOR_hardware_Fault, system-signal=FD14_BOR_hardware_Fault
        data-element=PpToComDbgFD14Tx.FD14_BOR_MinDistance, system-signal=FD14_BOR_MinDistance
        data-element=PpToComDbgFD14Tx.FD14_BOR_overTemp_Fault, system-signal=FD14_BOR_overTemp_Fault
        data-element=PpToComDbgFD14Tx.FD14_BumberStatus_Front, system-signal=FD14_BumberStatus_Front
        data-element=PpToComDbgFD14Tx.FD14_BumberStatus_Left_Side, system-signal=FD14_BumberStatus_Left_Side
        data-element=PpToComDbgFD14Tx.FD14_BumberStatus_Rear, system-signal=FD14_BumberStatus_Rear
        data-element=PpToComDbgFD14Tx.FD14_BumberStatus_Right_Side, system-signal=FD14_BumberStatus_Right_Side
        data-element=PpToComDbgFD14Tx.FD14_calibrationCompleted, system-signal=FD14_calibrationCompleted
        data-element=PpToComDbgFD14Tx.FD14_calibrationSubState, system-signal=FD14_calibrationSubState
        data-element=PpToComDbgFD14Tx.FD14_CalibStatus_STM_Current_Front, system-signal=FD14_CalibStatus_STM_Current_Front
        data-element=PpToComDbgFD14Tx.FD14_CalibStatus_STM_Current_Left, system-signal=FD14_CalibStatus_STM_Current_Left
        data-element=PpToComDbgFD14Tx.FD14_CalibStatus_STM_Current_Rear, system-signal=FD14_CalibStatus_STM_Current_Rear
        data-element=PpToComDbgFD14Tx.FD14_CalibStatus_STM_Current_Right, system-signal=FD14_CalibStatus_STM_Current_Right
        data-element=PpToComDbgFD14Tx.FD14_CalibStatus_STM_EOL_Front, system-signal=FD14_CalibStatus_STM_EOL_Front
        data-element=PpToComDbgFD14Tx.FD14_CalibStatus_STM_EOL_Left, system-signal=FD14_CalibStatus_STM_EOL_Left
        data-element=PpToComDbgFD14Tx.FD14_CalibStatus_STM_EOL_Rear, system-signal=FD14_CalibStatus_STM_EOL_Rear
        data-element=PpToComDbgFD14Tx.FD14_CalibStatus_STM_EOL_Right, system-signal=FD14_CalibStatus_STM_EOL_Right
        data-element=PpToComDbgFD14Tx.FD14_CalibStatus_STM_OC_Front, system-signal=FD14_CalibStatus_STM_OC_Front
        data-element=PpToComDbgFD14Tx.FD14_CalibStatus_STM_OC_Left, system-signal=FD14_CalibStatus_STM_OC_Left
        data-element=PpToComDbgFD14Tx.FD14_CalibStatus_STM_OC_Rear, system-signal=FD14_CalibStatus_STM_OC_Rear
        data-element=PpToComDbgFD14Tx.FD14_CalibStatus_STM_OC_Right, system-signal=FD14_CalibStatus_STM_OC_Right
        data-element=PpToComDbgFD14Tx.FD14_CalibStatus_STM_SC_Front, system-signal=FD14_CalibStatus_STM_SC_Front
        data-element=PpToComDbgFD14Tx.FD14_CalibStatus_STM_SC_Left, system-signal=FD14_CalibStatus_STM_SC_Left
        data-element=PpToComDbgFD14Tx.FD14_CalibStatus_STM_SC_Rear, system-signal=FD14_CalibStatus_STM_SC_Rear
        data-element=PpToComDbgFD14Tx.FD14_CalibStatus_STM_SC_Right, system-signal=FD14_CalibStatus_STM_SC_Right
        data-element=PpToComDbgFD14Tx.FD14_CAM_NA_Bitfield_u8, system-signal=FD14_CAM_NA_Bitfield_u8
        data-element=PpToComDbgFD14Tx.FD14_CameraDisplaySts2_e, system-signal=FD14_CameraDisplaySts2_e
        data-element=PpToComDbgFD14Tx.FD14_cntrCvpamFdData1_u16, system-signal=FD14_cntrCvpamFdData1_u16
        data-element=PpToComDbgFD14Tx.FD14_crcCvpamFdData1_u8, system-signal=FD14_crcCvpamFdData1_u8
        data-element=PpToComDbgFD14Tx.FD14_Curr_DisplayedViewByAcore_e, system-signal=FD14_Curr_DisplayedViewByAcore_e
        data-element=PpToComDbgFD14Tx.FD14_Curr_RequestedViewByHmiM_e, system-signal=FD14_Curr_RequestedViewByHmiM_e
        data-element=PpToComDbgFD14Tx.FD14_Curr_SystemState_e, system-signal=FD14_Curr_SystemState_e
        data-element=PpToComDbgFD14Tx.FD14_Curr_TRG_Stat, system-signal=FD14_Curr_TRG_Stat
        data-element=PpToComDbgFD14Tx.FD14_Current_Firing_Sequence, system-signal=FD14_Current_Firing_Sequence
        data-element=PpToComDbgFD14Tx.FD14_CurrentTrailer_ID, system-signal=FD14_CurrentTrailer_ID
        data-element=PpToComDbgFD14Tx.FD14_curState, system-signal=FD14_curState
        data-element=PpToComDbgFD14Tx.FD14_Debug_Signal_{1..8}, system-signal=FD14_Debug_Signal_{1..8}
        data-element=PpToComDbgFD14Tx.FD14_DynOvl_Error_e, system-signal=FD14_DynOvl_Error_e
        data-element=PpToComDbgFD14Tx.FD14_EOL_ModuleState_STM_Front, system-signal=FD14_EOL_ModuleState_STM_Front
        data-element=PpToComDbgFD14Tx.FD14_EOL_ModuleState_STM_Left, system-signal=FD14_EOL_ModuleState_STM_Left
        data-element=PpToComDbgFD14Tx.FD14_EOL_ModuleState_STM_Rear, system-signal=FD14_EOL_ModuleState_STM_Rear
        data-element=PpToComDbgFD14Tx.FD14_EOL_ModuleState_STM_Right, system-signal=FD14_EOL_ModuleState_STM_Right
        data-element=PpToComDbgFD14Tx.FD14_Err_Code_EOL_Front, system-signal=FD14_Err_Code_EOL_Front
        data-element=PpToComDbgFD14Tx.FD14_Err_Code_EOL_Left, system-signal=FD14_Err_Code_EOL_Left
        data-element=PpToComDbgFD14Tx.FD14_Err_Code_EOL_Rear, system-signal=FD14_Err_Code_EOL_Rear
        data-element=PpToComDbgFD14Tx.FD14_Err_Code_EOL_Rear_Copy_1, system-signal=FD14_Err_Code_EOL_Rear_Copy_1
        data-element=PpToComDbgFD14Tx.FD14_Err_Code_OC_Front, system-signal=FD14_Err_Code_OC_Front
        data-element=PpToComDbgFD14Tx.FD14_Err_Code_OC_Left, system-signal=FD14_Err_Code_OC_Left
        data-element=PpToComDbgFD14Tx.FD14_Err_Code_OC_Rear, system-signal=FD14_Err_Code_OC_Rear
        data-element=PpToComDbgFD14Tx.FD14_Err_Code_OC_Right, system-signal=FD14_Err_Code_OC_Right
        data-element=PpToComDbgFD14Tx.FD14_Err_Code_SC_Front, system-signal=FD14_Err_Code_SC_Front
        data-element=PpToComDbgFD14Tx.FD14_Err_Code_SC_Left, system-signal=FD14_Err_Code_SC_Left
        data-element=PpToComDbgFD14Tx.FD14_Err_Code_SC_Rear, system-signal=FD14_Err_Code_SC_Rear
        data-element=PpToComDbgFD14Tx.FD14_Err_Code_SC_Right, system-signal=FD14_Err_Code_SC_Right
        data-element=PpToComDbgFD14Tx.FD14_FFCV_BTN_PRESSED_b, system-signal=FD14_FFCV_BTN_PRESSED_b
        data-element=PpToComDbgFD14Tx.FD14_FIL_Blockage, system-signal=FD14_FIL_Blockage
        data-element=PpToComDbgFD14Tx.FD14_FIL_comm_Fault, system-signal=FD14_FIL_comm_Fault
        data-element=PpToComDbgFD14Tx.FD14_FIL_CommUnknown, system-signal=FD14_FIL_CommUnknown
        data-element=PpToComDbgFD14Tx.FD14_FIL_hardware_Fault, system-signal=FD14_FIL_hardware_Fault
        data-element=PpToComDbgFD14Tx.FD14_FIL_MinDistance, system-signal=FD14_FIL_MinDistance
        data-element=PpToComDbgFD14Tx.FD14_FIL_overTemp_Fault, system-signal=FD14_FIL_overTemp_Fault
        data-element=PpToComDbgFD14Tx.FD14_FIR_Blockage, system-signal=FD14_FIR_Blockage
        data-element=PpToComDbgFD14Tx.FD14_FIR_comm_Fault, system-signal=FD14_FIR_comm_Fault
        data-element=PpToComDbgFD14Tx.FD14_FIR_CommUnknown, system-signal=FD14_FIR_CommUnknown
        data-element=PpToComDbgFD14Tx.FD14_FIR_hardware_Fault, system-signal=FD14_FIR_hardware_Fault
        data-element=PpToComDbgFD14Tx.FD14_FIR_MinDistance, system-signal=FD14_FIR_MinDistance
        data-element=PpToComDbgFD14Tx.FD14_FIR_overTemp_Fault, system-signal=FD14_FIR_overTemp_Fault
        data-element=PpToComDbgFD14Tx.FD14_Firing_Mode_Seq, system-signal=FD14_Firing_Mode_Seq
        data-element=PpToComDbgFD14Tx.FD14_Firing_Sensor, system-signal=FD14_Firing_Sensor
        data-element=PpToComDbgFD14Tx.FD14_Firing_Sensor_Info_F, system-signal=FD14_Firing_Sensor_Info_F
        data-element=PpToComDbgFD14Tx.FD14_Firing_Sensor_Info_R, system-signal=FD14_Firing_Sensor_Info_R
        data-element=PpToComDbgFD14Tx.FD14_FiringMode_TimeStamp, system-signal=FD14_FiringMode_TimeStamp
        data-element=PpToComDbgFD14Tx.FD14_FiringSnr_TimeStamp, system-signal=FD14_FiringSnr_TimeStamp
        data-element=PpToComDbgFD14Tx.FD14_FOL_Blockage, system-signal=FD14_FOL_Blockage
        data-element=PpToComDbgFD14Tx.FD14_FOL_comm_Fault, system-signal=FD14_FOL_comm_Fault
        data-element=PpToComDbgFD14Tx.FD14_FOL_CommUnknown, system-signal=FD14_FOL_CommUnknown
        data-element=PpToComDbgFD14Tx.FD14_FOL_hardware_Fault, system-signal=FD14_FOL_hardware_Fault
        data-element=PpToComDbgFD14Tx.FD14_FOL_MinDistance, system-signal=FD14_FOL_MinDistance
        data-element=PpToComDbgFD14Tx.FD14_FOL_overTemp_Fault, system-signal=FD14_FOL_overTemp_Fault
        data-element=PpToComDbgFD14Tx.FD14_FOR_Blockage, system-signal=FD14_FOR_Blockage
        data-element=PpToComDbgFD14Tx.FD14_FOR_comm_Fault, system-signal=FD14_FOR_comm_Fault
        data-element=PpToComDbgFD14Tx.FD14_FOR_CommUnknown, system-signal=FD14_FOR_CommUnknown
        data-element=PpToComDbgFD14Tx.FD14_FOR_hardware_Fault, system-signal=FD14_FOR_hardware_Fault
        data-element=PpToComDbgFD14Tx.FD14_FOR_MinDistance, system-signal=FD14_FOR_MinDistance
        data-element=PpToComDbgFD14Tx.FD14_FOR_overTemp_Fault, system-signal=FD14_FOR_overTemp_Fault
        data-element=PpToComDbgFD14Tx.FD14_Frame_Index_Lanes__1, system-signal=FD14_Frame_Index_Lanes__1
        data-element=PpToComDbgFD14Tx.FD14_Frameset1AndTopFrontText_b, system-signal=FD14_Frameset1AndTopFrontText_b
        data-element=PpToComDbgFD14Tx.FD14_Frameset1AndTopRearText_b, system-signal=FD14_Frameset1AndTopRearText_b
        data-element=PpToComDbgFD14Tx.FD14_Frameset2AndFrontCrossText_b, system-signal=FD14_Frameset2AndFrontCrossText_b
        data-element=PpToComDbgFD14Tx.FD14_Frameset2AndRearCrossText_b, system-signal=FD14_Frameset2AndRearCrossText_b
        data-element=PpToComDbgFD14Tx.FD14_FRONT_CROSS_BTN_PRESSED_b, system-signal=FD14_FRONT_CROSS_BTN_PRESSED_b
        data-element=PpToComDbgFD14Tx.FD14_FRONT_TOP_BTN_PRESSED_b, system-signal=FD14_FRONT_TOP_BTN_PRESSED_b
        data-element=PpToComDbgFD14Tx.FD14_FrontCam_NA_b, system-signal=FD14_FrontCam_NA_b
        data-element=PpToComDbgFD14Tx.FD14_FrontCrossButtonNoSelect_b, system-signal=FD14_FrontCrossButtonNoSelect_b
        data-element=PpToComDbgFD14Tx.FD14_FrontCrossButtonSelect_b, system-signal=FD14_FrontCrossButtonSelect_b
        data-element=PpToComDbgFD14Tx.FD14_FrontFaceCamButtonNoSelect_b, system-signal=FD14_FrontFaceCamButtonNoSelect_b
        data-element=PpToComDbgFD14Tx.FD14_FrontFaceCamButtonSelect_b, system-signal=FD14_FrontFaceCamButtonSelect_b
        data-element=PpToComDbgFD14Tx.FD14_FrontSensorDetHealth_e, system-signal=FD14_FrontSensorDetHealth_e
        data-element=PpToComDbgFD14Tx.FD14_FrontTireTracks_b, system-signal=FD14_FrontTireTracks_b
        data-element=PpToComDbgFD14Tx.FD14_FrontViewDynamics_b, system-signal=FD14_FrontViewDynamics_b
        data-element=PpToComDbgFD14Tx.FD14_FSL_Blockage, system-signal=FD14_FSL_Blockage
        data-element=PpToComDbgFD14Tx.FD14_FSL_comm_Fault, system-signal=FD14_FSL_comm_Fault
        data-element=PpToComDbgFD14Tx.FD14_FSL_CommUnknown, system-signal=FD14_FSL_CommUnknown
        data-element=PpToComDbgFD14Tx.FD14_FSL_hardware_Fault, system-signal=FD14_FSL_hardware_Fault
        data-element=PpToComDbgFD14Tx.FD14_FSL_MinDistance, system-signal=FD14_FSL_MinDistance
        data-element=PpToComDbgFD14Tx.FD14_FSL_overTemp_Fault, system-signal=FD14_FSL_overTemp_Fault
        data-element=PpToComDbgFD14Tx.FD14_FSR_Blockage, system-signal=FD14_FSR_Blockage
        data-element=PpToComDbgFD14Tx.FD14_FSR_comm_Fault, system-signal=FD14_FSR_comm_Fault
        data-element=PpToComDbgFD14Tx.FD14_FSR_CommUnknown, system-signal=FD14_FSR_CommUnknown
        data-element=PpToComDbgFD14Tx.FD14_FSR_hardware_Fault, system-signal=FD14_FSR_hardware_Fault
        data-element=PpToComDbgFD14Tx.FD14_FSR_MinDistance, system-signal=FD14_FSR_MinDistance
        data-element=PpToComDbgFD14Tx.FD14_FSR_overTemp_Fault, system-signal=FD14_FSR_overTemp_Fault
        data-element=PpToComDbgFD14Tx.FD14_GW_C_I6_timeout_b, system-signal=FD14_GW_C_I6_timeout_b
        data-element=PpToComDbgFD14Tx.FD14_hitchLength, system-signal=FD14_hitchLength
        data-element=PpToComDbgFD14Tx.FD14_IeAP_b_MnvPosOk, system-signal=FD14_IeAP_b_MnvPosOk
        data-element=PpToComDbgFD14Tx.FD14_IeAP_cm_FrntCenterMinXDist, system-signal=FD14_IeAP_cm_FrntCenterMinXDist
        data-element=PpToComDbgFD14Tx.FD14_IeAP_cm_FrntCenterMinXDist_KPI, system-signal=FD14_IeAP_cm_FrntCenterMinXDist_KPI
        data-element=PpToComDbgFD14Tx.FD14_IeAP_cm_FrntLeftMinXDist, system-signal=FD14_IeAP_cm_FrntLeftMinXDist
        data-element=PpToComDbgFD14Tx.FD14_IeAP_cm_FrntLeftMinXDist_KPI, system-signal=FD14_IeAP_cm_FrntLeftMinXDist_KPI
        data-element=PpToComDbgFD14Tx.FD14_IeAP_cm_FrntRightMinXDist, system-signal=FD14_IeAP_cm_FrntRightMinXDist
        data-element=PpToComDbgFD14Tx.FD14_IeAP_cm_FrntRightMinXDist_KPI, system-signal=FD14_IeAP_cm_FrntRightMinXDist_KPI
        data-element=PpToComDbgFD14Tx.FD14_IeAP_cm_RearCenterMinXDist, system-signal=FD14_IeAP_cm_RearCenterMinXDist
        data-element=PpToComDbgFD14Tx.FD14_IeAP_cm_RearCenterMinXDist_KPI, system-signal=FD14_IeAP_cm_RearCenterMinXDist_KPI
        data-element=PpToComDbgFD14Tx.FD14_IeAP_cm_RearLeftMinXDist, system-signal=FD14_IeAP_cm_RearLeftMinXDist
        data-element=PpToComDbgFD14Tx.FD14_IeAP_cm_RearLeftMinXDist_KPI, system-signal=FD14_IeAP_cm_RearLeftMinXDist_KPI
        data-element=PpToComDbgFD14Tx.FD14_IeAP_cm_RearRightMinXDist, system-signal=FD14_IeAP_cm_RearRightMinXDist
        data-element=PpToComDbgFD14Tx.FD14_IeAP_cm_RearRightMinXDist_KPI, system-signal=FD14_IeAP_cm_RearRightMinXDist_KPI
        data-element=PpToComDbgFD14Tx.FD14_IeAP_cnt_CurrentVehSweep, system-signal=FD14_IeAP_cnt_CurrentVehSweep
        data-element=PpToComDbgFD14Tx.FD14_IeAP_e_AbortCon, system-signal=FD14_IeAP_e_AbortCon
        data-element=PpToComDbgFD14Tx.FD14_IeAP_e_AutoParkStatus, system-signal=FD14_IeAP_e_AutoParkStatus
        data-element=PpToComDbgFD14Tx.FD14_IeAutoPark_e_AlgoState, system-signal=FD14_IeAutoPark_e_AlgoState
        data-element=PpToComDbgFD14Tx.FD14_IeLMD_e_CameraStatus, system-signal=FD14_IeLMD_e_CameraStatus
        data-element=PpToComDbgFD14Tx.FD14_IeTHA_b_ChimeActvLhf, system-signal=FD14_IeTHA_b_ChimeActvLhf
        data-element=PpToComDbgFD14Tx.FD14_IeTHA_b_ChimeActvRhf, system-signal=FD14_IeTHA_b_ChimeActvRhf
        data-element=PpToComDbgFD14Tx.FD14_IeTHA_e_PamChimeTyp, system-signal=FD14_IeTHA_e_PamChimeTyp
        data-element=PpToComDbgFD14Tx.FD14_IeTHA_e_PamVol, system-signal=FD14_IeTHA_e_PamVol
        data-element=PpToComDbgFD14Tx.FD14_IeTRSC_cnt_KnobPos, system-signal=FD14_IeTRSC_cnt_KnobPos
        data-element=PpToComDbgFD14Tx.FD14_IeTRSC_cnt_TrlrCalibFailCnt, system-signal=FD14_IeTRSC_cnt_TrlrCalibFailCnt
        data-element=PpToComDbgFD14Tx.FD14_IeTRSC_cnt_TrlrCalibFailCntCurr, system-signal=FD14_IeTRSC_cnt_TrlrCalibFailCntCurr
        data-element=PpToComDbgFD14Tx.FD14_IeTRSC_cnt_TrlrCalibPassCnt, system-signal=FD14_IeTRSC_cnt_TrlrCalibPassCnt
        data-element=PpToComDbgFD14Tx.FD14_IeTRSC_cnt_TrlrCalibPassCntCurr, system-signal=FD14_IeTRSC_cnt_TrlrCalibPassCntCurr
        data-element=PpToComDbgFD14Tx.FD14_IeTRSC_deg_FrntWhlAng, system-signal=FD14_IeTRSC_deg_FrntWhlAng
        data-element=PpToComDbgFD14Tx.FD14_IeTRSC_deg_JackknifeThrAngle, system-signal=FD14_IeTRSC_deg_JackknifeThrAngle
        data-element=PpToComDbgFD14Tx.FD14_IeTRSC_deg_TADAngle, system-signal=FD14_IeTRSC_deg_TADAngle
        data-element=PpToComDbgFD14Tx.FD14_IeTRSC_deg_TrlrAngKnob, system-signal=FD14_IeTRSC_deg_TrlrAngKnob
        data-element=PpToComDbgFD14Tx.FD14_IeTRSC_e_CamBlockSts, system-signal=FD14_IeTRSC_e_CamBlockSts
        data-element=PpToComDbgFD14Tx.FD14_IeTRSC_e_GearShiftSts, system-signal=FD14_IeTRSC_e_GearShiftSts
        data-element=PpToComDbgFD14Tx.FD14_IeTRSC_e_TrailerID, system-signal=FD14_IeTRSC_e_TrailerID
        data-element=PpToComDbgFD14Tx.FD14_IeTRSC_e_TrlrAngGrapOverSts, system-signal=FD14_IeTRSC_e_TrlrAngGrapOverSts
        data-element=PpToComDbgFD14Tx.FD14_IeTRSC_e_TrlrCalibFailReas, system-signal=FD14_IeTRSC_e_TrlrCalibFailReas
        data-element=PpToComDbgFD14Tx.FD14_IeTRSC_e_TrlrCalibManState, system-signal=FD14_IeTRSC_e_TrlrCalibManState
        data-element=PpToComDbgFD14Tx.FD14_IeTRSC_e_TrlrCalibSts, system-signal=FD14_IeTRSC_e_TrlrCalibSts
        data-element=PpToComDbgFD14Tx.FD14_IeTRSC_e_TrlrPrsntFailReas, system-signal=FD14_IeTRSC_e_TrlrPrsntFailReas
        data-element=PpToComDbgFD14Tx.FD14_IeTRSC_e_TrlrPrsntSts, system-signal=FD14_IeTRSC_e_TrlrPrsntSts
        data-element=PpToComDbgFD14Tx.FD14_IeTRSC_e_TrlrRecogInfo, system-signal=FD14_IeTRSC_e_TrlrRecogInfo
        data-element=PpToComDbgFD14Tx.FD14_IeTRSC_e_TRSCAbortReas, system-signal=FD14_IeTRSC_e_TRSCAbortReas
        data-element=PpToComDbgFD14Tx.FD14_IeTRSC_e_TRSCUnavailReas, system-signal=FD14_IeTRSC_e_TRSCUnavailReas
        data-element=PpToComDbgFD14Tx.FD14_IeTRSC_e_TRSKMBtnSts, system-signal=FD14_IeTRSC_e_TRSKMBtnSts
        data-element=PpToComDbgFD14Tx.FD14_IeTRSC_e_TRSKMCenBtnSts, system-signal=FD14_IeTRSC_e_TRSKMCenBtnSts
        data-element=PpToComDbgFD14Tx.FD14_IeTRSC_e_TRSKMSts, system-signal=FD14_IeTRSC_e_TRSKMSts
        data-element=PpToComDbgFD14Tx.FD14_IeTRSC_kph_VehSpeedVSOSig, system-signal=FD14_IeTRSC_kph_VehSpeedVSOSig
        data-element=PpToComDbgFD14Tx.FD14_IeTRSC_m_TrlrWhlBaseEff, system-signal=FD14_IeTRSC_m_TrlrWhlBaseEff
        data-element=PpToComDbgFD14Tx.FD14_IeTRSC_M_TRSCStrTrq, system-signal=FD14_IeTRSC_M_TRSCStrTrq
        data-element=PpToComDbgFD14Tx.FD14_IeTRSC_pct_TrlrDetConf, system-signal=FD14_IeTRSC_pct_TrlrDetConf
        data-element=PpToComDbgFD14Tx.FD14_IeTRSC_pct_TrlrRecogConf, system-signal=FD14_IeTRSC_pct_TrlrRecogConf
        data-element=PpToComDbgFD14Tx.FD14_IeTRSC_pct_TrlrTrackConf, system-signal=FD14_IeTRSC_pct_TrlrTrackConf
        data-element=PpToComDbgFD14Tx.FD14_IeVBII_nfcd_MinDisToCollisionObj, system-signal=FD14_IeVBII_nfcd_MinDisToCollisionObj
        data-element=PpToComDbgFD14Tx.FD14_ignitionStatus_e, system-signal=FD14_ignitionStatus_e
        data-element=PpToComDbgFD14Tx.FD14_IgnoredFeatures_Front_u32, system-signal=FD14_IgnoredFeatures_Front_u32
        data-element=PpToComDbgFD14Tx.FD14_IgnoredFeatures_Left_u32, system-signal=FD14_IgnoredFeatures_Left_u32
        data-element=PpToComDbgFD14Tx.FD14_IgnoredFeatures_Rear_u32, system-signal=FD14_IgnoredFeatures_Rear_u32
        data-element=PpToComDbgFD14Tx.FD14_IgnoredFeatures_Right_u32, system-signal=FD14_IgnoredFeatures_Right_u32
        data-element=PpToComDbgFD14Tx.FD14_IgnoreVehicleOffSpeed, system-signal=FD14_IgnoreVehicleOffSpeed
        data-element=PpToComDbgFD14Tx.FD14_ImageDefeat_Error_e, system-signal=FD14_ImageDefeat_Error_e
        data-element=PpToComDbgFD14Tx.FD14_InvalidFeatures_Front_u32, system-signal=FD14_InvalidFeatures_Front_u32
        data-element=PpToComDbgFD14Tx.FD14_InvalidFeatures_Left_u32, system-signal=FD14_InvalidFeatures_Left_u32
        data-element=PpToComDbgFD14Tx.FD14_InvalidFeatures_Rear_u32, system-signal=FD14_InvalidFeatures_Rear_u32
        data-element=PpToComDbgFD14Tx.FD14_InvalidFeatures_Right_u32, system-signal=FD14_InvalidFeatures_Right_u32
        data-element=PpToComDbgFD14Tx.FD14_IsBackSftbtnSel, system-signal=FD14_IsBackSftbtnSel
        data-element=PpToComDbgFD14Tx.FD14_IsExitSftBtnSel, system-signal=FD14_IsExitSftBtnSel
        data-element=PpToComDbgFD14Tx.FD14_IsParkSftBtnSel, system-signal=FD14_IsParkSftBtnSel
        data-element=PpToComDbgFD14Tx.FD14_isPLDInitSuccess_b, system-signal=FD14_isPLDInitSuccess_b
        data-element=PpToComDbgFD14Tx.FD14_IsSlotSel, system-signal=FD14_IsSlotSel
        data-element=PpToComDbgFD14Tx.FD14_isUSSInitSuccess_b, system-signal=FD14_isUSSInitSuccess_b
        data-element=PpToComDbgFD14Tx.FD14_ItbmTrailerStatus, system-signal=FD14_ItbmTrailerStatus
        data-element=PpToComDbgFD14Tx.FD14_JackknifeAngle, system-signal=FD14_JackknifeAngle
        data-element=PpToComDbgFD14Tx.FD14_JackknifeThrAngle, system-signal=FD14_JackknifeThrAngle
        data-element=PpToComDbgFD14Tx.FD14_KnobAngle, system-signal=FD14_KnobAngle
        data-element=PpToComDbgFD14Tx.FD14_LanguageSelection_u8, system-signal=FD14_LanguageSelection_u8
        data-element=PpToComDbgFD14Tx.FD14_LastViewBeforeTestPattern_e, system-signal=FD14_LastViewBeforeTestPattern_e
        data-element=PpToComDbgFD14Tx.FD14_LeftCam_NA_b, system-signal=FD14_LeftCam_NA_b
        data-element=PpToComDbgFD14Tx.FD14_LeftDoorFrontClose_Icon_b, system-signal=FD14_LeftDoorFrontClose_Icon_b
        data-element=PpToComDbgFD14Tx.FD14_LeftDoorFrontOpen_Icon_b, system-signal=FD14_LeftDoorFrontOpen_Icon_b
        data-element=PpToComDbgFD14Tx.FD14_LeftDoorRearClose_Icon_b, system-signal=FD14_LeftDoorRearClose_Icon_b
        data-element=PpToComDbgFD14Tx.FD14_LeftDoorRearOpen_Icon_b, system-signal=FD14_LeftDoorRearOpen_Icon_b
        data-element=PpToComDbgFD14Tx.FD14_leLMD_e_HealthStatus, system-signal=FD14_leLMD_e_HealthStatus
        data-element=PpToComDbgFD14Tx.FD14_LMD_e_Line_{1..4}_Type, system-signal=FD14_LMD_e_Line_{1..4}_Type
        data-element=PpToComDbgFD14Tx.FD14_LMD_e_Segment_{1..8}_ID, system-signal=FD14_LMD_e_Segment_{1..8}_ID
        data-element=PpToComDbgFD14Tx.FD14_LMD_m_Line_1_End_Range, system-signal=FD14_LMD_m_Line_1_End_Range
        data-element=PpToComDbgFD14Tx.FD14_LMD_m_Line_1_Offset, system-signal=FD14_LMD_m_Line_1_Offset
        data-element=PpToComDbgFD14Tx.FD14_LMD_m_Line_1_Start_Range, system-signal=FD14_LMD_m_Line_1_Start_Range
        data-element=PpToComDbgFD14Tx.FD14_LMD_m_Line_2_End_Range, system-signal=FD14_LMD_m_Line_2_End_Range
        data-element=PpToComDbgFD14Tx.FD14_LMD_m_Line_2_Offset, system-signal=FD14_LMD_m_Line_2_Offset
        data-element=PpToComDbgFD14Tx.FD14_LMD_m_Line_2_Start_Range, system-signal=FD14_LMD_m_Line_2_Start_Range
        data-element=PpToComDbgFD14Tx.FD14_LMD_m_Line_3_End_Range, system-signal=FD14_LMD_m_Line_3_End_Range
        data-element=PpToComDbgFD14Tx.FD14_LMD_m_Line_3_Offset, system-signal=FD14_LMD_m_Line_3_Offset
        data-element=PpToComDbgFD14Tx.FD14_LMD_m_Line_3_Start_Range, system-signal=FD14_LMD_m_Line_3_Start_Range
        data-element=PpToComDbgFD14Tx.FD14_LMD_m_Line_4_End_Range, system-signal=FD14_LMD_m_Line_4_End_Range
        data-element=PpToComDbgFD14Tx.FD14_LMD_m_Line_4_Offset, system-signal=FD14_LMD_m_Line_4_Offset
        data-element=PpToComDbgFD14Tx.FD14_LMD_m_Line_4_Start_Range, system-signal=FD14_LMD_m_Line_4_Start_Range
        data-element=PpToComDbgFD14Tx.FD14_LMD_m_Segment_1_X1, system-signal=FD14_LMD_m_Segment_1_X1
        data-element=PpToComDbgFD14Tx.FD14_LMD_m_Segment_1_X2, system-signal=FD14_LMD_m_Segment_1_X2
        data-element=PpToComDbgFD14Tx.FD14_LMD_m_Segment_1_Y1, system-signal=FD14_LMD_m_Segment_1_Y1
        data-element=PpToComDbgFD14Tx.FD14_LMD_m_Segment_1_Y2, system-signal=FD14_LMD_m_Segment_1_Y2
        data-element=PpToComDbgFD14Tx.FD14_LMD_m_Segment_2_X1, system-signal=FD14_LMD_m_Segment_2_X1
        data-element=PpToComDbgFD14Tx.FD14_LMD_m_Segment_2_X2, system-signal=FD14_LMD_m_Segment_2_X2
        data-element=PpToComDbgFD14Tx.FD14_LMD_m_Segment_2_Y1, system-signal=FD14_LMD_m_Segment_2_Y1
        data-element=PpToComDbgFD14Tx.FD14_LMD_m_Segment_2_Y2, system-signal=FD14_LMD_m_Segment_2_Y2
        data-element=PpToComDbgFD14Tx.FD14_LMD_m_Segment_3_X1, system-signal=FD14_LMD_m_Segment_3_X1
        data-element=PpToComDbgFD14Tx.FD14_LMD_m_Segment_3_X2, system-signal=FD14_LMD_m_Segment_3_X2
        data-element=PpToComDbgFD14Tx.FD14_LMD_m_Segment_3_Y1, system-signal=FD14_LMD_m_Segment_3_Y1
        data-element=PpToComDbgFD14Tx.FD14_LMD_m_Segment_3_Y2, system-signal=FD14_LMD_m_Segment_3_Y2
        data-element=PpToComDbgFD14Tx.FD14_LMD_m_Segment_4_X1, system-signal=FD14_LMD_m_Segment_4_X1
        data-element=PpToComDbgFD14Tx.FD14_LMD_m_Segment_4_X2, system-signal=FD14_LMD_m_Segment_4_X2
        data-element=PpToComDbgFD14Tx.FD14_LMD_m_Segment_4_Y1, system-signal=FD14_LMD_m_Segment_4_Y1
        data-element=PpToComDbgFD14Tx.FD14_LMD_m_Segment_4_Y2, system-signal=FD14_LMD_m_Segment_4_Y2
        data-element=PpToComDbgFD14Tx.FD14_LMD_m_Segment_5_X1, system-signal=FD14_LMD_m_Segment_5_X1
        data-element=PpToComDbgFD14Tx.FD14_LMD_m_Segment_5_X2, system-signal=FD14_LMD_m_Segment_5_X2
        data-element=PpToComDbgFD14Tx.FD14_LMD_m_Segment_5_Y1, system-signal=FD14_LMD_m_Segment_5_Y1
        data-element=PpToComDbgFD14Tx.FD14_LMD_m_Segment_5_Y2, system-signal=FD14_LMD_m_Segment_5_Y2
        data-element=PpToComDbgFD14Tx.FD14_LMD_m_Segment_6_X1, system-signal=FD14_LMD_m_Segment_6_X1
        data-element=PpToComDbgFD14Tx.FD14_LMD_m_Segment_6_X2, system-signal=FD14_LMD_m_Segment_6_X2
        data-element=PpToComDbgFD14Tx.FD14_LMD_m_Segment_6_Y1, system-signal=FD14_LMD_m_Segment_6_Y1
        data-element=PpToComDbgFD14Tx.FD14_LMD_m_Segment_6_Y2, system-signal=FD14_LMD_m_Segment_6_Y2
        data-element=PpToComDbgFD14Tx.FD14_LMD_m_Segment_7_X1, system-signal=FD14_LMD_m_Segment_7_X1
        data-element=PpToComDbgFD14Tx.FD14_LMD_m_Segment_7_X2, system-signal=FD14_LMD_m_Segment_7_X2
        data-element=PpToComDbgFD14Tx.FD14_LMD_m_Segment_7_Y1, system-signal=FD14_LMD_m_Segment_7_Y1
        data-element=PpToComDbgFD14Tx.FD14_LMD_m_Segment_7_Y2, system-signal=FD14_LMD_m_Segment_7_Y2
        data-element=PpToComDbgFD14Tx.FD14_LMD_m_Segment_8_X1, system-signal=FD14_LMD_m_Segment_8_X1
        data-element=PpToComDbgFD14Tx.FD14_LMD_m_Segment_8_X2, system-signal=FD14_LMD_m_Segment_8_X2
        data-element=PpToComDbgFD14Tx.FD14_LMD_m_Segment_8_Y1, system-signal=FD14_LMD_m_Segment_8_Y1
        data-element=PpToComDbgFD14Tx.FD14_LMD_m_Segment_8_Y2, system-signal=FD14_LMD_m_Segment_8_Y2
        data-element=PpToComDbgFD14Tx.FD14_LMD_pct_Line_{1..4}_Confidence, system-signal=FD14_LMD_pct_Line_{1..4}_Confidence
        data-element=PpToComDbgFD14Tx.FD14_LMD_pct_Segment_{1..8}_Confidence, system-signal=FD14_LMD_pct_Segment_{1..8}_Confidence
        data-element=PpToComDbgFD14Tx.FD14_LMD_px_Line_{1..4}_Curvature, system-signal=FD14_LMD_px_Line_{1..4}_Curvature
        data-element=PpToComDbgFD14Tx.FD14_LMD_rad_Line_{1..4}_Heading, system-signal=FD14_LMD_rad_Line_{1..4}_Heading
        data-element=PpToComDbgFD14Tx.FD14_Log_Sensor_Temperature, system-signal=FD14_Log_Sensor_Temperature
        data-element=PpToComDbgFD14Tx.FD14_Log_SnrMeasData_{1..7}, system-signal=FD14_Log_SnrMeasData_{1..7}
        data-element=PpToComDbgFD14Tx.FD14_lrwsST_e, system-signal=FD14_lrwsST_e
        data-element=PpToComDbgFD14Tx.FD14_M_BURV_Memory_e, system-signal=FD14_M_BURV_Memory_e
        data-element=PpToComDbgFD14Tx.FD14_M_CONFIRM_BTN_PRESSED_b, system-signal=FD14_M_CONFIRM_BTN_PRESSED_b
        data-element=PpToComDbgFD14Tx.FD14_M_Cplr_Htch_Distance, system-signal=FD14_M_Cplr_Htch_Distance
        data-element=PpToComDbgFD14Tx.FD14_M_CPLR_POS_X_u, system-signal=FD14_M_CPLR_POS_X_u
        data-element=PpToComDbgFD14Tx.FD14_M_CPLR_POS_Y_u, system-signal=FD14_M_CPLR_POS_Y_u
        data-element=PpToComDbgFD14Tx.FD14_M_Current_THA_State_On_Screen, system-signal=FD14_M_Current_THA_State_On_Screen
        data-element=PpToComDbgFD14Tx.FD14_M_Current_THA_State_On_Zync, system-signal=FD14_M_Current_THA_State_On_Zync
        data-element=PpToComDbgFD14Tx.FD14_M_FFClatch_e, system-signal=FD14_M_FFClatch_e
        data-element=PpToComDbgFD14Tx.FD14_m_FPAInfoToPLDSlotID, system-signal=FD14_m_FPAInfoToPLDSlotID
        data-element=PpToComDbgFD14Tx.FD14_m_FPAInfoToUSSOMSlotID, system-signal=FD14_m_FPAInfoToUSSOMSlotID
        data-element=PpToComDbgFD14Tx.FD14_m_FpaInfoToVCParkOutStyle, system-signal=FD14_m_FpaInfoToVCParkOutStyle
        data-element=PpToComDbgFD14Tx.FD14_m_FPAToNVMParkInStyle, system-signal=FD14_m_FPAToNVMParkInStyle
        data-element=PpToComDbgFD14Tx.FD14_m_FPAToNVMReadNVMParam_b, system-signal=FD14_m_FPAToNVMReadNVMParam_b
        data-element=PpToComDbgFD14Tx.FD14_m_FPAToNVMWriteNVMParam_b, system-signal=FD14_m_FPAToNVMWriteNVMParam_b
        data-element=PpToComDbgFD14Tx.FD14_M_Maneuver_Initial_Run, system-signal=FD14_M_Maneuver_Initial_Run
        data-element=PpToComDbgFD14Tx.FD14_M_Progress_Bar_Distance, system-signal=FD14_M_Progress_Bar_Distance
        data-element=PpToComDbgFD14Tx.FD14_M_Progress_Bar_Percentage, system-signal=FD14_M_Progress_Bar_Percentage
        data-element=PpToComDbgFD14Tx.FD14_m_QM_FID_TRSC_ASCMDef, system-signal=FD14_m_QM_FID_TRSC_ASCMDef
        data-element=PpToComDbgFD14Tx.FD14_m_QM_FID_TRSC_CAM_CAL_ABORT, system-signal=FD14_m_QM_FID_TRSC_CAM_CAL_ABORT
        data-element=PpToComDbgFD14Tx.FD14_m_QM_FID_TRSC_DISABLED, system-signal=FD14_m_QM_FID_TRSC_DISABLED
        data-element=PpToComDbgFD14Tx.FD14_m_QM_FID_TRSC_LIMITED_DefView, system-signal=FD14_m_QM_FID_TRSC_LIMITED_DefView
        data-element=PpToComDbgFD14Tx.FD14_m_QM_FID_TRSC_LIMITED_View, system-signal=FD14_m_QM_FID_TRSC_LIMITED_View
        data-element=PpToComDbgFD14Tx.FD14_M_Requested_THA_State, system-signal=FD14_M_Requested_THA_State
        data-element=PpToComDbgFD14Tx.FD14_M_START_BTN_PRESSED_b, system-signal=FD14_M_START_BTN_PRESSED_b
        data-element=PpToComDbgFD14Tx.FD14_M_THA_SFT_BTN_PRESSED_b, system-signal=FD14_M_THA_SFT_BTN_PRESSED_b
        data-element=PpToComDbgFD14Tx.FD14_M_VIEW_SCRN_TCH_STS_b, system-signal=FD14_M_VIEW_SCRN_TCH_STS_b
        data-element=PpToComDbgFD14Tx.FD14_M_VIEW_ZOOM_STS_b, system-signal=FD14_M_VIEW_ZOOM_STS_b
        data-element=PpToComDbgFD14Tx.FD14_MaAP_m_ParkSpot1FrntStreetX, system-signal=FD14_MaAP_m_ParkSpot1FrntStreetX
        data-element=PpToComDbgFD14Tx.FD14_MaAP_m_ParkSpot1FrntStreetY, system-signal=FD14_MaAP_m_ParkSpot1FrntStreetY
        data-element=PpToComDbgFD14Tx.FD14_MaAP_m_ParkSpot2FrntBorderX, system-signal=FD14_MaAP_m_ParkSpot2FrntBorderX
        data-element=PpToComDbgFD14Tx.FD14_MaAP_m_ParkSpot2FrntBorderY, system-signal=FD14_MaAP_m_ParkSpot2FrntBorderY
        data-element=PpToComDbgFD14Tx.FD14_MaAP_m_ParkSpot3RearBorderX, system-signal=FD14_MaAP_m_ParkSpot3RearBorderX
        data-element=PpToComDbgFD14Tx.FD14_MaAP_m_ParkSpot3RearBorderY, system-signal=FD14_MaAP_m_ParkSpot3RearBorderY
        data-element=PpToComDbgFD14Tx.FD14_MaAP_m_ParkSpot4RearStreetX, system-signal=FD14_MaAP_m_ParkSpot4RearStreetX
        data-element=PpToComDbgFD14Tx.FD14_MaAP_m_ParkSpot4RearStreetY, system-signal=FD14_MaAP_m_ParkSpot4RearStreetY
        data-element=PpToComDbgFD14Tx.FD14_macCvpamFdData1_u64, system-signal=FD14_macCvpamFdData1_u64
        data-element=PpToComDbgFD14Tx.FD14_MAGNIFIER_BTN_PRESSED_b, system-signal=FD14_MAGNIFIER_BTN_PRESSED_b
        data-element=PpToComDbgFD14Tx.FD14_MaxTadAngle, system-signal=FD14_MaxTadAngle
        data-element=PpToComDbgFD14Tx.FD14_MeAP_a_BrkCmd, system-signal=FD14_MeAP_a_BrkCmd
        data-element=PpToComDbgFD14Tx.FD14_MeAP_a_ThrtlCmd, system-signal=FD14_MeAP_a_ThrtlCmd
        data-element=PpToComDbgFD14Tx.FD14_MeAP_b_APInitSts, system-signal=FD14_MeAP_b_APInitSts
        data-element=PpToComDbgFD14Tx.FD14_MeAP_b_BSMHandshakeActv, system-signal=FD14_MeAP_b_BSMHandshakeActv
        data-element=PpToComDbgFD14Tx.FD14_MeAP_b_BSMInterfaceTimeout, system-signal=FD14_MeAP_b_BSMInterfaceTimeout
        data-element=PpToComDbgFD14Tx.FD14_MeAP_b_CamHandshakeTimeout, system-signal=FD14_MeAP_b_CamHandshakeTimeout
        data-element=PpToComDbgFD14Tx.FD14_MeAP_b_DriverOverride, system-signal=FD14_MeAP_b_DriverOverride
        data-element=PpToComDbgFD14Tx.FD14_MeAP_b_EPSInterfaceTimeout, system-signal=FD14_MeAP_b_EPSInterfaceTimeout
        data-element=PpToComDbgFD14Tx.FD14_MeAP_b_FeatureEnbl, system-signal=FD14_MeAP_b_FeatureEnbl
        data-element=PpToComDbgFD14Tx.FD14_MeAP_b_FPADisable, system-signal=FD14_MeAP_b_FPADisable
        data-element=PpToComDbgFD14Tx.FD14_MeAP_b_FPAStatus, system-signal=FD14_MeAP_b_FPAStatus
        data-element=PpToComDbgFD14Tx.FD14_MeAP_b_FPAVolDefMed, system-signal=FD14_MeAP_b_FPAVolDefMed
        data-element=PpToComDbgFD14Tx.FD14_MeAP_b_GearShiftWaitTimeout, system-signal=FD14_MeAP_b_GearShiftWaitTimeout
        data-element=PpToComDbgFD14Tx.FD14_MeAP_b_ManeuverAbort, system-signal=FD14_MeAP_b_ManeuverAbort
        data-element=PpToComDbgFD14Tx.FD14_MeAP_b_ManeuverSuccess, system-signal=FD14_MeAP_b_ManeuverSuccess
        data-element=PpToComDbgFD14Tx.FD14_MeAP_b_ObjInPathTimeout, system-signal=FD14_MeAP_b_ObjInPathTimeout
        data-element=PpToComDbgFD14Tx.FD14_MeAP_b_PARBActv4LOW, system-signal=FD14_MeAP_b_PARBActv4LOW
        data-element=PpToComDbgFD14Tx.FD14_MeAP_b_PARBActvTrlr, system-signal=FD14_MeAP_b_PARBActvTrlr
        data-element=PpToComDbgFD14Tx.FD14_MeAP_b_PARBDisable, system-signal=FD14_MeAP_b_PARBDisable
        data-element=PpToComDbgFD14Tx.FD14_MeAP_b_PausedPressBtnTimeout, system-signal=FD14_MeAP_b_PausedPressBtnTimeout
        data-element=PpToComDbgFD14Tx.FD14_MeAP_b_PAVolDefMed, system-signal=FD14_MeAP_b_PAVolDefMed
        data-element=PpToComDbgFD14Tx.FD14_MeAP_b_PosMet, system-signal=FD14_MeAP_b_PosMet
        data-element=PpToComDbgFD14Tx.FD14_MeAP_b_PPPAActv4LOW, system-signal=FD14_MeAP_b_PPPAActv4LOW
        data-element=PpToComDbgFD14Tx.FD14_MeAP_b_PPPAActvTrlr, system-signal=FD14_MeAP_b_PPPAActvTrlr
        data-element=PpToComDbgFD14Tx.FD14_MeAP_b_PPPADefEng, system-signal=FD14_MeAP_b_PPPADefEng
        data-element=PpToComDbgFD14Tx.FD14_MeAP_b_PPPADisable, system-signal=FD14_MeAP_b_PPPADisable
        data-element=PpToComDbgFD14Tx.FD14_MeAP_b_RPAActvTrlr, system-signal=FD14_MeAP_b_RPAActvTrlr
        data-element=PpToComDbgFD14Tx.FD14_MeAP_b_RPADisable, system-signal=FD14_MeAP_b_RPADisable
        data-element=PpToComDbgFD14Tx.FD14_MeAP_b_RPAStatus, system-signal=FD14_MeAP_b_RPAStatus
        data-element=PpToComDbgFD14Tx.FD14_MeAP_b_RPAVolDefMed, system-signal=FD14_MeAP_b_RPAVolDefMed
        data-element=PpToComDbgFD14Tx.FD14_MeAP_b_RPAwithBrkStatus, system-signal=FD14_MeAP_b_RPAwithBrkStatus
        data-element=PpToComDbgFD14Tx.FD14_MeAP_b_SeekSpdExceedTimeout, system-signal=FD14_MeAP_b_SeekSpdExceedTimeout
        data-element=PpToComDbgFD14Tx.FD14_MeAP_b_StandStill, system-signal=FD14_MeAP_b_StandStill
        data-element=PpToComDbgFD14Tx.FD14_MeAP_b_SteerActionReq, system-signal=FD14_MeAP_b_SteerActionReq
        data-element=PpToComDbgFD14Tx.FD14_MeAP_b_VCOpPaused, system-signal=FD14_MeAP_b_VCOpPaused
        data-element=PpToComDbgFD14Tx.FD14_MeAP_b_VehCndSts, system-signal=FD14_MeAP_b_VehCndSts
        data-element=PpToComDbgFD14Tx.FD14_MeAP_cm_FrntCenterMinXDist, system-signal=FD14_MeAP_cm_FrntCenterMinXDist
        data-element=PpToComDbgFD14Tx.FD14_MeAP_cm_FrntLeftMinXDist, system-signal=FD14_MeAP_cm_FrntLeftMinXDist
        data-element=PpToComDbgFD14Tx.FD14_MeAP_cm_FrntRightMinXDist, system-signal=FD14_MeAP_cm_FrntRightMinXDist
        data-element=PpToComDbgFD14Tx.FD14_MeAP_cm_RearCenterMinXDist, system-signal=FD14_MeAP_cm_RearCenterMinXDist
        data-element=PpToComDbgFD14Tx.FD14_MeAP_cm_RearLeftMinXDist, system-signal=FD14_MeAP_cm_RearLeftMinXDist
        data-element=PpToComDbgFD14Tx.FD14_MeAP_cm_RearRightMinXDist, system-signal=FD14_MeAP_cm_RearRightMinXDist
        data-element=PpToComDbgFD14Tx.FD14_MeAP_cnt_StateDebugVar, system-signal=FD14_MeAP_cnt_StateDebugVar
        data-element=PpToComDbgFD14Tx.FD14_MeAP_cnt_TransDebugVar, system-signal=FD14_MeAP_cnt_TransDebugVar
        data-element=PpToComDbgFD14Tx.FD14_MeAP_cnt_TransDebugVar_Copy_1, system-signal=FD14_MeAP_cnt_TransDebugVar_Copy_1
        data-element=PpToComDbgFD14Tx.FD14_MeAP_deg_StrCmd, system-signal=FD14_MeAP_deg_StrCmd
        data-element=PpToComDbgFD14Tx.FD14_MeAP_e_Park_state, system-signal=FD14_MeAP_e_Park_state
        data-element=PpToComDbgFD14Tx.FD14_MeAP_e_ParkAssistStatus, system-signal=FD14_MeAP_e_ParkAssistStatus
        data-element=PpToComDbgFD14Tx.FD14_MeAP_e_PP_state, system-signal=FD14_MeAP_e_PP_state
        data-element=PpToComDbgFD14Tx.FD14_MePRX_b_AuxTrlrCam, system-signal=FD14_MePRX_b_AuxTrlrCam
        data-element=PpToComDbgFD14Tx.FD14_MePRX_b_CanNode27, system-signal=FD14_MePRX_b_CanNode27
        data-element=PpToComDbgFD14Tx.FD14_MePRX_b_CANNode95, system-signal=FD14_MePRX_b_CANNode95
        data-element=PpToComDbgFD14Tx.FD14_MePRX_b_FrwFacingCam, system-signal=FD14_MePRX_b_FrwFacingCam
        data-element=PpToComDbgFD14Tx.FD14_MePRX_b_SurroundViewCamera, system-signal=FD14_MePRX_b_SurroundViewCamera
        data-element=PpToComDbgFD14Tx.FD14_MePRX_b_TRGPresence, system-signal=FD14_MePRX_b_TRGPresence
        data-element=PpToComDbgFD14Tx.FD14_MePRX_b_TRSCPresence, system-signal=FD14_MePRX_b_TRSCPresence
        data-element=PpToComDbgFD14Tx.FD14_MePRX_e_AutonomyLvl, system-signal=FD14_MePRX_e_AutonomyLvl
        data-element=PpToComDbgFD14Tx.FD14_MePRX_e_MirrorType, system-signal=FD14_MePRX_e_MirrorType
        data-element=PpToComDbgFD14Tx.FD14_MePRX_e_PAMTunSet, system-signal=FD14_MePRX_e_PAMTunSet
        data-element=PpToComDbgFD14Tx.FD14_MePRX_e_RadDispType, system-signal=FD14_MePRX_e_RadDispType
        data-element=PpToComDbgFD14Tx.FD14_MePRX_e_SteerRatRackPinionType, system-signal=FD14_MePRX_e_SteerRatRackPinionType
        data-element=PpToComDbgFD14Tx.FD14_MePRX_e_VariantID, system-signal=FD14_MePRX_e_VariantID
        data-element=PpToComDbgFD14Tx.FD14_MePRX_e_VehLineCfg, system-signal=FD14_MePRX_e_VehLineCfg
        data-element=PpToComDbgFD14Tx.FD14_MePRX_e_Wheelbase, system-signal=FD14_MePRX_e_Wheelbase
        data-element=PpToComDbgFD14Tx.FD14_MeSVS_b_MoreCamReqSts, system-signal=FD14_MeSVS_b_MoreCamReqSts
        data-element=PpToComDbgFD14Tx.FD14_MeSVS_e_DispView2Info, system-signal=FD14_MeSVS_e_DispView2Info
        data-element=PpToComDbgFD14Tx.FD14_MeTHA_b_EnblRearParkAsstTrg, system-signal=FD14_MeTHA_b_EnblRearParkAsstTrg
        data-element=PpToComDbgFD14Tx.FD14_MeTHA_b_THAAbortStatus, system-signal=FD14_MeTHA_b_THAAbortStatus
        data-element=PpToComDbgFD14Tx.FD14_MeTHA_b_TrlrCplrStatus, system-signal=FD14_MeTHA_b_TrlrCplrStatus
        data-element=PpToComDbgFD14Tx.FD14_MeTHA_b_UsrCplrSelCnfm, system-signal=FD14_MeTHA_b_UsrCplrSelCnfm
        data-element=PpToComDbgFD14Tx.FD14_MeTHA_b_UsrHitchCnfm, system-signal=FD14_MeTHA_b_UsrHitchCnfm
        data-element=PpToComDbgFD14Tx.FD14_MeTHA_deg_CplrAng, system-signal=FD14_MeTHA_deg_CplrAng
        data-element=PpToComDbgFD14Tx.FD14_MeTHA_deg_RoadWhlAng, system-signal=FD14_MeTHA_deg_RoadWhlAng
        data-element=PpToComDbgFD14Tx.FD14_MeTHA_e_CplrDetctStatus, system-signal=FD14_MeTHA_e_CplrDetctStatus
        data-element=PpToComDbgFD14Tx.FD14_MeTHA_e_HitchDetctStatus, system-signal=FD14_MeTHA_e_HitchDetctStatus
        data-element=PpToComDbgFD14Tx.FD14_MeTHA_e_RearBrkSupprInfo, system-signal=FD14_MeTHA_e_RearBrkSupprInfo
        data-element=PpToComDbgFD14Tx.FD14_MeTHA_e_ScreenRequest, system-signal=FD14_MeTHA_e_ScreenRequest
        data-element=PpToComDbgFD14Tx.FD14_MeTHA_e_THAStateInfo, system-signal=FD14_MeTHA_e_THAStateInfo
        data-element=PpToComDbgFD14Tx.FD14_MeTHA_pct_CplrDetConf, system-signal=FD14_MeTHA_pct_CplrDetConf
        data-element=PpToComDbgFD14Tx.FD14_MeTHA_pct_CplrTrckConf, system-signal=FD14_MeTHA_pct_CplrTrckConf
        data-element=PpToComDbgFD14Tx.FD14_MeTHA_px_CplrPntX, system-signal=FD14_MeTHA_px_CplrPntX
        data-element=PpToComDbgFD14Tx.FD14_MeTHA_px_CplrPntY, system-signal=FD14_MeTHA_px_CplrPntY
        data-element=PpToComDbgFD14Tx.FD14_MeTHA_px_HitchCplrPixDiffLat, system-signal=FD14_MeTHA_px_HitchCplrPixDiffLat
        data-element=PpToComDbgFD14Tx.FD14_MeTHA_px_HitchCplrPixDiffLong, system-signal=FD14_MeTHA_px_HitchCplrPixDiffLong
        data-element=PpToComDbgFD14Tx.FD14_MeTHA_px_HitchPntX, system-signal=FD14_MeTHA_px_HitchPntX
        data-element=PpToComDbgFD14Tx.FD14_MeTHA_px_HitchPntY, system-signal=FD14_MeTHA_px_HitchPntY
        data-element=PpToComDbgFD14Tx.FD14_MeTRSC_b_MoreCamSoftButtEnbl, system-signal=FD14_MeTRSC_b_MoreCamSoftButtEnbl
        data-element=PpToComDbgFD14Tx.FD14_MeTRSC_b_OBTLRecalibrate, system-signal=FD14_MeTRSC_b_OBTLRecalibrate
        data-element=PpToComDbgFD14Tx.FD14_MeTRSC_b_TrlrCalibDelayInfo, system-signal=FD14_MeTRSC_b_TrlrCalibDelayInfo
        data-element=PpToComDbgFD14Tx.FD14_MeTRSC_b_TrlrCalibPopInfo, system-signal=FD14_MeTRSC_b_TrlrCalibPopInfo
        data-element=PpToComDbgFD14Tx.FD14_MeTRSC_b_TrlrRevSteeringStsInfo, system-signal=FD14_MeTRSC_b_TrlrRevSteeringStsInfo
        data-element=PpToComDbgFD14Tx.FD14_MeTRSC_b_TRSCSwitchPressed, system-signal=FD14_MeTRSC_b_TRSCSwitchPressed
        data-element=PpToComDbgFD14Tx.FD14_MeTRSC_cnt_TrlrCalibFailCntInfo, system-signal=FD14_MeTRSC_cnt_TrlrCalibFailCntInfo
        data-element=PpToComDbgFD14Tx.FD14_MeTRSC_deg_DetJackKnifeAngle, system-signal=FD14_MeTRSC_deg_DetJackKnifeAngle
        data-element=PpToComDbgFD14Tx.FD14_MeTRSC_deg_DetJackknifeThrAngle, system-signal=FD14_MeTRSC_deg_DetJackknifeThrAngle
        data-element=PpToComDbgFD14Tx.FD14_MeTRSC_deg_JackKnifeAngle, system-signal=FD14_MeTRSC_deg_JackKnifeAngle
        data-element=PpToComDbgFD14Tx.FD14_MeTRSC_deg_JackknifeThrAngle, system-signal=FD14_MeTRSC_deg_JackknifeThrAngle
        data-element=PpToComDbgFD14Tx.FD14_MeTRSC_deg_KnobAngle, system-signal=FD14_MeTRSC_deg_KnobAngle
        data-element=PpToComDbgFD14Tx.FD14_MeTRSC_deg_MaxAllowedTADAngle, system-signal=FD14_MeTRSC_deg_MaxAllowedTADAngle
        data-element=PpToComDbgFD14Tx.FD14_MeTRSC_deg_TADAngle, system-signal=FD14_MeTRSC_deg_TADAngle
        data-element=PpToComDbgFD14Tx.FD14_MeTRSC_deg_TADAngleRate, system-signal=FD14_MeTRSC_deg_TADAngleRate
        data-element=PpToComDbgFD14Tx.FD14_MeTRSC_e_CalFail, system-signal=FD14_MeTRSC_e_CalFail
        data-element=PpToComDbgFD14Tx.FD14_MeTRSC_e_TADCalibrationSubstate, system-signal=FD14_MeTRSC_e_TADCalibrationSubstate
        data-element=PpToComDbgFD14Tx.FD14_MeTRSC_e_TADState, system-signal=FD14_MeTRSC_e_TADState
        data-element=PpToComDbgFD14Tx.FD14_MeTRSC_e_TrailerID, system-signal=FD14_MeTRSC_e_TrailerID
        data-element=PpToComDbgFD14Tx.FD14_MeTRSC_e_TrlrAngSign, system-signal=FD14_MeTRSC_e_TrlrAngSign
        data-element=PpToComDbgFD14Tx.FD14_MeTRSC_e_TrlrCalInfo, system-signal=FD14_MeTRSC_e_TrlrCalInfo
        data-element=PpToComDbgFD14Tx.FD14_MeTRSC_e_TrlrPrsntInfo, system-signal=FD14_MeTRSC_e_TrlrPrsntInfo
        data-element=PpToComDbgFD14Tx.FD14_MeTRSC_e_TrlrPrsntInfoCAN, system-signal=FD14_MeTRSC_e_TrlrPrsntInfoCAN
        data-element=PpToComDbgFD14Tx.FD14_MeTRSC_e_TrlrRecogInfo, system-signal=FD14_MeTRSC_e_TrlrRecogInfo
        data-element=PpToComDbgFD14Tx.FD14_MeTRSC_e_TRSCStat, system-signal=FD14_MeTRSC_e_TRSCStat
        data-element=PpToComDbgFD14Tx.FD14_MeTRSC_e_TurnAroundSubState, system-signal=FD14_MeTRSC_e_TurnAroundSubState
        data-element=PpToComDbgFD14Tx.FD14_MeTRSC_m_DetTrailerBeamLen, system-signal=FD14_MeTRSC_m_DetTrailerBeamLen
        data-element=PpToComDbgFD14Tx.FD14_MeTRSC_m_HitchLength, system-signal=FD14_MeTRSC_m_HitchLength
        data-element=PpToComDbgFD14Tx.FD14_MeTRSC_M_SteeringTorqInfo, system-signal=FD14_MeTRSC_M_SteeringTorqInfo
        data-element=PpToComDbgFD14Tx.FD14_MeTRSC_m_TrailerBeamLen, system-signal=FD14_MeTRSC_m_TrailerBeamLen
        data-element=PpToComDbgFD14Tx.FD14_MinDistance_TimeStamp, system-signal=FD14_MinDistance_TimeStamp
        data-element=PpToComDbgFD14Tx.FD14_MoreCamsButton1NoSelect_b, system-signal=FD14_MoreCamsButton1NoSelect_b
        data-element=PpToComDbgFD14Tx.FD14_MoreCamsButton1Select_b, system-signal=FD14_MoreCamsButton1Select_b
        data-element=PpToComDbgFD14Tx.FD14_MoreCamsButton2NoSelect_b, system-signal=FD14_MoreCamsButton2NoSelect_b
        data-element=PpToComDbgFD14Tx.FD14_MoreCamsButton2Select_b, system-signal=FD14_MoreCamsButton2Select_b
        data-element=PpToComDbgFD14Tx.FD14_MoreCamsIconFullScreenNoSelect_b, system-signal=FD14_MoreCamsIconFullScreenNoSelect_b
        data-element=PpToComDbgFD14Tx.FD14_MOT_ClosestPntDist_0_{0..9}, system-signal=FD14_MOT_ClosestPntDist_0_{0..9}
        data-element=PpToComDbgFD14Tx.FD14_MOT_ClosestPntDist_1_{0..9}, system-signal=FD14_MOT_ClosestPntDist_1_{0..9}
        data-element=PpToComDbgFD14Tx.FD14_MOT_ObjectDimensions_0_{0..9}, system-signal=FD14_MOT_ObjectDimensions_0_{0..9}
        data-element=PpToComDbgFD14Tx.FD14_MOT_ObjectDimensions_1_{0..9}, system-signal=FD14_MOT_ObjectDimensions_1_{0..9}
        data-element=PpToComDbgFD14Tx.FD14_MOT_ObjValid_{0..9}, system-signal=FD14_MOT_ObjValid_{0..9}
        data-element=PpToComDbgFD14Tx.FD14_MOT_ObjVelX_{0..9}, system-signal=FD14_MOT_ObjVelX_{0..9}
        data-element=PpToComDbgFD14Tx.FD14_MOT_ObjVelY_{0..9}, system-signal=FD14_MOT_ObjVelY_{0..9}
        data-element=PpToComDbgFD14Tx.FD14_msgcntrCvpamFdData1_u8, system-signal=FD14_msgcntrCvpamFdData1_u8
        data-element=PpToComDbgFD14Tx.FD14_NetCfg_TRSCM_e, system-signal=FD14_NetCfg_TRSCM_e
        data-element=PpToComDbgFD14Tx.FD14_NFCD_DistanceToClosestPoint_0_{0..9}, system-signal=FD14_NFCD_DistanceToClosestPoint_0_{0..9}
        data-element=PpToComDbgFD14Tx.FD14_NFCD_DistanceToClosestPoint_1_{0..9}, system-signal=FD14_NFCD_DistanceToClosestPoint_1_{0..9}
        data-element=PpToComDbgFD14Tx.FD14_NFCD_ObjValid_{0..9}, system-signal=FD14_NFCD_ObjValid_{0..9}
        data-element=PpToComDbgFD14Tx.FD14_obj_Pos_Lat, system-signal=FD14_obj_Pos_Lat
        data-element=PpToComDbgFD14Tx.FD14_obj_Pos_Longi, system-signal=FD14_obj_Pos_Longi
        data-element=PpToComDbgFD14Tx.FD14_objConf_e, system-signal=FD14_objConf_e
        data-element=PpToComDbgFD14Tx.FD14_OBTLRecalibrate, system-signal=FD14_OBTLRecalibrate
        data-element=PpToComDbgFD14Tx.FD14_OC_ModuleState_STM_Front, system-signal=FD14_OC_ModuleState_STM_Front
        data-element=PpToComDbgFD14Tx.FD14_OC_ModuleState_STM_Left, system-signal=FD14_OC_ModuleState_STM_Left
        data-element=PpToComDbgFD14Tx.FD14_OC_ModuleState_STM_Rear, system-signal=FD14_OC_ModuleState_STM_Rear
        data-element=PpToComDbgFD14Tx.FD14_OC_ModuleState_STM_Right, system-signal=FD14_OC_ModuleState_STM_Right
        data-element=PpToComDbgFD14Tx.FD14_OFFRD_ABSNT_AUXCAM_BTN_PRESSED_b, system-signal=FD14_OFFRD_ABSNT_AUXCAM_BTN_PRESSED_b
        data-element=PpToComDbgFD14Tx.FD14_OFFRD_PRSNT_AUXCAM_BTN_PRESSED_b, system-signal=FD14_OFFRD_PRSNT_AUXCAM_BTN_PRESSED_b
        data-element=PpToComDbgFD14Tx.FD14_OFFROAD_ABSNT_MC_BTN_PRESSED_b, system-signal=FD14_OFFROAD_ABSNT_MC_BTN_PRESSED_b
        data-element=PpToComDbgFD14Tx.FD14_OFFROAD_PRSNT_MC_BTN_PRESSED_b, system-signal=FD14_OFFROAD_PRSNT_MC_BTN_PRESSED_b
        data-element=PpToComDbgFD14Tx.FD14_parkExtSideSel, system-signal=FD14_parkExtSideSel
        data-element=PpToComDbgFD14Tx.FD14_parkingDirection, system-signal=FD14_parkingDirection
        data-element=PpToComDbgFD14Tx.FD14_parkingSlotType, system-signal=FD14_parkingSlotType
        data-element=PpToComDbgFD14Tx.FD14_PDC_FrontCenter_Red_b, system-signal=FD14_PDC_FrontCenter_Red_b
        data-element=PpToComDbgFD14Tx.FD14_PDC_FrontCenter_Yellow_b, system-signal=FD14_PDC_FrontCenter_Yellow_b
        data-element=PpToComDbgFD14Tx.FD14_PDC_FrontLeft_Red_b, system-signal=FD14_PDC_FrontLeft_Red_b
        data-element=PpToComDbgFD14Tx.FD14_PDC_FrontLeft_Yellow_b, system-signal=FD14_PDC_FrontLeft_Yellow_b
        data-element=PpToComDbgFD14Tx.FD14_PDC_FrontRight_Red_b, system-signal=FD14_PDC_FrontRight_Red_b
        data-element=PpToComDbgFD14Tx.FD14_PDC_FrontRight_Yellow_b, system-signal=FD14_PDC_FrontRight_Yellow_b
        data-element=PpToComDbgFD14Tx.FD14_PDC_RearCenter_Red_b, system-signal=FD14_PDC_RearCenter_Red_b
        data-element=PpToComDbgFD14Tx.FD14_PDC_RearCenter_Yellow_b, system-signal=FD14_PDC_RearCenter_Yellow_b
        data-element=PpToComDbgFD14Tx.FD14_PDC_RearLeft_Red_b, system-signal=FD14_PDC_RearLeft_Red_b
        data-element=PpToComDbgFD14Tx.FD14_PDC_RearLeft_Yellow_b, system-signal=FD14_PDC_RearLeft_Yellow_b
        data-element=PpToComDbgFD14Tx.FD14_PDC_RearRight_Red_b, system-signal=FD14_PDC_RearRight_Red_b
        data-element=PpToComDbgFD14Tx.FD14_PDC_RearRight_Yellow_b, system-signal=FD14_PDC_RearRight_Yellow_b
        data-element=PpToComDbgFD14Tx.FD14_perpParkDirectionSel, system-signal=FD14_perpParkDirectionSel
        data-element=PpToComDbgFD14Tx.FD14_Pitch_f32_Current_Rear, system-signal=FD14_Pitch_f32_Current_Rear
        data-element=PpToComDbgFD14Tx.FD14_Pitch_f32_Current_Right, system-signal=FD14_Pitch_f32_Current_Right
        data-element=PpToComDbgFD14Tx.FD14_Pitch_f32_EOL_Front, system-signal=FD14_Pitch_f32_EOL_Front
        data-element=PpToComDbgFD14Tx.FD14_Pitch_f32_EOL_Left, system-signal=FD14_Pitch_f32_EOL_Left
        data-element=PpToComDbgFD14Tx.FD14_Pitch_f32_EOL_Rear, system-signal=FD14_Pitch_f32_EOL_Rear
        data-element=PpToComDbgFD14Tx.FD14_Pitch_f32_EOL_Right, system-signal=FD14_Pitch_f32_EOL_Right
        data-element=PpToComDbgFD14Tx.FD14_Pitch_f32_OC_Front, system-signal=FD14_Pitch_f32_OC_Front
        data-element=PpToComDbgFD14Tx.FD14_Pitch_f32_OC_Left, system-signal=FD14_Pitch_f32_OC_Left
        data-element=PpToComDbgFD14Tx.FD14_Pitch_f32_OC_Rear, system-signal=FD14_Pitch_f32_OC_Rear
        data-element=PpToComDbgFD14Tx.FD14_Pitch_f32_OC_Right, system-signal=FD14_Pitch_f32_OC_Right
        data-element=PpToComDbgFD14Tx.FD14_Pitch_f32_SC_Front, system-signal=FD14_Pitch_f32_SC_Front
        data-element=PpToComDbgFD14Tx.FD14_Pitch_f32_SC_Left, system-signal=FD14_Pitch_f32_SC_Left
        data-element=PpToComDbgFD14Tx.FD14_Pitch_f32_SC_Rear, system-signal=FD14_Pitch_f32_SC_Rear
        data-element=PpToComDbgFD14Tx.FD14_Pitch_f32_SC_Right, system-signal=FD14_Pitch_f32_SC_Right
        data-element=PpToComDbgFD14Tx.FD14_Pntdebugdata_{0..3}, system-signal=FD14_Pntdebugdata_{0..3}
        data-element=PpToComDbgFD14Tx.FD14_Point_Map_Age_0, system-signal=FD14_Point_Map_Age_0
        data-element=PpToComDbgFD14Tx.FD14_Point_Map_Age_1, system-signal=FD14_Point_Map_Age_1
        data-element=PpToComDbgFD14Tx.FD14_Point_Map_Age_{10..19}, system-signal=FD14_Point_Map_Age_{10..19}
        data-element=PpToComDbgFD14Tx.FD14_Point_Map_Age_2, system-signal=FD14_Point_Map_Age_2
        data-element=PpToComDbgFD14Tx.FD14_Point_Map_Age_{20..29}, system-signal=FD14_Point_Map_Age_{20..29}
        data-element=PpToComDbgFD14Tx.FD14_Point_Map_Age_3, system-signal=FD14_Point_Map_Age_3
        data-element=PpToComDbgFD14Tx.FD14_Point_Map_Age_{30..39}, system-signal=FD14_Point_Map_Age_{30..39}
        data-element=PpToComDbgFD14Tx.FD14_Point_Map_Age_4, system-signal=FD14_Point_Map_Age_4
        data-element=PpToComDbgFD14Tx.FD14_Point_Map_Age_{40..49}, system-signal=FD14_Point_Map_Age_{40..49}
        data-element=PpToComDbgFD14Tx.FD14_Point_Map_Age_5, system-signal=FD14_Point_Map_Age_5
        data-element=PpToComDbgFD14Tx.FD14_Point_Map_Age_{50..59}, system-signal=FD14_Point_Map_Age_{50..59}
        data-element=PpToComDbgFD14Tx.FD14_Point_Map_Age_6, system-signal=FD14_Point_Map_Age_6
        data-element=PpToComDbgFD14Tx.FD14_Point_Map_Age_{60..69}, system-signal=FD14_Point_Map_Age_{60..69}
        data-element=PpToComDbgFD14Tx.FD14_Point_Map_Age_7, system-signal=FD14_Point_Map_Age_7
        data-element=PpToComDbgFD14Tx.FD14_Point_Map_Age_{70..79}, system-signal=FD14_Point_Map_Age_{70..79}
        data-element=PpToComDbgFD14Tx.FD14_Point_Map_Age_8, system-signal=FD14_Point_Map_Age_8
        data-element=PpToComDbgFD14Tx.FD14_Point_Map_Age_{80..89}, system-signal=FD14_Point_Map_Age_{80..89}
        data-element=PpToComDbgFD14Tx.FD14_Point_Map_Age_9, system-signal=FD14_Point_Map_Age_9
        data-element=PpToComDbgFD14Tx.FD14_Point_Map_Age_{90..95}, system-signal=FD14_Point_Map_Age_{90..95}
        data-element=PpToComDbgFD14Tx.FD14_Point_Map_Confidence_0, system-signal=FD14_Point_Map_Confidence_0
        data-element=PpToComDbgFD14Tx.FD14_Point_Map_Confidence_1, system-signal=FD14_Point_Map_Confidence_1
        data-element=PpToComDbgFD14Tx.FD14_Point_Map_Confidence_{10..19}, system-signal=FD14_Point_Map_Confidence_{10..19}
        data-element=PpToComDbgFD14Tx.FD14_Point_Map_Confidence_2, system-signal=FD14_Point_Map_Confidence_2
        data-element=PpToComDbgFD14Tx.FD14_Point_Map_Confidence_{20..29}, system-signal=FD14_Point_Map_Confidence_{20..29}
        data-element=PpToComDbgFD14Tx.FD14_Point_Map_Confidence_3, system-signal=FD14_Point_Map_Confidence_3
        data-element=PpToComDbgFD14Tx.FD14_Point_Map_Confidence_{30..39}, system-signal=FD14_Point_Map_Confidence_{30..39}
        data-element=PpToComDbgFD14Tx.FD14_Point_Map_Confidence_4, system-signal=FD14_Point_Map_Confidence_4
        data-element=PpToComDbgFD14Tx.FD14_Point_Map_Confidence_{40..49}, system-signal=FD14_Point_Map_Confidence_{40..49}
        data-element=PpToComDbgFD14Tx.FD14_Point_Map_Confidence_5, system-signal=FD14_Point_Map_Confidence_5
        data-element=PpToComDbgFD14Tx.FD14_Point_Map_Confidence_{50..59}, system-signal=FD14_Point_Map_Confidence_{50..59}
        data-element=PpToComDbgFD14Tx.FD14_Point_Map_Confidence_6, system-signal=FD14_Point_Map_Confidence_6
        data-element=PpToComDbgFD14Tx.FD14_Point_Map_Confidence_{60..69}, system-signal=FD14_Point_Map_Confidence_{60..69}
        data-element=PpToComDbgFD14Tx.FD14_Point_Map_Confidence_7, system-signal=FD14_Point_Map_Confidence_7
        data-element=PpToComDbgFD14Tx.FD14_Point_Map_Confidence_{70..79}, system-signal=FD14_Point_Map_Confidence_{70..79}
        data-element=PpToComDbgFD14Tx.FD14_Point_Map_Confidence_8, system-signal=FD14_Point_Map_Confidence_8
        data-element=PpToComDbgFD14Tx.FD14_Point_Map_Confidence_{80..89}, system-signal=FD14_Point_Map_Confidence_{80..89}
        data-element=PpToComDbgFD14Tx.FD14_Point_Map_Confidence_9, system-signal=FD14_Point_Map_Confidence_9
        data-element=PpToComDbgFD14Tx.FD14_Point_Map_Confidence_{90..95}, system-signal=FD14_Point_Map_Confidence_{90..95}
        data-element=PpToComDbgFD14Tx.FD14_Point_Map_Cruising_Age_0, system-signal=FD14_Point_Map_Cruising_Age_0
        data-element=PpToComDbgFD14Tx.FD14_Point_Map_Cruising_Age_1, system-signal=FD14_Point_Map_Cruising_Age_1
        data-element=PpToComDbgFD14Tx.FD14_Point_Map_Cruising_Age_{10..19}, system-signal=FD14_Point_Map_Cruising_Age_{10..19}
        data-element=PpToComDbgFD14Tx.FD14_Point_Map_Cruising_Age_2, system-signal=FD14_Point_Map_Cruising_Age_2
        data-element=PpToComDbgFD14Tx.FD14_Point_Map_Cruising_Age_{20..29}, system-signal=FD14_Point_Map_Cruising_Age_{20..29}
        data-element=PpToComDbgFD14Tx.FD14_Point_Map_Cruising_Age_3, system-signal=FD14_Point_Map_Cruising_Age_3
        data-element=PpToComDbgFD14Tx.FD14_Point_Map_Cruising_Age_{30..39}, system-signal=FD14_Point_Map_Cruising_Age_{30..39}
        data-element=PpToComDbgFD14Tx.FD14_Point_Map_Cruising_Age_4, system-signal=FD14_Point_Map_Cruising_Age_4
        data-element=PpToComDbgFD14Tx.FD14_Point_Map_Cruising_Age_{40..49}, system-signal=FD14_Point_Map_Cruising_Age_{40..49}
        data-element=PpToComDbgFD14Tx.FD14_Point_Map_Cruising_Age_5, system-signal=FD14_Point_Map_Cruising_Age_5
        data-element=PpToComDbgFD14Tx.FD14_Point_Map_Cruising_Age_{50..59}, system-signal=FD14_Point_Map_Cruising_Age_{50..59}
        data-element=PpToComDbgFD14Tx.FD14_Point_Map_Cruising_Age_6, system-signal=FD14_Point_Map_Cruising_Age_6
        data-element=PpToComDbgFD14Tx.FD14_Point_Map_Cruising_Age_{60..69}, system-signal=FD14_Point_Map_Cruising_Age_{60..69}
        data-element=PpToComDbgFD14Tx.FD14_Point_Map_Cruising_Age_7, system-signal=FD14_Point_Map_Cruising_Age_7
        data-element=PpToComDbgFD14Tx.FD14_Point_Map_Cruising_Age_{70..79}, system-signal=FD14_Point_Map_Cruising_Age_{70..79}
        data-element=PpToComDbgFD14Tx.FD14_Point_Map_Cruising_Age_8, system-signal=FD14_Point_Map_Cruising_Age_8
        data-element=PpToComDbgFD14Tx.FD14_Point_Map_Cruising_Age_{80..89}, system-signal=FD14_Point_Map_Cruising_Age_{80..89}
        data-element=PpToComDbgFD14Tx.FD14_Point_Map_Cruising_Age_9, system-signal=FD14_Point_Map_Cruising_Age_9
        data-element=PpToComDbgFD14Tx.FD14_Point_Map_Cruising_Age_{90..95}, system-signal=FD14_Point_Map_Cruising_Age_{90..95}
        data-element=PpToComDbgFD14Tx.FD14_Point_Map_Height_0, system-signal=FD14_Point_Map_Height_0
        data-element=PpToComDbgFD14Tx.FD14_Point_Map_Height_1, system-signal=FD14_Point_Map_Height_1
        data-element=PpToComDbgFD14Tx.FD14_Point_Map_Height_{10..19}, system-signal=FD14_Point_Map_Height_{10..19}
        data-element=PpToComDbgFD14Tx.FD14_Point_Map_Height_2, system-signal=FD14_Point_Map_Height_2
        data-element=PpToComDbgFD14Tx.FD14_Point_Map_Height_{20..29}, system-signal=FD14_Point_Map_Height_{20..29}
        data-element=PpToComDbgFD14Tx.FD14_Point_Map_Height_3, system-signal=FD14_Point_Map_Height_3
        data-element=PpToComDbgFD14Tx.FD14_Point_Map_Height_{30..39}, system-signal=FD14_Point_Map_Height_{30..39}
        data-element=PpToComDbgFD14Tx.FD14_Point_Map_Height_4, system-signal=FD14_Point_Map_Height_4
        data-element=PpToComDbgFD14Tx.FD14_Point_Map_Height_{40..49}, system-signal=FD14_Point_Map_Height_{40..49}
        data-element=PpToComDbgFD14Tx.FD14_Point_Map_Height_5, system-signal=FD14_Point_Map_Height_5
        data-element=PpToComDbgFD14Tx.FD14_Point_Map_Height_{50..59}, system-signal=FD14_Point_Map_Height_{50..59}
        data-element=PpToComDbgFD14Tx.FD14_Point_Map_Height_6, system-signal=FD14_Point_Map_Height_6
        data-element=PpToComDbgFD14Tx.FD14_Point_Map_Height_{60..69}, system-signal=FD14_Point_Map_Height_{60..69}
        data-element=PpToComDbgFD14Tx.FD14_Point_Map_Height_7, system-signal=FD14_Point_Map_Height_7
        data-element=PpToComDbgFD14Tx.FD14_Point_Map_Height_{70..79}, system-signal=FD14_Point_Map_Height_{70..79}
        data-element=PpToComDbgFD14Tx.FD14_Point_Map_Height_8, system-signal=FD14_Point_Map_Height_8
        data-element=PpToComDbgFD14Tx.FD14_Point_Map_Height_{80..89}, system-signal=FD14_Point_Map_Height_{80..89}
        data-element=PpToComDbgFD14Tx.FD14_Point_Map_Height_9, system-signal=FD14_Point_Map_Height_9
        data-element=PpToComDbgFD14Tx.FD14_Point_Map_Height_{90..95}, system-signal=FD14_Point_Map_Height_{90..95}
        data-element=PpToComDbgFD14Tx.FD14_Point_Map_Reserved_0, system-signal=FD14_Point_Map_Reserved_0
        data-element=PpToComDbgFD14Tx.FD14_Point_Map_Reserved_1, system-signal=FD14_Point_Map_Reserved_1
        data-element=PpToComDbgFD14Tx.FD14_Point_Map_Reserved_{10..19}, system-signal=FD14_Point_Map_Reserved_{10..19}
        data-element=PpToComDbgFD14Tx.FD14_Point_Map_Reserved_2, system-signal=FD14_Point_Map_Reserved_2
        data-element=PpToComDbgFD14Tx.FD14_Point_Map_Reserved_{20..29}, system-signal=FD14_Point_Map_Reserved_{20..29}
        data-element=PpToComDbgFD14Tx.FD14_Point_Map_Reserved_3, system-signal=FD14_Point_Map_Reserved_3
        data-element=PpToComDbgFD14Tx.FD14_Point_Map_Reserved_{30..39}, system-signal=FD14_Point_Map_Reserved_{30..39}
        data-element=PpToComDbgFD14Tx.FD14_Point_Map_Reserved_4, system-signal=FD14_Point_Map_Reserved_4
        data-element=PpToComDbgFD14Tx.FD14_Point_Map_Reserved_{40..49}, system-signal=FD14_Point_Map_Reserved_{40..49}
        data-element=PpToComDbgFD14Tx.FD14_Point_Map_Reserved_5, system-signal=FD14_Point_Map_Reserved_5
        data-element=PpToComDbgFD14Tx.FD14_Point_Map_Reserved_{50..59}, system-signal=FD14_Point_Map_Reserved_{50..59}
        data-element=PpToComDbgFD14Tx.FD14_Point_Map_Reserved_6, system-signal=FD14_Point_Map_Reserved_6
        data-element=PpToComDbgFD14Tx.FD14_Point_Map_Reserved_{60..69}, system-signal=FD14_Point_Map_Reserved_{60..69}
        data-element=PpToComDbgFD14Tx.FD14_Point_Map_Reserved_7, system-signal=FD14_Point_Map_Reserved_7
        data-element=PpToComDbgFD14Tx.FD14_Point_Map_Reserved_{70..79}, system-signal=FD14_Point_Map_Reserved_{70..79}
        data-element=PpToComDbgFD14Tx.FD14_Point_Map_Reserved_8, system-signal=FD14_Point_Map_Reserved_8
        data-element=PpToComDbgFD14Tx.FD14_Point_Map_Reserved_{80..89}, system-signal=FD14_Point_Map_Reserved_{80..89}
        data-element=PpToComDbgFD14Tx.FD14_Point_Map_Reserved_9, system-signal=FD14_Point_Map_Reserved_9
        data-element=PpToComDbgFD14Tx.FD14_Point_Map_Reserved_{90..95}, system-signal=FD14_Point_Map_Reserved_{90..95}
        data-element=PpToComDbgFD14Tx.FD14_Point_Map_X_0, system-signal=FD14_Point_Map_X_0
        data-element=PpToComDbgFD14Tx.FD14_Point_Map_X_1, system-signal=FD14_Point_Map_X_1
        data-element=PpToComDbgFD14Tx.FD14_Point_Map_X_{10..19}, system-signal=FD14_Point_Map_X_{10..19}
        data-element=PpToComDbgFD14Tx.FD14_Point_Map_X_2, system-signal=FD14_Point_Map_X_2
        data-element=PpToComDbgFD14Tx.FD14_Point_Map_X_{20..29}, system-signal=FD14_Point_Map_X_{20..29}
        data-element=PpToComDbgFD14Tx.FD14_Point_Map_X_3, system-signal=FD14_Point_Map_X_3
        data-element=PpToComDbgFD14Tx.FD14_Point_Map_X_{30..39}, system-signal=FD14_Point_Map_X_{30..39}
        data-element=PpToComDbgFD14Tx.FD14_Point_Map_X_4, system-signal=FD14_Point_Map_X_4
        data-element=PpToComDbgFD14Tx.FD14_Point_Map_X_{40..49}, system-signal=FD14_Point_Map_X_{40..49}
        data-element=PpToComDbgFD14Tx.FD14_Point_Map_X_5, system-signal=FD14_Point_Map_X_5
        data-element=PpToComDbgFD14Tx.FD14_Point_Map_X_{50..59}, system-signal=FD14_Point_Map_X_{50..59}
        data-element=PpToComDbgFD14Tx.FD14_Point_Map_X_6, system-signal=FD14_Point_Map_X_6
        data-element=PpToComDbgFD14Tx.FD14_Point_Map_X_{60..69}, system-signal=FD14_Point_Map_X_{60..69}
        data-element=PpToComDbgFD14Tx.FD14_Point_Map_X_7, system-signal=FD14_Point_Map_X_7
        data-element=PpToComDbgFD14Tx.FD14_Point_Map_X_{70..79}, system-signal=FD14_Point_Map_X_{70..79}
        data-element=PpToComDbgFD14Tx.FD14_Point_Map_X_8, system-signal=FD14_Point_Map_X_8
        data-element=PpToComDbgFD14Tx.FD14_Point_Map_X_{80..89}, system-signal=FD14_Point_Map_X_{80..89}
        data-element=PpToComDbgFD14Tx.FD14_Point_Map_X_9, system-signal=FD14_Point_Map_X_9
        data-element=PpToComDbgFD14Tx.FD14_Point_Map_X_{90..95}, system-signal=FD14_Point_Map_X_{90..95}
        data-element=PpToComDbgFD14Tx.FD14_Point_Map_Y_0, system-signal=FD14_Point_Map_Y_0
        data-element=PpToComDbgFD14Tx.FD14_Point_Map_Y_1, system-signal=FD14_Point_Map_Y_1
        data-element=PpToComDbgFD14Tx.FD14_Point_Map_Y_{10..19}, system-signal=FD14_Point_Map_Y_{10..19}
        data-element=PpToComDbgFD14Tx.FD14_Point_Map_Y_2, system-signal=FD14_Point_Map_Y_2
        data-element=PpToComDbgFD14Tx.FD14_Point_Map_Y_{20..29}, system-signal=FD14_Point_Map_Y_{20..29}
        data-element=PpToComDbgFD14Tx.FD14_Point_Map_Y_3, system-signal=FD14_Point_Map_Y_3
        data-element=PpToComDbgFD14Tx.FD14_Point_Map_Y_{30..39}, system-signal=FD14_Point_Map_Y_{30..39}
        data-element=PpToComDbgFD14Tx.FD14_Point_Map_Y_4, system-signal=FD14_Point_Map_Y_4
        data-element=PpToComDbgFD14Tx.FD14_Point_Map_Y_{40..49}, system-signal=FD14_Point_Map_Y_{40..49}
        data-element=PpToComDbgFD14Tx.FD14_Point_Map_Y_5, system-signal=FD14_Point_Map_Y_5
        data-element=PpToComDbgFD14Tx.FD14_Point_Map_Y_{50..59}, system-signal=FD14_Point_Map_Y_{50..59}
        data-element=PpToComDbgFD14Tx.FD14_Point_Map_Y_6, system-signal=FD14_Point_Map_Y_6
        data-element=PpToComDbgFD14Tx.FD14_Point_Map_Y_{60..69}, system-signal=FD14_Point_Map_Y_{60..69}
        data-element=PpToComDbgFD14Tx.FD14_Point_Map_Y_7, system-signal=FD14_Point_Map_Y_7
        data-element=PpToComDbgFD14Tx.FD14_Point_Map_Y_{70..79}, system-signal=FD14_Point_Map_Y_{70..79}
        data-element=PpToComDbgFD14Tx.FD14_Point_Map_Y_8, system-signal=FD14_Point_Map_Y_8
        data-element=PpToComDbgFD14Tx.FD14_Point_Map_Y_{80..89}, system-signal=FD14_Point_Map_Y_{80..89}
        data-element=PpToComDbgFD14Tx.FD14_Point_Map_Y_9, system-signal=FD14_Point_Map_Y_9
        data-element=PpToComDbgFD14Tx.FD14_Point_Map_Y_{90..95}, system-signal=FD14_Point_Map_Y_{90..95}
        data-element=PpToComDbgFD14Tx.FD14_Presentinfo, system-signal=FD14_Presentinfo
        data-element=PpToComDbgFD14Tx.FD14_Prev_DisplayedViewByAcore_e, system-signal=FD14_Prev_DisplayedViewByAcore_e
        data-element=PpToComDbgFD14Tx.FD14_Prev_RequestedViewByHmiM_e, system-signal=FD14_Prev_RequestedViewByHmiM_e
        data-element=PpToComDbgFD14Tx.FD14_Prev_SystemState_e, system-signal=FD14_Prev_SystemState_e
        data-element=PpToComDbgFD14Tx.FD14_Prev_TRG_Stat, system-signal=FD14_Prev_TRG_Stat
        data-element=PpToComDbgFD14Tx.FD14_prndStatus_e, system-signal=FD14_prndStatus_e
        data-element=PpToComDbgFD14Tx.FD14_REAR_CROSS_BTN_PRESSED_b, system-signal=FD14_REAR_CROSS_BTN_PRESSED_b
        data-element=PpToComDbgFD14Tx.FD14_REAR_TOP_BTN_PRESSED_b, system-signal=FD14_REAR_TOP_BTN_PRESSED_b
        data-element=PpToComDbgFD14Tx.FD14_RearCrossButtonNoSelect_b, system-signal=FD14_RearCrossButtonNoSelect_b
        data-element=PpToComDbgFD14Tx.FD14_RearCrossButtonSelect_b, system-signal=FD14_RearCrossButtonSelect_b
        data-element=PpToComDbgFD14Tx.FD14_RearViewDynamics_b, system-signal=FD14_RearViewDynamics_b
        data-element=PpToComDbgFD14Tx.FD14_RecognitionInfo, system-signal=FD14_RecognitionInfo
        data-element=PpToComDbgFD14Tx.FD14_Reserved0_b, system-signal=FD14_Reserved0_b
        data-element=PpToComDbgFD14Tx.FD14_Reserved08_b, system-signal=FD14_Reserved08_b
        data-element=PpToComDbgFD14Tx.FD14_Reserved09_b, system-signal=FD14_Reserved09_b
        data-element=PpToComDbgFD14Tx.FD14_Reserved1_b, system-signal=FD14_Reserved1_b
        data-element=PpToComDbgFD14Tx.FD14_Reserved{10..13}_b, system-signal=FD14_Reserved{10..13}_b
        data-element=PpToComDbgFD14Tx.FD14_Reserved2_b, system-signal=FD14_Reserved2_b
        data-element=PpToComDbgFD14Tx.FD14_Reserved3_b, system-signal=FD14_Reserved3_b
        data-element=PpToComDbgFD14Tx.FD14_revGear_e, system-signal=FD14_revGear_e
        data-element=PpToComDbgFD14Tx.FD14_RightCam_NA_b, system-signal=FD14_RightCam_NA_b
        data-element=PpToComDbgFD14Tx.FD14_RightDoorFrontClose_Icon_b, system-signal=FD14_RightDoorFrontClose_Icon_b
        data-element=PpToComDbgFD14Tx.FD14_RightDoorFrontOpen_Icon_b, system-signal=FD14_RightDoorFrontOpen_Icon_b
        data-element=PpToComDbgFD14Tx.FD14_RightDoorRearClose_Icon_b, system-signal=FD14_RightDoorRearClose_Icon_b
        data-element=PpToComDbgFD14Tx.FD14_RightDoorRearOpen_Icon_b, system-signal=FD14_RightDoorRearOpen_Icon_b
        data-element=PpToComDbgFD14Tx.FD14_RIL_Blockage, system-signal=FD14_RIL_Blockage
        data-element=PpToComDbgFD14Tx.FD14_RIL_comm_Fault, system-signal=FD14_RIL_comm_Fault
        data-element=PpToComDbgFD14Tx.FD14_RIL_CommUnknown, system-signal=FD14_RIL_CommUnknown
        data-element=PpToComDbgFD14Tx.FD14_RIL_hardware_Fault, system-signal=FD14_RIL_hardware_Fault
        data-element=PpToComDbgFD14Tx.FD14_RIL_MinDistance, system-signal=FD14_RIL_MinDistance
        data-element=PpToComDbgFD14Tx.FD14_RIL_overTemp_Fault, system-signal=FD14_RIL_overTemp_Fault
        data-element=PpToComDbgFD14Tx.FD14_RIR_Blockage, system-signal=FD14_RIR_Blockage
        data-element=PpToComDbgFD14Tx.FD14_RIR_comm_Fault, system-signal=FD14_RIR_comm_Fault
        data-element=PpToComDbgFD14Tx.FD14_RIR_CommUnknown, system-signal=FD14_RIR_CommUnknown
        data-element=PpToComDbgFD14Tx.FD14_RIR_hardware_Fault, system-signal=FD14_RIR_hardware_Fault
        data-element=PpToComDbgFD14Tx.FD14_RIR_MinDistance, system-signal=FD14_RIR_MinDistance
        data-element=PpToComDbgFD14Tx.FD14_RIR_overTemp_Fault, system-signal=FD14_RIR_overTemp_Fault
        data-element=PpToComDbgFD14Tx.FD14_ROL_Blockage, system-signal=FD14_ROL_Blockage
        data-element=PpToComDbgFD14Tx.FD14_ROL_comm_Fault, system-signal=FD14_ROL_comm_Fault
        data-element=PpToComDbgFD14Tx.FD14_ROL_CommUnknown, system-signal=FD14_ROL_CommUnknown
        data-element=PpToComDbgFD14Tx.FD14_ROL_hardware_Fault, system-signal=FD14_ROL_hardware_Fault
        data-element=PpToComDbgFD14Tx.FD14_ROL_MinDistance, system-signal=FD14_ROL_MinDistance
        data-element=PpToComDbgFD14Tx.FD14_ROL_overTemp_Fault, system-signal=FD14_ROL_overTemp_Fault
        data-element=PpToComDbgFD14Tx.FD14_Roll_f32_Current_Rear, system-signal=FD14_Roll_f32_Current_Rear
        data-element=PpToComDbgFD14Tx.FD14_Roll_f32_Current_Right, system-signal=FD14_Roll_f32_Current_Right
        data-element=PpToComDbgFD14Tx.FD14_Roll_f32_EOL_Front, system-signal=FD14_Roll_f32_EOL_Front
        data-element=PpToComDbgFD14Tx.FD14_Roll_f32_EOL_Left, system-signal=FD14_Roll_f32_EOL_Left
        data-element=PpToComDbgFD14Tx.FD14_Roll_f32_EOL_Rear, system-signal=FD14_Roll_f32_EOL_Rear
        data-element=PpToComDbgFD14Tx.FD14_Roll_f32_EOL_Right, system-signal=FD14_Roll_f32_EOL_Right
        data-element=PpToComDbgFD14Tx.FD14_Roll_f32_OC_Front, system-signal=FD14_Roll_f32_OC_Front
        data-element=PpToComDbgFD14Tx.FD14_Roll_f32_OC_Left, system-signal=FD14_Roll_f32_OC_Left
        data-element=PpToComDbgFD14Tx.FD14_Roll_f32_OC_Rear, system-signal=FD14_Roll_f32_OC_Rear
        data-element=PpToComDbgFD14Tx.FD14_Roll_f32_OC_Right, system-signal=FD14_Roll_f32_OC_Right
        data-element=PpToComDbgFD14Tx.FD14_Roll_f32_SC_Front, system-signal=FD14_Roll_f32_SC_Front
        data-element=PpToComDbgFD14Tx.FD14_Roll_f32_SC_Left, system-signal=FD14_Roll_f32_SC_Left
        data-element=PpToComDbgFD14Tx.FD14_Roll_f32_SC_Rear, system-signal=FD14_Roll_f32_SC_Rear
        data-element=PpToComDbgFD14Tx.FD14_Roll_f32_SC_Right, system-signal=FD14_Roll_f32_SC_Right
        data-element=PpToComDbgFD14Tx.FD14_ROR_Blockage, system-signal=FD14_ROR_Blockage
        data-element=PpToComDbgFD14Tx.FD14_ROR_comm_Fault, system-signal=FD14_ROR_comm_Fault
        data-element=PpToComDbgFD14Tx.FD14_ROR_CommUnknown, system-signal=FD14_ROR_CommUnknown
        data-element=PpToComDbgFD14Tx.FD14_ROR_hardware_Fault, system-signal=FD14_ROR_hardware_Fault
        data-element=PpToComDbgFD14Tx.FD14_ROR_MinDistance, system-signal=FD14_ROR_MinDistance
        data-element=PpToComDbgFD14Tx.FD14_ROR_overTemp_Fault, system-signal=FD14_ROR_overTemp_Fault
        data-element=PpToComDbgFD14Tx.FD14_RSL_Blockage, system-signal=FD14_RSL_Blockage
        data-element=PpToComDbgFD14Tx.FD14_RSL_comm_Fault, system-signal=FD14_RSL_comm_Fault
        data-element=PpToComDbgFD14Tx.FD14_RSL_CommUnknown, system-signal=FD14_RSL_CommUnknown
        data-element=PpToComDbgFD14Tx.FD14_RSL_hardware_Fault, system-signal=FD14_RSL_hardware_Fault
        data-element=PpToComDbgFD14Tx.FD14_RSL_MinDistance, system-signal=FD14_RSL_MinDistance
        data-element=PpToComDbgFD14Tx.FD14_RSL_overTemp_Fault, system-signal=FD14_RSL_overTemp_Fault
        data-element=PpToComDbgFD14Tx.FD14_RSR_Blockage, system-signal=FD14_RSR_Blockage
        data-element=PpToComDbgFD14Tx.FD14_RSR_comm_Fault, system-signal=FD14_RSR_comm_Fault
        data-element=PpToComDbgFD14Tx.FD14_RSR_CommUnknown, system-signal=FD14_RSR_CommUnknown
        data-element=PpToComDbgFD14Tx.FD14_RSR_hardware_Fault, system-signal=FD14_RSR_hardware_Fault
        data-element=PpToComDbgFD14Tx.FD14_RSR_MinDistance, system-signal=FD14_RSR_MinDistance
        data-element=PpToComDbgFD14Tx.FD14_RSR_overTemp_Fault, system-signal=FD14_RSR_overTemp_Fault
        data-element=PpToComDbgFD14Tx.FD14_RVCONLY_BTN_PRESSED_b, system-signal=FD14_RVCONLY_BTN_PRESSED_b
        data-element=PpToComDbgFD14Tx.FD14_SC_ModuleState_STM_Front, system-signal=FD14_SC_ModuleState_STM_Front
        data-element=PpToComDbgFD14Tx.FD14_SC_ModuleState_STM_Left, system-signal=FD14_SC_ModuleState_STM_Left
        data-element=PpToComDbgFD14Tx.FD14_SC_ModuleState_STM_Rear, system-signal=FD14_SC_ModuleState_STM_Rear
        data-element=PpToComDbgFD14Tx.FD14_SC_ModuleState_STM_Right, system-signal=FD14_SC_ModuleState_STM_Right
        data-element=PpToComDbgFD14Tx.FD14_slotSide, system-signal=FD14_slotSide
        data-element=PpToComDbgFD14Tx.FD14_SnrDat_FIL_Dir1_cm, system-signal=FD14_SnrDat_FIL_Dir1_cm
        data-element=PpToComDbgFD14Tx.FD14_SnrDat_FIL_Dir2_cm, system-signal=FD14_SnrDat_FIL_Dir2_cm
        data-element=PpToComDbgFD14Tx.FD14_SnrDat_FIR_Dir1_cm, system-signal=FD14_SnrDat_FIR_Dir1_cm
        data-element=PpToComDbgFD14Tx.FD14_SnrDat_FIR_Dir2_cm, system-signal=FD14_SnrDat_FIR_Dir2_cm
        data-element=PpToComDbgFD14Tx.FD14_SnrDat_FOL_Dir1_cm, system-signal=FD14_SnrDat_FOL_Dir1_cm
        data-element=PpToComDbgFD14Tx.FD14_SnrDat_FOL_Dir2_cm, system-signal=FD14_SnrDat_FOL_Dir2_cm
        data-element=PpToComDbgFD14Tx.FD14_SnrDat_FOR_Dir1_cm, system-signal=FD14_SnrDat_FOR_Dir1_cm
        data-element=PpToComDbgFD14Tx.FD14_SnrDat_FOR_Dir2_cm, system-signal=FD14_SnrDat_FOR_Dir2_cm
        data-element=PpToComDbgFD14Tx.FD14_SnrDat_FSL_Dir1_cm, system-signal=FD14_SnrDat_FSL_Dir1_cm
        data-element=PpToComDbgFD14Tx.FD14_SnrDat_FSL_Dir2_cm, system-signal=FD14_SnrDat_FSL_Dir2_cm
        data-element=PpToComDbgFD14Tx.FD14_SnrDat_FSR_Dir1_cm, system-signal=FD14_SnrDat_FSR_Dir1_cm
        data-element=PpToComDbgFD14Tx.FD14_SnrDat_FSR_Dir2_cm, system-signal=FD14_SnrDat_FSR_Dir2_cm
        data-element=PpToComDbgFD14Tx.FD14_SnrDat_RIL_Dir1_cm, system-signal=FD14_SnrDat_RIL_Dir1_cm
        data-element=PpToComDbgFD14Tx.FD14_SnrDat_RIL_Dir2_cm, system-signal=FD14_SnrDat_RIL_Dir2_cm
        data-element=PpToComDbgFD14Tx.FD14_SnrDat_RIR_Dir1_cm, system-signal=FD14_SnrDat_RIR_Dir1_cm
        data-element=PpToComDbgFD14Tx.FD14_SnrDat_RIR_Dir2_cm, system-signal=FD14_SnrDat_RIR_Dir2_cm
        data-element=PpToComDbgFD14Tx.FD14_SnrDat_ROL_Dir1_cm, system-signal=FD14_SnrDat_ROL_Dir1_cm
        data-element=PpToComDbgFD14Tx.FD14_SnrDat_ROL_Dir2_cm, system-signal=FD14_SnrDat_ROL_Dir2_cm
        data-element=PpToComDbgFD14Tx.FD14_SnrDat_ROR_Dir1_cm, system-signal=FD14_SnrDat_ROR_Dir1_cm
        data-element=PpToComDbgFD14Tx.FD14_SnrDat_ROR_Dir2_cm, system-signal=FD14_SnrDat_ROR_Dir2_cm
        data-element=PpToComDbgFD14Tx.FD14_SnrDat_RSL_Dir1_cm, system-signal=FD14_SnrDat_RSL_Dir1_cm
        data-element=PpToComDbgFD14Tx.FD14_SnrDat_RSL_Dir2_cm, system-signal=FD14_SnrDat_RSL_Dir2_cm
        data-element=PpToComDbgFD14Tx.FD14_SnrDat_RSR_Dir1_cm, system-signal=FD14_SnrDat_RSR_Dir1_cm
        data-element=PpToComDbgFD14Tx.FD14_SnrDat_RSR_Dir2_cm, system-signal=FD14_SnrDat_RSR_Dir2_cm
        data-element=PpToComDbgFD14Tx.FD14_SnrDat_sFIL_Indir_FIR_cm, system-signal=FD14_SnrDat_sFIL_Indir_FIR_cm
        data-element=PpToComDbgFD14Tx.FD14_SnrDat_sFIL_Indir_FOL_cm, system-signal=FD14_SnrDat_sFIL_Indir_FOL_cm
        data-element=PpToComDbgFD14Tx.FD14_SnrDat_sFIR_Indir_FIL_cm, system-signal=FD14_SnrDat_sFIR_Indir_FIL_cm
        data-element=PpToComDbgFD14Tx.FD14_SnrDat_sFIR_Indir_FOR_cm, system-signal=FD14_SnrDat_sFIR_Indir_FOR_cm
        data-element=PpToComDbgFD14Tx.FD14_SnrDat_sFOL_Indir_FIL_cm, system-signal=FD14_SnrDat_sFOL_Indir_FIL_cm
        data-element=PpToComDbgFD14Tx.FD14_SnrDat_sFOL_Indir_FSL_cm, system-signal=FD14_SnrDat_sFOL_Indir_FSL_cm
        data-element=PpToComDbgFD14Tx.FD14_SnrDat_sFOR_Indir_FIR_cm, system-signal=FD14_SnrDat_sFOR_Indir_FIR_cm
        data-element=PpToComDbgFD14Tx.FD14_SnrDat_sFOR_Indir_FSR_cm, system-signal=FD14_SnrDat_sFOR_Indir_FSR_cm
        data-element=PpToComDbgFD14Tx.FD14_SnrDat_sFSL_Indir_FOL_cm, system-signal=FD14_SnrDat_sFSL_Indir_FOL_cm
        data-element=PpToComDbgFD14Tx.FD14_SnrDat_sFSR_Indir_FOR_cm, system-signal=FD14_SnrDat_sFSR_Indir_FOR_cm
        data-element=PpToComDbgFD14Tx.FD14_SnrDat_sRIL_Indir_RIR_cm, system-signal=FD14_SnrDat_sRIL_Indir_RIR_cm
        data-element=PpToComDbgFD14Tx.FD14_SnrDat_sRIL_Indir_ROL_cm, system-signal=FD14_SnrDat_sRIL_Indir_ROL_cm
        data-element=PpToComDbgFD14Tx.FD14_SnrDat_sRIR_Indir_RIL_cm, system-signal=FD14_SnrDat_sRIR_Indir_RIL_cm
        data-element=PpToComDbgFD14Tx.FD14_SnrDat_sRIR_Indir_ROR_cm, system-signal=FD14_SnrDat_sRIR_Indir_ROR_cm
        data-element=PpToComDbgFD14Tx.FD14_SnrDat_sROL_Indir_RIL_cm, system-signal=FD14_SnrDat_sROL_Indir_RIL_cm
        data-element=PpToComDbgFD14Tx.FD14_SnrDat_sROL_Indir_RSL_cm, system-signal=FD14_SnrDat_sROL_Indir_RSL_cm
        data-element=PpToComDbgFD14Tx.FD14_SnrDat_sROR_Indir_RIR_cm, system-signal=FD14_SnrDat_sROR_Indir_RIR_cm
        data-element=PpToComDbgFD14Tx.FD14_SnrDat_sROR_Indir_RSR_cm, system-signal=FD14_SnrDat_sROR_Indir_RSR_cm
        data-element=PpToComDbgFD14Tx.FD14_SnrDat_sRSL_Indir_ROL_cm, system-signal=FD14_SnrDat_sRSL_Indir_ROL_cm
        data-element=PpToComDbgFD14Tx.FD14_SnrDat_sRSR_Indir_ROR_cm, system-signal=FD14_SnrDat_sRSR_Indir_ROR_cm
        data-element=PpToComDbgFD14Tx.FD14_SnrMeasDataChecksum, system-signal=FD14_SnrMeasDataChecksum
        data-element=PpToComDbgFD14Tx.FD14_SoftBtn_Error_e, system-signal=FD14_SoftBtn_Error_e
        data-element=PpToComDbgFD14Tx.FD14_SrvCamIndBaNok_b, system-signal=FD14_SrvCamIndBaNok_b
        data-element=PpToComDbgFD14Tx.FD14_SrvCamIndBaNone_b, system-signal=FD14_SrvCamIndBaNone_b
        data-element=PpToComDbgFD14Tx.FD14_SrvCamIndBaOk_b, system-signal=FD14_SrvCamIndBaOk_b
        data-element=PpToComDbgFD14Tx.FD14_SrvCamIndBaPend_b, system-signal=FD14_SrvCamIndBaPend_b
        data-element=PpToComDbgFD14Tx.FD14_SrvCamIndFrNok_b, system-signal=FD14_SrvCamIndFrNok_b
        data-element=PpToComDbgFD14Tx.FD14_SrvCamIndFrNone_b, system-signal=FD14_SrvCamIndFrNone_b
        data-element=PpToComDbgFD14Tx.FD14_SrvCamIndFrOk_b, system-signal=FD14_SrvCamIndFrOk_b
        data-element=PpToComDbgFD14Tx.FD14_SrvCamIndFrPend_b, system-signal=FD14_SrvCamIndFrPend_b
        data-element=PpToComDbgFD14Tx.FD14_SrvCamIndLeNok_b, system-signal=FD14_SrvCamIndLeNok_b
        data-element=PpToComDbgFD14Tx.FD14_SrvCamIndLeNone_b, system-signal=FD14_SrvCamIndLeNone_b
        data-element=PpToComDbgFD14Tx.FD14_SrvCamIndLeOk_b, system-signal=FD14_SrvCamIndLeOk_b
        data-element=PpToComDbgFD14Tx.FD14_SrvCamIndLePend_b, system-signal=FD14_SrvCamIndLePend_b
        data-element=PpToComDbgFD14Tx.FD14_SrvCamIndRiNok_b, system-signal=FD14_SrvCamIndRiNok_b
        data-element=PpToComDbgFD14Tx.FD14_SrvCamIndRiNone_b, system-signal=FD14_SrvCamIndRiNone_b
        data-element=PpToComDbgFD14Tx.FD14_SrvCamIndRiOk_b, system-signal=FD14_SrvCamIndRiOk_b
        data-element=PpToComDbgFD14Tx.FD14_SrvCamIndRiPend_b, system-signal=FD14_SrvCamIndRiPend_b
        data-element=PpToComDbgFD14Tx.FD14_SrvChkIndCondNok_b, system-signal=FD14_SrvChkIndCondNok_b
        data-element=PpToComDbgFD14Tx.FD14_SrvChkIndNok_b, system-signal=FD14_SrvChkIndNok_b
        data-element=PpToComDbgFD14Tx.FD14_SrvChkIndOk_b, system-signal=FD14_SrvChkIndOk_b
        data-element=PpToComDbgFD14Tx.FD14_SrvChkIndRun_b, system-signal=FD14_SrvChkIndRun_b
        data-element=PpToComDbgFD14Tx.FD14_SrvLayout_b, system-signal=FD14_SrvLayout_b
        data-element=PpToComDbgFD14Tx.FD14_SrvPrgBar0Per_b, system-signal=FD14_SrvPrgBar0Per_b
        data-element=PpToComDbgFD14Tx.FD14_SrvPrgBar100Per_b, system-signal=FD14_SrvPrgBar100Per_b
        data-element=PpToComDbgFD14Tx.FD14_SrvPrgBar20Per_b, system-signal=FD14_SrvPrgBar20Per_b
        data-element=PpToComDbgFD14Tx.FD14_SrvPrgBar40Per_b, system-signal=FD14_SrvPrgBar40Per_b
        data-element=PpToComDbgFD14Tx.FD14_SrvPrgBar60Per_b, system-signal=FD14_SrvPrgBar60Per_b
        data-element=PpToComDbgFD14Tx.FD14_SrvPrgBar80Per_b, system-signal=FD14_SrvPrgBar80Per_b
        data-element=PpToComDbgFD14Tx.FD14_SrvSpOmIndNok_b, system-signal=FD14_SrvSpOmIndNok_b
        data-element=PpToComDbgFD14Tx.FD14_SrvSpOmIndOk_b, system-signal=FD14_SrvSpOmIndOk_b
        data-element=PpToComDbgFD14Tx.FD14_SrvStAngIndNok_b, system-signal=FD14_SrvStAngIndNok_b
        data-element=PpToComDbgFD14Tx.FD14_SrvStAngIndOk_b, system-signal=FD14_SrvStAngIndOk_b
        data-element=PpToComDbgFD14Tx.FD14_steeringWheelAngle_f32, system-signal=FD14_steeringWheelAngle_f32
        data-element=PpToComDbgFD14Tx.FD14_stFPAInfoToHMISlot{1..6}Valid, system-signal=FD14_stFPAInfoToHMISlot{1..6}Valid
        data-element=PpToComDbgFD14Tx.FD14_stFPAInfoToVCLockedSlotFrntLeftX, system-signal=FD14_stFPAInfoToVCLockedSlotFrntLeftX
        data-element=PpToComDbgFD14Tx.FD14_stFPAInfoToVCLockedSlotFrntLeftY, system-signal=FD14_stFPAInfoToVCLockedSlotFrntLeftY
        data-element=PpToComDbgFD14Tx.FD14_stFPAInfoToVCLockedSlotID, system-signal=FD14_stFPAInfoToVCLockedSlotID
        data-element=PpToComDbgFD14Tx.FD14_stFPAInfoToVCLockedSlotRearRghtX, system-signal=FD14_stFPAInfoToVCLockedSlotRearRghtX
        data-element=PpToComDbgFD14Tx.FD14_stFPAInfoToVCLockedSlotRearRghtY, system-signal=FD14_stFPAInfoToVCLockedSlotRearRghtY
        data-element=PpToComDbgFD14Tx.FD14_stFPAInfoToVCLockedSlotSide, system-signal=FD14_stFPAInfoToVCLockedSlotSide
        data-element=PpToComDbgFD14Tx.FD14_stFPAInfoToVCLockedSlotType, system-signal=FD14_stFPAInfoToVCLockedSlotType
        data-element=PpToComDbgFD14Tx.FD14_stFPAInfoToVCLockedSlotValid, system-signal=FD14_stFPAInfoToVCLockedSlotValid
        data-element=PpToComDbgFD14Tx.FD14_stLeftObjectList{1..4}Valid, system-signal=FD14_stLeftObjectList{1..4}Valid
        data-element=PpToComDbgFD14Tx.FD14_STM_v_TRGAUTO_BTN_PRESSED_b, system-signal=FD14_STM_v_TRGAUTO_BTN_PRESSED_b
        data-element=PpToComDbgFD14Tx.FD14_STM_v_TRGLEFT_BTN_PRESSED_b, system-signal=FD14_STM_v_TRGLEFT_BTN_PRESSED_b
        data-element=PpToComDbgFD14Tx.FD14_STM_v_TRGRIGHT_BTN_PRESSED_b, system-signal=FD14_STM_v_TRGRIGHT_BTN_PRESSED_b
        data-element=PpToComDbgFD14Tx.FD14_stnumPointsL, system-signal=FD14_stnumPointsL
        data-element=PpToComDbgFD14Tx.FD14_stnumPointsR, system-signal=FD14_stnumPointsR
        data-element=PpToComDbgFD14Tx.FD14_stPLDLockedSlotDataFrontLeftX, system-signal=FD14_stPLDLockedSlotDataFrontLeftX
        data-element=PpToComDbgFD14Tx.FD14_stPLDLockedSlotDataFrontLeftY, system-signal=FD14_stPLDLockedSlotDataFrontLeftY
        data-element=PpToComDbgFD14Tx.FD14_stPLDLockedSlotDataRearRightX, system-signal=FD14_stPLDLockedSlotDataRearRightX
        data-element=PpToComDbgFD14Tx.FD14_stPLDLockedSlotDataRearRightY, system-signal=FD14_stPLDLockedSlotDataRearRightY
        data-element=PpToComDbgFD14Tx.FD14_stPLDLockedSlotDataSlotID, system-signal=FD14_stPLDLockedSlotDataSlotID
        data-element=PpToComDbgFD14Tx.FD14_stPLDLockedSlotDataSlotSide, system-signal=FD14_stPLDLockedSlotDataSlotSide
        data-element=PpToComDbgFD14Tx.FD14_stPLDLockedSlotDataSlotType, system-signal=FD14_stPLDLockedSlotDataSlotType
        data-element=PpToComDbgFD14Tx.FD14_stPLDLockedSlotDataSlotValid, system-signal=FD14_stPLDLockedSlotDataSlotValid
        data-element=PpToComDbgFD14Tx.FD14_stPLDParkingSlot1DataSlotID, system-signal=FD14_stPLDParkingSlot1DataSlotID
        data-element=PpToComDbgFD14Tx.FD14_stPLDParkingSlot1DataSlotSide, system-signal=FD14_stPLDParkingSlot1DataSlotSide
        data-element=PpToComDbgFD14Tx.FD14_stPLDParkingSlot1FrontLeftX, system-signal=FD14_stPLDParkingSlot1FrontLeftX
        data-element=PpToComDbgFD14Tx.FD14_stPLDParkingSlot1FrontLeftY, system-signal=FD14_stPLDParkingSlot1FrontLeftY
        data-element=PpToComDbgFD14Tx.FD14_stPLDParkingSlot1RearRightX, system-signal=FD14_stPLDParkingSlot1RearRightX
        data-element=PpToComDbgFD14Tx.FD14_stPLDParkingSlot1RearRightY, system-signal=FD14_stPLDParkingSlot1RearRightY
        data-element=PpToComDbgFD14Tx.FD14_stPLDParkingSlot1SlotType, system-signal=FD14_stPLDParkingSlot1SlotType
        data-element=PpToComDbgFD14Tx.FD14_stPLDParkingSlot{1..3}SlotValid, system-signal=FD14_stPLDParkingSlot{1..3}SlotValid
        data-element=PpToComDbgFD14Tx.FD14_stPLDParkingSlot4DataSlotID, system-signal=FD14_stPLDParkingSlot4DataSlotID
        data-element=PpToComDbgFD14Tx.FD14_stPLDParkingSlot4DataSlotSide, system-signal=FD14_stPLDParkingSlot4DataSlotSide
        data-element=PpToComDbgFD14Tx.FD14_stPLDParkingSlot4FrontLeftX, system-signal=FD14_stPLDParkingSlot4FrontLeftX
        data-element=PpToComDbgFD14Tx.FD14_stPLDParkingSlot4FrontLeftY, system-signal=FD14_stPLDParkingSlot4FrontLeftY
        data-element=PpToComDbgFD14Tx.FD14_stPLDParkingSlot4RearRightX, system-signal=FD14_stPLDParkingSlot4RearRightX
        data-element=PpToComDbgFD14Tx.FD14_stPLDParkingSlot4RearRightY, system-signal=FD14_stPLDParkingSlot4RearRightY
        data-element=PpToComDbgFD14Tx.FD14_stPLDParkingSlot4SlotType, system-signal=FD14_stPLDParkingSlot4SlotType
        data-element=PpToComDbgFD14Tx.FD14_stPLDParkingSlot{4..6}SlotValid, system-signal=FD14_stPLDParkingSlot{4..6}SlotValid
        data-element=PpToComDbgFD14Tx.FD14_stRightObjectList{1..4}Valid, system-signal=FD14_stRightObjectList{1..4}Valid
        data-element=PpToComDbgFD14Tx.FD14_stUSSLockedSlotDataFrontLeftX, system-signal=FD14_stUSSLockedSlotDataFrontLeftX
        data-element=PpToComDbgFD14Tx.FD14_stUSSLockedSlotDataFrontLeftY, system-signal=FD14_stUSSLockedSlotDataFrontLeftY
        data-element=PpToComDbgFD14Tx.FD14_stUSSLockedSlotDataRearRightX, system-signal=FD14_stUSSLockedSlotDataRearRightX
        data-element=PpToComDbgFD14Tx.FD14_stUSSLockedSlotDataRearRightY, system-signal=FD14_stUSSLockedSlotDataRearRightY
        data-element=PpToComDbgFD14Tx.FD14_stUSSLockedSlotDataSlotID, system-signal=FD14_stUSSLockedSlotDataSlotID
        data-element=PpToComDbgFD14Tx.FD14_stUSSLockedSlotDataSlotSide, system-signal=FD14_stUSSLockedSlotDataSlotSide
        data-element=PpToComDbgFD14Tx.FD14_stUSSLockedSlotDataSlotType, system-signal=FD14_stUSSLockedSlotDataSlotType
        data-element=PpToComDbgFD14Tx.FD14_stUSSLockedSlotDataSlotValid, system-signal=FD14_stUSSLockedSlotDataSlotValid
        data-element=PpToComDbgFD14Tx.FD14_stUSSParkingSlot1DataSlotID, system-signal=FD14_stUSSParkingSlot1DataSlotID
        data-element=PpToComDbgFD14Tx.FD14_stUSSParkingSlot1DataSlotSide, system-signal=FD14_stUSSParkingSlot1DataSlotSide
        data-element=PpToComDbgFD14Tx.FD14_stUSSParkingSlot1FrontLeftX, system-signal=FD14_stUSSParkingSlot1FrontLeftX
        data-element=PpToComDbgFD14Tx.FD14_stUSSParkingSlot1FrontLeftY, system-signal=FD14_stUSSParkingSlot1FrontLeftY
        data-element=PpToComDbgFD14Tx.FD14_stUSSParkingSlot1RearRightX, system-signal=FD14_stUSSParkingSlot1RearRightX
        data-element=PpToComDbgFD14Tx.FD14_stUSSParkingSlot1RearRightY, system-signal=FD14_stUSSParkingSlot1RearRightY
        data-element=PpToComDbgFD14Tx.FD14_stUSSParkingSlot1SlotType, system-signal=FD14_stUSSParkingSlot1SlotType
        data-element=PpToComDbgFD14Tx.FD14_stUSSParkingSlot{1..3}SlotValid, system-signal=FD14_stUSSParkingSlot{1..3}SlotValid
        data-element=PpToComDbgFD14Tx.FD14_stUSSParkingSlot4DataSlotSide, system-signal=FD14_stUSSParkingSlot4DataSlotSide
        data-element=PpToComDbgFD14Tx.FD14_stUSSParkingSlot4FrontLeftX, system-signal=FD14_stUSSParkingSlot4FrontLeftX
        data-element=PpToComDbgFD14Tx.FD14_stUSSParkingSlot4FrontLeftY, system-signal=FD14_stUSSParkingSlot4FrontLeftY
        data-element=PpToComDbgFD14Tx.FD14_stUSSParkingSlot4RearRightX, system-signal=FD14_stUSSParkingSlot4RearRightX
        data-element=PpToComDbgFD14Tx.FD14_stUSSParkingSlot4RearRightY, system-signal=FD14_stUSSParkingSlot4RearRightY
        data-element=PpToComDbgFD14Tx.FD14_stUSSParkingSlot4SlotType, system-signal=FD14_stUSSParkingSlot4SlotType
        data-element=PpToComDbgFD14Tx.FD14_stUSSParkingSlot{4..6}SlotValid, system-signal=FD14_stUSSParkingSlot{4..6}SlotValid
        data-element=PpToComDbgFD14Tx.FD14_SVC_Delay_Feature_b, system-signal=FD14_SVC_Delay_Feature_b
        data-element=PpToComDbgFD14Tx.FD14_SVC_Dynamic_Gridlines_Feature_b, system-signal=FD14_SVC_Dynamic_Gridlines_Feature_b
        data-element=PpToComDbgFD14Tx.FD14_SVC_FFCV_Gridlines_Feature_b, system-signal=FD14_SVC_FFCV_Gridlines_Feature_b
        data-element=PpToComDbgFD14Tx.FD14_SVC_Static_Gridlines_Feature_b, system-signal=FD14_SVC_Static_Gridlines_Feature_b
        data-element=PpToComDbgFD14Tx.FD14_SystemMode, system-signal=FD14_SystemMode
        data-element=PpToComDbgFD14Tx.FD14_SystemStatus, system-signal=FD14_SystemStatus
        data-element=PpToComDbgFD14Tx.FD14_TadAngle, system-signal=FD14_TadAngle
        data-element=PpToComDbgFD14Tx.FD14_TADAngleRate, system-signal=FD14_TADAngleRate
        data-element=PpToComDbgFD14Tx.FD14_TargetDetectLeftFront_Front_s8, system-signal=FD14_TargetDetectLeftFront_Front_s8
        data-element=PpToComDbgFD14Tx.FD14_TargetDetectLeftFront_Left_s8, system-signal=FD14_TargetDetectLeftFront_Left_s8
        data-element=PpToComDbgFD14Tx.FD14_TargetDetectLeftFront_Rear_s8, system-signal=FD14_TargetDetectLeftFront_Rear_s8
        data-element=PpToComDbgFD14Tx.FD14_TargetDetectLeftFront_Right_s8, system-signal=FD14_TargetDetectLeftFront_Right_s8
        data-element=PpToComDbgFD14Tx.FD14_TargetDetectLeftRear_Front_s8, system-signal=FD14_TargetDetectLeftRear_Front_s8
        data-element=PpToComDbgFD14Tx.FD14_TargetDetectLeftRear_Rear_s8, system-signal=FD14_TargetDetectLeftRear_Rear_s8
        data-element=PpToComDbgFD14Tx.FD14_TargetDetectLeftRear_Right_s8, system-signal=FD14_TargetDetectLeftRear_Right_s8
        data-element=PpToComDbgFD14Tx.FD14_TargetDetectRightFront_Front_s8, system-signal=FD14_TargetDetectRightFront_Front_s8
        data-element=PpToComDbgFD14Tx.FD14_TargetDetectRightFront_Left_s8, system-signal=FD14_TargetDetectRightFront_Left_s8
        data-element=PpToComDbgFD14Tx.FD14_TargetDetectRightFront_Rear_s8, system-signal=FD14_TargetDetectRightFront_Rear_s8
        data-element=PpToComDbgFD14Tx.FD14_TargetDetectRightFront_Right_s8, system-signal=FD14_TargetDetectRightFront_Right_s8
        data-element=PpToComDbgFD14Tx.FD14_TargetDetectRightRear_Front_s8, system-signal=FD14_TargetDetectRightRear_Front_s8
        data-element=PpToComDbgFD14Tx.FD14_TargetDetectRightRear_Left_s8, system-signal=FD14_TargetDetectRightRear_Left_s8
        data-element=PpToComDbgFD14Tx.FD14_TargetDetectRightRear_Rear_s8, system-signal=FD14_TargetDetectRightRear_Rear_s8
        data-element=PpToComDbgFD14Tx.FD14_TargetDetectRightRear_Right_s8, system-signal=FD14_TargetDetectRightRear_Right_s8
        data-element=PpToComDbgFD14Tx.FD14_TargetInit_Front_s8, system-signal=FD14_TargetInit_Front_s8
        data-element=PpToComDbgFD14Tx.FD14_TargetInit_Left_s8, system-signal=FD14_TargetInit_Left_s8
        data-element=PpToComDbgFD14Tx.FD14_TargetInit_Rear_s8, system-signal=FD14_TargetInit_Rear_s8
        data-element=PpToComDbgFD14Tx.FD14_TargetInit_Right_s8, system-signal=FD14_TargetInit_Right_s8
        data-element=PpToComDbgFD14Tx.FD14_TargetLimitFront_Front_s8, system-signal=FD14_TargetLimitFront_Front_s8
        data-element=PpToComDbgFD14Tx.FD14_TargetLimitFront_Left_s8, system-signal=FD14_TargetLimitFront_Left_s8
        data-element=PpToComDbgFD14Tx.FD14_TargetLimitFront_Rear_s8, system-signal=FD14_TargetLimitFront_Rear_s8
        data-element=PpToComDbgFD14Tx.FD14_TargetLimitFront_Right_s8, system-signal=FD14_TargetLimitFront_Right_s8
        data-element=PpToComDbgFD14Tx.FD14_TargetLimitRear_Front_s8, system-signal=FD14_TargetLimitRear_Front_s8
        data-element=PpToComDbgFD14Tx.FD14_TargetLimitRear_Left_s8, system-signal=FD14_TargetLimitRear_Left_s8
        data-element=PpToComDbgFD14Tx.FD14_TargetLimitRear_Rear_s8, system-signal=FD14_TargetLimitRear_Rear_s8
        data-element=PpToComDbgFD14Tx.FD14_TargetLimitRear_Right_s8, system-signal=FD14_TargetLimitRear_Right_s8
        data-element=PpToComDbgFD14Tx.FD14_tchScrnCoord_s_X_u16, system-signal=FD14_tchScrnCoord_s_X_u16
        data-element=PpToComDbgFD14Tx.FD14_tchScrnCoord_s_Y_u16, system-signal=FD14_tchScrnCoord_s_Y_u16
        data-element=PpToComDbgFD14Tx.FD14_tchScrnStatus_e, system-signal=FD14_tchScrnStatus_e
        data-element=PpToComDbgFD14Tx.FD14_tgwDispStatus_e, system-signal=FD14_tgwDispStatus_e
        data-element=PpToComDbgFD14Tx.FD14_THAButtonGrey, system-signal=FD14_THAButtonGrey
        data-element=PpToComDbgFD14Tx.FD14_THAButtonSelectable, system-signal=FD14_THAButtonSelectable
        data-element=PpToComDbgFD14Tx.FD14_THAConfirmButton, system-signal=FD14_THAConfirmButton
        data-element=PpToComDbgFD14Tx.FD14_THACouplerBulletIcon, system-signal=FD14_THACouplerBulletIcon
        data-element=PpToComDbgFD14Tx.FD14_THAProgressBar, system-signal=FD14_THAProgressBar
        data-element=PpToComDbgFD14Tx.FD14_THAStartButton, system-signal=FD14_THAStartButton
        data-element=PpToComDbgFD14Tx.FD14_THATriangleOverlay, system-signal=FD14_THATriangleOverlay
        data-element=PpToComDbgFD14Tx.FD14_TimeStamp_SystemStatus, system-signal=FD14_TimeStamp_SystemStatus
        data-element=PpToComDbgFD14Tx.FD14_TopFrontButtonNoSelect_b, system-signal=FD14_TopFrontButtonNoSelect_b
        data-element=PpToComDbgFD14Tx.FD14_TopFrontButtonSelect_b, system-signal=FD14_TopFrontButtonSelect_b
        data-element=PpToComDbgFD14Tx.FD14_TopRearButtonNoSelect_b, system-signal=FD14_TopRearButtonNoSelect_b
        data-element=PpToComDbgFD14Tx.FD14_TopRearButtonSelect_b, system-signal=FD14_TopRearButtonSelect_b
        data-element=PpToComDbgFD14Tx.FD14_TopVideoBlanked_b, system-signal=FD14_TopVideoBlanked_b
        data-element=PpToComDbgFD14Tx.FD14_TopViewBlack_b, system-signal=FD14_TopViewBlack_b
        data-element=PpToComDbgFD14Tx.FD14_TopViewFrontDynamics_b, system-signal=FD14_TopViewFrontDynamics_b
        data-element=PpToComDbgFD14Tx.FD14_TopViewRearDynamics_b, system-signal=FD14_TopViewRearDynamics_b
        data-element=PpToComDbgFD14Tx.FD14_Total_lines_count, system-signal=FD14_Total_lines_count
        data-element=PpToComDbgFD14Tx.FD14_Trailer_Recognition_Confidence, system-signal=FD14_Trailer_Recognition_Confidence
        data-element=PpToComDbgFD14Tx.FD14_Trailer_tracking_confidence, system-signal=FD14_Trailer_tracking_confidence
        data-element=PpToComDbgFD14Tx.FD14_trailerAngle, system-signal=FD14_trailerAngle
        data-element=PpToComDbgFD14Tx.FD14_TrailerAngleSign, system-signal=FD14_TrailerAngleSign
        data-element=PpToComDbgFD14Tx.FD14_TrailerCalFailInfo, system-signal=FD14_TrailerCalFailInfo
        data-element=PpToComDbgFD14Tx.FD14_trailerCalibrationCount, system-signal=FD14_trailerCalibrationCount
        data-element=PpToComDbgFD14Tx.FD14_trailerCalibrationDelay, system-signal=FD14_trailerCalibrationDelay
        data-element=PpToComDbgFD14Tx.FD14_TrailerCalibrationStatus, system-signal=FD14_TrailerCalibrationStatus
        data-element=PpToComDbgFD14Tx.FD14_Trailercalinfo, system-signal=FD14_Trailercalinfo
        data-element=PpToComDbgFD14Tx.FD14_TrailerConnectionStatus, system-signal=FD14_TrailerConnectionStatus
        data-element=PpToComDbgFD14Tx.FD14_TrailerWheelBase, system-signal=FD14_TrailerWheelBase
        data-element=PpToComDbgFD14Tx.FD14_transEquipped_e, system-signal=FD14_transEquipped_e
        data-element=PpToComDbgFD14Tx.FD14_TrscJackKnifeOrange, system-signal=FD14_TrscJackKnifeOrange
        data-element=PpToComDbgFD14Tx.FD14_TrscJackKnifeRed, system-signal=FD14_TrscJackKnifeRed
        data-element=PpToComDbgFD14Tx.FD14_TrscOvl, system-signal=FD14_TrscOvl
        data-element=PpToComDbgFD14Tx.FD14_trscStat_e, system-signal=FD14_trscStat_e
        data-element=PpToComDbgFD14Tx.FD14_TrscStatus, system-signal=FD14_TrscStatus
        data-element=PpToComDbgFD14Tx.FD14_TrscTrailerRed, system-signal=FD14_TrscTrailerRed
        data-element=PpToComDbgFD14Tx.FD14_Tstr_SD_FIL_DrvFreq, system-signal=FD14_Tstr_SD_FIL_DrvFreq
        data-element=PpToComDbgFD14Tx.FD14_Tstr_SD_FIL_EchoHeight_adc, system-signal=FD14_Tstr_SD_FIL_EchoHeight_adc
        data-element=PpToComDbgFD14Tx.FD14_Tstr_SD_FIL_RingFreq, system-signal=FD14_Tstr_SD_FIL_RingFreq
        data-element=PpToComDbgFD14Tx.FD14_Tstr_SD_FIL_Ringtime_us, system-signal=FD14_Tstr_SD_FIL_Ringtime_us
        data-element=PpToComDbgFD14Tx.FD14_Tstr_SD_FIL_SensorBlkgClrCounter, system-signal=FD14_Tstr_SD_FIL_SensorBlkgClrCounter
        data-element=PpToComDbgFD14Tx.FD14_Tstr_SD_FIL_SensorBlkgSetCounter, system-signal=FD14_Tstr_SD_FIL_SensorBlkgSetCounter
        data-element=PpToComDbgFD14Tx.FD14_Tstr_SD_FIL_Unfiltered_DirDist1, system-signal=FD14_Tstr_SD_FIL_Unfiltered_DirDist1
        data-element=PpToComDbgFD14Tx.FD14_Tstr_SD_FIL_Unfiltered_DirDist2, system-signal=FD14_Tstr_SD_FIL_Unfiltered_DirDist2
        data-element=PpToComDbgFD14Tx.FD14_Tstr_SD_FIR_DrvFreq, system-signal=FD14_Tstr_SD_FIR_DrvFreq
        data-element=PpToComDbgFD14Tx.FD14_Tstr_SD_FIR_EchoHeight_adc, system-signal=FD14_Tstr_SD_FIR_EchoHeight_adc
        data-element=PpToComDbgFD14Tx.FD14_Tstr_SD_FIR_RingFreq, system-signal=FD14_Tstr_SD_FIR_RingFreq
        data-element=PpToComDbgFD14Tx.FD14_Tstr_SD_FIR_Ringtime_us, system-signal=FD14_Tstr_SD_FIR_Ringtime_us
        data-element=PpToComDbgFD14Tx.FD14_Tstr_SD_FIR_SensorBlkgClrCounter, system-signal=FD14_Tstr_SD_FIR_SensorBlkgClrCounter
        data-element=PpToComDbgFD14Tx.FD14_Tstr_SD_FIR_SensorBlkgSetCounter, system-signal=FD14_Tstr_SD_FIR_SensorBlkgSetCounter
        data-element=PpToComDbgFD14Tx.FD14_Tstr_SD_FIR_Unfiltered_DirDist1, system-signal=FD14_Tstr_SD_FIR_Unfiltered_DirDist1
        data-element=PpToComDbgFD14Tx.FD14_Tstr_SD_FIR_Unfiltered_DirDist2, system-signal=FD14_Tstr_SD_FIR_Unfiltered_DirDist2
        data-element=PpToComDbgFD14Tx.FD14_Tstr_SD_FOL_DrvFreq, system-signal=FD14_Tstr_SD_FOL_DrvFreq
        data-element=PpToComDbgFD14Tx.FD14_Tstr_SD_FOL_EchoHeight_adc, system-signal=FD14_Tstr_SD_FOL_EchoHeight_adc
        data-element=PpToComDbgFD14Tx.FD14_Tstr_SD_FOL_RingFreq, system-signal=FD14_Tstr_SD_FOL_RingFreq
        data-element=PpToComDbgFD14Tx.FD14_Tstr_SD_FOL_Ringtime_us, system-signal=FD14_Tstr_SD_FOL_Ringtime_us
        data-element=PpToComDbgFD14Tx.FD14_Tstr_SD_FOL_SensorBlkgClrCounter, system-signal=FD14_Tstr_SD_FOL_SensorBlkgClrCounter
        data-element=PpToComDbgFD14Tx.FD14_Tstr_SD_FOL_SensorBlkgSetCounter, system-signal=FD14_Tstr_SD_FOL_SensorBlkgSetCounter
        data-element=PpToComDbgFD14Tx.FD14_Tstr_SD_FOL_Unfiltered_DirDist1, system-signal=FD14_Tstr_SD_FOL_Unfiltered_DirDist1
        data-element=PpToComDbgFD14Tx.FD14_Tstr_SD_FOL_Unfiltered_DirDist2, system-signal=FD14_Tstr_SD_FOL_Unfiltered_DirDist2
        data-element=PpToComDbgFD14Tx.FD14_Tstr_SD_FOR_DrvFreq, system-signal=FD14_Tstr_SD_FOR_DrvFreq
        data-element=PpToComDbgFD14Tx.FD14_Tstr_SD_FOR_EchoHeight_adc, system-signal=FD14_Tstr_SD_FOR_EchoHeight_adc
        data-element=PpToComDbgFD14Tx.FD14_Tstr_SD_FOR_RingFreq, system-signal=FD14_Tstr_SD_FOR_RingFreq
        data-element=PpToComDbgFD14Tx.FD14_Tstr_SD_FOR_Ringtime_us, system-signal=FD14_Tstr_SD_FOR_Ringtime_us
        data-element=PpToComDbgFD14Tx.FD14_Tstr_SD_FOR_SensorBlkgClrCounter, system-signal=FD14_Tstr_SD_FOR_SensorBlkgClrCounter
        data-element=PpToComDbgFD14Tx.FD14_Tstr_SD_FOR_SensorBlkgSetCounter, system-signal=FD14_Tstr_SD_FOR_SensorBlkgSetCounter
        data-element=PpToComDbgFD14Tx.FD14_Tstr_SD_FOR_Unfiltered_DirDist1, system-signal=FD14_Tstr_SD_FOR_Unfiltered_DirDist1
        data-element=PpToComDbgFD14Tx.FD14_Tstr_SD_FOR_Unfiltered_DirDist2, system-signal=FD14_Tstr_SD_FOR_Unfiltered_DirDist2
        data-element=PpToComDbgFD14Tx.FD14_Tstr_SD_FSL_DrvFreq, system-signal=FD14_Tstr_SD_FSL_DrvFreq
        data-element=PpToComDbgFD14Tx.FD14_Tstr_SD_FSL_EchoHeight_adc, system-signal=FD14_Tstr_SD_FSL_EchoHeight_adc
        data-element=PpToComDbgFD14Tx.FD14_Tstr_SD_FSL_RingFreq, system-signal=FD14_Tstr_SD_FSL_RingFreq
        data-element=PpToComDbgFD14Tx.FD14_Tstr_SD_FSL_Ringtime_us, system-signal=FD14_Tstr_SD_FSL_Ringtime_us
        data-element=PpToComDbgFD14Tx.FD14_Tstr_SD_FSL_SensorBlkgClrCounter, system-signal=FD14_Tstr_SD_FSL_SensorBlkgClrCounter
        data-element=PpToComDbgFD14Tx.FD14_Tstr_SD_FSL_SensorBlkgSetCounter, system-signal=FD14_Tstr_SD_FSL_SensorBlkgSetCounter
        data-element=PpToComDbgFD14Tx.FD14_Tstr_SD_FSL_Unfiltered_DirDist1, system-signal=FD14_Tstr_SD_FSL_Unfiltered_DirDist1
        data-element=PpToComDbgFD14Tx.FD14_Tstr_SD_FSL_Unfiltered_DirDist2, system-signal=FD14_Tstr_SD_FSL_Unfiltered_DirDist2
        data-element=PpToComDbgFD14Tx.FD14_Tstr_SD_FSR_DrvFreq, system-signal=FD14_Tstr_SD_FSR_DrvFreq
        data-element=PpToComDbgFD14Tx.FD14_Tstr_SD_FSR_EchoHeight_adc, system-signal=FD14_Tstr_SD_FSR_EchoHeight_adc
        data-element=PpToComDbgFD14Tx.FD14_Tstr_SD_FSR_RingFreq, system-signal=FD14_Tstr_SD_FSR_RingFreq
        data-element=PpToComDbgFD14Tx.FD14_Tstr_SD_FSR_Ringtime_us, system-signal=FD14_Tstr_SD_FSR_Ringtime_us
        data-element=PpToComDbgFD14Tx.FD14_Tstr_SD_FSR_SensorBlkgClrCounter, system-signal=FD14_Tstr_SD_FSR_SensorBlkgClrCounter
        data-element=PpToComDbgFD14Tx.FD14_Tstr_SD_FSR_SensorBlkgSetCounter, system-signal=FD14_Tstr_SD_FSR_SensorBlkgSetCounter
        data-element=PpToComDbgFD14Tx.FD14_Tstr_SD_FSR_Unfiltered_DirDist1, system-signal=FD14_Tstr_SD_FSR_Unfiltered_DirDist1
        data-element=PpToComDbgFD14Tx.FD14_Tstr_SD_FSR_Unfiltered_DirDist2, system-signal=FD14_Tstr_SD_FSR_Unfiltered_DirDist2
        data-element=PpToComDbgFD14Tx.FD14_Tstr_SD_RIL_DrvFreq, system-signal=FD14_Tstr_SD_RIL_DrvFreq
        data-element=PpToComDbgFD14Tx.FD14_Tstr_SD_RIL_EchoHeight_adc, system-signal=FD14_Tstr_SD_RIL_EchoHeight_adc
        data-element=PpToComDbgFD14Tx.FD14_Tstr_SD_RIL_RingFreq, system-signal=FD14_Tstr_SD_RIL_RingFreq
        data-element=PpToComDbgFD14Tx.FD14_Tstr_SD_RIL_Ringtime_us, system-signal=FD14_Tstr_SD_RIL_Ringtime_us
        data-element=PpToComDbgFD14Tx.FD14_Tstr_SD_RIL_SensorBlkgClrCounter, system-signal=FD14_Tstr_SD_RIL_SensorBlkgClrCounter
        data-element=PpToComDbgFD14Tx.FD14_Tstr_SD_RIL_SensorBlkgSetCounter, system-signal=FD14_Tstr_SD_RIL_SensorBlkgSetCounter
        data-element=PpToComDbgFD14Tx.FD14_Tstr_SD_RIL_Unfiltered_DirDist1, system-signal=FD14_Tstr_SD_RIL_Unfiltered_DirDist1
        data-element=PpToComDbgFD14Tx.FD14_Tstr_SD_RIL_Unfiltered_DirDist2, system-signal=FD14_Tstr_SD_RIL_Unfiltered_DirDist2
        data-element=PpToComDbgFD14Tx.FD14_Tstr_SD_RIR_DrvFreq, system-signal=FD14_Tstr_SD_RIR_DrvFreq
        data-element=PpToComDbgFD14Tx.FD14_Tstr_SD_RIR_EchoHeight_adc, system-signal=FD14_Tstr_SD_RIR_EchoHeight_adc
        data-element=PpToComDbgFD14Tx.FD14_Tstr_SD_RIR_RingFreq, system-signal=FD14_Tstr_SD_RIR_RingFreq
        data-element=PpToComDbgFD14Tx.FD14_Tstr_SD_RIR_Ringtime_us, system-signal=FD14_Tstr_SD_RIR_Ringtime_us
        data-element=PpToComDbgFD14Tx.FD14_Tstr_SD_RIR_SensorBlkgClrCounter, system-signal=FD14_Tstr_SD_RIR_SensorBlkgClrCounter
        data-element=PpToComDbgFD14Tx.FD14_Tstr_SD_RIR_SensorBlkgSetCounter, system-signal=FD14_Tstr_SD_RIR_SensorBlkgSetCounter
        data-element=PpToComDbgFD14Tx.FD14_Tstr_SD_RIR_Unfiltered_DirDist1, system-signal=FD14_Tstr_SD_RIR_Unfiltered_DirDist1
        data-element=PpToComDbgFD14Tx.FD14_Tstr_SD_RIR_Unfiltered_DirDist2, system-signal=FD14_Tstr_SD_RIR_Unfiltered_DirDist2
        data-element=PpToComDbgFD14Tx.FD14_Tstr_SD_ROL_DrvFreq, system-signal=FD14_Tstr_SD_ROL_DrvFreq
        data-element=PpToComDbgFD14Tx.FD14_Tstr_SD_ROL_EchoHeight_adc, system-signal=FD14_Tstr_SD_ROL_EchoHeight_adc
        data-element=PpToComDbgFD14Tx.FD14_Tstr_SD_ROL_RingFreq, system-signal=FD14_Tstr_SD_ROL_RingFreq
        data-element=PpToComDbgFD14Tx.FD14_Tstr_SD_ROL_Ringtime_us, system-signal=FD14_Tstr_SD_ROL_Ringtime_us
        data-element=PpToComDbgFD14Tx.FD14_Tstr_SD_ROL_SensorBlkgClrCounter, system-signal=FD14_Tstr_SD_ROL_SensorBlkgClrCounter
        data-element=PpToComDbgFD14Tx.FD14_Tstr_SD_ROL_SensorBlkgSetCounter, system-signal=FD14_Tstr_SD_ROL_SensorBlkgSetCounter
        data-element=PpToComDbgFD14Tx.FD14_Tstr_SD_ROL_Unfiltered_DirDist1, system-signal=FD14_Tstr_SD_ROL_Unfiltered_DirDist1
        data-element=PpToComDbgFD14Tx.FD14_Tstr_SD_ROL_Unfiltered_DirDist2, system-signal=FD14_Tstr_SD_ROL_Unfiltered_DirDist2
        data-element=PpToComDbgFD14Tx.FD14_Tstr_SD_ROR_DrvFreq, system-signal=FD14_Tstr_SD_ROR_DrvFreq
        data-element=PpToComDbgFD14Tx.FD14_Tstr_SD_ROR_EchoHeight_adc, system-signal=FD14_Tstr_SD_ROR_EchoHeight_adc
        data-element=PpToComDbgFD14Tx.FD14_Tstr_SD_ROR_RingFreq, system-signal=FD14_Tstr_SD_ROR_RingFreq
        data-element=PpToComDbgFD14Tx.FD14_Tstr_SD_ROR_Ringtime_us, system-signal=FD14_Tstr_SD_ROR_Ringtime_us
        data-element=PpToComDbgFD14Tx.FD14_Tstr_SD_ROR_SensorBlkgClrCounter, system-signal=FD14_Tstr_SD_ROR_SensorBlkgClrCounter
        data-element=PpToComDbgFD14Tx.FD14_Tstr_SD_ROR_SensorBlkgSetCounter, system-signal=FD14_Tstr_SD_ROR_SensorBlkgSetCounter
        data-element=PpToComDbgFD14Tx.FD14_Tstr_SD_ROR_Unfiltered_DirDist1, system-signal=FD14_Tstr_SD_ROR_Unfiltered_DirDist1
        data-element=PpToComDbgFD14Tx.FD14_Tstr_SD_ROR_Unfiltered_DirDist2, system-signal=FD14_Tstr_SD_ROR_Unfiltered_DirDist2
        data-element=PpToComDbgFD14Tx.FD14_Tstr_SD_RSL_DrvFreq, system-signal=FD14_Tstr_SD_RSL_DrvFreq
        data-element=PpToComDbgFD14Tx.FD14_Tstr_SD_RSL_EchoHeight_adc, system-signal=FD14_Tstr_SD_RSL_EchoHeight_adc
        data-element=PpToComDbgFD14Tx.FD14_Tstr_SD_RSL_RingFreq, system-signal=FD14_Tstr_SD_RSL_RingFreq
        data-element=PpToComDbgFD14Tx.FD14_Tstr_SD_RSL_Ringtime_us, system-signal=FD14_Tstr_SD_RSL_Ringtime_us
        data-element=PpToComDbgFD14Tx.FD14_Tstr_SD_RSL_SensorBlkgClrCounter, system-signal=FD14_Tstr_SD_RSL_SensorBlkgClrCounter
        data-element=PpToComDbgFD14Tx.FD14_Tstr_SD_RSL_SensorBlkgSetCounter, system-signal=FD14_Tstr_SD_RSL_SensorBlkgSetCounter
        data-element=PpToComDbgFD14Tx.FD14_Tstr_SD_RSL_Unfiltered_DirDist1, system-signal=FD14_Tstr_SD_RSL_Unfiltered_DirDist1
        data-element=PpToComDbgFD14Tx.FD14_Tstr_SD_RSL_Unfiltered_DirDist2, system-signal=FD14_Tstr_SD_RSL_Unfiltered_DirDist2
        data-element=PpToComDbgFD14Tx.FD14_Tstr_SD_RSR_DrvFreq, system-signal=FD14_Tstr_SD_RSR_DrvFreq
        data-element=PpToComDbgFD14Tx.FD14_Tstr_SD_RSR_EchoHeight_adc, system-signal=FD14_Tstr_SD_RSR_EchoHeight_adc
        data-element=PpToComDbgFD14Tx.FD14_Tstr_SD_RSR_RingFreq, system-signal=FD14_Tstr_SD_RSR_RingFreq
        data-element=PpToComDbgFD14Tx.FD14_Tstr_SD_RSR_Ringtime_us, system-signal=FD14_Tstr_SD_RSR_Ringtime_us
        data-element=PpToComDbgFD14Tx.FD14_Tstr_SD_RSR_SensorBlkgClrCounter, system-signal=FD14_Tstr_SD_RSR_SensorBlkgClrCounter
        data-element=PpToComDbgFD14Tx.FD14_Tstr_SD_RSR_SensorBlkgSetCounter, system-signal=FD14_Tstr_SD_RSR_SensorBlkgSetCounter
        data-element=PpToComDbgFD14Tx.FD14_Tstr_SD_RSR_Unfiltered_DirDist1, system-signal=FD14_Tstr_SD_RSR_Unfiltered_DirDist1
        data-element=PpToComDbgFD14Tx.FD14_Tstr_SD_RSR_Unfiltered_DirDist2, system-signal=FD14_Tstr_SD_RSR_Unfiltered_DirDist2
        data-element=PpToComDbgFD14Tx.FD14_turnaroundSubState, system-signal=FD14_turnaroundSubState
        data-element=PpToComDbgFD14Tx.FD14_USS_MPAZoneB{00..03}, system-signal=FD14_USS_MPAZoneB{00..03}
        data-element=PpToComDbgFD14Tx.FD14_USS_MPAZoneF{00..03}, system-signal=FD14_USS_MPAZoneF{00..03}
        data-element=PpToComDbgFD14Tx.FD14_ValidFeatures_Front_u32, system-signal=FD14_ValidFeatures_Front_u32
        data-element=PpToComDbgFD14Tx.FD14_ValidFeatures_Left_u32, system-signal=FD14_ValidFeatures_Left_u32
        data-element=PpToComDbgFD14Tx.FD14_ValidFeatures_Rear_u32, system-signal=FD14_ValidFeatures_Rear_u32
        data-element=PpToComDbgFD14Tx.FD14_ValidFeatures_Right_u32, system-signal=FD14_ValidFeatures_Right_u32
        data-element=PpToComDbgFD14Tx.FD14_vehicleLine_e, system-signal=FD14_vehicleLine_e
        data-element=PpToComDbgFD14Tx.FD14_vehicleSpeed_f32, system-signal=FD14_vehicleSpeed_f32
        data-element=PpToComDbgFD14Tx.FD14_View_Error_e, system-signal=FD14_View_Error_e
        data-element=PpToComDbgFD14Tx.FD14_X_BTN_PRESSED_b, system-signal=FD14_X_BTN_PRESSED_b
        data-element=PpToComDbgFD14Tx.FD14_X_f32_Current_Rear, system-signal=FD14_X_f32_Current_Rear
        data-element=PpToComDbgFD14Tx.FD14_X_f32_Current_Right, system-signal=FD14_X_f32_Current_Right
        data-element=PpToComDbgFD14Tx.FD14_X_f32_EOL_Front, system-signal=FD14_X_f32_EOL_Front
        data-element=PpToComDbgFD14Tx.FD14_X_f32_EOL_Left, system-signal=FD14_X_f32_EOL_Left
        data-element=PpToComDbgFD14Tx.FD14_X_f32_EOL_Rear, system-signal=FD14_X_f32_EOL_Rear
        data-element=PpToComDbgFD14Tx.FD14_X_f32_EOL_Right, system-signal=FD14_X_f32_EOL_Right
        data-element=PpToComDbgFD14Tx.FD14_XIcon_b, system-signal=FD14_XIcon_b
        data-element=PpToComDbgFD14Tx.FD14_Y_f32_Current_Rear, system-signal=FD14_Y_f32_Current_Rear
        data-element=PpToComDbgFD14Tx.FD14_Y_f32_Current_Right, system-signal=FD14_Y_f32_Current_Right
        data-element=PpToComDbgFD14Tx.FD14_Y_f32_EOL_Front, system-signal=FD14_Y_f32_EOL_Front
        data-element=PpToComDbgFD14Tx.FD14_Y_f32_EOL_Left, system-signal=FD14_Y_f32_EOL_Left
        data-element=PpToComDbgFD14Tx.FD14_Y_f32_EOL_Rear, system-signal=FD14_Y_f32_EOL_Rear
        data-element=PpToComDbgFD14Tx.FD14_Y_f32_EOL_Right, system-signal=FD14_Y_f32_EOL_Right
        data-element=PpToComDbgFD14Tx.FD14_Yaw_f32_Current_Rear, system-signal=FD14_Yaw_f32_Current_Rear
        data-element=PpToComDbgFD14Tx.FD14_Yaw_f32_Current_Right, system-signal=FD14_Yaw_f32_Current_Right
        data-element=PpToComDbgFD14Tx.FD14_Yaw_f32_EOL_Front, system-signal=FD14_Yaw_f32_EOL_Front
        data-element=PpToComDbgFD14Tx.FD14_Yaw_f32_EOL_Left, system-signal=FD14_Yaw_f32_EOL_Left
        data-element=PpToComDbgFD14Tx.FD14_Yaw_f32_EOL_Rear, system-signal=FD14_Yaw_f32_EOL_Rear
        data-element=PpToComDbgFD14Tx.FD14_Yaw_f32_EOL_Right, system-signal=FD14_Yaw_f32_EOL_Right
        data-element=PpToComDbgFD14Tx.FD14_Yaw_f32_OC_Front, system-signal=FD14_Yaw_f32_OC_Front
        data-element=PpToComDbgFD14Tx.FD14_Yaw_f32_OC_Left, system-signal=FD14_Yaw_f32_OC_Left
        data-element=PpToComDbgFD14Tx.FD14_Yaw_f32_OC_Rear, system-signal=FD14_Yaw_f32_OC_Rear
        data-element=PpToComDbgFD14Tx.FD14_Yaw_f32_OC_Right, system-signal=FD14_Yaw_f32_OC_Right
        data-element=PpToComDbgFD14Tx.FD14_Yaw_f32_SC_Front, system-signal=FD14_Yaw_f32_SC_Front
        data-element=PpToComDbgFD14Tx.FD14_Yaw_f32_SC_Left, system-signal=FD14_Yaw_f32_SC_Left
        data-element=PpToComDbgFD14Tx.FD14_Yaw_f32_SC_Rear, system-signal=FD14_Yaw_f32_SC_Rear
        data-element=PpToComDbgFD14Tx.FD14_Yaw_f32_SC_Right, system-signal=FD14_Yaw_f32_SC_Right
        data-element=PpToComDbgFD14Tx.FD14_Z_f32_Current_Rear, system-signal=FD14_Z_f32_Current_Rear
        data-element=PpToComDbgFD14Tx.FD14_Z_f32_Current_Right, system-signal=FD14_Z_f32_Current_Right
        data-element=PpToComDbgFD14Tx.FD14_Z_f32_EOL_Front, system-signal=FD14_Z_f32_EOL_Front
        data-element=PpToComDbgFD14Tx.FD14_Z_f32_EOL_Left, system-signal=FD14_Z_f32_EOL_Left
        data-element=PpToComDbgFD14Tx.FD14_Z_f32_EOL_Rear, system-signal=FD14_Z_f32_EOL_Rear
        data-element=PpToComDbgFD14Tx.FD14_Z_f32_EOL_Right, system-signal=FD14_Z_f32_EOL_Right
        data-element=PpToComDbgFD14Tx.FD14_ZoomButtonDisable_b, system-signal=FD14_ZoomButtonDisable_b
        data-element=PpToComDbgFD14Tx.FD14_ZoomFactor_u8, system-signal=FD14_ZoomFactor_u8
        data-element=PpToComDbgFD14Tx.FD14_ZoomMinusIcon_b, system-signal=FD14_ZoomMinusIcon_b
        data-element=PpToComDbgFD14Tx.FD14_ZoomPlusIcon_b, system-signal=FD14_ZoomPlusIcon_b
        data-element=PpToComSafeFD14Tx.FD14_Camera_Status, system-signal=FD14_Camera_Status
        data-element=PpToComSafeFD14Tx.FD14_Cntr_ADAS_FD_LANES_1, system-signal=FD14_Cntr_ADAS_FD_LANES_1
        data-element=PpToComSafeFD14Tx.FD14_Cntr_ADAS_FD_LANES_2, system-signal=FD14_Cntr_ADAS_FD_LANES_2
        data-element=PpToComSafeFD14Tx.FD14_FOD_Confidence, system-signal=FD14_FOD_Confidence
        data-element=PpToComSafeFD14Tx.FD14_Frame_Index_Lanes_1, system-signal=FD14_Frame_Index_Lanes_1
        data-element=PpToComSafeFD14Tx.FD14_Frame_Index_Lanes_2, system-signal=FD14_Frame_Index_Lanes_2
        data-element=PpToComSafeFD14Tx.FD14_Health_Front_Object_Detection, system-signal=FD14_Health_Front_Object_Detection
        data-element=PpToComSafeFD14Tx.FD14_Health_Lane_Detection, system-signal=FD14_Health_Lane_Detection
        data-element=PpToComSafeFD14Tx.FD14_Line_1_Confidence, system-signal=FD14_Line_1_Confidence
        data-element=PpToComSafeFD14Tx.FD14_Line_1_Curvature, system-signal=FD14_Line_1_Curvature
        data-element=PpToComSafeFD14Tx.FD14_Line_1_Curvature_Rate, system-signal=FD14_Line_1_Curvature_Rate
        data-element=PpToComSafeFD14Tx.FD14_Line_1_End_Range, system-signal=FD14_Line_1_End_Range
        data-element=PpToComSafeFD14Tx.FD14_Line_1_Heading, system-signal=FD14_Line_1_Heading
        data-element=PpToComSafeFD14Tx.FD14_Line_1_Offset, system-signal=FD14_Line_1_Offset
        data-element=PpToComSafeFD14Tx.FD14_Line_1_Start_Range, system-signal=FD14_Line_1_Start_Range
        data-element=PpToComSafeFD14Tx.FD14_Line_1_Type, system-signal=FD14_Line_1_Type
        data-element=PpToComSafeFD14Tx.FD14_Line_2_Confidence, system-signal=FD14_Line_2_Confidence
        data-element=PpToComSafeFD14Tx.FD14_Line_2_Curvature, system-signal=FD14_Line_2_Curvature
        data-element=PpToComSafeFD14Tx.FD14_Line_2_Curvature_Rate, system-signal=FD14_Line_2_Curvature_Rate
        data-element=PpToComSafeFD14Tx.FD14_Line_2_End_Range, system-signal=FD14_Line_2_End_Range
        data-element=PpToComSafeFD14Tx.FD14_Line_2_Heading, system-signal=FD14_Line_2_Heading
        data-element=PpToComSafeFD14Tx.FD14_Line_2_Offset, system-signal=FD14_Line_2_Offset
        data-element=PpToComSafeFD14Tx.FD14_Line_2_Start_Range, system-signal=FD14_Line_2_Start_Range
        data-element=PpToComSafeFD14Tx.FD14_Line_2_Type, system-signal=FD14_Line_2_Type
        data-element=PpToComSafeFD14Tx.FD14_Line_3_Confidence, system-signal=FD14_Line_3_Confidence
        data-element=PpToComSafeFD14Tx.FD14_Line_3_Curvature, system-signal=FD14_Line_3_Curvature
        data-element=PpToComSafeFD14Tx.FD14_Line_3_Curvature_Rate, system-signal=FD14_Line_3_Curvature_Rate
        data-element=PpToComSafeFD14Tx.FD14_Line_3_End_Range, system-signal=FD14_Line_3_End_Range
        data-element=PpToComSafeFD14Tx.FD14_Line_3_Heading, system-signal=FD14_Line_3_Heading
        data-element=PpToComSafeFD14Tx.FD14_Line_3_Offset, system-signal=FD14_Line_3_Offset
        data-element=PpToComSafeFD14Tx.FD14_Line_3_Start_Range, system-signal=FD14_Line_3_Start_Range
        data-element=PpToComSafeFD14Tx.FD14_Line_3_Type, system-signal=FD14_Line_3_Type
        data-element=PpToComSafeFD14Tx.FD14_Line_4_Confidence, system-signal=FD14_Line_4_Confidence
        data-element=PpToComSafeFD14Tx.FD14_Line_4_Curvature, system-signal=FD14_Line_4_Curvature
        data-element=PpToComSafeFD14Tx.FD14_Line_4_Curvature_Rate, system-signal=FD14_Line_4_Curvature_Rate
        data-element=PpToComSafeFD14Tx.FD14_Line_4_End_Range, system-signal=FD14_Line_4_End_Range
        data-element=PpToComSafeFD14Tx.FD14_Line_4_Heading, system-signal=FD14_Line_4_Heading
        data-element=PpToComSafeFD14Tx.FD14_Line_4_Offset, system-signal=FD14_Line_4_Offset
        data-element=PpToComSafeFD14Tx.FD14_Line_4_Start_Range, system-signal=FD14_Line_4_Start_Range
        data-element=PpToComSafeFD14Tx.FD14_Line_4_Type, system-signal=FD14_Line_4_Type
        data-element=PpToComSafeFD14Tx.FD14_MAC_ADAS_FD_LANES_1, system-signal=FD14_MAC_ADAS_FD_LANES_1
        data-element=PpToComSafeFD14Tx.FD14_MAC_ADAS_FD_LANES_2, system-signal=FD14_MAC_ADAS_FD_LANES_2
        data-element=PpToComSafeFD14Tx.FD14_ParkingManeuverActive, system-signal=FD14_ParkingManeuverActive
        data-element=PpToComSafeFD14Tx.FD14_Reserved_for_functional_safety, system-signal=FD14_Reserved_for_functional_safety
        data-element=PpToComSafeFD14Tx.FD14_Segment_1_Confidence, system-signal=FD14_Segment_1_Confidence
        data-element=PpToComSafeFD14Tx.FD14_Segment_1_ID, system-signal=FD14_Segment_1_ID
        data-element=PpToComSafeFD14Tx.FD14_Segment_1_X1, system-signal=FD14_Segment_1_X1
        data-element=PpToComSafeFD14Tx.FD14_Segment_1_X2, system-signal=FD14_Segment_1_X2
        data-element=PpToComSafeFD14Tx.FD14_Segment_1_Y1, system-signal=FD14_Segment_1_Y1
        data-element=PpToComSafeFD14Tx.FD14_Segment_1_Y2, system-signal=FD14_Segment_1_Y2
        data-element=PpToComSafeFD14Tx.FD14_Segment_2_Confidence, system-signal=FD14_Segment_2_Confidence
        data-element=PpToComSafeFD14Tx.FD14_Segment_2_ID, system-signal=FD14_Segment_2_ID
        data-element=PpToComSafeFD14Tx.FD14_Segment_2_X1, system-signal=FD14_Segment_2_X1
        data-element=PpToComSafeFD14Tx.FD14_Segment_2_X2, system-signal=FD14_Segment_2_X2
        data-element=PpToComSafeFD14Tx.FD14_Segment_2_Y1, system-signal=FD14_Segment_2_Y1
        data-element=PpToComSafeFD14Tx.FD14_Segment_2_Y2, system-signal=FD14_Segment_2_Y2
        data-element=PpToComSafeFD14Tx.FD14_Segment_3_Confidence, system-signal=FD14_Segment_3_Confidence
        data-element=PpToComSafeFD14Tx.FD14_Segment_3_ID, system-signal=FD14_Segment_3_ID
        data-element=PpToComSafeFD14Tx.FD14_Segment_3_X1, system-signal=FD14_Segment_3_X1
        data-element=PpToComSafeFD14Tx.FD14_Segment_3_X2, system-signal=FD14_Segment_3_X2
        data-element=PpToComSafeFD14Tx.FD14_Segment_3_Y1, system-signal=FD14_Segment_3_Y1
        data-element=PpToComSafeFD14Tx.FD14_Segment_3_Y2, system-signal=FD14_Segment_3_Y2
        data-element=PpToComSafeFD14Tx.FD14_Segment_4_Confidence, system-signal=FD14_Segment_4_Confidence
        data-element=PpToComSafeFD14Tx.FD14_Segment_4_ID, system-signal=FD14_Segment_4_ID
        data-element=PpToComSafeFD14Tx.FD14_Segment_4_X1, system-signal=FD14_Segment_4_X1
        data-element=PpToComSafeFD14Tx.FD14_Segment_4_X2, system-signal=FD14_Segment_4_X2
        data-element=PpToComSafeFD14Tx.FD14_Segment_4_Y1, system-signal=FD14_Segment_4_Y1
        data-element=PpToComSafeFD14Tx.FD14_Segment_4_Y2, system-signal=FD14_Segment_4_Y2
        data-element=PpToComSafeFD14Tx.FD14_Segment_5_Confidence, system-signal=FD14_Segment_5_Confidence
        data-element=PpToComSafeFD14Tx.FD14_Segment_5_ID, system-signal=FD14_Segment_5_ID
        data-element=PpToComSafeFD14Tx.FD14_Segment_5_X1, system-signal=FD14_Segment_5_X1
        data-element=PpToComSafeFD14Tx.FD14_Segment_5_X2, system-signal=FD14_Segment_5_X2
        data-element=PpToComSafeFD14Tx.FD14_Segment_5_Y1, system-signal=FD14_Segment_5_Y1
        data-element=PpToComSafeFD14Tx.FD14_Segment_5_Y2, system-signal=FD14_Segment_5_Y2
        data-element=PpToComSafeFD14Tx.FD14_Segment_6_Confidence, system-signal=FD14_Segment_6_Confidence
        data-element=PpToComSafeFD14Tx.FD14_Segment_6_ID, system-signal=FD14_Segment_6_ID
        data-element=PpToComSafeFD14Tx.FD14_Segment_6_X1, system-signal=FD14_Segment_6_X1
        data-element=PpToComSafeFD14Tx.FD14_Segment_6_X2, system-signal=FD14_Segment_6_X2
        data-element=PpToComSafeFD14Tx.FD14_Segment_6_Y1, system-signal=FD14_Segment_6_Y1
        data-element=PpToComSafeFD14Tx.FD14_Segment_6_Y2, system-signal=FD14_Segment_6_Y2
        data-element=PpToComSafeFD14Tx.FD14_Segment_7_Confidence, system-signal=FD14_Segment_7_Confidence
        data-element=PpToComSafeFD14Tx.FD14_Segment_7_ID, system-signal=FD14_Segment_7_ID
        data-element=PpToComSafeFD14Tx.FD14_Segment_7_X1, system-signal=FD14_Segment_7_X1
        data-element=PpToComSafeFD14Tx.FD14_Segment_7_X2, system-signal=FD14_Segment_7_X2
        data-element=PpToComSafeFD14Tx.FD14_Segment_7_Y1, system-signal=FD14_Segment_7_Y1
        data-element=PpToComSafeFD14Tx.FD14_Segment_7_Y2, system-signal=FD14_Segment_7_Y2
        data-element=PpToComSafeFD14Tx.FD14_Segment_8_Confidence, system-signal=FD14_Segment_8_Confidence
        data-element=PpToComSafeFD14Tx.FD14_Segment_8_ID, system-signal=FD14_Segment_8_ID
        data-element=PpToComSafeFD14Tx.FD14_Segment_8_X1, system-signal=FD14_Segment_8_X1
        data-element=PpToComSafeFD14Tx.FD14_Segment_8_X2, system-signal=FD14_Segment_8_X2
        data-element=PpToComSafeFD14Tx.FD14_Segment_8_Y1, system-signal=FD14_Segment_8_Y1
        data-element=PpToComSafeFD14Tx.FD14_Segment_8_Y2, system-signal=FD14_Segment_8_Y2
        data-element=PpToComSafeFD14Tx.FD14_ManoeuvrePhase, system-signal=FD14_ManoeuvrePhase
        data-element=PpToComSafeFD14Tx.FD14_ParkingGearShiftReq, system-signal=FD14_ParkingGearShiftReq
        data-element=PpToComSafeFD14Tx.FD14_PPPA_AccelMax, system-signal=FD14_PPPA_AccelMax
        data-element=PpToComSafeFD14Tx.FD14_PPPA_AccelMin, system-signal=FD14_PPPA_AccelMin
        data-element=PpToComSafeFD14Tx.FD14_PPPA_DecelMax, system-signal=FD14_PPPA_DecelMax
        data-element=PpToComSafeFD14Tx.FD14_PPPA_DecelMin, system-signal=FD14_PPPA_DecelMin
        data-element=PpToComSafeFD14Tx.FD14_PPPA_Interface_BSM, system-signal=FD14_PPPA_Interface_BSM
        data-element=PpToComSafeFD14Tx.FD14_PPPA_JerkAccelMax, system-signal=FD14_PPPA_JerkAccelMax
        data-element=PpToComSafeFD14Tx.FD14_PPPA_JerkAccelMin, system-signal=FD14_PPPA_JerkAccelMin
        data-element=PpToComSafeFD14Tx.FD14_PPPA_JerkDecelMax, system-signal=FD14_PPPA_JerkDecelMax
        data-element=PpToComSafeFD14Tx.FD14_PPPA_JerkDecelMin, system-signal=FD14_PPPA_JerkDecelMin
        data-element=PpToComSafeFD14Tx.FD14_PPPA_MaxSpeed, system-signal=FD14_PPPA_MaxSpeed
        data-element=PpToComSafeFD14Tx.FD14_PPPA_StandstillRqst, system-signal=FD14_PPPA_StandstillRqst
        data-element=PpToComSafeFD14Tx.FD14_PPPA_TargetDistance, system-signal=FD14_PPPA_TargetDistance
        data-element=PpToComSafeFD14Tx.FD14_RR_PAM_Brk_RqSts, system-signal=FD14_RR_PAM_Brk_RqSts
        data-element=PpToComSafeFD14Tx.FD14_RR_PAM_Dist, system-signal=FD14_RR_PAM_Dist
        data-element=PpToComSafeFD14Tx.FD14_SPM_Lat_Ctrl_RequestSts, system-signal=FD14_SPM_Lat_Ctrl_RequestSts
        data-element=PpToComSafeFD14Tx.FD14_TorqueOverlaySteeringReq_SPM, system-signal=FD14_TorqueOverlaySteeringReq_SPM
        data-element=PpToComDbgSafeFD14Tx.FD14_1_Err_FaultInfo_MCU1_0, system-signal=FD14_1_Err_FaultInfo_MCU1_0
        data-element=PpToComDbgSafeFD14Tx.FD14_1_Err_FaultInfo_MCU2_1, system-signal=FD14_1_Err_FaultInfo_MCU2_1
        data-element=PpToComDbgSafeFD14Tx.FD14_1_Err_FaultInfo_MPU1_0, system-signal=FD14_1_Err_FaultInfo_MPU1_0
        data-element=PpToComDbgSafeFD14Tx.FD14_1_Err_FaultNum_MCU1_0, system-signal=FD14_1_Err_FaultNum_MCU1_0
        data-element=PpToComDbgSafeFD14Tx.FD14_1_Err_FaultNum_MCU2_0, system-signal=FD14_1_Err_FaultNum_MCU2_0
        data-element=PpToComDbgSafeFD14Tx.FD14_1_Err_FaultNum_MCU2_1, system-signal=FD14_1_Err_FaultNum_MCU2_1
        data-element=PpToComDbgSafeFD14Tx.FD14_1_Err_FaultNum_MPU1_0, system-signal=FD14_1_Err_FaultNum_MPU1_0
        data-element=PpToComDbgSafeFD14Tx.FD14_1_ErrFaultInfo_MCU2_0, system-signal=FD14_1_ErrFaultInfo_MCU2_0
        data-element=PpToComDbgSafeFD14Tx.FD14_1_Reserved_MCU1_0, system-signal=FD14_1_Reserved_MCU1_0
        data-element=PpToComDbgSafeFD14Tx.FD14_1_Reserved_MCU2_0, system-signal=FD14_1_Reserved_MCU2_0
        data-element=PpToComDbgSafeFD14Tx.FD14_1_Reserved_MCU2_1, system-signal=FD14_1_Reserved_MCU2_1
        data-element=PpToComDbgSafeFD14Tx.FD14_1_Reserved_MPU1_0, system-signal=FD14_1_Reserved_MPU1_0
        data-element=PpToComDbgSafeFD14Tx.FD14_1_SDL_Fault_MCU1_0, system-signal=FD14_1_SDL_Fault_MCU1_0
        data-element=PpToComDbgSafeFD14Tx.FD14_1_SSM_FltData1_MCU1_0, system-signal=FD14_1_SSM_FltData1_MCU1_0
        data-element=PpToComDbgSafeFD14Tx.FD14_1_SSM_FltData{10..18}_MCU1_0, system-signal=FD14_1_SSM_FltData{10..18}_MCU1_0
        data-element=PpToComDbgSafeFD14Tx.FD14_1_SSM_FltData{2..9}_MCU1_0, system-signal=FD14_1_SSM_FltData{2..9}_MCU1_0
        data-element=PpToComDbgSafeFD14Tx.FD14_1_WDG_Error_ID_MCU1_0, system-signal=FD14_1_WDG_Error_ID_MCU1_0
        data-element=PpToComDbgSafeFD14Tx.FD14_1_Hook_actTsk_MCU1_0, system-signal=FD14_1_Hook_actTsk_MCU1_0
        data-element=PpToComDbgSafeFD14Tx.FD14_1_Hook_DtErr_MCU1_0, system-signal=FD14_1_Hook_DtErr_MCU1_0
        data-element=PpToComDbgSafeFD14Tx.FD14_1_Hook_Error_MCU1_0, system-signal=FD14_1_Hook_Error_MCU1_0
        data-element=PpToComDbgSafeFD14Tx.FD14_1_Hook_fatalErr_MCU1_0, system-signal=FD14_1_Hook_fatalErr_MCU1_0
        data-element=PpToComDbgSafeFD14Tx.FD14_1_Hook_PresentPtr_MCU1_0, system-signal=FD14_1_Hook_PresentPtr_MCU1_0
        data-element=PpToComDbgSafeFD14Tx.FD14_1_Hook_Reserved_MCU1_0, system-signal=FD14_1_Hook_Reserved_MCU1_0
        data-element=PpToComDbgSafeFD14Tx.FD14_1_Hook_Service_MCU1_0, system-signal=FD14_1_Hook_Service_MCU1_0
        data-element=PpToComDbgSafeFD14Tx.FD14_1_Hook_Type_MCU1_0, system-signal=FD14_1_Hook_Type_MCU1_0
        data-element=PpToComDbgFD14Tx.FD14_MeTRSC_cnt_TRSCAliveCounter, system-signal=FD14_MeTRSC_cnt_TRSCAliveCounter
        data-element=PpToComDbgFD14Tx.FD14_MeTRSC_deg_TADAngleSMVC, system-signal=FD14_MeTRSC_deg_TADAngleSMVC
        data-element=PpToComDbgFD14Tx.FD14_MeTRSC_e_TrlrCalInfoSMVC, system-signal=FD14_MeTRSC_e_TrlrCalInfoSMVC
        data-element=PpToComDbgFD14Tx.FD14_MeTRSC_s_TRSCPeriodicity, system-signal=FD14_MeTRSC_s_TRSCPeriodicity
        data-element=PpToComDbgFD14Tx.FD14_MeTRSC_s_TRSCTimeTaken, system-signal=FD14_MeTRSC_s_TRSCTimeTaken
        data-element=PpToComDbgFD14Tx.FD14_ReservedSignal1, system-signal=FD14_ReservedSignal1
        data-element=PpToComDbgFD14Tx.FD14_ReservedSignal2, system-signal=FD14_ReservedSignal2
        data-element=PpToComDbgFD14Tx.FD14_ReservedTRSCSig1, system-signal=FD14_ReservedTRSCSig1
        data-element=PpToComDbgFD14Tx.FD14_ReservedTRSCSig2, system-signal=FD14_ReservedTRSCSig2
        data-element=PpToComFD02Tx.TRSC_PopupDisp_Info2, system-signal=TRSC_PopupDisp_Info2
        data-element=PpToComDbgSafeFD14Tx.FD14_1_AliveCntr_MCU2_0, system-signal=FD14_1_AliveCntr_MCU2_0
        data-element=PpToComDbgSafeFD14Tx.FD14_1_AliveCntr_MCU2_1, system-signal=FD14_1_AliveCntr_MCU2_1
        data-element=PpToComDbgSafeFD14Tx.FD14_1_AliveCntr_MPU1_0, system-signal=FD14_1_AliveCntr_MPU1_0
        data-element=PpToComDbgSafeFD14Tx.FD14_1_OsRegMCU_ADFSR, system-signal=FD14_1_OsRegMCU_ADFSR
        data-element=PpToComDbgSafeFD14Tx.FD14_1_OsRegMCU_AIFSR, system-signal=FD14_1_OsRegMCU_AIFSR
        data-element=PpToComDbgSafeFD14Tx.FD14_1_OsRegMCU_DFAR, system-signal=FD14_1_OsRegMCU_DFAR
        data-element=PpToComDbgSafeFD14Tx.FD14_1_OsRegMCU_DFSR, system-signal=FD14_1_OsRegMCU_DFSR
        data-element=PpToComDbgSafeFD14Tx.FD14_1_OsRegMCU_IFAR, system-signal=FD14_1_OsRegMCU_IFAR
        data-element=PpToComDbgSafeFD14Tx.FD14_1_OsRegMCU_IFSR, system-signal=FD14_1_OsRegMCU_IFSR
        data-element=PpToComDbgSafeFD14Tx.FD14_1_OsRegMCU_Link, system-signal=FD14_1_OsRegMCU_Link
        data-element=PpToComDbgSafeFD14Tx.FD14_1_OsRegMCU_SPSR, system-signal=FD14_1_OsRegMCU_SPSR
        data-element=PpToComDbgSafeFD14Tx.FD14_1_OsRegMCU_Stack{0..9}, system-signal=FD14_1_OsRegMCU_Stack{0..9}
        data-element=PpToComDbgSafeFD14Tx.FD14_1_SSM_SystemStateReq, system-signal=FD14_1_SSM_SystemStateReq
        data-element=PpToComDbgSafeFD14Tx.FD14_1_TimeSincePowerON, system-signal=FD14_1_TimeSincePowerON
    root-software-compositions:
      root sw composition prototype EcuSwComposition: software-composition=ECU_Composition
