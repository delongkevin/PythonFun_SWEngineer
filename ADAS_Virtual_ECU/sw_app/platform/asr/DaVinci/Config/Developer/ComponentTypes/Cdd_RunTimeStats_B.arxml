AUTOSAR XML (schema 00050)
package /FCADT/ComponentTypes
  complex device driver sw component type Cdd_RunTimeStats_B
    require port RpPerformanceStatsEnable: required-interface=IF_PerformanceStatsEnable
      required-com-specs:
        data-element=RunTimeStatsEnable, filter=data-filter-type=ALWAYS, init-value=0
        data-element=StackUsageStatsEnable, filter=data-filter-type=ALWAYS, init-value=0
    behavior Cdd_RunTimeStats_B_InternalBehavior
      8 x timing event:
        TMT_Cdd_RunTimeStat_B_Safety_Task_00_10ms_Start: start-on-event=Cdd_RunTimeStats_B_Safety_Task_00_10ms_Start, period=0.01
        TMT_Cdd_RunTimeStat_B_Safety_Task_00_10ms_Stop: start-on-event=Cdd_RunTimeStats_B_Safety_Task_00_10ms_Stop, period=0.01
        TMT_Cdd_RunTimeStat_B_Safety_Task_01_10ms_Start: start-on-event=Cdd_RunTimeStats_B_Safety_Task_01_10ms_Start, period=0.01
        TMT_Cdd_RunTimeStat_B_Safety_Task_01_10ms_Stop: start-on-event=Cdd_RunTimeStats_B_Safety_Task_01_10ms_Stop, period=0.01
        TMT_Cdd_RunTimeStat_B_Safety_Task_01_10ms_Start_1: start-on-event=Cdd_RunTimeStats_B_Safety_Task_200ms_Start, period=0.2
        TMT_Cdd_RunTimeStat_B_Safety_Task_01_10ms_Start_1_1: start-on-event=Cdd_RunTimeStats_B_Safety_Task_200ms_Stop, period=0.2
        TMT_Cdd_RunTimeStat_B_Safety_Task_Init_Start_1: start-on-event=Cdd_RunTimeStats_B_Safety_WdgTask_10ms_Start, period=0.01
        TMT_Cdd_RunTimeStat_B_Safety_Task_Init_Start_2: start-on-event=Cdd_RunTimeStats_B_Safety_WdgTask_10ms_Stop, period=0.01
      init event Cdd_RunTimeStats_B_Safety_Task_Init_Start_InitEvent: start-on-event=Cdd_RunTimeStats_B_Safety_Task_Init_Start
      init event Cdd_RunTimeStats_B_Safety_Task_Init_Stop_InitEvent: start-on-event=Cdd_RunTimeStats_B_Safety_Task_Init_Stop
      10 x runnable:
        Cdd_RunTimeStats_B_Safety_Task_00_10ms_Start
          data-receive-point-by-arguments:
            access REC_RpPerformanceStatsEnable_RunTimeStatsEnable: accessed-variable=RpPerformanceStatsEnable.RunTimeStatsEnable
        Cdd_RunTimeStats_B_Safety_Task_00_10ms_Stop
        Cdd_RunTimeStats_B_Safety_Task_01_10ms_Start
        Cdd_RunTimeStats_B_Safety_Task_01_10ms_Stop
        Cdd_RunTimeStats_B_Safety_Task_200ms_Start
        Cdd_RunTimeStats_B_Safety_Task_200ms_Stop
        Cdd_RunTimeStats_B_Safety_Task_Init_Start
        Cdd_RunTimeStats_B_Safety_Task_Init_Stop
        Cdd_RunTimeStats_B_Safety_WdgTask_10ms_Start
        Cdd_RunTimeStats_B_Safety_WdgTask_10ms_Stop
  swc implementation Cdd_RunTimeStats_B_Implementation: behavior=Cdd_RunTimeStats_B_InternalBehavior
