AUTOSAR XML (schema 00050)
package /FCADT/ComponentTypes
  application sw component type SWC_SafeVCANMgr
    behavior SWC_SafeVCANMgr_InternalBehavior
  swc implementation SWC_SafeVCANMgr_Implementation: behavior=SWC_SafeVCANMgr_InternalBehavior
