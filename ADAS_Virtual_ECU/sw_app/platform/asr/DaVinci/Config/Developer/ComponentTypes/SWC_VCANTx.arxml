[part 2 of 2: package /ComponentTypes]
AUTOSAR XML (schema 00050)
package /ComponentTypes  (continued)
  application sw component type SWC_VCANTx  (continued)
    behavior SWC_VCANTx_InternalBehavior: data-type-mapping=[defaultDataTypeMappingSet_CPFS, defaultDataTypeMappingSet_CPFS, defaultDataTypeMappingSet_CPFS, defaultDataTypeMappingSet_CPFS]
      init event SWC_VCANTx_InitEvent: start-on-event=RE_VCANTx_Init
      timing event TMT_RE_VCANTx_Main: start-on-event=RE_VCANTx_Main, period=0.01
      runnable RE_VCANTx_Init
      runnable RE_VCANTx_Main
        data-receive-point-by-arguments:
          107 x access:
            REC_RpAPSMPAOut_TbAP_APSMPAOut_t: accessed-variable=RpAPSMPAOut.TbAP_APSMPAOut_t
            REC_RpCVPAMFDData_IFOD_Outputs_CVPAMFDData_t: accessed-variable=RpCVPAMFDData.IFOD_Outputs_CVPAMFDData_t
            REC_RpCVPAMFDData2_LMD_Outputs_CVPAMFDData2_t: accessed-variable=RpCVPAMFDData2.LMD_Outputs_CVPAMFDData2_t
            REC_RpCan14DbgRoutineState_Can14DbgRoutine: accessed-variable=RpCan14DbgRoutineState.Can14DbgRoutine
            REC_RpDebCurReqOverlay_Debug_HMI_Curr_Requested_Overlays: accessed-variable=RpDebCurReqOverlay.Debug_HMI_Curr_Requested_Overlays
            REC_RpDebCurrDispOverlay_Debug_HMI_Curr_Displayed_Overlays: accessed-variable=RpDebCurrDispOverlay.Debug_HMI_Curr_Displayed_Overlays
            REC_RpDebCurrDispProxiCfg_Debug_HMI_Curr_Displayed_ProxiConfig: accessed-variable=RpDebCurrDispProxiCfg.Debug_HMI_Curr_Displayed_ProxiConfig
            REC_RpDebCurrReqProxiCfg_Debug_HMI_Curr_Requested_ProxiConfig: accessed-variable=RpDebCurrReqProxiCfg.Debug_HMI_Curr_Requested_ProxiConfig
            REC_RpDebHmiInput_Debug_HMI_Input_Data_t: accessed-variable=RpDebHmiInput.Debug_HMI_Input_Data_t
            REC_RpDebHmiInternal_Debug_HMI_Internal_Data_t: accessed-variable=RpDebHmiInternal.Debug_HMI_Internal_Data_t
            REC_RpDebHmiTrailViews_Debug_HMI_Trailer_Views_Data_t: accessed-variable=RpDebHmiTrailViews.Debug_HMI_Trailer_Views_Data_t
            REC_RpDetInpTrsc_Detection_Inputs_from_TRSC_t: accessed-variable=RpDetInpTrsc.Detection_Inputs_from_TRSC_t
            REC_RpDriveAssistStatOut_TbAP_DriveAssistStatOut_t: accessed-variable=RpDriveAssistStatOut.TbAP_DriveAssistStatOut_t
            REC_RpFPAWarnOut_TbAP_FPAWarnOut_t: accessed-variable=RpFPAWarnOut.TbAP_FPAWarnOut_t
            REC_RpFeatureOutputsTHA_TbTHASmVc_FeatureOutputs_t: accessed-variable=RpFeatureOutputsTHA.TbTHASmVc_FeatureOutputs_t
            REC_RpFromSwcFD02Tx_CurrentCanNMState_FD02_PAM: accessed-variable=RpFromSwcFD02Tx.CurrentCanNMState_FD02_PAM
            REC_RpFromSwcFD02Tx_CurrentFailSts_FD02_PAM: accessed-variable=RpFromSwcFD02Tx.CurrentFailSts_FD02_PAM
            REC_RpFromSwcFD02Tx_DES_FD02_PAM: accessed-variable=RpFromSwcFD02Tx.DES_FD02_PAM
            REC_RpFromSwcFD02Tx_Digit_{01..11}_PAM: accessed-variable=RpFromSwcFD02Tx.Digit_{01..11}_PAM
            REC_RpFromSwcFD02Tx_EOL_FD02_PAM: accessed-variable=RpFromSwcFD02Tx.EOL_FD02_PAM
            REC_RpFromSwcFD02Tx_GenericFailSts_FD02_PAM: accessed-variable=RpFromSwcFD02Tx.GenericFailSts_FD02_PAM
            REC_RpFromSwcFD02Tx_N_PDU: accessed-variable=RpFromSwcFD02Tx.N_PDU
            REC_RpFromSwcFD02Tx_PreviousCanNMState_FD02_PAM: accessed-variable=RpFromSwcFD02Tx.PreviousCanNMState_FD02_PAM
            REC_RpFromSwcFD02Tx_StayActiveSource_FD02_PAM: accessed-variable=RpFromSwcFD02Tx.StayActiveSource_FD02_PAM
            REC_RpFromSwcFD02Tx_THA_EPB_Req: accessed-variable=RpFromSwcFD02Tx.THA_EPB_Req
            REC_RpFromSwcFD02Tx_THA_STAT: accessed-variable=RpFromSwcFD02Tx.THA_STAT
            REC_RpFromSwcFD02Tx_THA_SpeedLimit_Req: accessed-variable=RpFromSwcFD02Tx.THA_SpeedLimit_Req
            REC_RpFromSwcFD02Tx_THA_Speed_Limit: accessed-variable=RpFromSwcFD02Tx.THA_Speed_Limit
            REC_RpFromSwcFD02Tx_THA_SteeringDamping: accessed-variable=RpFromSwcFD02Tx.THA_SteeringDamping
            REC_RpFromSwcFD02Tx_THA_SteeringTorqueInfo: accessed-variable=RpFromSwcFD02Tx.THA_SteeringTorqueInfo
            REC_RpFromSwcFD02Tx_THA_SteeringTorqueReq: accessed-variable=RpFromSwcFD02Tx.THA_SteeringTorqueReq
            REC_RpFromSwcFD02Tx_TRSCMoreCamRQSts: accessed-variable=RpFromSwcFD02Tx.TRSCMoreCamRQSts
            REC_RpFromSwcFD02Tx_TRSC_PopupDisp_Info: accessed-variable=RpFromSwcFD02Tx.TRSC_PopupDisp_Info
            REC_RpFromSwcFD02Tx_TRSC_STAT: accessed-variable=RpFromSwcFD02Tx.TRSC_STAT
            REC_RpFromSwcFD02Tx_TRSC_SpeedLimit_Req: accessed-variable=RpFromSwcFD02Tx.TRSC_SpeedLimit_Req
            REC_RpFromSwcFD02Tx_TRSC_SteeringDamping: accessed-variable=RpFromSwcFD02Tx.TRSC_SteeringDamping
            REC_RpFromSwcFD02Tx_TRSC_SteeringTorqueInfo: accessed-variable=RpFromSwcFD02Tx.TRSC_SteeringTorqueInfo
            REC_RpFromSwcFD02Tx_TRSC_SteeringTorqueReq: accessed-variable=RpFromSwcFD02Tx.TRSC_SteeringTorqueReq
            REC_RpFromSwcFD02Tx_TRSC_VehicleStop_Req: accessed-variable=RpFromSwcFD02Tx.TRSC_VehicleStop_Req
            REC_RpFromSwcFD02Tx_Trailer_Angle: accessed-variable=RpFromSwcFD02Tx.Trailer_Angle
            REC_RpFromSwcFD02Tx_Trailer_Angle_Sign: accessed-variable=RpFromSwcFD02Tx.Trailer_Angle_Sign
            REC_RpFromSwcFD02Tx_Trailer_Calibration: accessed-variable=RpFromSwcFD02Tx.Trailer_Calibration
            REC_RpFromSwcFD02Tx_TrlrHitchLight_Cntrl: accessed-variable=RpFromSwcFD02Tx.TrlrHitchLight_Cntrl
            REC_RpFromSwcFD02Tx_WakeupSource_FD02_PAM: accessed-variable=RpFromSwcFD02Tx.WakeupSource_FD02_PAM
            REC_RpFromSwcFD14Tx_FD14_THA_EPB_Req: accessed-variable=RpFromSwcFD14Tx.FD14_THA_EPB_Req
            REC_RpFromSwcFD14Tx_FD14_THA_STAT: accessed-variable=RpFromSwcFD14Tx.FD14_THA_STAT
            REC_RpFromSwcFD14Tx_FD14_THA_SpeedLimit_Req: accessed-variable=RpFromSwcFD14Tx.FD14_THA_SpeedLimit_Req
            REC_RpFromSwcFD14Tx_FD14_THA_Speed_Limit: accessed-variable=RpFromSwcFD14Tx.FD14_THA_Speed_Limit
            REC_RpFromSwcFD14Tx_FD14_THA_SteeringDamping: accessed-variable=RpFromSwcFD14Tx.FD14_THA_SteeringDamping
            REC_RpFromSwcFD14Tx_FD14_THA_SteeringTorqueInfo: accessed-variable=RpFromSwcFD14Tx.FD14_THA_SteeringTorqueInfo
            REC_RpFromSwcFD14Tx_FD14_THA_SteeringTorqueReq: accessed-variable=RpFromSwcFD14Tx.FD14_THA_SteeringTorqueReq
            REC_RpFromSwcFD14Tx_FD14_TRSC_STAT: accessed-variable=RpFromSwcFD14Tx.FD14_TRSC_STAT
            REC_RpFromSwcFD14Tx_FD14_TRSC_SpeedLimit_Req: accessed-variable=RpFromSwcFD14Tx.FD14_TRSC_SpeedLimit_Req
            REC_RpFromSwcFD14Tx_FD14_TRSC_SteeringDamping: accessed-variable=RpFromSwcFD14Tx.FD14_TRSC_SteeringDamping
            REC_RpFromSwcFD14Tx_FD14_TRSC_SteeringTorqueInfo: accessed-variable=RpFromSwcFD14Tx.FD14_TRSC_SteeringTorqueInfo
            REC_RpFromSwcFD14Tx_FD14_TRSC_SteeringTorqueReq: accessed-variable=RpFromSwcFD14Tx.FD14_TRSC_SteeringTorqueReq
            REC_RpFromSwcFD14Tx_FD14_TRSC_VehicleStop_Req: accessed-variable=RpFromSwcFD14Tx.FD14_TRSC_VehicleStop_Req
            REC_RpIJobUSSObjOp_IJobUSSObjectMapOutput_t: accessed-variable=RpIJobUSSObjOp.IJobUSSObjectMapOutput_t
            REC_RpJobFPAData_IJobFPAOutput_t: accessed-variable=RpJobFPAData.IJobFPAOutput_t
            REC_RpJobPLDData_IJobPLDOutput_t: accessed-variable=RpJobPLDData.IJobPLDOutput_t
            REC_RpJobTHADetOutput_JobTHADetOutput_t: accessed-variable=RpJobTHADetOutput.JobTHADetOutput_t
            REC_RpLMDLaneOp_LMD_Lane_Outputs_s: accessed-variable=RpLMDLaneOp.LMD_Lane_Outputs_s
            REC_RpNFCDOutput_NFCD_Output: accessed-variable=RpNFCDOutput.NFCD_Output
            REC_RpNVMSignMgr_NVMSignalManager_t: accessed-variable=RpNVMSignMgr.NVMSignalManager_t
            REC_RpPAStateOut_TbAP_PAStateOut_t: accessed-variable=RpPAStateOut.TbAP_PAStateOut_t
            REC_RpPointDistOpBuff_US_S_PointDistOutputBuff_t: accessed-variable=RpPointDistOpBuff.US_S_PointDistOutputBuff_t
            REC_RpRPAWarnOut_TbAP_RPAWarnOut_t: accessed-variable=RpRPAWarnOut.TbAP_RPAWarnOut_t
            REC_RpSMDAInternal_TbAP_SMDAInternalOut_t: accessed-variable=RpSMDAInternal.TbAP_SMDAInternalOut_t
            REC_RpSR_State_MCU2_State_2_0: accessed-variable=RpSR_State_MCU2.State_2_0
            REC_RpSR_State_MCU2_State_2_1: accessed-variable=RpSR_State_MCU2.State_2_1
            REC_RpSVSNVMData_SVS_NVMData_t: accessed-variable=RpSVSNVMData.SVS_NVMData_t
            REC_RpSVStoTRSC_SVStoTRSC_t: accessed-variable=RpSVStoTRSC.SVStoTRSC_t
            REC_RpScreenRequest_ScreenRequest_t: accessed-variable=RpScreenRequest.ScreenRequest_t
            REC_RpSvsToTHA_SvsToTHA_t: accessed-variable=RpSvsToTHA.SvsToTHA_t
            REC_RpSvsToVCAN_SvsToVCAN_t: accessed-variable=RpSvsToVCAN.SvsToVCAN_t
            REC_RpTRSC_ME_VehOut_TRSC_t: accessed-variable=RpTRSC.ME_VehOut_TRSC_t
            REC_RpTbAPDebugOut_TbAP_DebugOut: accessed-variable=RpTbAPDebugOut.TbAP_DebugOut
            REC_RpTbAPSMPAOut_TbAP_SMPAInternalOut_t: accessed-variable=RpTbAPSMPAOut.TbAP_SMPAInternalOut_t
            REC_RpTbFAArbiterOutput_TbFA_ArbiterOutput_t: accessed-variable=RpTbFAArbiterOutput.TbFA_ArbiterOutput_t
            REC_RpTrailerDetectOP_TrailerDetection_Output_DID_t: accessed-variable=RpTrailerDetectOP.TrailerDetection_Output_DID_t
            REC_RpTrscSmvctoSvs_TRSCSMVCtoSVS_t: accessed-variable=RpTrscSmvctoSvs.TRSCSMVCtoSVS_t
            REC_RpTrscToDiag_TRSCtoDiagMgr_t: accessed-variable=RpTrscToDiag.TRSCtoDiagMgr_t
            REC_RpTrscTrlrDet_TRSC_Inputs_from_TrailerDetection_t: accessed-variable=RpTrscTrlrDet.TRSC_Inputs_from_TrailerDetection_t
            REC_RpUSSBlockageBit_US_S_BlockageBit_t: accessed-variable=RpUSSBlockageBit.US_S_BlockageBit_t
            REC_RpUSSErrorDiagData_US_S_USSErrorDiagData_t: accessed-variable=RpUSSErrorDiagData.US_S_USSErrorDiagData_t
            REC_RpUssDataCollection_US_S_USSDataCollectionData_t: accessed-variable=RpUssDataCollection.US_S_USSDataCollectionData_t
            REC_RpUssPointMapGrp_US_S_PointMapGroup_t: accessed-variable=RpUssPointMapGrp.US_S_PointMapGroup_t
            REC_RpUssZoneInfo_US_S_ZoneInfo_t: accessed-variable=RpUssZoneInfo.US_S_ZoneInfo_t
            REC_RpVCActuatorOut_TbAP_VCActuatorOut_t: accessed-variable=RpVCActuatorOut.TbAP_VCActuatorOut_t
            REC_RpVCState_TbAP_VCStateOut_t: accessed-variable=RpVCState.TbAP_VCStateOut_t
            REC_RpTRSCSMVCtoDebug_TRSCSMVCtoDebugCAN_t: accessed-variable=RpTRSCSMVCtoDebug.TRSCSMVCtoDebugCAN_t
            REC_RpUsCsmStatCngRsn_US_S_CsmStateChangeReason_Type: accessed-variable=RpUsCsmStatCngRsn.US_S_CsmStateChangeReason_Type
            REC_RpUSSPeriodDiagData_US_S_USSPeriodDiagData_t: accessed-variable=RpUSSPeriodDiagData.US_S_USSPeriodDiagData_t
            REC_RpUssDebugMsg_US_S_DebugMsg_t: accessed-variable=RpUssDebugMsg.US_S_DebugMsg_t
            REC_RpFID_Output_QM_FID_QM: accessed-variable=RpFID_Output_QM.FID_QM
            REC_RpBusOffIndication_V_BusOffIndicationFlagRte_u8: accessed-variable=RpBusOffIndication.V_BusOffIndicationFlagRte_u8
            REC_RpFromSwcFD02Tx_TRSC_PopupDisp_Info2: accessed-variable=RpFromSwcFD02Tx.TRSC_PopupDisp_Info2
        data-send-points:
          1895 x access:
            SEND_PpToComDbgFD14Tx_FD14_AOL_Blockage: accessed-variable=PpToComDbgFD14Tx.FD14_AOL_Blockage
            SEND_PpToComDbgFD14Tx_FD14_AOL_CommUnknown: accessed-variable=PpToComDbgFD14Tx.FD14_AOL_CommUnknown
            SEND_PpToComDbgFD14Tx_FD14_AOL_MinDistance: accessed-variable=PpToComDbgFD14Tx.FD14_AOL_MinDistance
            SEND_PpToComDbgFD14Tx_FD14_AOL_comm_Fault: accessed-variable=PpToComDbgFD14Tx.FD14_AOL_comm_Fault
            SEND_PpToComDbgFD14Tx_FD14_AOL_hardware_Fault: accessed-variable=PpToComDbgFD14Tx.FD14_AOL_hardware_Fault
            SEND_PpToComDbgFD14Tx_FD14_AOL_overTemp_Fault: accessed-variable=PpToComDbgFD14Tx.FD14_AOL_overTemp_Fault
            SEND_PpToComDbgFD14Tx_FD14_AOR_Blockage: accessed-variable=PpToComDbgFD14Tx.FD14_AOR_Blockage
            SEND_PpToComDbgFD14Tx_FD14_AOR_CommUnknown: accessed-variable=PpToComDbgFD14Tx.FD14_AOR_CommUnknown
            SEND_PpToComDbgFD14Tx_FD14_AOR_MinDistance: accessed-variable=PpToComDbgFD14Tx.FD14_AOR_MinDistance
            SEND_PpToComDbgFD14Tx_FD14_AOR_comm_Fault: accessed-variable=PpToComDbgFD14Tx.FD14_AOR_comm_Fault
            SEND_PpToComDbgFD14Tx_FD14_AOR_hardware_Fault: accessed-variable=PpToComDbgFD14Tx.FD14_AOR_hardware_Fault
            SEND_PpToComDbgFD14Tx_FD14_AOR_overTemp_Fault: accessed-variable=PpToComDbgFD14Tx.FD14_AOR_overTemp_Fault
            SEND_PpToComDbgFD14Tx_FD14_AutoParkInitializedStatus_b: accessed-variable=PpToComDbgFD14Tx.FD14_AutoParkInitializedStatus_b
            SEND_PpToComDbgFD14Tx_FD14_AuxCamButton1NoSelect_b: accessed-variable=PpToComDbgFD14Tx.FD14_AuxCamButton1NoSelect_b
            SEND_PpToComDbgFD14Tx_FD14_AuxCamButton1Select_b: accessed-variable=PpToComDbgFD14Tx.FD14_AuxCamButton1Select_b
            SEND_PpToComDbgFD14Tx_FD14_AuxCamButton2NoSelect_b: accessed-variable=PpToComDbgFD14Tx.FD14_AuxCamButton2NoSelect_b
            SEND_PpToComDbgFD14Tx_FD14_AuxCamButton2Select_b: accessed-variable=PpToComDbgFD14Tx.FD14_AuxCamButton2Select_b
            SEND_PpToComDbgFD14Tx_FD14_BOL_Blockage: accessed-variable=PpToComDbgFD14Tx.FD14_BOL_Blockage
            SEND_PpToComDbgFD14Tx_FD14_BOL_CommUnknown: accessed-variable=PpToComDbgFD14Tx.FD14_BOL_CommUnknown
            SEND_PpToComDbgFD14Tx_FD14_BOL_MinDistance: accessed-variable=PpToComDbgFD14Tx.FD14_BOL_MinDistance
            SEND_PpToComDbgFD14Tx_FD14_BOL_comm_Fault: accessed-variable=PpToComDbgFD14Tx.FD14_BOL_comm_Fault
            SEND_PpToComDbgFD14Tx_FD14_BOL_hardware_Fault: accessed-variable=PpToComDbgFD14Tx.FD14_BOL_hardware_Fault
            SEND_PpToComDbgFD14Tx_FD14_BOL_overTemp_Fault: accessed-variable=PpToComDbgFD14Tx.FD14_BOL_overTemp_Fault
            SEND_PpToComDbgFD14Tx_FD14_BOR_Blockage: accessed-variable=PpToComDbgFD14Tx.FD14_BOR_Blockage
            SEND_PpToComDbgFD14Tx_FD14_BOR_CommUnknown: accessed-variable=PpToComDbgFD14Tx.FD14_BOR_CommUnknown
            SEND_PpToComDbgFD14Tx_FD14_BOR_MinDistance: accessed-variable=PpToComDbgFD14Tx.FD14_BOR_MinDistance
            SEND_PpToComDbgFD14Tx_FD14_BOR_comm_Fault: accessed-variable=PpToComDbgFD14Tx.FD14_BOR_comm_Fault
            SEND_PpToComDbgFD14Tx_FD14_BOR_hardware_Fault: accessed-variable=PpToComDbgFD14Tx.FD14_BOR_hardware_Fault
            SEND_PpToComDbgFD14Tx_FD14_BOR_overTemp_Fault: accessed-variable=PpToComDbgFD14Tx.FD14_BOR_overTemp_Fault
            SEND_PpToComDbgFD14Tx_FD14_BackCam_NA_b: accessed-variable=PpToComDbgFD14Tx.FD14_BackCam_NA_b
            SEND_PpToComDbgFD14Tx_FD14_BackDoorOpen_Icon_b: accessed-variable=PpToComDbgFD14Tx.FD14_BackDoorOpen_Icon_b
            SEND_PpToComDbgFD14Tx_FD14_BackupRearCamButtonNoSelect_b: accessed-variable=PpToComDbgFD14Tx.FD14_BackupRearCamButtonNoSelect_b
            SEND_PpToComDbgFD14Tx_FD14_BackupRearCamButtonSelect_b: accessed-variable=PpToComDbgFD14Tx.FD14_BackupRearCamButtonSelect_b
            SEND_PpToComDbgFD14Tx_FD14_BumberStatus_Front: accessed-variable=PpToComDbgFD14Tx.FD14_BumberStatus_Front
            SEND_PpToComDbgFD14Tx_FD14_BumberStatus_Left_Side: accessed-variable=PpToComDbgFD14Tx.FD14_BumberStatus_Left_Side
            SEND_PpToComDbgFD14Tx_FD14_BumberStatus_Rear: accessed-variable=PpToComDbgFD14Tx.FD14_BumberStatus_Rear
            SEND_PpToComDbgFD14Tx_FD14_BumberStatus_Right_Side: accessed-variable=PpToComDbgFD14Tx.FD14_BumberStatus_Right_Side
            SEND_PpToComDbgFD14Tx_FD14_CAM_NA_Bitfield_u8: accessed-variable=PpToComDbgFD14Tx.FD14_CAM_NA_Bitfield_u8
            SEND_PpToComDbgFD14Tx_FD14_CalibStatus_STM_Current_Front: accessed-variable=PpToComDbgFD14Tx.FD14_CalibStatus_STM_Current_Front
            SEND_PpToComDbgFD14Tx_FD14_CalibStatus_STM_Current_Left: accessed-variable=PpToComDbgFD14Tx.FD14_CalibStatus_STM_Current_Left
            SEND_PpToComDbgFD14Tx_FD14_CalibStatus_STM_Current_Rear: accessed-variable=PpToComDbgFD14Tx.FD14_CalibStatus_STM_Current_Rear
            SEND_PpToComDbgFD14Tx_FD14_CalibStatus_STM_Current_Right: accessed-variable=PpToComDbgFD14Tx.FD14_CalibStatus_STM_Current_Right
            SEND_PpToComDbgFD14Tx_FD14_CalibStatus_STM_EOL_Front: accessed-variable=PpToComDbgFD14Tx.FD14_CalibStatus_STM_EOL_Front
            SEND_PpToComDbgFD14Tx_FD14_CalibStatus_STM_EOL_Left: accessed-variable=PpToComDbgFD14Tx.FD14_CalibStatus_STM_EOL_Left
            SEND_PpToComDbgFD14Tx_FD14_CalibStatus_STM_EOL_Rear: accessed-variable=PpToComDbgFD14Tx.FD14_CalibStatus_STM_EOL_Rear
            SEND_PpToComDbgFD14Tx_FD14_CalibStatus_STM_EOL_Right: accessed-variable=PpToComDbgFD14Tx.FD14_CalibStatus_STM_EOL_Right
            SEND_PpToComDbgFD14Tx_FD14_CalibStatus_STM_OC_Front: accessed-variable=PpToComDbgFD14Tx.FD14_CalibStatus_STM_OC_Front
            SEND_PpToComDbgFD14Tx_FD14_CalibStatus_STM_OC_Left: accessed-variable=PpToComDbgFD14Tx.FD14_CalibStatus_STM_OC_Left
            SEND_PpToComDbgFD14Tx_FD14_CalibStatus_STM_OC_Rear: accessed-variable=PpToComDbgFD14Tx.FD14_CalibStatus_STM_OC_Rear
            SEND_PpToComDbgFD14Tx_FD14_CalibStatus_STM_OC_Right: accessed-variable=PpToComDbgFD14Tx.FD14_CalibStatus_STM_OC_Right
            SEND_PpToComDbgFD14Tx_FD14_CalibStatus_STM_SC_Front: accessed-variable=PpToComDbgFD14Tx.FD14_CalibStatus_STM_SC_Front
            SEND_PpToComDbgFD14Tx_FD14_CalibStatus_STM_SC_Left: accessed-variable=PpToComDbgFD14Tx.FD14_CalibStatus_STM_SC_Left
            SEND_PpToComDbgFD14Tx_FD14_CalibStatus_STM_SC_Rear: accessed-variable=PpToComDbgFD14Tx.FD14_CalibStatus_STM_SC_Rear
            SEND_PpToComDbgFD14Tx_FD14_CalibStatus_STM_SC_Right: accessed-variable=PpToComDbgFD14Tx.FD14_CalibStatus_STM_SC_Right
            SEND_PpToComDbgFD14Tx_FD14_CameraDisplaySts2_e: accessed-variable=PpToComDbgFD14Tx.FD14_CameraDisplaySts2_e
            SEND_PpToComDbgFD14Tx_FD14_Curr_DisplayedViewByAcore_e: accessed-variable=PpToComDbgFD14Tx.FD14_Curr_DisplayedViewByAcore_e
            SEND_PpToComDbgFD14Tx_FD14_Curr_RequestedViewByHmiM_e: accessed-variable=PpToComDbgFD14Tx.FD14_Curr_RequestedViewByHmiM_e
            SEND_PpToComDbgFD14Tx_FD14_Curr_SystemState_e: accessed-variable=PpToComDbgFD14Tx.FD14_Curr_SystemState_e
            SEND_PpToComDbgFD14Tx_FD14_Curr_TRG_Stat: accessed-variable=PpToComDbgFD14Tx.FD14_Curr_TRG_Stat
            SEND_PpToComDbgFD14Tx_FD14_CurrentTrailer_ID: accessed-variable=PpToComDbgFD14Tx.FD14_CurrentTrailer_ID
            SEND_PpToComDbgFD14Tx_FD14_Current_Firing_Sequence: accessed-variable=PpToComDbgFD14Tx.FD14_Current_Firing_Sequence
            SEND_PpToComDbgFD14Tx_FD14_Debug_Signal_{1..8}: accessed-variable=PpToComDbgFD14Tx.FD14_Debug_Signal_{1..8}
            SEND_PpToComDbgFD14Tx_FD14_DynOvl_Error_e: accessed-variable=PpToComDbgFD14Tx.FD14_DynOvl_Error_e
            SEND_PpToComDbgFD14Tx_FD14_EOL_ModuleState_STM_Front: accessed-variable=PpToComDbgFD14Tx.FD14_EOL_ModuleState_STM_Front
            SEND_PpToComDbgFD14Tx_FD14_EOL_ModuleState_STM_Left: accessed-variable=PpToComDbgFD14Tx.FD14_EOL_ModuleState_STM_Left
            SEND_PpToComDbgFD14Tx_FD14_EOL_ModuleState_STM_Rear: accessed-variable=PpToComDbgFD14Tx.FD14_EOL_ModuleState_STM_Rear
            SEND_PpToComDbgFD14Tx_FD14_EOL_ModuleState_STM_Right: accessed-variable=PpToComDbgFD14Tx.FD14_EOL_ModuleState_STM_Right
            SEND_PpToComDbgFD14Tx_FD14_Err_Code_EOL_Front: accessed-variable=PpToComDbgFD14Tx.FD14_Err_Code_EOL_Front
            SEND_PpToComDbgFD14Tx_FD14_Err_Code_EOL_Left: accessed-variable=PpToComDbgFD14Tx.FD14_Err_Code_EOL_Left
            SEND_PpToComDbgFD14Tx_FD14_Err_Code_EOL_Rear: accessed-variable=PpToComDbgFD14Tx.FD14_Err_Code_EOL_Rear
            SEND_PpToComDbgFD14Tx_FD14_Err_Code_EOL_Rear_Copy_1: accessed-variable=PpToComDbgFD14Tx.FD14_Err_Code_EOL_Rear_Copy_1
            SEND_PpToComDbgFD14Tx_FD14_Err_Code_OC_Front: accessed-variable=PpToComDbgFD14Tx.FD14_Err_Code_OC_Front
            SEND_PpToComDbgFD14Tx_FD14_Err_Code_OC_Left: accessed-variable=PpToComDbgFD14Tx.FD14_Err_Code_OC_Left
            SEND_PpToComDbgFD14Tx_FD14_Err_Code_OC_Rear: accessed-variable=PpToComDbgFD14Tx.FD14_Err_Code_OC_Rear
            SEND_PpToComDbgFD14Tx_FD14_Err_Code_OC_Right: accessed-variable=PpToComDbgFD14Tx.FD14_Err_Code_OC_Right
            SEND_PpToComDbgFD14Tx_FD14_Err_Code_SC_Front: accessed-variable=PpToComDbgFD14Tx.FD14_Err_Code_SC_Front
            SEND_PpToComDbgFD14Tx_FD14_Err_Code_SC_Left: accessed-variable=PpToComDbgFD14Tx.FD14_Err_Code_SC_Left
            SEND_PpToComDbgFD14Tx_FD14_Err_Code_SC_Rear: accessed-variable=PpToComDbgFD14Tx.FD14_Err_Code_SC_Rear
            SEND_PpToComDbgFD14Tx_FD14_Err_Code_SC_Right: accessed-variable=PpToComDbgFD14Tx.FD14_Err_Code_SC_Right
            SEND_PpToComDbgFD14Tx_FD14_FFCV_BTN_PRESSED_b: accessed-variable=PpToComDbgFD14Tx.FD14_FFCV_BTN_PRESSED_b
            SEND_PpToComDbgFD14Tx_FD14_FIL_Blockage: accessed-variable=PpToComDbgFD14Tx.FD14_FIL_Blockage
            SEND_PpToComDbgFD14Tx_FD14_FIL_CommUnknown: accessed-variable=PpToComDbgFD14Tx.FD14_FIL_CommUnknown
            SEND_PpToComDbgFD14Tx_FD14_FIL_MinDistance: accessed-variable=PpToComDbgFD14Tx.FD14_FIL_MinDistance
            SEND_PpToComDbgFD14Tx_FD14_FIL_comm_Fault: accessed-variable=PpToComDbgFD14Tx.FD14_FIL_comm_Fault
            SEND_PpToComDbgFD14Tx_FD14_FIL_hardware_Fault: accessed-variable=PpToComDbgFD14Tx.FD14_FIL_hardware_Fault
            SEND_PpToComDbgFD14Tx_FD14_FIL_overTemp_Fault: accessed-variable=PpToComDbgFD14Tx.FD14_FIL_overTemp_Fault
            SEND_PpToComDbgFD14Tx_FD14_FIR_Blockage: accessed-variable=PpToComDbgFD14Tx.FD14_FIR_Blockage
            SEND_PpToComDbgFD14Tx_FD14_FIR_CommUnknown: accessed-variable=PpToComDbgFD14Tx.FD14_FIR_CommUnknown
            SEND_PpToComDbgFD14Tx_FD14_FIR_MinDistance: accessed-variable=PpToComDbgFD14Tx.FD14_FIR_MinDistance
            SEND_PpToComDbgFD14Tx_FD14_FIR_comm_Fault: accessed-variable=PpToComDbgFD14Tx.FD14_FIR_comm_Fault
            SEND_PpToComDbgFD14Tx_FD14_FIR_hardware_Fault: accessed-variable=PpToComDbgFD14Tx.FD14_FIR_hardware_Fault
            SEND_PpToComDbgFD14Tx_FD14_FIR_overTemp_Fault: accessed-variable=PpToComDbgFD14Tx.FD14_FIR_overTemp_Fault
            SEND_PpToComDbgFD14Tx_FD14_FOL_Blockage: accessed-variable=PpToComDbgFD14Tx.FD14_FOL_Blockage
            SEND_PpToComDbgFD14Tx_FD14_FOL_CommUnknown: accessed-variable=PpToComDbgFD14Tx.FD14_FOL_CommUnknown
            SEND_PpToComDbgFD14Tx_FD14_FOL_MinDistance: accessed-variable=PpToComDbgFD14Tx.FD14_FOL_MinDistance
            SEND_PpToComDbgFD14Tx_FD14_FOL_comm_Fault: accessed-variable=PpToComDbgFD14Tx.FD14_FOL_comm_Fault
            SEND_PpToComDbgFD14Tx_FD14_FOL_hardware_Fault: accessed-variable=PpToComDbgFD14Tx.FD14_FOL_hardware_Fault
            SEND_PpToComDbgFD14Tx_FD14_FOL_overTemp_Fault: accessed-variable=PpToComDbgFD14Tx.FD14_FOL_overTemp_Fault
            SEND_PpToComDbgFD14Tx_FD14_FOR_Blockage: accessed-variable=PpToComDbgFD14Tx.FD14_FOR_Blockage
            SEND_PpToComDbgFD14Tx_FD14_FOR_CommUnknown: accessed-variable=PpToComDbgFD14Tx.FD14_FOR_CommUnknown
            SEND_PpToComDbgFD14Tx_FD14_FOR_MinDistance: accessed-variable=PpToComDbgFD14Tx.FD14_FOR_MinDistance
            SEND_PpToComDbgFD14Tx_FD14_FOR_comm_Fault: accessed-variable=PpToComDbgFD14Tx.FD14_FOR_comm_Fault
            SEND_PpToComDbgFD14Tx_FD14_FOR_hardware_Fault: accessed-variable=PpToComDbgFD14Tx.FD14_FOR_hardware_Fault
            SEND_PpToComDbgFD14Tx_FD14_FOR_overTemp_Fault: accessed-variable=PpToComDbgFD14Tx.FD14_FOR_overTemp_Fault
            SEND_PpToComDbgFD14Tx_FD14_FRONT_CROSS_BTN_PRESSED_b: accessed-variable=PpToComDbgFD14Tx.FD14_FRONT_CROSS_BTN_PRESSED_b
            SEND_PpToComDbgFD14Tx_FD14_FRONT_TOP_BTN_PRESSED_b: accessed-variable=PpToComDbgFD14Tx.FD14_FRONT_TOP_BTN_PRESSED_b
            SEND_PpToComDbgFD14Tx_FD14_FSL_Blockage: accessed-variable=PpToComDbgFD14Tx.FD14_FSL_Blockage
            SEND_PpToComDbgFD14Tx_FD14_FSL_CommUnknown: accessed-variable=PpToComDbgFD14Tx.FD14_FSL_CommUnknown
            SEND_PpToComDbgFD14Tx_FD14_FSL_MinDistance: accessed-variable=PpToComDbgFD14Tx.FD14_FSL_MinDistance
            SEND_PpToComDbgFD14Tx_FD14_FSL_comm_Fault: accessed-variable=PpToComDbgFD14Tx.FD14_FSL_comm_Fault
            SEND_PpToComDbgFD14Tx_FD14_FSL_hardware_Fault: accessed-variable=PpToComDbgFD14Tx.FD14_FSL_hardware_Fault
            SEND_PpToComDbgFD14Tx_FD14_FSL_overTemp_Fault: accessed-variable=PpToComDbgFD14Tx.FD14_FSL_overTemp_Fault
            SEND_PpToComDbgFD14Tx_FD14_FSR_Blockage: accessed-variable=PpToComDbgFD14Tx.FD14_FSR_Blockage
            SEND_PpToComDbgFD14Tx_FD14_FSR_CommUnknown: accessed-variable=PpToComDbgFD14Tx.FD14_FSR_CommUnknown
            SEND_PpToComDbgFD14Tx_FD14_FSR_MinDistance: accessed-variable=PpToComDbgFD14Tx.FD14_FSR_MinDistance
            SEND_PpToComDbgFD14Tx_FD14_FSR_comm_Fault: accessed-variable=PpToComDbgFD14Tx.FD14_FSR_comm_Fault
            SEND_PpToComDbgFD14Tx_FD14_FSR_hardware_Fault: accessed-variable=PpToComDbgFD14Tx.FD14_FSR_hardware_Fault
            SEND_PpToComDbgFD14Tx_FD14_FSR_overTemp_Fault: accessed-variable=PpToComDbgFD14Tx.FD14_FSR_overTemp_Fault
            SEND_PpToComDbgFD14Tx_FD14_FiringMode_TimeStamp: accessed-variable=PpToComDbgFD14Tx.FD14_FiringMode_TimeStamp
            SEND_PpToComDbgFD14Tx_FD14_FiringSnr_TimeStamp: accessed-variable=PpToComDbgFD14Tx.FD14_FiringSnr_TimeStamp
            SEND_PpToComDbgFD14Tx_FD14_Firing_Mode_Seq: accessed-variable=PpToComDbgFD14Tx.FD14_Firing_Mode_Seq
            SEND_PpToComDbgFD14Tx_FD14_Firing_Sensor: accessed-variable=PpToComDbgFD14Tx.FD14_Firing_Sensor
            SEND_PpToComDbgFD14Tx_FD14_Firing_Sensor_Info_F: accessed-variable=PpToComDbgFD14Tx.FD14_Firing_Sensor_Info_F
            SEND_PpToComDbgFD14Tx_FD14_Firing_Sensor_Info_R: accessed-variable=PpToComDbgFD14Tx.FD14_Firing_Sensor_Info_R
            SEND_PpToComDbgFD14Tx_FD14_Frame_Index_Lanes__1: accessed-variable=PpToComDbgFD14Tx.FD14_Frame_Index_Lanes__1
            SEND_PpToComDbgFD14Tx_FD14_Frameset1AndTopFrontText_b: accessed-variable=PpToComDbgFD14Tx.FD14_Frameset1AndTopFrontText_b
            SEND_PpToComDbgFD14Tx_FD14_Frameset1AndTopRearText_b: accessed-variable=PpToComDbgFD14Tx.FD14_Frameset1AndTopRearText_b
            SEND_PpToComDbgFD14Tx_FD14_Frameset2AndFrontCrossText_b: accessed-variable=PpToComDbgFD14Tx.FD14_Frameset2AndFrontCrossText_b
            SEND_PpToComDbgFD14Tx_FD14_Frameset2AndRearCrossText_b: accessed-variable=PpToComDbgFD14Tx.FD14_Frameset2AndRearCrossText_b
            SEND_PpToComDbgFD14Tx_FD14_FrontCam_NA_b: accessed-variable=PpToComDbgFD14Tx.FD14_FrontCam_NA_b
            SEND_PpToComDbgFD14Tx_FD14_FrontCrossButtonNoSelect_b: accessed-variable=PpToComDbgFD14Tx.FD14_FrontCrossButtonNoSelect_b
            SEND_PpToComDbgFD14Tx_FD14_FrontCrossButtonSelect_b: accessed-variable=PpToComDbgFD14Tx.FD14_FrontCrossButtonSelect_b
            SEND_PpToComDbgFD14Tx_FD14_FrontFaceCamButtonNoSelect_b: accessed-variable=PpToComDbgFD14Tx.FD14_FrontFaceCamButtonNoSelect_b
            SEND_PpToComDbgFD14Tx_FD14_FrontFaceCamButtonSelect_b: accessed-variable=PpToComDbgFD14Tx.FD14_FrontFaceCamButtonSelect_b
            SEND_PpToComDbgFD14Tx_FD14_FrontSensorDetHealth_e: accessed-variable=PpToComDbgFD14Tx.FD14_FrontSensorDetHealth_e
            SEND_PpToComDbgFD14Tx_FD14_FrontTireTracks_b: accessed-variable=PpToComDbgFD14Tx.FD14_FrontTireTracks_b
            SEND_PpToComDbgFD14Tx_FD14_FrontViewDynamics_b: accessed-variable=PpToComDbgFD14Tx.FD14_FrontViewDynamics_b
            SEND_PpToComDbgFD14Tx_FD14_GW_C_I6_timeout_b: accessed-variable=PpToComDbgFD14Tx.FD14_GW_C_I6_timeout_b
            SEND_PpToComDbgFD14Tx_FD14_IeAP_b_MnvPosOk: accessed-variable=PpToComDbgFD14Tx.FD14_IeAP_b_MnvPosOk
            SEND_PpToComDbgFD14Tx_FD14_IeAP_cm_FrntCenterMinXDist: accessed-variable=PpToComDbgFD14Tx.FD14_IeAP_cm_FrntCenterMinXDist
            SEND_PpToComDbgFD14Tx_FD14_IeAP_cm_FrntCenterMinXDist_KPI: accessed-variable=PpToComDbgFD14Tx.FD14_IeAP_cm_FrntCenterMinXDist_KPI
            SEND_PpToComDbgFD14Tx_FD14_IeAP_cm_FrntLeftMinXDist: accessed-variable=PpToComDbgFD14Tx.FD14_IeAP_cm_FrntLeftMinXDist
            SEND_PpToComDbgFD14Tx_FD14_IeAP_cm_FrntLeftMinXDist_KPI: accessed-variable=PpToComDbgFD14Tx.FD14_IeAP_cm_FrntLeftMinXDist_KPI
            SEND_PpToComDbgFD14Tx_FD14_IeAP_cm_FrntRightMinXDist: accessed-variable=PpToComDbgFD14Tx.FD14_IeAP_cm_FrntRightMinXDist
            SEND_PpToComDbgFD14Tx_FD14_IeAP_cm_FrntRightMinXDist_KPI: accessed-variable=PpToComDbgFD14Tx.FD14_IeAP_cm_FrntRightMinXDist_KPI
            SEND_PpToComDbgFD14Tx_FD14_IeAP_cm_RearCenterMinXDist: accessed-variable=PpToComDbgFD14Tx.FD14_IeAP_cm_RearCenterMinXDist
            SEND_PpToComDbgFD14Tx_FD14_IeAP_cm_RearCenterMinXDist_KPI: accessed-variable=PpToComDbgFD14Tx.FD14_IeAP_cm_RearCenterMinXDist_KPI
            SEND_PpToComDbgFD14Tx_FD14_IeAP_cm_RearLeftMinXDist: accessed-variable=PpToComDbgFD14Tx.FD14_IeAP_cm_RearLeftMinXDist
            SEND_PpToComDbgFD14Tx_FD14_IeAP_cm_RearLeftMinXDist_KPI: accessed-variable=PpToComDbgFD14Tx.FD14_IeAP_cm_RearLeftMinXDist_KPI
            SEND_PpToComDbgFD14Tx_FD14_IeAP_cm_RearRightMinXDist: accessed-variable=PpToComDbgFD14Tx.FD14_IeAP_cm_RearRightMinXDist
            SEND_PpToComDbgFD14Tx_FD14_IeAP_cm_RearRightMinXDist_KPI: accessed-variable=PpToComDbgFD14Tx.FD14_IeAP_cm_RearRightMinXDist_KPI
            SEND_PpToComDbgFD14Tx_FD14_IeAP_cnt_CurrentVehSweep: accessed-variable=PpToComDbgFD14Tx.FD14_IeAP_cnt_CurrentVehSweep
            SEND_PpToComDbgFD14Tx_FD14_IeAP_e_AbortCon: accessed-variable=PpToComDbgFD14Tx.FD14_IeAP_e_AbortCon
            SEND_PpToComDbgFD14Tx_FD14_IeAP_e_AutoParkStatus: accessed-variable=PpToComDbgFD14Tx.FD14_IeAP_e_AutoParkStatus
            SEND_PpToComDbgFD14Tx_FD14_IeAutoPark_e_AlgoState: accessed-variable=PpToComDbgFD14Tx.FD14_IeAutoPark_e_AlgoState
            SEND_PpToComDbgFD14Tx_FD14_IeLMD_e_CameraStatus: accessed-variable=PpToComDbgFD14Tx.FD14_IeLMD_e_CameraStatus
            SEND_PpToComDbgFD14Tx_FD14_IeTHA_b_ChimeActvLhf: accessed-variable=PpToComDbgFD14Tx.FD14_IeTHA_b_ChimeActvLhf
            SEND_PpToComDbgFD14Tx_FD14_IeTHA_b_ChimeActvRhf: accessed-variable=PpToComDbgFD14Tx.FD14_IeTHA_b_ChimeActvRhf
            SEND_PpToComDbgFD14Tx_FD14_IeTHA_e_PamChimeTyp: accessed-variable=PpToComDbgFD14Tx.FD14_IeTHA_e_PamChimeTyp
            SEND_PpToComDbgFD14Tx_FD14_IeTHA_e_PamVol: accessed-variable=PpToComDbgFD14Tx.FD14_IeTHA_e_PamVol
            SEND_PpToComDbgFD14Tx_FD14_IeTRSC_M_TRSCStrTrq: accessed-variable=PpToComDbgFD14Tx.FD14_IeTRSC_M_TRSCStrTrq
            SEND_PpToComDbgFD14Tx_FD14_IeTRSC_cnt_KnobPos: accessed-variable=PpToComDbgFD14Tx.FD14_IeTRSC_cnt_KnobPos
            SEND_PpToComDbgFD14Tx_FD14_IeTRSC_cnt_TrlrCalibFailCnt: accessed-variable=PpToComDbgFD14Tx.FD14_IeTRSC_cnt_TrlrCalibFailCnt
            SEND_PpToComDbgFD14Tx_FD14_IeTRSC_cnt_TrlrCalibFailCntCurr: accessed-variable=PpToComDbgFD14Tx.FD14_IeTRSC_cnt_TrlrCalibFailCntCurr
            SEND_PpToComDbgFD14Tx_FD14_IeTRSC_cnt_TrlrCalibPassCnt: accessed-variable=PpToComDbgFD14Tx.FD14_IeTRSC_cnt_TrlrCalibPassCnt
            SEND_PpToComDbgFD14Tx_FD14_IeTRSC_cnt_TrlrCalibPassCntCurr: accessed-variable=PpToComDbgFD14Tx.FD14_IeTRSC_cnt_TrlrCalibPassCntCurr
            SEND_PpToComDbgFD14Tx_FD14_IeTRSC_deg_FrntWhlAng: accessed-variable=PpToComDbgFD14Tx.FD14_IeTRSC_deg_FrntWhlAng
            SEND_PpToComDbgFD14Tx_FD14_IeTRSC_deg_JackknifeThrAngle: accessed-variable=PpToComDbgFD14Tx.FD14_IeTRSC_deg_JackknifeThrAngle
            SEND_PpToComDbgFD14Tx_FD14_IeTRSC_deg_TADAngle: accessed-variable=PpToComDbgFD14Tx.FD14_IeTRSC_deg_TADAngle
            SEND_PpToComDbgFD14Tx_FD14_IeTRSC_deg_TrlrAngKnob: accessed-variable=PpToComDbgFD14Tx.FD14_IeTRSC_deg_TrlrAngKnob
            SEND_PpToComDbgFD14Tx_FD14_IeTRSC_e_CamBlockSts: accessed-variable=PpToComDbgFD14Tx.FD14_IeTRSC_e_CamBlockSts
            SEND_PpToComDbgFD14Tx_FD14_IeTRSC_e_GearShiftSts: accessed-variable=PpToComDbgFD14Tx.FD14_IeTRSC_e_GearShiftSts
            SEND_PpToComDbgFD14Tx_FD14_IeTRSC_e_TRSCAbortReas: accessed-variable=PpToComDbgFD14Tx.FD14_IeTRSC_e_TRSCAbortReas
            SEND_PpToComDbgFD14Tx_FD14_IeTRSC_e_TRSCUnavailReas: accessed-variable=PpToComDbgFD14Tx.FD14_IeTRSC_e_TRSCUnavailReas
            SEND_PpToComDbgFD14Tx_FD14_IeTRSC_e_TRSKMBtnSts: accessed-variable=PpToComDbgFD14Tx.FD14_IeTRSC_e_TRSKMBtnSts
            SEND_PpToComDbgFD14Tx_FD14_IeTRSC_e_TRSKMCenBtnSts: accessed-variable=PpToComDbgFD14Tx.FD14_IeTRSC_e_TRSKMCenBtnSts
            SEND_PpToComDbgFD14Tx_FD14_IeTRSC_e_TRSKMSts: accessed-variable=PpToComDbgFD14Tx.FD14_IeTRSC_e_TRSKMSts
            SEND_PpToComDbgFD14Tx_FD14_IeTRSC_e_TrailerID: accessed-variable=PpToComDbgFD14Tx.FD14_IeTRSC_e_TrailerID
            SEND_PpToComDbgFD14Tx_FD14_IeTRSC_e_TrlrAngGrapOverSts: accessed-variable=PpToComDbgFD14Tx.FD14_IeTRSC_e_TrlrAngGrapOverSts
            SEND_PpToComDbgFD14Tx_FD14_IeTRSC_e_TrlrCalibFailReas: accessed-variable=PpToComDbgFD14Tx.FD14_IeTRSC_e_TrlrCalibFailReas
            SEND_PpToComDbgFD14Tx_FD14_IeTRSC_e_TrlrCalibManState: accessed-variable=PpToComDbgFD14Tx.FD14_IeTRSC_e_TrlrCalibManState
            SEND_PpToComDbgFD14Tx_FD14_IeTRSC_e_TrlrCalibSts: accessed-variable=PpToComDbgFD14Tx.FD14_IeTRSC_e_TrlrCalibSts
            SEND_PpToComDbgFD14Tx_FD14_IeTRSC_e_TrlrPrsntFailReas: accessed-variable=PpToComDbgFD14Tx.FD14_IeTRSC_e_TrlrPrsntFailReas
            SEND_PpToComDbgFD14Tx_FD14_IeTRSC_e_TrlrPrsntSts: accessed-variable=PpToComDbgFD14Tx.FD14_IeTRSC_e_TrlrPrsntSts
            SEND_PpToComDbgFD14Tx_FD14_IeTRSC_e_TrlrRecogInfo: accessed-variable=PpToComDbgFD14Tx.FD14_IeTRSC_e_TrlrRecogInfo
            SEND_PpToComDbgFD14Tx_FD14_IeTRSC_kph_VehSpeedVSOSig: accessed-variable=PpToComDbgFD14Tx.FD14_IeTRSC_kph_VehSpeedVSOSig
            SEND_PpToComDbgFD14Tx_FD14_IeTRSC_m_TrlrWhlBaseEff: accessed-variable=PpToComDbgFD14Tx.FD14_IeTRSC_m_TrlrWhlBaseEff
            SEND_PpToComDbgFD14Tx_FD14_IeTRSC_pct_TrlrDetConf: accessed-variable=PpToComDbgFD14Tx.FD14_IeTRSC_pct_TrlrDetConf
            SEND_PpToComDbgFD14Tx_FD14_IeTRSC_pct_TrlrRecogConf: accessed-variable=PpToComDbgFD14Tx.FD14_IeTRSC_pct_TrlrRecogConf
            SEND_PpToComDbgFD14Tx_FD14_IeTRSC_pct_TrlrTrackConf: accessed-variable=PpToComDbgFD14Tx.FD14_IeTRSC_pct_TrlrTrackConf
            SEND_PpToComDbgFD14Tx_FD14_IeVBII_nfcd_MinDisToCollisionObj: accessed-variable=PpToComDbgFD14Tx.FD14_IeVBII_nfcd_MinDisToCollisionObj
            SEND_PpToComDbgFD14Tx_FD14_IgnoreVehicleOffSpeed: accessed-variable=PpToComDbgFD14Tx.FD14_IgnoreVehicleOffSpeed
            SEND_PpToComDbgFD14Tx_FD14_IgnoredFeatures_Front_u32: accessed-variable=PpToComDbgFD14Tx.FD14_IgnoredFeatures_Front_u32
            SEND_PpToComDbgFD14Tx_FD14_IgnoredFeatures_Left_u32: accessed-variable=PpToComDbgFD14Tx.FD14_IgnoredFeatures_Left_u32
            SEND_PpToComDbgFD14Tx_FD14_IgnoredFeatures_Rear_u32: accessed-variable=PpToComDbgFD14Tx.FD14_IgnoredFeatures_Rear_u32
            SEND_PpToComDbgFD14Tx_FD14_IgnoredFeatures_Right_u32: accessed-variable=PpToComDbgFD14Tx.FD14_IgnoredFeatures_Right_u32
            SEND_PpToComDbgFD14Tx_FD14_ImageDefeat_Error_e: accessed-variable=PpToComDbgFD14Tx.FD14_ImageDefeat_Error_e
            SEND_PpToComDbgFD14Tx_FD14_InvalidFeatures_Front_u32: accessed-variable=PpToComDbgFD14Tx.FD14_InvalidFeatures_Front_u32
            SEND_PpToComDbgFD14Tx_FD14_InvalidFeatures_Left_u32: accessed-variable=PpToComDbgFD14Tx.FD14_InvalidFeatures_Left_u32
            SEND_PpToComDbgFD14Tx_FD14_InvalidFeatures_Rear_u32: accessed-variable=PpToComDbgFD14Tx.FD14_InvalidFeatures_Rear_u32
            SEND_PpToComDbgFD14Tx_FD14_InvalidFeatures_Right_u32: accessed-variable=PpToComDbgFD14Tx.FD14_InvalidFeatures_Right_u32
            SEND_PpToComDbgFD14Tx_FD14_IsBackSftbtnSel: accessed-variable=PpToComDbgFD14Tx.FD14_IsBackSftbtnSel
            SEND_PpToComDbgFD14Tx_FD14_IsExitSftBtnSel: accessed-variable=PpToComDbgFD14Tx.FD14_IsExitSftBtnSel
            SEND_PpToComDbgFD14Tx_FD14_IsParkSftBtnSel: accessed-variable=PpToComDbgFD14Tx.FD14_IsParkSftBtnSel
            SEND_PpToComDbgFD14Tx_FD14_IsSlotSel: accessed-variable=PpToComDbgFD14Tx.FD14_IsSlotSel
            SEND_PpToComDbgFD14Tx_FD14_ItbmTrailerStatus: accessed-variable=PpToComDbgFD14Tx.FD14_ItbmTrailerStatus
            SEND_PpToComDbgFD14Tx_FD14_JackknifeAngle: accessed-variable=PpToComDbgFD14Tx.FD14_JackknifeAngle
            SEND_PpToComDbgFD14Tx_FD14_JackknifeThrAngle: accessed-variable=PpToComDbgFD14Tx.FD14_JackknifeThrAngle
            SEND_PpToComDbgFD14Tx_FD14_KnobAngle: accessed-variable=PpToComDbgFD14Tx.FD14_KnobAngle
            SEND_PpToComDbgFD14Tx_FD14_LMD_e_Line_{1..4}_Type: accessed-variable=PpToComDbgFD14Tx.FD14_LMD_e_Line_{1..4}_Type
            SEND_PpToComDbgFD14Tx_FD14_LMD_e_Segment_{1..8}_ID: accessed-variable=PpToComDbgFD14Tx.FD14_LMD_e_Segment_{1..8}_ID
            SEND_PpToComDbgFD14Tx_FD14_LMD_m_Line_1_End_Range: accessed-variable=PpToComDbgFD14Tx.FD14_LMD_m_Line_1_End_Range
            SEND_PpToComDbgFD14Tx_FD14_LMD_m_Line_1_Offset: accessed-variable=PpToComDbgFD14Tx.FD14_LMD_m_Line_1_Offset
            SEND_PpToComDbgFD14Tx_FD14_LMD_m_Line_1_Start_Range: accessed-variable=PpToComDbgFD14Tx.FD14_LMD_m_Line_1_Start_Range
            SEND_PpToComDbgFD14Tx_FD14_LMD_m_Line_2_End_Range: accessed-variable=PpToComDbgFD14Tx.FD14_LMD_m_Line_2_End_Range
            SEND_PpToComDbgFD14Tx_FD14_LMD_m_Line_2_Offset: accessed-variable=PpToComDbgFD14Tx.FD14_LMD_m_Line_2_Offset
            SEND_PpToComDbgFD14Tx_FD14_LMD_m_Line_2_Start_Range: accessed-variable=PpToComDbgFD14Tx.FD14_LMD_m_Line_2_Start_Range
            SEND_PpToComDbgFD14Tx_FD14_LMD_m_Line_3_End_Range: accessed-variable=PpToComDbgFD14Tx.FD14_LMD_m_Line_3_End_Range
            SEND_PpToComDbgFD14Tx_FD14_LMD_m_Line_3_Offset: accessed-variable=PpToComDbgFD14Tx.FD14_LMD_m_Line_3_Offset
            SEND_PpToComDbgFD14Tx_FD14_LMD_m_Line_3_Start_Range: accessed-variable=PpToComDbgFD14Tx.FD14_LMD_m_Line_3_Start_Range
            SEND_PpToComDbgFD14Tx_FD14_LMD_m_Line_4_End_Range: accessed-variable=PpToComDbgFD14Tx.FD14_LMD_m_Line_4_End_Range
            SEND_PpToComDbgFD14Tx_FD14_LMD_m_Line_4_Offset: accessed-variable=PpToComDbgFD14Tx.FD14_LMD_m_Line_4_Offset
            SEND_PpToComDbgFD14Tx_FD14_LMD_m_Line_4_Start_Range: accessed-variable=PpToComDbgFD14Tx.FD14_LMD_m_Line_4_Start_Range
            SEND_PpToComDbgFD14Tx_FD14_LMD_m_Segment_1_X1: accessed-variable=PpToComDbgFD14Tx.FD14_LMD_m_Segment_1_X1
            SEND_PpToComDbgFD14Tx_FD14_LMD_m_Segment_1_X2: accessed-variable=PpToComDbgFD14Tx.FD14_LMD_m_Segment_1_X2
            SEND_PpToComDbgFD14Tx_FD14_LMD_m_Segment_1_Y1: accessed-variable=PpToComDbgFD14Tx.FD14_LMD_m_Segment_1_Y1
            SEND_PpToComDbgFD14Tx_FD14_LMD_m_Segment_1_Y2: accessed-variable=PpToComDbgFD14Tx.FD14_LMD_m_Segment_1_Y2
            SEND_PpToComDbgFD14Tx_FD14_LMD_m_Segment_2_X1: accessed-variable=PpToComDbgFD14Tx.FD14_LMD_m_Segment_2_X1
            SEND_PpToComDbgFD14Tx_FD14_LMD_m_Segment_2_X2: accessed-variable=PpToComDbgFD14Tx.FD14_LMD_m_Segment_2_X2
            SEND_PpToComDbgFD14Tx_FD14_LMD_m_Segment_2_Y1: accessed-variable=PpToComDbgFD14Tx.FD14_LMD_m_Segment_2_Y1
            SEND_PpToComDbgFD14Tx_FD14_LMD_m_Segment_2_Y2: accessed-variable=PpToComDbgFD14Tx.FD14_LMD_m_Segment_2_Y2
            SEND_PpToComDbgFD14Tx_FD14_LMD_m_Segment_3_X1: accessed-variable=PpToComDbgFD14Tx.FD14_LMD_m_Segment_3_X1
            SEND_PpToComDbgFD14Tx_FD14_LMD_m_Segment_3_X2: accessed-variable=PpToComDbgFD14Tx.FD14_LMD_m_Segment_3_X2
            SEND_PpToComDbgFD14Tx_FD14_LMD_m_Segment_3_Y1: accessed-variable=PpToComDbgFD14Tx.FD14_LMD_m_Segment_3_Y1
            SEND_PpToComDbgFD14Tx_FD14_LMD_m_Segment_3_Y2: accessed-variable=PpToComDbgFD14Tx.FD14_LMD_m_Segment_3_Y2
            SEND_PpToComDbgFD14Tx_FD14_LMD_m_Segment_4_X1: accessed-variable=PpToComDbgFD14Tx.FD14_LMD_m_Segment_4_X1
            SEND_PpToComDbgFD14Tx_FD14_LMD_m_Segment_4_X2: accessed-variable=PpToComDbgFD14Tx.FD14_LMD_m_Segment_4_X2
            SEND_PpToComDbgFD14Tx_FD14_LMD_m_Segment_4_Y1: accessed-variable=PpToComDbgFD14Tx.FD14_LMD_m_Segment_4_Y1
            SEND_PpToComDbgFD14Tx_FD14_LMD_m_Segment_4_Y2: accessed-variable=PpToComDbgFD14Tx.FD14_LMD_m_Segment_4_Y2
            SEND_PpToComDbgFD14Tx_FD14_LMD_m_Segment_5_X1: accessed-variable=PpToComDbgFD14Tx.FD14_LMD_m_Segment_5_X1
            SEND_PpToComDbgFD14Tx_FD14_LMD_m_Segment_5_X2: accessed-variable=PpToComDbgFD14Tx.FD14_LMD_m_Segment_5_X2
            SEND_PpToComDbgFD14Tx_FD14_LMD_m_Segment_5_Y1: accessed-variable=PpToComDbgFD14Tx.FD14_LMD_m_Segment_5_Y1
            SEND_PpToComDbgFD14Tx_FD14_LMD_m_Segment_5_Y2: accessed-variable=PpToComDbgFD14Tx.FD14_LMD_m_Segment_5_Y2
            SEND_PpToComDbgFD14Tx_FD14_LMD_m_Segment_6_X1: accessed-variable=PpToComDbgFD14Tx.FD14_LMD_m_Segment_6_X1
            SEND_PpToComDbgFD14Tx_FD14_LMD_m_Segment_6_X2: accessed-variable=PpToComDbgFD14Tx.FD14_LMD_m_Segment_6_X2
            SEND_PpToComDbgFD14Tx_FD14_LMD_m_Segment_6_Y1: accessed-variable=PpToComDbgFD14Tx.FD14_LMD_m_Segment_6_Y1
            SEND_PpToComDbgFD14Tx_FD14_LMD_m_Segment_6_Y2: accessed-variable=PpToComDbgFD14Tx.FD14_LMD_m_Segment_6_Y2
            SEND_PpToComDbgFD14Tx_FD14_LMD_m_Segment_7_X1: accessed-variable=PpToComDbgFD14Tx.FD14_LMD_m_Segment_7_X1
            SEND_PpToComDbgFD14Tx_FD14_LMD_m_Segment_7_X2: accessed-variable=PpToComDbgFD14Tx.FD14_LMD_m_Segment_7_X2
            SEND_PpToComDbgFD14Tx_FD14_LMD_m_Segment_7_Y1: accessed-variable=PpToComDbgFD14Tx.FD14_LMD_m_Segment_7_Y1
            SEND_PpToComDbgFD14Tx_FD14_LMD_m_Segment_7_Y2: accessed-variable=PpToComDbgFD14Tx.FD14_LMD_m_Segment_7_Y2
            SEND_PpToComDbgFD14Tx_FD14_LMD_m_Segment_8_X1: accessed-variable=PpToComDbgFD14Tx.FD14_LMD_m_Segment_8_X1
            SEND_PpToComDbgFD14Tx_FD14_LMD_m_Segment_8_X2: accessed-variable=PpToComDbgFD14Tx.FD14_LMD_m_Segment_8_X2
            SEND_PpToComDbgFD14Tx_FD14_LMD_m_Segment_8_Y1: accessed-variable=PpToComDbgFD14Tx.FD14_LMD_m_Segment_8_Y1
            SEND_PpToComDbgFD14Tx_FD14_LMD_m_Segment_8_Y2: accessed-variable=PpToComDbgFD14Tx.FD14_LMD_m_Segment_8_Y2
            SEND_PpToComDbgFD14Tx_FD14_LMD_pct_Line_{1..4}_Confidence: accessed-variable=PpToComDbgFD14Tx.FD14_LMD_pct_Line_{1..4}_Confidence
            SEND_PpToComDbgFD14Tx_FD14_LMD_pct_Segment_{1..8}_Confidence: accessed-variable=PpToComDbgFD14Tx.FD14_LMD_pct_Segment_{1..8}_Confidence
            SEND_PpToComDbgFD14Tx_FD14_LMD_px_Line_{1..4}_Curvature: accessed-variable=PpToComDbgFD14Tx.FD14_LMD_px_Line_{1..4}_Curvature
            SEND_PpToComDbgFD14Tx_FD14_LMD_rad_Line_{1..4}_Heading: accessed-variable=PpToComDbgFD14Tx.FD14_LMD_rad_Line_{1..4}_Heading
            SEND_PpToComDbgFD14Tx_FD14_LanguageSelection_u8: accessed-variable=PpToComDbgFD14Tx.FD14_LanguageSelection_u8
            SEND_PpToComDbgFD14Tx_FD14_LastViewBeforeTestPattern_e: accessed-variable=PpToComDbgFD14Tx.FD14_LastViewBeforeTestPattern_e
            SEND_PpToComDbgFD14Tx_FD14_LeftCam_NA_b: accessed-variable=PpToComDbgFD14Tx.FD14_LeftCam_NA_b
            SEND_PpToComDbgFD14Tx_FD14_LeftDoorFrontClose_Icon_b: accessed-variable=PpToComDbgFD14Tx.FD14_LeftDoorFrontClose_Icon_b
            SEND_PpToComDbgFD14Tx_FD14_LeftDoorFrontOpen_Icon_b: accessed-variable=PpToComDbgFD14Tx.FD14_LeftDoorFrontOpen_Icon_b
            SEND_PpToComDbgFD14Tx_FD14_LeftDoorRearClose_Icon_b: accessed-variable=PpToComDbgFD14Tx.FD14_LeftDoorRearClose_Icon_b
            SEND_PpToComDbgFD14Tx_FD14_LeftDoorRearOpen_Icon_b: accessed-variable=PpToComDbgFD14Tx.FD14_LeftDoorRearOpen_Icon_b
            SEND_PpToComDbgFD14Tx_FD14_Log_Sensor_Temperature: accessed-variable=PpToComDbgFD14Tx.FD14_Log_Sensor_Temperature
            SEND_PpToComDbgFD14Tx_FD14_Log_SnrMeasData_{1..7}: accessed-variable=PpToComDbgFD14Tx.FD14_Log_SnrMeasData_{1..7}
            SEND_PpToComDbgFD14Tx_FD14_MAGNIFIER_BTN_PRESSED_b: accessed-variable=PpToComDbgFD14Tx.FD14_MAGNIFIER_BTN_PRESSED_b
            SEND_PpToComDbgFD14Tx_FD14_MOT_ClosestPntDist_0_{0..9}: accessed-variable=PpToComDbgFD14Tx.FD14_MOT_ClosestPntDist_0_{0..9}
            SEND_PpToComDbgFD14Tx_FD14_MOT_ClosestPntDist_1_{0..9}: accessed-variable=PpToComDbgFD14Tx.FD14_MOT_ClosestPntDist_1_{0..9}
            SEND_PpToComDbgFD14Tx_FD14_MOT_ObjValid_{0..9}: accessed-variable=PpToComDbgFD14Tx.FD14_MOT_ObjValid_{0..9}
            SEND_PpToComDbgFD14Tx_FD14_MOT_ObjVelX_{0..9}: accessed-variable=PpToComDbgFD14Tx.FD14_MOT_ObjVelX_{0..9}
            SEND_PpToComDbgFD14Tx_FD14_MOT_ObjVelY_{0..9}: accessed-variable=PpToComDbgFD14Tx.FD14_MOT_ObjVelY_{0..9}
            SEND_PpToComDbgFD14Tx_FD14_MOT_ObjectDimensions_0_{0..9}: accessed-variable=PpToComDbgFD14Tx.FD14_MOT_ObjectDimensions_0_{0..9}
            SEND_PpToComDbgFD14Tx_FD14_MOT_ObjectDimensions_1_{0..9}: accessed-variable=PpToComDbgFD14Tx.FD14_MOT_ObjectDimensions_1_{0..9}
            SEND_PpToComDbgFD14Tx_FD14_M_BURV_Memory_e: accessed-variable=PpToComDbgFD14Tx.FD14_M_BURV_Memory_e
            SEND_PpToComDbgFD14Tx_FD14_M_CONFIRM_BTN_PRESSED_b: accessed-variable=PpToComDbgFD14Tx.FD14_M_CONFIRM_BTN_PRESSED_b
            SEND_PpToComDbgFD14Tx_FD14_M_CPLR_POS_X_u: accessed-variable=PpToComDbgFD14Tx.FD14_M_CPLR_POS_X_u
            SEND_PpToComDbgFD14Tx_FD14_M_CPLR_POS_Y_u: accessed-variable=PpToComDbgFD14Tx.FD14_M_CPLR_POS_Y_u
            SEND_PpToComDbgFD14Tx_FD14_M_Cplr_Htch_Distance: accessed-variable=PpToComDbgFD14Tx.FD14_M_Cplr_Htch_Distance
            SEND_PpToComDbgFD14Tx_FD14_M_Current_THA_State_On_Screen: accessed-variable=PpToComDbgFD14Tx.FD14_M_Current_THA_State_On_Screen
            SEND_PpToComDbgFD14Tx_FD14_M_Current_THA_State_On_Zync: accessed-variable=PpToComDbgFD14Tx.FD14_M_Current_THA_State_On_Zync
            SEND_PpToComDbgFD14Tx_FD14_M_FFClatch_e: accessed-variable=PpToComDbgFD14Tx.FD14_M_FFClatch_e
            SEND_PpToComDbgFD14Tx_FD14_M_Maneuver_Initial_Run: accessed-variable=PpToComDbgFD14Tx.FD14_M_Maneuver_Initial_Run
            SEND_PpToComDbgFD14Tx_FD14_M_Progress_Bar_Distance: accessed-variable=PpToComDbgFD14Tx.FD14_M_Progress_Bar_Distance
            SEND_PpToComDbgFD14Tx_FD14_M_Progress_Bar_Percentage: accessed-variable=PpToComDbgFD14Tx.FD14_M_Progress_Bar_Percentage
            SEND_PpToComDbgFD14Tx_FD14_M_Requested_THA_State: accessed-variable=PpToComDbgFD14Tx.FD14_M_Requested_THA_State
            SEND_PpToComDbgFD14Tx_FD14_M_START_BTN_PRESSED_b: accessed-variable=PpToComDbgFD14Tx.FD14_M_START_BTN_PRESSED_b
            SEND_PpToComDbgFD14Tx_FD14_M_THA_SFT_BTN_PRESSED_b: accessed-variable=PpToComDbgFD14Tx.FD14_M_THA_SFT_BTN_PRESSED_b
            SEND_PpToComDbgFD14Tx_FD14_M_VIEW_SCRN_TCH_STS_b: accessed-variable=PpToComDbgFD14Tx.FD14_M_VIEW_SCRN_TCH_STS_b
            SEND_PpToComDbgFD14Tx_FD14_M_VIEW_ZOOM_STS_b: accessed-variable=PpToComDbgFD14Tx.FD14_M_VIEW_ZOOM_STS_b
            SEND_PpToComDbgFD14Tx_FD14_MaAP_m_ParkSpot1FrntStreetX: accessed-variable=PpToComDbgFD14Tx.FD14_MaAP_m_ParkSpot1FrntStreetX
            SEND_PpToComDbgFD14Tx_FD14_MaAP_m_ParkSpot1FrntStreetY: accessed-variable=PpToComDbgFD14Tx.FD14_MaAP_m_ParkSpot1FrntStreetY
            SEND_PpToComDbgFD14Tx_FD14_MaAP_m_ParkSpot2FrntBorderX: accessed-variable=PpToComDbgFD14Tx.FD14_MaAP_m_ParkSpot2FrntBorderX
            SEND_PpToComDbgFD14Tx_FD14_MaAP_m_ParkSpot2FrntBorderY: accessed-variable=PpToComDbgFD14Tx.FD14_MaAP_m_ParkSpot2FrntBorderY
            SEND_PpToComDbgFD14Tx_FD14_MaAP_m_ParkSpot3RearBorderX: accessed-variable=PpToComDbgFD14Tx.FD14_MaAP_m_ParkSpot3RearBorderX
            SEND_PpToComDbgFD14Tx_FD14_MaAP_m_ParkSpot3RearBorderY: accessed-variable=PpToComDbgFD14Tx.FD14_MaAP_m_ParkSpot3RearBorderY
            SEND_PpToComDbgFD14Tx_FD14_MaAP_m_ParkSpot4RearStreetX: accessed-variable=PpToComDbgFD14Tx.FD14_MaAP_m_ParkSpot4RearStreetX
            SEND_PpToComDbgFD14Tx_FD14_MaAP_m_ParkSpot4RearStreetY: accessed-variable=PpToComDbgFD14Tx.FD14_MaAP_m_ParkSpot4RearStreetY
            SEND_PpToComDbgFD14Tx_FD14_MaxTadAngle: accessed-variable=PpToComDbgFD14Tx.FD14_MaxTadAngle
            SEND_PpToComDbgFD14Tx_FD14_MeAP_a_BrkCmd: accessed-variable=PpToComDbgFD14Tx.FD14_MeAP_a_BrkCmd
            SEND_PpToComDbgFD14Tx_FD14_MeAP_a_ThrtlCmd: accessed-variable=PpToComDbgFD14Tx.FD14_MeAP_a_ThrtlCmd
            SEND_PpToComDbgFD14Tx_FD14_MeAP_b_APInitSts: accessed-variable=PpToComDbgFD14Tx.FD14_MeAP_b_APInitSts
            SEND_PpToComDbgFD14Tx_FD14_MeAP_b_BSMHandshakeActv: accessed-variable=PpToComDbgFD14Tx.FD14_MeAP_b_BSMHandshakeActv
            SEND_PpToComDbgFD14Tx_FD14_MeAP_b_BSMInterfaceTimeout: accessed-variable=PpToComDbgFD14Tx.FD14_MeAP_b_BSMInterfaceTimeout
            SEND_PpToComDbgFD14Tx_FD14_MeAP_b_CamHandshakeTimeout: accessed-variable=PpToComDbgFD14Tx.FD14_MeAP_b_CamHandshakeTimeout
            SEND_PpToComDbgFD14Tx_FD14_MeAP_b_DriverOverride: accessed-variable=PpToComDbgFD14Tx.FD14_MeAP_b_DriverOverride
            SEND_PpToComDbgFD14Tx_FD14_MeAP_b_EPSInterfaceTimeout: accessed-variable=PpToComDbgFD14Tx.FD14_MeAP_b_EPSInterfaceTimeout
            SEND_PpToComDbgFD14Tx_FD14_MeAP_b_FPADisable: accessed-variable=PpToComDbgFD14Tx.FD14_MeAP_b_FPADisable
            SEND_PpToComDbgFD14Tx_FD14_MeAP_b_FPAStatus: accessed-variable=PpToComDbgFD14Tx.FD14_MeAP_b_FPAStatus
            SEND_PpToComDbgFD14Tx_FD14_MeAP_b_FPAVolDefMed: accessed-variable=PpToComDbgFD14Tx.FD14_MeAP_b_FPAVolDefMed
            SEND_PpToComDbgFD14Tx_FD14_MeAP_b_FeatureEnbl: accessed-variable=PpToComDbgFD14Tx.FD14_MeAP_b_FeatureEnbl
            SEND_PpToComDbgFD14Tx_FD14_MeAP_b_GearShiftWaitTimeout: accessed-variable=PpToComDbgFD14Tx.FD14_MeAP_b_GearShiftWaitTimeout
            SEND_PpToComDbgFD14Tx_FD14_MeAP_b_ManeuverAbort: accessed-variable=PpToComDbgFD14Tx.FD14_MeAP_b_ManeuverAbort
            SEND_PpToComDbgFD14Tx_FD14_MeAP_b_ManeuverSuccess: accessed-variable=PpToComDbgFD14Tx.FD14_MeAP_b_ManeuverSuccess
            SEND_PpToComDbgFD14Tx_FD14_MeAP_b_ObjInPathTimeout: accessed-variable=PpToComDbgFD14Tx.FD14_MeAP_b_ObjInPathTimeout
            SEND_PpToComDbgFD14Tx_FD14_MeAP_b_PARBActv4LOW: accessed-variable=PpToComDbgFD14Tx.FD14_MeAP_b_PARBActv4LOW
            SEND_PpToComDbgFD14Tx_FD14_MeAP_b_PARBActvTrlr: accessed-variable=PpToComDbgFD14Tx.FD14_MeAP_b_PARBActvTrlr
            SEND_PpToComDbgFD14Tx_FD14_MeAP_b_PARBDisable: accessed-variable=PpToComDbgFD14Tx.FD14_MeAP_b_PARBDisable
            SEND_PpToComDbgFD14Tx_FD14_MeAP_b_PAVolDefMed: accessed-variable=PpToComDbgFD14Tx.FD14_MeAP_b_PAVolDefMed
            SEND_PpToComDbgFD14Tx_FD14_MeAP_b_PPPAActv4LOW: accessed-variable=PpToComDbgFD14Tx.FD14_MeAP_b_PPPAActv4LOW
            SEND_PpToComDbgFD14Tx_FD14_MeAP_b_PPPAActvTrlr: accessed-variable=PpToComDbgFD14Tx.FD14_MeAP_b_PPPAActvTrlr
            SEND_PpToComDbgFD14Tx_FD14_MeAP_b_PPPADefEng: accessed-variable=PpToComDbgFD14Tx.FD14_MeAP_b_PPPADefEng
            SEND_PpToComDbgFD14Tx_FD14_MeAP_b_PPPADisable: accessed-variable=PpToComDbgFD14Tx.FD14_MeAP_b_PPPADisable
            SEND_PpToComDbgFD14Tx_FD14_MeAP_b_PausedPressBtnTimeout: accessed-variable=PpToComDbgFD14Tx.FD14_MeAP_b_PausedPressBtnTimeout
            SEND_PpToComDbgFD14Tx_FD14_MeAP_b_PosMet: accessed-variable=PpToComDbgFD14Tx.FD14_MeAP_b_PosMet
            SEND_PpToComDbgFD14Tx_FD14_MeAP_b_RPAActvTrlr: accessed-variable=PpToComDbgFD14Tx.FD14_MeAP_b_RPAActvTrlr
            SEND_PpToComDbgFD14Tx_FD14_MeAP_b_RPADisable: accessed-variable=PpToComDbgFD14Tx.FD14_MeAP_b_RPADisable
            SEND_PpToComDbgFD14Tx_FD14_MeAP_b_RPAStatus: accessed-variable=PpToComDbgFD14Tx.FD14_MeAP_b_RPAStatus
            SEND_PpToComDbgFD14Tx_FD14_MeAP_b_RPAVolDefMed: accessed-variable=PpToComDbgFD14Tx.FD14_MeAP_b_RPAVolDefMed
            SEND_PpToComDbgFD14Tx_FD14_MeAP_b_RPAwithBrkStatus: accessed-variable=PpToComDbgFD14Tx.FD14_MeAP_b_RPAwithBrkStatus
            SEND_PpToComDbgFD14Tx_FD14_MeAP_b_SeekSpdExceedTimeout: accessed-variable=PpToComDbgFD14Tx.FD14_MeAP_b_SeekSpdExceedTimeout
            SEND_PpToComDbgFD14Tx_FD14_MeAP_b_StandStill: accessed-variable=PpToComDbgFD14Tx.FD14_MeAP_b_StandStill
            SEND_PpToComDbgFD14Tx_FD14_MeAP_b_SteerActionReq: accessed-variable=PpToComDbgFD14Tx.FD14_MeAP_b_SteerActionReq
            SEND_PpToComDbgFD14Tx_FD14_MeAP_b_VCOpPaused: accessed-variable=PpToComDbgFD14Tx.FD14_MeAP_b_VCOpPaused
            SEND_PpToComDbgFD14Tx_FD14_MeAP_b_VehCndSts: accessed-variable=PpToComDbgFD14Tx.FD14_MeAP_b_VehCndSts
            SEND_PpToComDbgFD14Tx_FD14_MeAP_cm_FrntCenterMinXDist: accessed-variable=PpToComDbgFD14Tx.FD14_MeAP_cm_FrntCenterMinXDist
            SEND_PpToComDbgFD14Tx_FD14_MeAP_cm_FrntLeftMinXDist: accessed-variable=PpToComDbgFD14Tx.FD14_MeAP_cm_FrntLeftMinXDist
            SEND_PpToComDbgFD14Tx_FD14_MeAP_cm_FrntRightMinXDist: accessed-variable=PpToComDbgFD14Tx.FD14_MeAP_cm_FrntRightMinXDist
            SEND_PpToComDbgFD14Tx_FD14_MeAP_cm_RearCenterMinXDist: accessed-variable=PpToComDbgFD14Tx.FD14_MeAP_cm_RearCenterMinXDist
            SEND_PpToComDbgFD14Tx_FD14_MeAP_cm_RearLeftMinXDist: accessed-variable=PpToComDbgFD14Tx.FD14_MeAP_cm_RearLeftMinXDist
            SEND_PpToComDbgFD14Tx_FD14_MeAP_cm_RearRightMinXDist: accessed-variable=PpToComDbgFD14Tx.FD14_MeAP_cm_RearRightMinXDist
            SEND_PpToComDbgFD14Tx_FD14_MeAP_cnt_StateDebugVar: accessed-variable=PpToComDbgFD14Tx.FD14_MeAP_cnt_StateDebugVar
            SEND_PpToComDbgFD14Tx_FD14_MeAP_cnt_TransDebugVar: accessed-variable=PpToComDbgFD14Tx.FD14_MeAP_cnt_TransDebugVar
            SEND_PpToComDbgFD14Tx_FD14_MeAP_cnt_TransDebugVar_Copy_1: accessed-variable=PpToComDbgFD14Tx.FD14_MeAP_cnt_TransDebugVar_Copy_1
            SEND_PpToComDbgFD14Tx_FD14_MeAP_deg_StrCmd: accessed-variable=PpToComDbgFD14Tx.FD14_MeAP_deg_StrCmd
            SEND_PpToComDbgFD14Tx_FD14_MeAP_e_PP_state: accessed-variable=PpToComDbgFD14Tx.FD14_MeAP_e_PP_state
            SEND_PpToComDbgFD14Tx_FD14_MeAP_e_ParkAssistStatus: accessed-variable=PpToComDbgFD14Tx.FD14_MeAP_e_ParkAssistStatus
            SEND_PpToComDbgFD14Tx_FD14_MeAP_e_Park_state: accessed-variable=PpToComDbgFD14Tx.FD14_MeAP_e_Park_state
            SEND_PpToComDbgFD14Tx_FD14_MePRX_b_AuxTrlrCam: accessed-variable=PpToComDbgFD14Tx.FD14_MePRX_b_AuxTrlrCam
            SEND_PpToComDbgFD14Tx_FD14_MePRX_b_CANNode95: accessed-variable=PpToComDbgFD14Tx.FD14_MePRX_b_CANNode95
            SEND_PpToComDbgFD14Tx_FD14_MePRX_b_CanNode27: accessed-variable=PpToComDbgFD14Tx.FD14_MePRX_b_CanNode27
            SEND_PpToComDbgFD14Tx_FD14_MePRX_b_FrwFacingCam: accessed-variable=PpToComDbgFD14Tx.FD14_MePRX_b_FrwFacingCam
            SEND_PpToComDbgFD14Tx_FD14_MePRX_b_SurroundViewCamera: accessed-variable=PpToComDbgFD14Tx.FD14_MePRX_b_SurroundViewCamera
            SEND_PpToComDbgFD14Tx_FD14_MePRX_b_TRGPresence: accessed-variable=PpToComDbgFD14Tx.FD14_MePRX_b_TRGPresence
            SEND_PpToComDbgFD14Tx_FD14_MePRX_b_TRSCPresence: accessed-variable=PpToComDbgFD14Tx.FD14_MePRX_b_TRSCPresence
            SEND_PpToComDbgFD14Tx_FD14_MePRX_e_AutonomyLvl: accessed-variable=PpToComDbgFD14Tx.FD14_MePRX_e_AutonomyLvl
            SEND_PpToComDbgFD14Tx_FD14_MePRX_e_MirrorType: accessed-variable=PpToComDbgFD14Tx.FD14_MePRX_e_MirrorType
            SEND_PpToComDbgFD14Tx_FD14_MePRX_e_PAMTunSet: accessed-variable=PpToComDbgFD14Tx.FD14_MePRX_e_PAMTunSet
            SEND_PpToComDbgFD14Tx_FD14_MePRX_e_RadDispType: accessed-variable=PpToComDbgFD14Tx.FD14_MePRX_e_RadDispType
            SEND_PpToComDbgFD14Tx_FD14_MePRX_e_SteerRatRackPinionType: accessed-variable=PpToComDbgFD14Tx.FD14_MePRX_e_SteerRatRackPinionType
            SEND_PpToComDbgFD14Tx_FD14_MePRX_e_VariantID: accessed-variable=PpToComDbgFD14Tx.FD14_MePRX_e_VariantID
            SEND_PpToComDbgFD14Tx_FD14_MePRX_e_VehLineCfg: accessed-variable=PpToComDbgFD14Tx.FD14_MePRX_e_VehLineCfg
            SEND_PpToComDbgFD14Tx_FD14_MePRX_e_Wheelbase: accessed-variable=PpToComDbgFD14Tx.FD14_MePRX_e_Wheelbase
            SEND_PpToComDbgFD14Tx_FD14_MeSVS_b_MoreCamReqSts: accessed-variable=PpToComDbgFD14Tx.FD14_MeSVS_b_MoreCamReqSts
            SEND_PpToComDbgFD14Tx_FD14_MeSVS_e_DispView2Info: accessed-variable=PpToComDbgFD14Tx.FD14_MeSVS_e_DispView2Info
            SEND_PpToComDbgFD14Tx_FD14_MeTHA_b_EnblRearParkAsstTrg: accessed-variable=PpToComDbgFD14Tx.FD14_MeTHA_b_EnblRearParkAsstTrg
            SEND_PpToComDbgFD14Tx_FD14_MeTHA_b_THAAbortStatus: accessed-variable=PpToComDbgFD14Tx.FD14_MeTHA_b_THAAbortStatus
            SEND_PpToComDbgFD14Tx_FD14_MeTHA_b_TrlrCplrStatus: accessed-variable=PpToComDbgFD14Tx.FD14_MeTHA_b_TrlrCplrStatus
            SEND_PpToComDbgFD14Tx_FD14_MeTHA_b_UsrCplrSelCnfm: accessed-variable=PpToComDbgFD14Tx.FD14_MeTHA_b_UsrCplrSelCnfm
            SEND_PpToComDbgFD14Tx_FD14_MeTHA_b_UsrHitchCnfm: accessed-variable=PpToComDbgFD14Tx.FD14_MeTHA_b_UsrHitchCnfm
            SEND_PpToComDbgFD14Tx_FD14_MeTHA_deg_CplrAng: accessed-variable=PpToComDbgFD14Tx.FD14_MeTHA_deg_CplrAng
            SEND_PpToComDbgFD14Tx_FD14_MeTHA_deg_RoadWhlAng: accessed-variable=PpToComDbgFD14Tx.FD14_MeTHA_deg_RoadWhlAng
            SEND_PpToComDbgFD14Tx_FD14_MeTHA_e_CplrDetctStatus: accessed-variable=PpToComDbgFD14Tx.FD14_MeTHA_e_CplrDetctStatus
            SEND_PpToComDbgFD14Tx_FD14_MeTHA_e_HitchDetctStatus: accessed-variable=PpToComDbgFD14Tx.FD14_MeTHA_e_HitchDetctStatus
            SEND_PpToComDbgFD14Tx_FD14_MeTHA_e_RearBrkSupprInfo: accessed-variable=PpToComDbgFD14Tx.FD14_MeTHA_e_RearBrkSupprInfo
            SEND_PpToComDbgFD14Tx_FD14_MeTHA_e_ScreenRequest: accessed-variable=PpToComDbgFD14Tx.FD14_MeTHA_e_ScreenRequest
            SEND_PpToComDbgFD14Tx_FD14_MeTHA_e_THAStateInfo: accessed-variable=PpToComDbgFD14Tx.FD14_MeTHA_e_THAStateInfo
            SEND_PpToComDbgFD14Tx_FD14_MeTHA_pct_CplrDetConf: accessed-variable=PpToComDbgFD14Tx.FD14_MeTHA_pct_CplrDetConf
            SEND_PpToComDbgFD14Tx_FD14_MeTHA_pct_CplrTrckConf: accessed-variable=PpToComDbgFD14Tx.FD14_MeTHA_pct_CplrTrckConf
            SEND_PpToComDbgFD14Tx_FD14_MeTHA_px_CplrPntX: accessed-variable=PpToComDbgFD14Tx.FD14_MeTHA_px_CplrPntX
            SEND_PpToComDbgFD14Tx_FD14_MeTHA_px_CplrPntY: accessed-variable=PpToComDbgFD14Tx.FD14_MeTHA_px_CplrPntY
            SEND_PpToComDbgFD14Tx_FD14_MeTHA_px_HitchCplrPixDiffLat: accessed-variable=PpToComDbgFD14Tx.FD14_MeTHA_px_HitchCplrPixDiffLat
            SEND_PpToComDbgFD14Tx_FD14_MeTHA_px_HitchCplrPixDiffLong: accessed-variable=PpToComDbgFD14Tx.FD14_MeTHA_px_HitchCplrPixDiffLong
            SEND_PpToComDbgFD14Tx_FD14_MeTHA_px_HitchPntX: accessed-variable=PpToComDbgFD14Tx.FD14_MeTHA_px_HitchPntX
            SEND_PpToComDbgFD14Tx_FD14_MeTHA_px_HitchPntY: accessed-variable=PpToComDbgFD14Tx.FD14_MeTHA_px_HitchPntY
            SEND_PpToComDbgFD14Tx_FD14_MeTRSC_M_SteeringTorqInfo: accessed-variable=PpToComDbgFD14Tx.FD14_MeTRSC_M_SteeringTorqInfo
            SEND_PpToComDbgFD14Tx_FD14_MeTRSC_b_MoreCamSoftButtEnbl: accessed-variable=PpToComDbgFD14Tx.FD14_MeTRSC_b_MoreCamSoftButtEnbl
            SEND_PpToComDbgFD14Tx_FD14_MeTRSC_b_OBTLRecalibrate: accessed-variable=PpToComDbgFD14Tx.FD14_MeTRSC_b_OBTLRecalibrate
            SEND_PpToComDbgFD14Tx_FD14_MeTRSC_b_TRSCSwitchPressed: accessed-variable=PpToComDbgFD14Tx.FD14_MeTRSC_b_TRSCSwitchPressed
            SEND_PpToComDbgFD14Tx_FD14_MeTRSC_b_TrlrCalibDelayInfo: accessed-variable=PpToComDbgFD14Tx.FD14_MeTRSC_b_TrlrCalibDelayInfo
            SEND_PpToComDbgFD14Tx_FD14_MeTRSC_b_TrlrCalibPopInfo: accessed-variable=PpToComDbgFD14Tx.FD14_MeTRSC_b_TrlrCalibPopInfo
            SEND_PpToComDbgFD14Tx_FD14_MeTRSC_b_TrlrRevSteeringStsInfo: accessed-variable=PpToComDbgFD14Tx.FD14_MeTRSC_b_TrlrRevSteeringStsInfo
            SEND_PpToComDbgFD14Tx_FD14_MeTRSC_cnt_TrlrCalibFailCntInfo: accessed-variable=PpToComDbgFD14Tx.FD14_MeTRSC_cnt_TrlrCalibFailCntInfo
            SEND_PpToComDbgFD14Tx_FD14_MeTRSC_deg_DetJackKnifeAngle: accessed-variable=PpToComDbgFD14Tx.FD14_MeTRSC_deg_DetJackKnifeAngle
            SEND_PpToComDbgFD14Tx_FD14_MeTRSC_deg_DetJackknifeThrAngle: accessed-variable=PpToComDbgFD14Tx.FD14_MeTRSC_deg_DetJackknifeThrAngle
            SEND_PpToComDbgFD14Tx_FD14_MeTRSC_deg_JackKnifeAngle: accessed-variable=PpToComDbgFD14Tx.FD14_MeTRSC_deg_JackKnifeAngle
            SEND_PpToComDbgFD14Tx_FD14_MeTRSC_deg_JackknifeThrAngle: accessed-variable=PpToComDbgFD14Tx.FD14_MeTRSC_deg_JackknifeThrAngle
            SEND_PpToComDbgFD14Tx_FD14_MeTRSC_deg_KnobAngle: accessed-variable=PpToComDbgFD14Tx.FD14_MeTRSC_deg_KnobAngle
            SEND_PpToComDbgFD14Tx_FD14_MeTRSC_deg_MaxAllowedTADAngle: accessed-variable=PpToComDbgFD14Tx.FD14_MeTRSC_deg_MaxAllowedTADAngle
            SEND_PpToComDbgFD14Tx_FD14_MeTRSC_deg_TADAngle: accessed-variable=PpToComDbgFD14Tx.FD14_MeTRSC_deg_TADAngle
            SEND_PpToComDbgFD14Tx_FD14_MeTRSC_deg_TADAngleRate: accessed-variable=PpToComDbgFD14Tx.FD14_MeTRSC_deg_TADAngleRate
            SEND_PpToComDbgFD14Tx_FD14_MeTRSC_e_CalFail: accessed-variable=PpToComDbgFD14Tx.FD14_MeTRSC_e_CalFail
            SEND_PpToComDbgFD14Tx_FD14_MeTRSC_e_TADCalibrationSubstate: accessed-variable=PpToComDbgFD14Tx.FD14_MeTRSC_e_TADCalibrationSubstate
            SEND_PpToComDbgFD14Tx_FD14_MeTRSC_e_TADState: accessed-variable=PpToComDbgFD14Tx.FD14_MeTRSC_e_TADState
            SEND_PpToComDbgFD14Tx_FD14_MeTRSC_e_TRSCStat: accessed-variable=PpToComDbgFD14Tx.FD14_MeTRSC_e_TRSCStat
            SEND_PpToComDbgFD14Tx_FD14_MeTRSC_e_TrailerID: accessed-variable=PpToComDbgFD14Tx.FD14_MeTRSC_e_TrailerID
            SEND_PpToComDbgFD14Tx_FD14_MeTRSC_e_TrlrAngSign: accessed-variable=PpToComDbgFD14Tx.FD14_MeTRSC_e_TrlrAngSign
            SEND_PpToComDbgFD14Tx_FD14_MeTRSC_e_TrlrCalInfo: accessed-variable=PpToComDbgFD14Tx.FD14_MeTRSC_e_TrlrCalInfo
            SEND_PpToComDbgFD14Tx_FD14_MeTRSC_e_TrlrPrsntInfo: accessed-variable=PpToComDbgFD14Tx.FD14_MeTRSC_e_TrlrPrsntInfo
            SEND_PpToComDbgFD14Tx_FD14_MeTRSC_e_TrlrPrsntInfoCAN: accessed-variable=PpToComDbgFD14Tx.FD14_MeTRSC_e_TrlrPrsntInfoCAN
            SEND_PpToComDbgFD14Tx_FD14_MeTRSC_e_TrlrRecogInfo: accessed-variable=PpToComDbgFD14Tx.FD14_MeTRSC_e_TrlrRecogInfo
            SEND_PpToComDbgFD14Tx_FD14_MeTRSC_e_TurnAroundSubState: accessed-variable=PpToComDbgFD14Tx.FD14_MeTRSC_e_TurnAroundSubState
            SEND_PpToComDbgFD14Tx_FD14_MeTRSC_m_DetTrailerBeamLen: accessed-variable=PpToComDbgFD14Tx.FD14_MeTRSC_m_DetTrailerBeamLen
            SEND_PpToComDbgFD14Tx_FD14_MeTRSC_m_HitchLength: accessed-variable=PpToComDbgFD14Tx.FD14_MeTRSC_m_HitchLength
            SEND_PpToComDbgFD14Tx_FD14_MeTRSC_m_TrailerBeamLen: accessed-variable=PpToComDbgFD14Tx.FD14_MeTRSC_m_TrailerBeamLen
            SEND_PpToComDbgFD14Tx_FD14_MinDistance_TimeStamp: accessed-variable=PpToComDbgFD14Tx.FD14_MinDistance_TimeStamp
            SEND_PpToComDbgFD14Tx_FD14_MoreCamsButton1NoSelect_b: accessed-variable=PpToComDbgFD14Tx.FD14_MoreCamsButton1NoSelect_b
            SEND_PpToComDbgFD14Tx_FD14_MoreCamsButton1Select_b: accessed-variable=PpToComDbgFD14Tx.FD14_MoreCamsButton1Select_b
            SEND_PpToComDbgFD14Tx_FD14_MoreCamsButton2NoSelect_b: accessed-variable=PpToComDbgFD14Tx.FD14_MoreCamsButton2NoSelect_b
            SEND_PpToComDbgFD14Tx_FD14_MoreCamsButton2Select_b: accessed-variable=PpToComDbgFD14Tx.FD14_MoreCamsButton2Select_b
            SEND_PpToComDbgFD14Tx_FD14_MoreCamsIconFullScreenNoSelect_b: accessed-variable=PpToComDbgFD14Tx.FD14_MoreCamsIconFullScreenNoSelect_b
            SEND_PpToComDbgFD14Tx_FD14_NFCD_DistanceToClosestPoint_0_{0..9}: accessed-variable=PpToComDbgFD14Tx.FD14_NFCD_DistanceToClosestPoint_0_{0..9}
            SEND_PpToComDbgFD14Tx_FD14_NFCD_DistanceToClosestPoint_1_{0..9}: accessed-variable=PpToComDbgFD14Tx.FD14_NFCD_DistanceToClosestPoint_1_{0..9}
            SEND_PpToComDbgFD14Tx_FD14_NFCD_ObjValid_{0..9}: accessed-variable=PpToComDbgFD14Tx.FD14_NFCD_ObjValid_{0..9}
            SEND_PpToComDbgFD14Tx_FD14_NetCfg_TRSCM_e: accessed-variable=PpToComDbgFD14Tx.FD14_NetCfg_TRSCM_e
            SEND_PpToComDbgFD14Tx_FD14_OBTLRecalibrate: accessed-variable=PpToComDbgFD14Tx.FD14_OBTLRecalibrate
            SEND_PpToComDbgFD14Tx_FD14_OC_ModuleState_STM_Front: accessed-variable=PpToComDbgFD14Tx.FD14_OC_ModuleState_STM_Front
            SEND_PpToComDbgFD14Tx_FD14_OC_ModuleState_STM_Left: accessed-variable=PpToComDbgFD14Tx.FD14_OC_ModuleState_STM_Left
            SEND_PpToComDbgFD14Tx_FD14_OC_ModuleState_STM_Rear: accessed-variable=PpToComDbgFD14Tx.FD14_OC_ModuleState_STM_Rear
            SEND_PpToComDbgFD14Tx_FD14_OC_ModuleState_STM_Right: accessed-variable=PpToComDbgFD14Tx.FD14_OC_ModuleState_STM_Right
            SEND_PpToComDbgFD14Tx_FD14_OFFRD_ABSNT_AUXCAM_BTN_PRESSED_b: accessed-variable=PpToComDbgFD14Tx.FD14_OFFRD_ABSNT_AUXCAM_BTN_PRESSED_b
            SEND_PpToComDbgFD14Tx_FD14_OFFRD_PRSNT_AUXCAM_BTN_PRESSED_b: accessed-variable=PpToComDbgFD14Tx.FD14_OFFRD_PRSNT_AUXCAM_BTN_PRESSED_b
            SEND_PpToComDbgFD14Tx_FD14_OFFROAD_ABSNT_MC_BTN_PRESSED_b: accessed-variable=PpToComDbgFD14Tx.FD14_OFFROAD_ABSNT_MC_BTN_PRESSED_b
            SEND_PpToComDbgFD14Tx_FD14_OFFROAD_PRSNT_MC_BTN_PRESSED_b: accessed-variable=PpToComDbgFD14Tx.FD14_OFFROAD_PRSNT_MC_BTN_PRESSED_b
            SEND_PpToComDbgFD14Tx_FD14_PDC_FrontCenter_Red_b: accessed-variable=PpToComDbgFD14Tx.FD14_PDC_FrontCenter_Red_b
            SEND_PpToComDbgFD14Tx_FD14_PDC_FrontCenter_Yellow_b: accessed-variable=PpToComDbgFD14Tx.FD14_PDC_FrontCenter_Yellow_b
            SEND_PpToComDbgFD14Tx_FD14_PDC_FrontLeft_Red_b: accessed-variable=PpToComDbgFD14Tx.FD14_PDC_FrontLeft_Red_b
            SEND_PpToComDbgFD14Tx_FD14_PDC_FrontLeft_Yellow_b: accessed-variable=PpToComDbgFD14Tx.FD14_PDC_FrontLeft_Yellow_b
            SEND_PpToComDbgFD14Tx_FD14_PDC_FrontRight_Red_b: accessed-variable=PpToComDbgFD14Tx.FD14_PDC_FrontRight_Red_b
            SEND_PpToComDbgFD14Tx_FD14_PDC_FrontRight_Yellow_b: accessed-variable=PpToComDbgFD14Tx.FD14_PDC_FrontRight_Yellow_b
            SEND_PpToComDbgFD14Tx_FD14_PDC_RearCenter_Red_b: accessed-variable=PpToComDbgFD14Tx.FD14_PDC_RearCenter_Red_b
            SEND_PpToComDbgFD14Tx_FD14_PDC_RearCenter_Yellow_b: accessed-variable=PpToComDbgFD14Tx.FD14_PDC_RearCenter_Yellow_b
            SEND_PpToComDbgFD14Tx_FD14_PDC_RearLeft_Red_b: accessed-variable=PpToComDbgFD14Tx.FD14_PDC_RearLeft_Red_b
            SEND_PpToComDbgFD14Tx_FD14_PDC_RearLeft_Yellow_b: accessed-variable=PpToComDbgFD14Tx.FD14_PDC_RearLeft_Yellow_b
            SEND_PpToComDbgFD14Tx_FD14_PDC_RearRight_Red_b: accessed-variable=PpToComDbgFD14Tx.FD14_PDC_RearRight_Red_b
            SEND_PpToComDbgFD14Tx_FD14_PDC_RearRight_Yellow_b: accessed-variable=PpToComDbgFD14Tx.FD14_PDC_RearRight_Yellow_b
            SEND_PpToComDbgFD14Tx_FD14_Pitch_f32_Current_Rear: accessed-variable=PpToComDbgFD14Tx.FD14_Pitch_f32_Current_Rear
            SEND_PpToComDbgFD14Tx_FD14_Pitch_f32_Current_Right: accessed-variable=PpToComDbgFD14Tx.FD14_Pitch_f32_Current_Right
            SEND_PpToComDbgFD14Tx_FD14_Pitch_f32_EOL_Front: accessed-variable=PpToComDbgFD14Tx.FD14_Pitch_f32_EOL_Front
            SEND_PpToComDbgFD14Tx_FD14_Pitch_f32_EOL_Left: accessed-variable=PpToComDbgFD14Tx.FD14_Pitch_f32_EOL_Left
            SEND_PpToComDbgFD14Tx_FD14_Pitch_f32_EOL_Rear: accessed-variable=PpToComDbgFD14Tx.FD14_Pitch_f32_EOL_Rear
            SEND_PpToComDbgFD14Tx_FD14_Pitch_f32_EOL_Right: accessed-variable=PpToComDbgFD14Tx.FD14_Pitch_f32_EOL_Right
            SEND_PpToComDbgFD14Tx_FD14_Pitch_f32_OC_Front: accessed-variable=PpToComDbgFD14Tx.FD14_Pitch_f32_OC_Front
            SEND_PpToComDbgFD14Tx_FD14_Pitch_f32_OC_Left: accessed-variable=PpToComDbgFD14Tx.FD14_Pitch_f32_OC_Left
            SEND_PpToComDbgFD14Tx_FD14_Pitch_f32_OC_Rear: accessed-variable=PpToComDbgFD14Tx.FD14_Pitch_f32_OC_Rear
            SEND_PpToComDbgFD14Tx_FD14_Pitch_f32_OC_Right: accessed-variable=PpToComDbgFD14Tx.FD14_Pitch_f32_OC_Right
            SEND_PpToComDbgFD14Tx_FD14_Pitch_f32_SC_Front: accessed-variable=PpToComDbgFD14Tx.FD14_Pitch_f32_SC_Front
            SEND_PpToComDbgFD14Tx_FD14_Pitch_f32_SC_Left: accessed-variable=PpToComDbgFD14Tx.FD14_Pitch_f32_SC_Left
            SEND_PpToComDbgFD14Tx_FD14_Pitch_f32_SC_Rear: accessed-variable=PpToComDbgFD14Tx.FD14_Pitch_f32_SC_Rear
            SEND_PpToComDbgFD14Tx_FD14_Pitch_f32_SC_Right: accessed-variable=PpToComDbgFD14Tx.FD14_Pitch_f32_SC_Right
            SEND_PpToComDbgFD14Tx_FD14_Pntdebugdata_{0..3}: accessed-variable=PpToComDbgFD14Tx.FD14_Pntdebugdata_{0..3}
            SEND_PpToComDbgFD14Tx_FD14_Point_Map_Age_0: accessed-variable=PpToComDbgFD14Tx.FD14_Point_Map_Age_0
            SEND_PpToComDbgFD14Tx_FD14_Point_Map_Age_1: accessed-variable=PpToComDbgFD14Tx.FD14_Point_Map_Age_1
            SEND_PpToComDbgFD14Tx_FD14_Point_Map_Age_{10..19}: accessed-variable=PpToComDbgFD14Tx.FD14_Point_Map_Age_{10..19}
            SEND_PpToComDbgFD14Tx_FD14_Point_Map_Age_2: accessed-variable=PpToComDbgFD14Tx.FD14_Point_Map_Age_2
            SEND_PpToComDbgFD14Tx_FD14_Point_Map_Age_{20..29}: accessed-variable=PpToComDbgFD14Tx.FD14_Point_Map_Age_{20..29}
            SEND_PpToComDbgFD14Tx_FD14_Point_Map_Age_3: accessed-variable=PpToComDbgFD14Tx.FD14_Point_Map_Age_3
            SEND_PpToComDbgFD14Tx_FD14_Point_Map_Age_{30..39}: accessed-variable=PpToComDbgFD14Tx.FD14_Point_Map_Age_{30..39}
            SEND_PpToComDbgFD14Tx_FD14_Point_Map_Age_4: accessed-variable=PpToComDbgFD14Tx.FD14_Point_Map_Age_4
            SEND_PpToComDbgFD14Tx_FD14_Point_Map_Age_{40..49}: accessed-variable=PpToComDbgFD14Tx.FD14_Point_Map_Age_{40..49}
            SEND_PpToComDbgFD14Tx_FD14_Point_Map_Age_5: accessed-variable=PpToComDbgFD14Tx.FD14_Point_Map_Age_5
            SEND_PpToComDbgFD14Tx_FD14_Point_Map_Age_{50..59}: accessed-variable=PpToComDbgFD14Tx.FD14_Point_Map_Age_{50..59}
            SEND_PpToComDbgFD14Tx_FD14_Point_Map_Age_6: accessed-variable=PpToComDbgFD14Tx.FD14_Point_Map_Age_6
            SEND_PpToComDbgFD14Tx_FD14_Point_Map_Age_{60..69}: accessed-variable=PpToComDbgFD14Tx.FD14_Point_Map_Age_{60..69}
            SEND_PpToComDbgFD14Tx_FD14_Point_Map_Age_7: accessed-variable=PpToComDbgFD14Tx.FD14_Point_Map_Age_7
            SEND_PpToComDbgFD14Tx_FD14_Point_Map_Age_{70..79}: accessed-variable=PpToComDbgFD14Tx.FD14_Point_Map_Age_{70..79}
            SEND_PpToComDbgFD14Tx_FD14_Point_Map_Age_8: accessed-variable=PpToComDbgFD14Tx.FD14_Point_Map_Age_8
            SEND_PpToComDbgFD14Tx_FD14_Point_Map_Age_{80..89}: accessed-variable=PpToComDbgFD14Tx.FD14_Point_Map_Age_{80..89}
            SEND_PpToComDbgFD14Tx_FD14_Point_Map_Age_9: accessed-variable=PpToComDbgFD14Tx.FD14_Point_Map_Age_9
            SEND_PpToComDbgFD14Tx_FD14_Point_Map_Age_{90..95}: accessed-variable=PpToComDbgFD14Tx.FD14_Point_Map_Age_{90..95}
            SEND_PpToComDbgFD14Tx_FD14_Point_Map_Confidence_0: accessed-variable=PpToComDbgFD14Tx.FD14_Point_Map_Confidence_0
            SEND_PpToComDbgFD14Tx_FD14_Point_Map_Confidence_1: accessed-variable=PpToComDbgFD14Tx.FD14_Point_Map_Confidence_1
            SEND_PpToComDbgFD14Tx_FD14_Point_Map_Confidence_{10..19}: accessed-variable=PpToComDbgFD14Tx.FD14_Point_Map_Confidence_{10..19}
            SEND_PpToComDbgFD14Tx_FD14_Point_Map_Confidence_2: accessed-variable=PpToComDbgFD14Tx.FD14_Point_Map_Confidence_2
            SEND_PpToComDbgFD14Tx_FD14_Point_Map_Confidence_{20..29}: accessed-variable=PpToComDbgFD14Tx.FD14_Point_Map_Confidence_{20..29}
            SEND_PpToComDbgFD14Tx_FD14_Point_Map_Confidence_3: accessed-variable=PpToComDbgFD14Tx.FD14_Point_Map_Confidence_3
            SEND_PpToComDbgFD14Tx_FD14_Point_Map_Confidence_{30..39}: accessed-variable=PpToComDbgFD14Tx.FD14_Point_Map_Confidence_{30..39}
            SEND_PpToComDbgFD14Tx_FD14_Point_Map_Confidence_4: accessed-variable=PpToComDbgFD14Tx.FD14_Point_Map_Confidence_4
            SEND_PpToComDbgFD14Tx_FD14_Point_Map_Confidence_{40..49}: accessed-variable=PpToComDbgFD14Tx.FD14_Point_Map_Confidence_{40..49}
            SEND_PpToComDbgFD14Tx_FD14_Point_Map_Confidence_5: accessed-variable=PpToComDbgFD14Tx.FD14_Point_Map_Confidence_5
            SEND_PpToComDbgFD14Tx_FD14_Point_Map_Confidence_{50..59}: accessed-variable=PpToComDbgFD14Tx.FD14_Point_Map_Confidence_{50..59}
            SEND_PpToComDbgFD14Tx_FD14_Point_Map_Confidence_6: accessed-variable=PpToComDbgFD14Tx.FD14_Point_Map_Confidence_6
            SEND_PpToComDbgFD14Tx_FD14_Point_Map_Confidence_{60..69}: accessed-variable=PpToComDbgFD14Tx.FD14_Point_Map_Confidence_{60..69}
            SEND_PpToComDbgFD14Tx_FD14_Point_Map_Confidence_7: accessed-variable=PpToComDbgFD14Tx.FD14_Point_Map_Confidence_7
            SEND_PpToComDbgFD14Tx_FD14_Point_Map_Confidence_{70..79}: accessed-variable=PpToComDbgFD14Tx.FD14_Point_Map_Confidence_{70..79}
            SEND_PpToComDbgFD14Tx_FD14_Point_Map_Confidence_8: accessed-variable=PpToComDbgFD14Tx.FD14_Point_Map_Confidence_8
            SEND_PpToComDbgFD14Tx_FD14_Point_Map_Confidence_{80..89}: accessed-variable=PpToComDbgFD14Tx.FD14_Point_Map_Confidence_{80..89}
            SEND_PpToComDbgFD14Tx_FD14_Point_Map_Confidence_9: accessed-variable=PpToComDbgFD14Tx.FD14_Point_Map_Confidence_9
            SEND_PpToComDbgFD14Tx_FD14_Point_Map_Confidence_{90..95}: accessed-variable=PpToComDbgFD14Tx.FD14_Point_Map_Confidence_{90..95}
            SEND_PpToComDbgFD14Tx_FD14_Point_Map_Cruising_Age_0: accessed-variable=PpToComDbgFD14Tx.FD14_Point_Map_Cruising_Age_0
            SEND_PpToComDbgFD14Tx_FD14_Point_Map_Cruising_Age_1: accessed-variable=PpToComDbgFD14Tx.FD14_Point_Map_Cruising_Age_1
            SEND_PpToComDbgFD14Tx_FD14_Point_Map_Cruising_Age_{10..19}: accessed-variable=PpToComDbgFD14Tx.FD14_Point_Map_Cruising_Age_{10..19}
            SEND_PpToComDbgFD14Tx_FD14_Point_Map_Cruising_Age_2: accessed-variable=PpToComDbgFD14Tx.FD14_Point_Map_Cruising_Age_2
            SEND_PpToComDbgFD14Tx_FD14_Point_Map_Cruising_Age_{20..29}: accessed-variable=PpToComDbgFD14Tx.FD14_Point_Map_Cruising_Age_{20..29}
            SEND_PpToComDbgFD14Tx_FD14_Point_Map_Cruising_Age_3: accessed-variable=PpToComDbgFD14Tx.FD14_Point_Map_Cruising_Age_3
            SEND_PpToComDbgFD14Tx_FD14_Point_Map_Cruising_Age_{30..39}: accessed-variable=PpToComDbgFD14Tx.FD14_Point_Map_Cruising_Age_{30..39}
            SEND_PpToComDbgFD14Tx_FD14_Point_Map_Cruising_Age_4: accessed-variable=PpToComDbgFD14Tx.FD14_Point_Map_Cruising_Age_4
            SEND_PpToComDbgFD14Tx_FD14_Point_Map_Cruising_Age_{40..49}: accessed-variable=PpToComDbgFD14Tx.FD14_Point_Map_Cruising_Age_{40..49}
            SEND_PpToComDbgFD14Tx_FD14_Point_Map_Cruising_Age_5: accessed-variable=PpToComDbgFD14Tx.FD14_Point_Map_Cruising_Age_5
            SEND_PpToComDbgFD14Tx_FD14_Point_Map_Cruising_Age_{50..59}: accessed-variable=PpToComDbgFD14Tx.FD14_Point_Map_Cruising_Age_{50..59}
            SEND_PpToComDbgFD14Tx_FD14_Point_Map_Cruising_Age_6: accessed-variable=PpToComDbgFD14Tx.FD14_Point_Map_Cruising_Age_6
            SEND_PpToComDbgFD14Tx_FD14_Point_Map_Cruising_Age_{60..69}: accessed-variable=PpToComDbgFD14Tx.FD14_Point_Map_Cruising_Age_{60..69}
            SEND_PpToComDbgFD14Tx_FD14_Point_Map_Cruising_Age_7: accessed-variable=PpToComDbgFD14Tx.FD14_Point_Map_Cruising_Age_7
            SEND_PpToComDbgFD14Tx_FD14_Point_Map_Cruising_Age_{70..79}: accessed-variable=PpToComDbgFD14Tx.FD14_Point_Map_Cruising_Age_{70..79}
            SEND_PpToComDbgFD14Tx_FD14_Point_Map_Cruising_Age_8: accessed-variable=PpToComDbgFD14Tx.FD14_Point_Map_Cruising_Age_8
            SEND_PpToComDbgFD14Tx_FD14_Point_Map_Cruising_Age_{80..89}: accessed-variable=PpToComDbgFD14Tx.FD14_Point_Map_Cruising_Age_{80..89}
            SEND_PpToComDbgFD14Tx_FD14_Point_Map_Cruising_Age_9: accessed-variable=PpToComDbgFD14Tx.FD14_Point_Map_Cruising_Age_9
            SEND_PpToComDbgFD14Tx_FD14_Point_Map_Cruising_Age_{90..95}: accessed-variable=PpToComDbgFD14Tx.FD14_Point_Map_Cruising_Age_{90..95}
            SEND_PpToComDbgFD14Tx_FD14_Point_Map_Height_0: accessed-variable=PpToComDbgFD14Tx.FD14_Point_Map_Height_0
            SEND_PpToComDbgFD14Tx_FD14_Point_Map_Height_1: accessed-variable=PpToComDbgFD14Tx.FD14_Point_Map_Height_1
            SEND_PpToComDbgFD14Tx_FD14_Point_Map_Height_{10..19}: accessed-variable=PpToComDbgFD14Tx.FD14_Point_Map_Height_{10..19}
            SEND_PpToComDbgFD14Tx_FD14_Point_Map_Height_2: accessed-variable=PpToComDbgFD14Tx.FD14_Point_Map_Height_2
            SEND_PpToComDbgFD14Tx_FD14_Point_Map_Height_{20..29}: accessed-variable=PpToComDbgFD14Tx.FD14_Point_Map_Height_{20..29}
            SEND_PpToComDbgFD14Tx_FD14_Point_Map_Height_3: accessed-variable=PpToComDbgFD14Tx.FD14_Point_Map_Height_3
            SEND_PpToComDbgFD14Tx_FD14_Point_Map_Height_{30..39}: accessed-variable=PpToComDbgFD14Tx.FD14_Point_Map_Height_{30..39}
            SEND_PpToComDbgFD14Tx_FD14_Point_Map_Height_4: accessed-variable=PpToComDbgFD14Tx.FD14_Point_Map_Height_4
            SEND_PpToComDbgFD14Tx_FD14_Point_Map_Height_{40..49}: accessed-variable=PpToComDbgFD14Tx.FD14_Point_Map_Height_{40..49}
            SEND_PpToComDbgFD14Tx_FD14_Point_Map_Height_5: accessed-variable=PpToComDbgFD14Tx.FD14_Point_Map_Height_5
            SEND_PpToComDbgFD14Tx_FD14_Point_Map_Height_{50..59}: accessed-variable=PpToComDbgFD14Tx.FD14_Point_Map_Height_{50..59}
            SEND_PpToComDbgFD14Tx_FD14_Point_Map_Height_6: accessed-variable=PpToComDbgFD14Tx.FD14_Point_Map_Height_6
            SEND_PpToComDbgFD14Tx_FD14_Point_Map_Height_{60..69}: accessed-variable=PpToComDbgFD14Tx.FD14_Point_Map_Height_{60..69}
            SEND_PpToComDbgFD14Tx_FD14_Point_Map_Height_7: accessed-variable=PpToComDbgFD14Tx.FD14_Point_Map_Height_7
            SEND_PpToComDbgFD14Tx_FD14_Point_Map_Height_{70..79}: accessed-variable=PpToComDbgFD14Tx.FD14_Point_Map_Height_{70..79}
            SEND_PpToComDbgFD14Tx_FD14_Point_Map_Height_8: accessed-variable=PpToComDbgFD14Tx.FD14_Point_Map_Height_8
            SEND_PpToComDbgFD14Tx_FD14_Point_Map_Height_{80..89}: accessed-variable=PpToComDbgFD14Tx.FD14_Point_Map_Height_{80..89}
            SEND_PpToComDbgFD14Tx_FD14_Point_Map_Height_9: accessed-variable=PpToComDbgFD14Tx.FD14_Point_Map_Height_9
            SEND_PpToComDbgFD14Tx_FD14_Point_Map_Height_{90..95}: accessed-variable=PpToComDbgFD14Tx.FD14_Point_Map_Height_{90..95}
            SEND_PpToComDbgFD14Tx_FD14_Point_Map_Reserved_0: accessed-variable=PpToComDbgFD14Tx.FD14_Point_Map_Reserved_0
            SEND_PpToComDbgFD14Tx_FD14_Point_Map_Reserved_1: accessed-variable=PpToComDbgFD14Tx.FD14_Point_Map_Reserved_1
            SEND_PpToComDbgFD14Tx_FD14_Point_Map_Reserved_{10..19}: accessed-variable=PpToComDbgFD14Tx.FD14_Point_Map_Reserved_{10..19}
            SEND_PpToComDbgFD14Tx_FD14_Point_Map_Reserved_2: accessed-variable=PpToComDbgFD14Tx.FD14_Point_Map_Reserved_2
            SEND_PpToComDbgFD14Tx_FD14_Point_Map_Reserved_{20..29}: accessed-variable=PpToComDbgFD14Tx.FD14_Point_Map_Reserved_{20..29}
            SEND_PpToComDbgFD14Tx_FD14_Point_Map_Reserved_3: accessed-variable=PpToComDbgFD14Tx.FD14_Point_Map_Reserved_3
            SEND_PpToComDbgFD14Tx_FD14_Point_Map_Reserved_{30..39}: accessed-variable=PpToComDbgFD14Tx.FD14_Point_Map_Reserved_{30..39}
            SEND_PpToComDbgFD14Tx_FD14_Point_Map_Reserved_4: accessed-variable=PpToComDbgFD14Tx.FD14_Point_Map_Reserved_4
            SEND_PpToComDbgFD14Tx_FD14_Point_Map_Reserved_{40..49}: accessed-variable=PpToComDbgFD14Tx.FD14_Point_Map_Reserved_{40..49}
            SEND_PpToComDbgFD14Tx_FD14_Point_Map_Reserved_5: accessed-variable=PpToComDbgFD14Tx.FD14_Point_Map_Reserved_5
            SEND_PpToComDbgFD14Tx_FD14_Point_Map_Reserved_{50..59}: accessed-variable=PpToComDbgFD14Tx.FD14_Point_Map_Reserved_{50..59}
            SEND_PpToComDbgFD14Tx_FD14_Point_Map_Reserved_6: accessed-variable=PpToComDbgFD14Tx.FD14_Point_Map_Reserved_6
            SEND_PpToComDbgFD14Tx_FD14_Point_Map_Reserved_{60..69}: accessed-variable=PpToComDbgFD14Tx.FD14_Point_Map_Reserved_{60..69}
            SEND_PpToComDbgFD14Tx_FD14_Point_Map_Reserved_7: accessed-variable=PpToComDbgFD14Tx.FD14_Point_Map_Reserved_7
            SEND_PpToComDbgFD14Tx_FD14_Point_Map_Reserved_{70..79}: accessed-variable=PpToComDbgFD14Tx.FD14_Point_Map_Reserved_{70..79}
            SEND_PpToComDbgFD14Tx_FD14_Point_Map_Reserved_8: accessed-variable=PpToComDbgFD14Tx.FD14_Point_Map_Reserved_8
            SEND_PpToComDbgFD14Tx_FD14_Point_Map_Reserved_{80..89}: accessed-variable=PpToComDbgFD14Tx.FD14_Point_Map_Reserved_{80..89}
            SEND_PpToComDbgFD14Tx_FD14_Point_Map_Reserved_9: accessed-variable=PpToComDbgFD14Tx.FD14_Point_Map_Reserved_9
            SEND_PpToComDbgFD14Tx_FD14_Point_Map_Reserved_{90..95}: accessed-variable=PpToComDbgFD14Tx.FD14_Point_Map_Reserved_{90..95}
            SEND_PpToComDbgFD14Tx_FD14_Point_Map_X_0: accessed-variable=PpToComDbgFD14Tx.FD14_Point_Map_X_0
            SEND_PpToComDbgFD14Tx_FD14_Point_Map_X_1: accessed-variable=PpToComDbgFD14Tx.FD14_Point_Map_X_1
            SEND_PpToComDbgFD14Tx_FD14_Point_Map_X_{10..19}: accessed-variable=PpToComDbgFD14Tx.FD14_Point_Map_X_{10..19}
            SEND_PpToComDbgFD14Tx_FD14_Point_Map_X_2: accessed-variable=PpToComDbgFD14Tx.FD14_Point_Map_X_2
            SEND_PpToComDbgFD14Tx_FD14_Point_Map_X_{20..29}: accessed-variable=PpToComDbgFD14Tx.FD14_Point_Map_X_{20..29}
            SEND_PpToComDbgFD14Tx_FD14_Point_Map_X_3: accessed-variable=PpToComDbgFD14Tx.FD14_Point_Map_X_3
            SEND_PpToComDbgFD14Tx_FD14_Point_Map_X_{30..39}: accessed-variable=PpToComDbgFD14Tx.FD14_Point_Map_X_{30..39}
            SEND_PpToComDbgFD14Tx_FD14_Point_Map_X_4: accessed-variable=PpToComDbgFD14Tx.FD14_Point_Map_X_4
            SEND_PpToComDbgFD14Tx_FD14_Point_Map_X_{40..49}: accessed-variable=PpToComDbgFD14Tx.FD14_Point_Map_X_{40..49}
            SEND_PpToComDbgFD14Tx_FD14_Point_Map_X_5: accessed-variable=PpToComDbgFD14Tx.FD14_Point_Map_X_5
            SEND_PpToComDbgFD14Tx_FD14_Point_Map_X_{50..59}: accessed-variable=PpToComDbgFD14Tx.FD14_Point_Map_X_{50..59}
            SEND_PpToComDbgFD14Tx_FD14_Point_Map_X_6: accessed-variable=PpToComDbgFD14Tx.FD14_Point_Map_X_6
            SEND_PpToComDbgFD14Tx_FD14_Point_Map_X_{60..69}: accessed-variable=PpToComDbgFD14Tx.FD14_Point_Map_X_{60..69}
            SEND_PpToComDbgFD14Tx_FD14_Point_Map_X_7: accessed-variable=PpToComDbgFD14Tx.FD14_Point_Map_X_7
            SEND_PpToComDbgFD14Tx_FD14_Point_Map_X_{70..79}: accessed-variable=PpToComDbgFD14Tx.FD14_Point_Map_X_{70..79}
            SEND_PpToComDbgFD14Tx_FD14_Point_Map_X_8: accessed-variable=PpToComDbgFD14Tx.FD14_Point_Map_X_8
            SEND_PpToComDbgFD14Tx_FD14_Point_Map_X_{80..89}: accessed-variable=PpToComDbgFD14Tx.FD14_Point_Map_X_{80..89}
            SEND_PpToComDbgFD14Tx_FD14_Point_Map_X_9: accessed-variable=PpToComDbgFD14Tx.FD14_Point_Map_X_9
            SEND_PpToComDbgFD14Tx_FD14_Point_Map_X_{90..95}: accessed-variable=PpToComDbgFD14Tx.FD14_Point_Map_X_{90..95}
            SEND_PpToComDbgFD14Tx_FD14_Point_Map_Y_0: accessed-variable=PpToComDbgFD14Tx.FD14_Point_Map_Y_0
            SEND_PpToComDbgFD14Tx_FD14_Point_Map_Y_1: accessed-variable=PpToComDbgFD14Tx.FD14_Point_Map_Y_1
            SEND_PpToComDbgFD14Tx_FD14_Point_Map_Y_{10..19}: accessed-variable=PpToComDbgFD14Tx.FD14_Point_Map_Y_{10..19}
            SEND_PpToComDbgFD14Tx_FD14_Point_Map_Y_2: accessed-variable=PpToComDbgFD14Tx.FD14_Point_Map_Y_2
            SEND_PpToComDbgFD14Tx_FD14_Point_Map_Y_{20..29}: accessed-variable=PpToComDbgFD14Tx.FD14_Point_Map_Y_{20..29}
            SEND_PpToComDbgFD14Tx_FD14_Point_Map_Y_3: accessed-variable=PpToComDbgFD14Tx.FD14_Point_Map_Y_3
            SEND_PpToComDbgFD14Tx_FD14_Point_Map_Y_{30..39}: accessed-variable=PpToComDbgFD14Tx.FD14_Point_Map_Y_{30..39}
            SEND_PpToComDbgFD14Tx_FD14_Point_Map_Y_4: accessed-variable=PpToComDbgFD14Tx.FD14_Point_Map_Y_4
            SEND_PpToComDbgFD14Tx_FD14_Point_Map_Y_{40..49}: accessed-variable=PpToComDbgFD14Tx.FD14_Point_Map_Y_{40..49}
            SEND_PpToComDbgFD14Tx_FD14_Point_Map_Y_5: accessed-variable=PpToComDbgFD14Tx.FD14_Point_Map_Y_5
            SEND_PpToComDbgFD14Tx_FD14_Point_Map_Y_{50..59}: accessed-variable=PpToComDbgFD14Tx.FD14_Point_Map_Y_{50..59}
            SEND_PpToComDbgFD14Tx_FD14_Point_Map_Y_6: accessed-variable=PpToComDbgFD14Tx.FD14_Point_Map_Y_6
            SEND_PpToComDbgFD14Tx_FD14_Point_Map_Y_{60..69}: accessed-variable=PpToComDbgFD14Tx.FD14_Point_Map_Y_{60..69}
            SEND_PpToComDbgFD14Tx_FD14_Point_Map_Y_7: accessed-variable=PpToComDbgFD14Tx.FD14_Point_Map_Y_7
            SEND_PpToComDbgFD14Tx_FD14_Point_Map_Y_{70..79}: accessed-variable=PpToComDbgFD14Tx.FD14_Point_Map_Y_{70..79}
            SEND_PpToComDbgFD14Tx_FD14_Point_Map_Y_8: accessed-variable=PpToComDbgFD14Tx.FD14_Point_Map_Y_8
            SEND_PpToComDbgFD14Tx_FD14_Point_Map_Y_{80..89}: accessed-variable=PpToComDbgFD14Tx.FD14_Point_Map_Y_{80..89}
            SEND_PpToComDbgFD14Tx_FD14_Point_Map_Y_9: accessed-variable=PpToComDbgFD14Tx.FD14_Point_Map_Y_9
            SEND_PpToComDbgFD14Tx_FD14_Point_Map_Y_{90..95}: accessed-variable=PpToComDbgFD14Tx.FD14_Point_Map_Y_{90..95}
            SEND_PpToComDbgFD14Tx_FD14_Presentinfo: accessed-variable=PpToComDbgFD14Tx.FD14_Presentinfo
            SEND_PpToComDbgFD14Tx_FD14_Prev_DisplayedViewByAcore_e: accessed-variable=PpToComDbgFD14Tx.FD14_Prev_DisplayedViewByAcore_e
            SEND_PpToComDbgFD14Tx_FD14_Prev_RequestedViewByHmiM_e: accessed-variable=PpToComDbgFD14Tx.FD14_Prev_RequestedViewByHmiM_e
            SEND_PpToComDbgFD14Tx_FD14_Prev_SystemState_e: accessed-variable=PpToComDbgFD14Tx.FD14_Prev_SystemState_e
            SEND_PpToComDbgFD14Tx_FD14_Prev_TRG_Stat: accessed-variable=PpToComDbgFD14Tx.FD14_Prev_TRG_Stat
            SEND_PpToComDbgFD14Tx_FD14_REAR_CROSS_BTN_PRESSED_b: accessed-variable=PpToComDbgFD14Tx.FD14_REAR_CROSS_BTN_PRESSED_b
            SEND_PpToComDbgFD14Tx_FD14_REAR_TOP_BTN_PRESSED_b: accessed-variable=PpToComDbgFD14Tx.FD14_REAR_TOP_BTN_PRESSED_b
            SEND_PpToComDbgFD14Tx_FD14_RIL_Blockage: accessed-variable=PpToComDbgFD14Tx.FD14_RIL_Blockage
            SEND_PpToComDbgFD14Tx_FD14_RIL_CommUnknown: accessed-variable=PpToComDbgFD14Tx.FD14_RIL_CommUnknown
            SEND_PpToComDbgFD14Tx_FD14_RIL_MinDistance: accessed-variable=PpToComDbgFD14Tx.FD14_RIL_MinDistance
            SEND_PpToComDbgFD14Tx_FD14_RIL_comm_Fault: accessed-variable=PpToComDbgFD14Tx.FD14_RIL_comm_Fault
            SEND_PpToComDbgFD14Tx_FD14_RIL_hardware_Fault: accessed-variable=PpToComDbgFD14Tx.FD14_RIL_hardware_Fault
            SEND_PpToComDbgFD14Tx_FD14_RIL_overTemp_Fault: accessed-variable=PpToComDbgFD14Tx.FD14_RIL_overTemp_Fault
            SEND_PpToComDbgFD14Tx_FD14_RIR_Blockage: accessed-variable=PpToComDbgFD14Tx.FD14_RIR_Blockage
            SEND_PpToComDbgFD14Tx_FD14_RIR_CommUnknown: accessed-variable=PpToComDbgFD14Tx.FD14_RIR_CommUnknown
            SEND_PpToComDbgFD14Tx_FD14_RIR_MinDistance: accessed-variable=PpToComDbgFD14Tx.FD14_RIR_MinDistance
            SEND_PpToComDbgFD14Tx_FD14_RIR_comm_Fault: accessed-variable=PpToComDbgFD14Tx.FD14_RIR_comm_Fault
            SEND_PpToComDbgFD14Tx_FD14_RIR_hardware_Fault: accessed-variable=PpToComDbgFD14Tx.FD14_RIR_hardware_Fault
            SEND_PpToComDbgFD14Tx_FD14_RIR_overTemp_Fault: accessed-variable=PpToComDbgFD14Tx.FD14_RIR_overTemp_Fault
            SEND_PpToComDbgFD14Tx_FD14_ROL_Blockage: accessed-variable=PpToComDbgFD14Tx.FD14_ROL_Blockage
            SEND_PpToComDbgFD14Tx_FD14_ROL_CommUnknown: accessed-variable=PpToComDbgFD14Tx.FD14_ROL_CommUnknown
            SEND_PpToComDbgFD14Tx_FD14_ROL_MinDistance: accessed-variable=PpToComDbgFD14Tx.FD14_ROL_MinDistance
            SEND_PpToComDbgFD14Tx_FD14_ROL_comm_Fault: accessed-variable=PpToComDbgFD14Tx.FD14_ROL_comm_Fault
            SEND_PpToComDbgFD14Tx_FD14_ROL_hardware_Fault: accessed-variable=PpToComDbgFD14Tx.FD14_ROL_hardware_Fault
            SEND_PpToComDbgFD14Tx_FD14_ROL_overTemp_Fault: accessed-variable=PpToComDbgFD14Tx.FD14_ROL_overTemp_Fault
            SEND_PpToComDbgFD14Tx_FD14_ROR_Blockage: accessed-variable=PpToComDbgFD14Tx.FD14_ROR_Blockage
            SEND_PpToComDbgFD14Tx_FD14_ROR_CommUnknown: accessed-variable=PpToComDbgFD14Tx.FD14_ROR_CommUnknown
            SEND_PpToComDbgFD14Tx_FD14_ROR_MinDistance: accessed-variable=PpToComDbgFD14Tx.FD14_ROR_MinDistance
            SEND_PpToComDbgFD14Tx_FD14_ROR_comm_Fault: accessed-variable=PpToComDbgFD14Tx.FD14_ROR_comm_Fault
            SEND_PpToComDbgFD14Tx_FD14_ROR_hardware_Fault: accessed-variable=PpToComDbgFD14Tx.FD14_ROR_hardware_Fault
            SEND_PpToComDbgFD14Tx_FD14_ROR_overTemp_Fault: accessed-variable=PpToComDbgFD14Tx.FD14_ROR_overTemp_Fault
            SEND_PpToComDbgFD14Tx_FD14_RSL_Blockage: accessed-variable=PpToComDbgFD14Tx.FD14_RSL_Blockage
            SEND_PpToComDbgFD14Tx_FD14_RSL_CommUnknown: accessed-variable=PpToComDbgFD14Tx.FD14_RSL_CommUnknown
            SEND_PpToComDbgFD14Tx_FD14_RSL_MinDistance: accessed-variable=PpToComDbgFD14Tx.FD14_RSL_MinDistance
            SEND_PpToComDbgFD14Tx_FD14_RSL_comm_Fault: accessed-variable=PpToComDbgFD14Tx.FD14_RSL_comm_Fault
            SEND_PpToComDbgFD14Tx_FD14_RSL_hardware_Fault: accessed-variable=PpToComDbgFD14Tx.FD14_RSL_hardware_Fault
            SEND_PpToComDbgFD14Tx_FD14_RSL_overTemp_Fault: accessed-variable=PpToComDbgFD14Tx.FD14_RSL_overTemp_Fault
            SEND_PpToComDbgFD14Tx_FD14_RSR_Blockage: accessed-variable=PpToComDbgFD14Tx.FD14_RSR_Blockage
            SEND_PpToComDbgFD14Tx_FD14_RSR_CommUnknown: accessed-variable=PpToComDbgFD14Tx.FD14_RSR_CommUnknown
            SEND_PpToComDbgFD14Tx_FD14_RSR_MinDistance: accessed-variable=PpToComDbgFD14Tx.FD14_RSR_MinDistance
            SEND_PpToComDbgFD14Tx_FD14_RSR_comm_Fault: accessed-variable=PpToComDbgFD14Tx.FD14_RSR_comm_Fault
            SEND_PpToComDbgFD14Tx_FD14_RSR_hardware_Fault: accessed-variable=PpToComDbgFD14Tx.FD14_RSR_hardware_Fault
            SEND_PpToComDbgFD14Tx_FD14_RSR_overTemp_Fault: accessed-variable=PpToComDbgFD14Tx.FD14_RSR_overTemp_Fault
            SEND_PpToComDbgFD14Tx_FD14_RVCONLY_BTN_PRESSED_b: accessed-variable=PpToComDbgFD14Tx.FD14_RVCONLY_BTN_PRESSED_b
            SEND_PpToComDbgFD14Tx_FD14_RearCrossButtonNoSelect_b: accessed-variable=PpToComDbgFD14Tx.FD14_RearCrossButtonNoSelect_b
            SEND_PpToComDbgFD14Tx_FD14_RearCrossButtonSelect_b: accessed-variable=PpToComDbgFD14Tx.FD14_RearCrossButtonSelect_b
            SEND_PpToComDbgFD14Tx_FD14_RearViewDynamics_b: accessed-variable=PpToComDbgFD14Tx.FD14_RearViewDynamics_b
            SEND_PpToComDbgFD14Tx_FD14_RecognitionInfo: accessed-variable=PpToComDbgFD14Tx.FD14_RecognitionInfo
            SEND_PpToComDbgFD14Tx_FD14_Reserved08_b: accessed-variable=PpToComDbgFD14Tx.FD14_Reserved08_b
            SEND_PpToComDbgFD14Tx_FD14_Reserved09_b: accessed-variable=PpToComDbgFD14Tx.FD14_Reserved09_b
            SEND_PpToComDbgFD14Tx_FD14_Reserved0_b: accessed-variable=PpToComDbgFD14Tx.FD14_Reserved0_b
            SEND_PpToComDbgFD14Tx_FD14_Reserved{10..13}_b: accessed-variable=PpToComDbgFD14Tx.FD14_Reserved{10..13}_b
            SEND_PpToComDbgFD14Tx_FD14_Reserved{1..3}_b: accessed-variable=PpToComDbgFD14Tx.FD14_Reserved{1..3}_b
            SEND_PpToComDbgFD14Tx_FD14_RightCam_NA_b: accessed-variable=PpToComDbgFD14Tx.FD14_RightCam_NA_b
            SEND_PpToComDbgFD14Tx_FD14_RightDoorFrontClose_Icon_b: accessed-variable=PpToComDbgFD14Tx.FD14_RightDoorFrontClose_Icon_b
            SEND_PpToComDbgFD14Tx_FD14_RightDoorFrontOpen_Icon_b: accessed-variable=PpToComDbgFD14Tx.FD14_RightDoorFrontOpen_Icon_b
            SEND_PpToComDbgFD14Tx_FD14_RightDoorRearClose_Icon_b: accessed-variable=PpToComDbgFD14Tx.FD14_RightDoorRearClose_Icon_b
            SEND_PpToComDbgFD14Tx_FD14_RightDoorRearOpen_Icon_b: accessed-variable=PpToComDbgFD14Tx.FD14_RightDoorRearOpen_Icon_b
            SEND_PpToComDbgFD14Tx_FD14_Roll_f32_Current_Rear: accessed-variable=PpToComDbgFD14Tx.FD14_Roll_f32_Current_Rear
            SEND_PpToComDbgFD14Tx_FD14_Roll_f32_Current_Right: accessed-variable=PpToComDbgFD14Tx.FD14_Roll_f32_Current_Right
            SEND_PpToComDbgFD14Tx_FD14_Roll_f32_EOL_Front: accessed-variable=PpToComDbgFD14Tx.FD14_Roll_f32_EOL_Front
            SEND_PpToComDbgFD14Tx_FD14_Roll_f32_EOL_Left: accessed-variable=PpToComDbgFD14Tx.FD14_Roll_f32_EOL_Left
            SEND_PpToComDbgFD14Tx_FD14_Roll_f32_EOL_Rear: accessed-variable=PpToComDbgFD14Tx.FD14_Roll_f32_EOL_Rear
            SEND_PpToComDbgFD14Tx_FD14_Roll_f32_EOL_Right: accessed-variable=PpToComDbgFD14Tx.FD14_Roll_f32_EOL_Right
            SEND_PpToComDbgFD14Tx_FD14_Roll_f32_OC_Front: accessed-variable=PpToComDbgFD14Tx.FD14_Roll_f32_OC_Front
            SEND_PpToComDbgFD14Tx_FD14_Roll_f32_OC_Left: accessed-variable=PpToComDbgFD14Tx.FD14_Roll_f32_OC_Left
            SEND_PpToComDbgFD14Tx_FD14_Roll_f32_OC_Rear: accessed-variable=PpToComDbgFD14Tx.FD14_Roll_f32_OC_Rear
            SEND_PpToComDbgFD14Tx_FD14_Roll_f32_OC_Right: accessed-variable=PpToComDbgFD14Tx.FD14_Roll_f32_OC_Right
            SEND_PpToComDbgFD14Tx_FD14_Roll_f32_SC_Front: accessed-variable=PpToComDbgFD14Tx.FD14_Roll_f32_SC_Front
            SEND_PpToComDbgFD14Tx_FD14_Roll_f32_SC_Left: accessed-variable=PpToComDbgFD14Tx.FD14_Roll_f32_SC_Left
            SEND_PpToComDbgFD14Tx_FD14_Roll_f32_SC_Rear: accessed-variable=PpToComDbgFD14Tx.FD14_Roll_f32_SC_Rear
            SEND_PpToComDbgFD14Tx_FD14_Roll_f32_SC_Right: accessed-variable=PpToComDbgFD14Tx.FD14_Roll_f32_SC_Right
            SEND_PpToComDbgFD14Tx_FD14_SC_ModuleState_STM_Front: accessed-variable=PpToComDbgFD14Tx.FD14_SC_ModuleState_STM_Front
            SEND_PpToComDbgFD14Tx_FD14_SC_ModuleState_STM_Left: accessed-variable=PpToComDbgFD14Tx.FD14_SC_ModuleState_STM_Left
            SEND_PpToComDbgFD14Tx_FD14_SC_ModuleState_STM_Rear: accessed-variable=PpToComDbgFD14Tx.FD14_SC_ModuleState_STM_Rear
            SEND_PpToComDbgFD14Tx_FD14_SC_ModuleState_STM_Right: accessed-variable=PpToComDbgFD14Tx.FD14_SC_ModuleState_STM_Right
            SEND_PpToComDbgFD14Tx_FD14_STM_v_TRGAUTO_BTN_PRESSED_b: accessed-variable=PpToComDbgFD14Tx.FD14_STM_v_TRGAUTO_BTN_PRESSED_b
            SEND_PpToComDbgFD14Tx_FD14_STM_v_TRGLEFT_BTN_PRESSED_b: accessed-variable=PpToComDbgFD14Tx.FD14_STM_v_TRGLEFT_BTN_PRESSED_b
            SEND_PpToComDbgFD14Tx_FD14_STM_v_TRGRIGHT_BTN_PRESSED_b: accessed-variable=PpToComDbgFD14Tx.FD14_STM_v_TRGRIGHT_BTN_PRESSED_b
            SEND_PpToComDbgFD14Tx_FD14_SVC_Delay_Feature_b: accessed-variable=PpToComDbgFD14Tx.FD14_SVC_Delay_Feature_b
            SEND_PpToComDbgFD14Tx_FD14_SVC_Dynamic_Gridlines_Feature_b: accessed-variable=PpToComDbgFD14Tx.FD14_SVC_Dynamic_Gridlines_Feature_b
            SEND_PpToComDbgFD14Tx_FD14_SVC_FFCV_Gridlines_Feature_b: accessed-variable=PpToComDbgFD14Tx.FD14_SVC_FFCV_Gridlines_Feature_b
            SEND_PpToComDbgFD14Tx_FD14_SVC_Static_Gridlines_Feature_b: accessed-variable=PpToComDbgFD14Tx.FD14_SVC_Static_Gridlines_Feature_b
            SEND_PpToComDbgFD14Tx_FD14_SnrDat_FIL_Dir1_cm: accessed-variable=PpToComDbgFD14Tx.FD14_SnrDat_FIL_Dir1_cm
            SEND_PpToComDbgFD14Tx_FD14_SnrDat_FIL_Dir2_cm: accessed-variable=PpToComDbgFD14Tx.FD14_SnrDat_FIL_Dir2_cm
            SEND_PpToComDbgFD14Tx_FD14_SnrDat_FIR_Dir1_cm: accessed-variable=PpToComDbgFD14Tx.FD14_SnrDat_FIR_Dir1_cm
            SEND_PpToComDbgFD14Tx_FD14_SnrDat_FIR_Dir2_cm: accessed-variable=PpToComDbgFD14Tx.FD14_SnrDat_FIR_Dir2_cm
            SEND_PpToComDbgFD14Tx_FD14_SnrDat_FOL_Dir1_cm: accessed-variable=PpToComDbgFD14Tx.FD14_SnrDat_FOL_Dir1_cm
            SEND_PpToComDbgFD14Tx_FD14_SnrDat_FOL_Dir2_cm: accessed-variable=PpToComDbgFD14Tx.FD14_SnrDat_FOL_Dir2_cm
            SEND_PpToComDbgFD14Tx_FD14_SnrDat_FOR_Dir1_cm: accessed-variable=PpToComDbgFD14Tx.FD14_SnrDat_FOR_Dir1_cm
            SEND_PpToComDbgFD14Tx_FD14_SnrDat_FOR_Dir2_cm: accessed-variable=PpToComDbgFD14Tx.FD14_SnrDat_FOR_Dir2_cm
            SEND_PpToComDbgFD14Tx_FD14_SnrDat_FSL_Dir1_cm: accessed-variable=PpToComDbgFD14Tx.FD14_SnrDat_FSL_Dir1_cm
            SEND_PpToComDbgFD14Tx_FD14_SnrDat_FSL_Dir2_cm: accessed-variable=PpToComDbgFD14Tx.FD14_SnrDat_FSL_Dir2_cm
            SEND_PpToComDbgFD14Tx_FD14_SnrDat_FSR_Dir1_cm: accessed-variable=PpToComDbgFD14Tx.FD14_SnrDat_FSR_Dir1_cm
            SEND_PpToComDbgFD14Tx_FD14_SnrDat_FSR_Dir2_cm: accessed-variable=PpToComDbgFD14Tx.FD14_SnrDat_FSR_Dir2_cm
            SEND_PpToComDbgFD14Tx_FD14_SnrDat_RIL_Dir1_cm: accessed-variable=PpToComDbgFD14Tx.FD14_SnrDat_RIL_Dir1_cm
            SEND_PpToComDbgFD14Tx_FD14_SnrDat_RIL_Dir2_cm: accessed-variable=PpToComDbgFD14Tx.FD14_SnrDat_RIL_Dir2_cm
            SEND_PpToComDbgFD14Tx_FD14_SnrDat_RIR_Dir1_cm: accessed-variable=PpToComDbgFD14Tx.FD14_SnrDat_RIR_Dir1_cm
            SEND_PpToComDbgFD14Tx_FD14_SnrDat_RIR_Dir2_cm: accessed-variable=PpToComDbgFD14Tx.FD14_SnrDat_RIR_Dir2_cm
            SEND_PpToComDbgFD14Tx_FD14_SnrDat_ROL_Dir1_cm: accessed-variable=PpToComDbgFD14Tx.FD14_SnrDat_ROL_Dir1_cm
            SEND_PpToComDbgFD14Tx_FD14_SnrDat_ROL_Dir2_cm: accessed-variable=PpToComDbgFD14Tx.FD14_SnrDat_ROL_Dir2_cm
            SEND_PpToComDbgFD14Tx_FD14_SnrDat_ROR_Dir1_cm: accessed-variable=PpToComDbgFD14Tx.FD14_SnrDat_ROR_Dir1_cm
            SEND_PpToComDbgFD14Tx_FD14_SnrDat_ROR_Dir2_cm: accessed-variable=PpToComDbgFD14Tx.FD14_SnrDat_ROR_Dir2_cm
            SEND_PpToComDbgFD14Tx_FD14_SnrDat_RSL_Dir1_cm: accessed-variable=PpToComDbgFD14Tx.FD14_SnrDat_RSL_Dir1_cm
            SEND_PpToComDbgFD14Tx_FD14_SnrDat_RSL_Dir2_cm: accessed-variable=PpToComDbgFD14Tx.FD14_SnrDat_RSL_Dir2_cm
            SEND_PpToComDbgFD14Tx_FD14_SnrDat_RSR_Dir1_cm: accessed-variable=PpToComDbgFD14Tx.FD14_SnrDat_RSR_Dir1_cm
            SEND_PpToComDbgFD14Tx_FD14_SnrDat_RSR_Dir2_cm: accessed-variable=PpToComDbgFD14Tx.FD14_SnrDat_RSR_Dir2_cm
            SEND_PpToComDbgFD14Tx_FD14_SnrDat_sFIL_Indir_FIR_cm: accessed-variable=PpToComDbgFD14Tx.FD14_SnrDat_sFIL_Indir_FIR_cm
            SEND_PpToComDbgFD14Tx_FD14_SnrDat_sFIL_Indir_FOL_cm: accessed-variable=PpToComDbgFD14Tx.FD14_SnrDat_sFIL_Indir_FOL_cm
            SEND_PpToComDbgFD14Tx_FD14_SnrDat_sFIR_Indir_FIL_cm: accessed-variable=PpToComDbgFD14Tx.FD14_SnrDat_sFIR_Indir_FIL_cm
            SEND_PpToComDbgFD14Tx_FD14_SnrDat_sFIR_Indir_FOR_cm: accessed-variable=PpToComDbgFD14Tx.FD14_SnrDat_sFIR_Indir_FOR_cm
            SEND_PpToComDbgFD14Tx_FD14_SnrDat_sFOL_Indir_FIL_cm: accessed-variable=PpToComDbgFD14Tx.FD14_SnrDat_sFOL_Indir_FIL_cm
            SEND_PpToComDbgFD14Tx_FD14_SnrDat_sFOL_Indir_FSL_cm: accessed-variable=PpToComDbgFD14Tx.FD14_SnrDat_sFOL_Indir_FSL_cm
            SEND_PpToComDbgFD14Tx_FD14_SnrDat_sFOR_Indir_FIR_cm: accessed-variable=PpToComDbgFD14Tx.FD14_SnrDat_sFOR_Indir_FIR_cm
            SEND_PpToComDbgFD14Tx_FD14_SnrDat_sFOR_Indir_FSR_cm: accessed-variable=PpToComDbgFD14Tx.FD14_SnrDat_sFOR_Indir_FSR_cm
            SEND_PpToComDbgFD14Tx_FD14_SnrDat_sFSL_Indir_FOL_cm: accessed-variable=PpToComDbgFD14Tx.FD14_SnrDat_sFSL_Indir_FOL_cm
            SEND_PpToComDbgFD14Tx_FD14_SnrDat_sFSR_Indir_FOR_cm: accessed-variable=PpToComDbgFD14Tx.FD14_SnrDat_sFSR_Indir_FOR_cm
            SEND_PpToComDbgFD14Tx_FD14_SnrDat_sRIL_Indir_RIR_cm: accessed-variable=PpToComDbgFD14Tx.FD14_SnrDat_sRIL_Indir_RIR_cm
            SEND_PpToComDbgFD14Tx_FD14_SnrDat_sRIL_Indir_ROL_cm: accessed-variable=PpToComDbgFD14Tx.FD14_SnrDat_sRIL_Indir_ROL_cm
            SEND_PpToComDbgFD14Tx_FD14_SnrDat_sRIR_Indir_RIL_cm: accessed-variable=PpToComDbgFD14Tx.FD14_SnrDat_sRIR_Indir_RIL_cm
            SEND_PpToComDbgFD14Tx_FD14_SnrDat_sRIR_Indir_ROR_cm: accessed-variable=PpToComDbgFD14Tx.FD14_SnrDat_sRIR_Indir_ROR_cm
            SEND_PpToComDbgFD14Tx_FD14_SnrDat_sROL_Indir_RIL_cm: accessed-variable=PpToComDbgFD14Tx.FD14_SnrDat_sROL_Indir_RIL_cm
            SEND_PpToComDbgFD14Tx_FD14_SnrDat_sROL_Indir_RSL_cm: accessed-variable=PpToComDbgFD14Tx.FD14_SnrDat_sROL_Indir_RSL_cm
            SEND_PpToComDbgFD14Tx_FD14_SnrDat_sROR_Indir_RIR_cm: accessed-variable=PpToComDbgFD14Tx.FD14_SnrDat_sROR_Indir_RIR_cm
            SEND_PpToComDbgFD14Tx_FD14_SnrDat_sROR_Indir_RSR_cm: accessed-variable=PpToComDbgFD14Tx.FD14_SnrDat_sROR_Indir_RSR_cm
            SEND_PpToComDbgFD14Tx_FD14_SnrDat_sRSL_Indir_ROL_cm: accessed-variable=PpToComDbgFD14Tx.FD14_SnrDat_sRSL_Indir_ROL_cm
            SEND_PpToComDbgFD14Tx_FD14_SnrDat_sRSR_Indir_ROR_cm: accessed-variable=PpToComDbgFD14Tx.FD14_SnrDat_sRSR_Indir_ROR_cm
            SEND_PpToComDbgFD14Tx_FD14_SnrMeasDataChecksum: accessed-variable=PpToComDbgFD14Tx.FD14_SnrMeasDataChecksum
            SEND_PpToComDbgFD14Tx_FD14_SoftBtn_Error_e: accessed-variable=PpToComDbgFD14Tx.FD14_SoftBtn_Error_e
            SEND_PpToComDbgFD14Tx_FD14_SrvCamIndBaNok_b: accessed-variable=PpToComDbgFD14Tx.FD14_SrvCamIndBaNok_b
            SEND_PpToComDbgFD14Tx_FD14_SrvCamIndBaNone_b: accessed-variable=PpToComDbgFD14Tx.FD14_SrvCamIndBaNone_b
            SEND_PpToComDbgFD14Tx_FD14_SrvCamIndBaOk_b: accessed-variable=PpToComDbgFD14Tx.FD14_SrvCamIndBaOk_b
            SEND_PpToComDbgFD14Tx_FD14_SrvCamIndBaPend_b: accessed-variable=PpToComDbgFD14Tx.FD14_SrvCamIndBaPend_b
            SEND_PpToComDbgFD14Tx_FD14_SrvCamIndFrNok_b: accessed-variable=PpToComDbgFD14Tx.FD14_SrvCamIndFrNok_b
            SEND_PpToComDbgFD14Tx_FD14_SrvCamIndFrNone_b: accessed-variable=PpToComDbgFD14Tx.FD14_SrvCamIndFrNone_b
            SEND_PpToComDbgFD14Tx_FD14_SrvCamIndFrOk_b: accessed-variable=PpToComDbgFD14Tx.FD14_SrvCamIndFrOk_b
            SEND_PpToComDbgFD14Tx_FD14_SrvCamIndFrPend_b: accessed-variable=PpToComDbgFD14Tx.FD14_SrvCamIndFrPend_b
            SEND_PpToComDbgFD14Tx_FD14_SrvCamIndLeNok_b: accessed-variable=PpToComDbgFD14Tx.FD14_SrvCamIndLeNok_b
            SEND_PpToComDbgFD14Tx_FD14_SrvCamIndLeNone_b: accessed-variable=PpToComDbgFD14Tx.FD14_SrvCamIndLeNone_b
            SEND_PpToComDbgFD14Tx_FD14_SrvCamIndLeOk_b: accessed-variable=PpToComDbgFD14Tx.FD14_SrvCamIndLeOk_b
            SEND_PpToComDbgFD14Tx_FD14_SrvCamIndLePend_b: accessed-variable=PpToComDbgFD14Tx.FD14_SrvCamIndLePend_b
            SEND_PpToComDbgFD14Tx_FD14_SrvCamIndRiNok_b: accessed-variable=PpToComDbgFD14Tx.FD14_SrvCamIndRiNok_b
            SEND_PpToComDbgFD14Tx_FD14_SrvCamIndRiNone_b: accessed-variable=PpToComDbgFD14Tx.FD14_SrvCamIndRiNone_b
            SEND_PpToComDbgFD14Tx_FD14_SrvCamIndRiOk_b: accessed-variable=PpToComDbgFD14Tx.FD14_SrvCamIndRiOk_b
            SEND_PpToComDbgFD14Tx_FD14_SrvCamIndRiPend_b: accessed-variable=PpToComDbgFD14Tx.FD14_SrvCamIndRiPend_b
            SEND_PpToComDbgFD14Tx_FD14_SrvChkIndCondNok_b: accessed-variable=PpToComDbgFD14Tx.FD14_SrvChkIndCondNok_b
            SEND_PpToComDbgFD14Tx_FD14_SrvChkIndNok_b: accessed-variable=PpToComDbgFD14Tx.FD14_SrvChkIndNok_b
            SEND_PpToComDbgFD14Tx_FD14_SrvChkIndOk_b: accessed-variable=PpToComDbgFD14Tx.FD14_SrvChkIndOk_b
            SEND_PpToComDbgFD14Tx_FD14_SrvChkIndRun_b: accessed-variable=PpToComDbgFD14Tx.FD14_SrvChkIndRun_b
            SEND_PpToComDbgFD14Tx_FD14_SrvLayout_b: accessed-variable=PpToComDbgFD14Tx.FD14_SrvLayout_b
            SEND_PpToComDbgFD14Tx_FD14_SrvPrgBar0Per_b: accessed-variable=PpToComDbgFD14Tx.FD14_SrvPrgBar0Per_b
            SEND_PpToComDbgFD14Tx_FD14_SrvPrgBar100Per_b: accessed-variable=PpToComDbgFD14Tx.FD14_SrvPrgBar100Per_b
            SEND_PpToComDbgFD14Tx_FD14_SrvPrgBar20Per_b: accessed-variable=PpToComDbgFD14Tx.FD14_SrvPrgBar20Per_b
            SEND_PpToComDbgFD14Tx_FD14_SrvPrgBar40Per_b: accessed-variable=PpToComDbgFD14Tx.FD14_SrvPrgBar40Per_b
            SEND_PpToComDbgFD14Tx_FD14_SrvPrgBar60Per_b: accessed-variable=PpToComDbgFD14Tx.FD14_SrvPrgBar60Per_b
            SEND_PpToComDbgFD14Tx_FD14_SrvPrgBar80Per_b: accessed-variable=PpToComDbgFD14Tx.FD14_SrvPrgBar80Per_b
            SEND_PpToComDbgFD14Tx_FD14_SrvSpOmIndNok_b: accessed-variable=PpToComDbgFD14Tx.FD14_SrvSpOmIndNok_b
            SEND_PpToComDbgFD14Tx_FD14_SrvSpOmIndOk_b: accessed-variable=PpToComDbgFD14Tx.FD14_SrvSpOmIndOk_b
            SEND_PpToComDbgFD14Tx_FD14_SrvStAngIndNok_b: accessed-variable=PpToComDbgFD14Tx.FD14_SrvStAngIndNok_b
            SEND_PpToComDbgFD14Tx_FD14_SrvStAngIndOk_b: accessed-variable=PpToComDbgFD14Tx.FD14_SrvStAngIndOk_b
            SEND_PpToComDbgFD14Tx_FD14_SystemMode: accessed-variable=PpToComDbgFD14Tx.FD14_SystemMode
            SEND_PpToComDbgFD14Tx_FD14_SystemStatus: accessed-variable=PpToComDbgFD14Tx.FD14_SystemStatus
            SEND_PpToComDbgFD14Tx_FD14_TADAngleRate: accessed-variable=PpToComDbgFD14Tx.FD14_TADAngleRate
            SEND_PpToComDbgFD14Tx_FD14_THAButtonGrey: accessed-variable=PpToComDbgFD14Tx.FD14_THAButtonGrey
            SEND_PpToComDbgFD14Tx_FD14_THAButtonSelectable: accessed-variable=PpToComDbgFD14Tx.FD14_THAButtonSelectable
            SEND_PpToComDbgFD14Tx_FD14_THAConfirmButton: accessed-variable=PpToComDbgFD14Tx.FD14_THAConfirmButton
            SEND_PpToComDbgFD14Tx_FD14_THACouplerBulletIcon: accessed-variable=PpToComDbgFD14Tx.FD14_THACouplerBulletIcon
            SEND_PpToComDbgFD14Tx_FD14_THAProgressBar: accessed-variable=PpToComDbgFD14Tx.FD14_THAProgressBar
            SEND_PpToComDbgFD14Tx_FD14_THAStartButton: accessed-variable=PpToComDbgFD14Tx.FD14_THAStartButton
            SEND_PpToComDbgFD14Tx_FD14_THATriangleOverlay: accessed-variable=PpToComDbgFD14Tx.FD14_THATriangleOverlay
            SEND_PpToComDbgFD14Tx_FD14_TadAngle: accessed-variable=PpToComDbgFD14Tx.FD14_TadAngle
            SEND_PpToComDbgFD14Tx_FD14_TargetDetectLeftFront_Front_s8: accessed-variable=PpToComDbgFD14Tx.FD14_TargetDetectLeftFront_Front_s8
            SEND_PpToComDbgFD14Tx_FD14_TargetDetectLeftFront_Left_s8: accessed-variable=PpToComDbgFD14Tx.FD14_TargetDetectLeftFront_Left_s8
            SEND_PpToComDbgFD14Tx_FD14_TargetDetectLeftFront_Rear_s8: accessed-variable=PpToComDbgFD14Tx.FD14_TargetDetectLeftFront_Rear_s8
            SEND_PpToComDbgFD14Tx_FD14_TargetDetectLeftFront_Right_s8: accessed-variable=PpToComDbgFD14Tx.FD14_TargetDetectLeftFront_Right_s8
            SEND_PpToComDbgFD14Tx_FD14_TargetDetectLeftRear_Front_s8: accessed-variable=PpToComDbgFD14Tx.FD14_TargetDetectLeftRear_Front_s8
            SEND_PpToComDbgFD14Tx_FD14_TargetDetectLeftRear_Rear_s8: accessed-variable=PpToComDbgFD14Tx.FD14_TargetDetectLeftRear_Rear_s8
            SEND_PpToComDbgFD14Tx_FD14_TargetDetectLeftRear_Right_s8: accessed-variable=PpToComDbgFD14Tx.FD14_TargetDetectLeftRear_Right_s8
            SEND_PpToComDbgFD14Tx_FD14_TargetDetectRightFront_Front_s8: accessed-variable=PpToComDbgFD14Tx.FD14_TargetDetectRightFront_Front_s8
            SEND_PpToComDbgFD14Tx_FD14_TargetDetectRightFront_Left_s8: accessed-variable=PpToComDbgFD14Tx.FD14_TargetDetectRightFront_Left_s8
            SEND_PpToComDbgFD14Tx_FD14_TargetDetectRightFront_Rear_s8: accessed-variable=PpToComDbgFD14Tx.FD14_TargetDetectRightFront_Rear_s8
            SEND_PpToComDbgFD14Tx_FD14_TargetDetectRightFront_Right_s8: accessed-variable=PpToComDbgFD14Tx.FD14_TargetDetectRightFront_Right_s8
            SEND_PpToComDbgFD14Tx_FD14_TargetDetectRightRear_Front_s8: accessed-variable=PpToComDbgFD14Tx.FD14_TargetDetectRightRear_Front_s8
            SEND_PpToComDbgFD14Tx_FD14_TargetDetectRightRear_Left_s8: accessed-variable=PpToComDbgFD14Tx.FD14_TargetDetectRightRear_Left_s8
            SEND_PpToComDbgFD14Tx_FD14_TargetDetectRightRear_Rear_s8: accessed-variable=PpToComDbgFD14Tx.FD14_TargetDetectRightRear_Rear_s8
            SEND_PpToComDbgFD14Tx_FD14_TargetDetectRightRear_Right_s8: accessed-variable=PpToComDbgFD14Tx.FD14_TargetDetectRightRear_Right_s8
            SEND_PpToComDbgFD14Tx_FD14_TargetInit_Front_s8: accessed-variable=PpToComDbgFD14Tx.FD14_TargetInit_Front_s8
            SEND_PpToComDbgFD14Tx_FD14_TargetInit_Left_s8: accessed-variable=PpToComDbgFD14Tx.FD14_TargetInit_Left_s8
            SEND_PpToComDbgFD14Tx_FD14_TargetInit_Rear_s8: accessed-variable=PpToComDbgFD14Tx.FD14_TargetInit_Rear_s8
            SEND_PpToComDbgFD14Tx_FD14_TargetInit_Right_s8: accessed-variable=PpToComDbgFD14Tx.FD14_TargetInit_Right_s8
            SEND_PpToComDbgFD14Tx_FD14_TargetLimitFront_Front_s8: accessed-variable=PpToComDbgFD14Tx.FD14_TargetLimitFront_Front_s8
            SEND_PpToComDbgFD14Tx_FD14_TargetLimitFront_Left_s8: accessed-variable=PpToComDbgFD14Tx.FD14_TargetLimitFront_Left_s8
            SEND_PpToComDbgFD14Tx_FD14_TargetLimitFront_Rear_s8: accessed-variable=PpToComDbgFD14Tx.FD14_TargetLimitFront_Rear_s8
            SEND_PpToComDbgFD14Tx_FD14_TargetLimitFront_Right_s8: accessed-variable=PpToComDbgFD14Tx.FD14_TargetLimitFront_Right_s8
            SEND_PpToComDbgFD14Tx_FD14_TargetLimitRear_Front_s8: accessed-variable=PpToComDbgFD14Tx.FD14_TargetLimitRear_Front_s8
            SEND_PpToComDbgFD14Tx_FD14_TargetLimitRear_Left_s8: accessed-variable=PpToComDbgFD14Tx.FD14_TargetLimitRear_Left_s8
            SEND_PpToComDbgFD14Tx_FD14_TargetLimitRear_Rear_s8: accessed-variable=PpToComDbgFD14Tx.FD14_TargetLimitRear_Rear_s8
            SEND_PpToComDbgFD14Tx_FD14_TargetLimitRear_Right_s8: accessed-variable=PpToComDbgFD14Tx.FD14_TargetLimitRear_Right_s8
            SEND_PpToComDbgFD14Tx_FD14_TimeStamp_SystemStatus: accessed-variable=PpToComDbgFD14Tx.FD14_TimeStamp_SystemStatus
            SEND_PpToComDbgFD14Tx_FD14_TopFrontButtonNoSelect_b: accessed-variable=PpToComDbgFD14Tx.FD14_TopFrontButtonNoSelect_b
            SEND_PpToComDbgFD14Tx_FD14_TopFrontButtonSelect_b: accessed-variable=PpToComDbgFD14Tx.FD14_TopFrontButtonSelect_b
            SEND_PpToComDbgFD14Tx_FD14_TopRearButtonNoSelect_b: accessed-variable=PpToComDbgFD14Tx.FD14_TopRearButtonNoSelect_b
            SEND_PpToComDbgFD14Tx_FD14_TopRearButtonSelect_b: accessed-variable=PpToComDbgFD14Tx.FD14_TopRearButtonSelect_b
            SEND_PpToComDbgFD14Tx_FD14_TopVideoBlanked_b: accessed-variable=PpToComDbgFD14Tx.FD14_TopVideoBlanked_b
            SEND_PpToComDbgFD14Tx_FD14_TopViewBlack_b: accessed-variable=PpToComDbgFD14Tx.FD14_TopViewBlack_b
            SEND_PpToComDbgFD14Tx_FD14_TopViewFrontDynamics_b: accessed-variable=PpToComDbgFD14Tx.FD14_TopViewFrontDynamics_b
            SEND_PpToComDbgFD14Tx_FD14_TopViewRearDynamics_b: accessed-variable=PpToComDbgFD14Tx.FD14_TopViewRearDynamics_b
            SEND_PpToComDbgFD14Tx_FD14_Total_lines_count: accessed-variable=PpToComDbgFD14Tx.FD14_Total_lines_count
            SEND_PpToComDbgFD14Tx_FD14_TrailerAngleSign: accessed-variable=PpToComDbgFD14Tx.FD14_TrailerAngleSign
            SEND_PpToComDbgFD14Tx_FD14_TrailerCalFailInfo: accessed-variable=PpToComDbgFD14Tx.FD14_TrailerCalFailInfo
            SEND_PpToComDbgFD14Tx_FD14_TrailerCalibrationStatus: accessed-variable=PpToComDbgFD14Tx.FD14_TrailerCalibrationStatus
            SEND_PpToComDbgFD14Tx_FD14_TrailerConnectionStatus: accessed-variable=PpToComDbgFD14Tx.FD14_TrailerConnectionStatus
            SEND_PpToComDbgFD14Tx_FD14_TrailerWheelBase: accessed-variable=PpToComDbgFD14Tx.FD14_TrailerWheelBase
            SEND_PpToComDbgFD14Tx_FD14_Trailer_Recognition_Confidence: accessed-variable=PpToComDbgFD14Tx.FD14_Trailer_Recognition_Confidence
            SEND_PpToComDbgFD14Tx_FD14_Trailer_tracking_confidence: accessed-variable=PpToComDbgFD14Tx.FD14_Trailer_tracking_confidence
            SEND_PpToComDbgFD14Tx_FD14_Trailercalinfo: accessed-variable=PpToComDbgFD14Tx.FD14_Trailercalinfo
            SEND_PpToComDbgFD14Tx_FD14_TrscJackKnifeOrange: accessed-variable=PpToComDbgFD14Tx.FD14_TrscJackKnifeOrange
            SEND_PpToComDbgFD14Tx_FD14_TrscJackKnifeRed: accessed-variable=PpToComDbgFD14Tx.FD14_TrscJackKnifeRed
            SEND_PpToComDbgFD14Tx_FD14_TrscOvl: accessed-variable=PpToComDbgFD14Tx.FD14_TrscOvl
            SEND_PpToComDbgFD14Tx_FD14_TrscStatus: accessed-variable=PpToComDbgFD14Tx.FD14_TrscStatus
            SEND_PpToComDbgFD14Tx_FD14_TrscTrailerRed: accessed-variable=PpToComDbgFD14Tx.FD14_TrscTrailerRed
            SEND_PpToComDbgFD14Tx_FD14_Tstr_SD_FIL_DrvFreq: accessed-variable=PpToComDbgFD14Tx.FD14_Tstr_SD_FIL_DrvFreq
            SEND_PpToComDbgFD14Tx_FD14_Tstr_SD_FIL_EchoHeight_adc: accessed-variable=PpToComDbgFD14Tx.FD14_Tstr_SD_FIL_EchoHeight_adc
            SEND_PpToComDbgFD14Tx_FD14_Tstr_SD_FIL_RingFreq: accessed-variable=PpToComDbgFD14Tx.FD14_Tstr_SD_FIL_RingFreq
            SEND_PpToComDbgFD14Tx_FD14_Tstr_SD_FIL_Ringtime_us: accessed-variable=PpToComDbgFD14Tx.FD14_Tstr_SD_FIL_Ringtime_us
            SEND_PpToComDbgFD14Tx_FD14_Tstr_SD_FIL_SensorBlkgClrCounter: accessed-variable=PpToComDbgFD14Tx.FD14_Tstr_SD_FIL_SensorBlkgClrCounter
            SEND_PpToComDbgFD14Tx_FD14_Tstr_SD_FIL_SensorBlkgSetCounter: accessed-variable=PpToComDbgFD14Tx.FD14_Tstr_SD_FIL_SensorBlkgSetCounter
            SEND_PpToComDbgFD14Tx_FD14_Tstr_SD_FIL_Unfiltered_DirDist1: accessed-variable=PpToComDbgFD14Tx.FD14_Tstr_SD_FIL_Unfiltered_DirDist1
            SEND_PpToComDbgFD14Tx_FD14_Tstr_SD_FIL_Unfiltered_DirDist2: accessed-variable=PpToComDbgFD14Tx.FD14_Tstr_SD_FIL_Unfiltered_DirDist2
            SEND_PpToComDbgFD14Tx_FD14_Tstr_SD_FIR_DrvFreq: accessed-variable=PpToComDbgFD14Tx.FD14_Tstr_SD_FIR_DrvFreq
            SEND_PpToComDbgFD14Tx_FD14_Tstr_SD_FIR_EchoHeight_adc: accessed-variable=PpToComDbgFD14Tx.FD14_Tstr_SD_FIR_EchoHeight_adc
            SEND_PpToComDbgFD14Tx_FD14_Tstr_SD_FIR_RingFreq: accessed-variable=PpToComDbgFD14Tx.FD14_Tstr_SD_FIR_RingFreq
            SEND_PpToComDbgFD14Tx_FD14_Tstr_SD_FIR_Ringtime_us: accessed-variable=PpToComDbgFD14Tx.FD14_Tstr_SD_FIR_Ringtime_us
            SEND_PpToComDbgFD14Tx_FD14_Tstr_SD_FIR_SensorBlkgClrCounter: accessed-variable=PpToComDbgFD14Tx.FD14_Tstr_SD_FIR_SensorBlkgClrCounter
            SEND_PpToComDbgFD14Tx_FD14_Tstr_SD_FIR_SensorBlkgSetCounter: accessed-variable=PpToComDbgFD14Tx.FD14_Tstr_SD_FIR_SensorBlkgSetCounter
            SEND_PpToComDbgFD14Tx_FD14_Tstr_SD_FIR_Unfiltered_DirDist1: accessed-variable=PpToComDbgFD14Tx.FD14_Tstr_SD_FIR_Unfiltered_DirDist1
            SEND_PpToComDbgFD14Tx_FD14_Tstr_SD_FIR_Unfiltered_DirDist2: accessed-variable=PpToComDbgFD14Tx.FD14_Tstr_SD_FIR_Unfiltered_DirDist2
            SEND_PpToComDbgFD14Tx_FD14_Tstr_SD_FOL_DrvFreq: accessed-variable=PpToComDbgFD14Tx.FD14_Tstr_SD_FOL_DrvFreq
            SEND_PpToComDbgFD14Tx_FD14_Tstr_SD_FOL_EchoHeight_adc: accessed-variable=PpToComDbgFD14Tx.FD14_Tstr_SD_FOL_EchoHeight_adc
            SEND_PpToComDbgFD14Tx_FD14_Tstr_SD_FOL_RingFreq: accessed-variable=PpToComDbgFD14Tx.FD14_Tstr_SD_FOL_RingFreq
            SEND_PpToComDbgFD14Tx_FD14_Tstr_SD_FOL_Ringtime_us: accessed-variable=PpToComDbgFD14Tx.FD14_Tstr_SD_FOL_Ringtime_us
            SEND_PpToComDbgFD14Tx_FD14_Tstr_SD_FOL_SensorBlkgClrCounter: accessed-variable=PpToComDbgFD14Tx.FD14_Tstr_SD_FOL_SensorBlkgClrCounter
            SEND_PpToComDbgFD14Tx_FD14_Tstr_SD_FOL_SensorBlkgSetCounter: accessed-variable=PpToComDbgFD14Tx.FD14_Tstr_SD_FOL_SensorBlkgSetCounter
            SEND_PpToComDbgFD14Tx_FD14_Tstr_SD_FOL_Unfiltered_DirDist1: accessed-variable=PpToComDbgFD14Tx.FD14_Tstr_SD_FOL_Unfiltered_DirDist1
            SEND_PpToComDbgFD14Tx_FD14_Tstr_SD_FOL_Unfiltered_DirDist2: accessed-variable=PpToComDbgFD14Tx.FD14_Tstr_SD_FOL_Unfiltered_DirDist2
            SEND_PpToComDbgFD14Tx_FD14_Tstr_SD_FOR_DrvFreq: accessed-variable=PpToComDbgFD14Tx.FD14_Tstr_SD_FOR_DrvFreq
            SEND_PpToComDbgFD14Tx_FD14_Tstr_SD_FOR_EchoHeight_adc: accessed-variable=PpToComDbgFD14Tx.FD14_Tstr_SD_FOR_EchoHeight_adc
            SEND_PpToComDbgFD14Tx_FD14_Tstr_SD_FOR_RingFreq: accessed-variable=PpToComDbgFD14Tx.FD14_Tstr_SD_FOR_RingFreq
            SEND_PpToComDbgFD14Tx_FD14_Tstr_SD_FOR_Ringtime_us: accessed-variable=PpToComDbgFD14Tx.FD14_Tstr_SD_FOR_Ringtime_us
            SEND_PpToComDbgFD14Tx_FD14_Tstr_SD_FOR_SensorBlkgClrCounter: accessed-variable=PpToComDbgFD14Tx.FD14_Tstr_SD_FOR_SensorBlkgClrCounter
            SEND_PpToComDbgFD14Tx_FD14_Tstr_SD_FOR_SensorBlkgSetCounter: accessed-variable=PpToComDbgFD14Tx.FD14_Tstr_SD_FOR_SensorBlkgSetCounter
            SEND_PpToComDbgFD14Tx_FD14_Tstr_SD_FOR_Unfiltered_DirDist1: accessed-variable=PpToComDbgFD14Tx.FD14_Tstr_SD_FOR_Unfiltered_DirDist1
            SEND_PpToComDbgFD14Tx_FD14_Tstr_SD_FOR_Unfiltered_DirDist2: accessed-variable=PpToComDbgFD14Tx.FD14_Tstr_SD_FOR_Unfiltered_DirDist2
            SEND_PpToComDbgFD14Tx_FD14_Tstr_SD_FSL_DrvFreq: accessed-variable=PpToComDbgFD14Tx.FD14_Tstr_SD_FSL_DrvFreq
            SEND_PpToComDbgFD14Tx_FD14_Tstr_SD_FSL_EchoHeight_adc: accessed-variable=PpToComDbgFD14Tx.FD14_Tstr_SD_FSL_EchoHeight_adc
            SEND_PpToComDbgFD14Tx_FD14_Tstr_SD_FSL_RingFreq: accessed-variable=PpToComDbgFD14Tx.FD14_Tstr_SD_FSL_RingFreq
            SEND_PpToComDbgFD14Tx_FD14_Tstr_SD_FSL_Ringtime_us: accessed-variable=PpToComDbgFD14Tx.FD14_Tstr_SD_FSL_Ringtime_us
            SEND_PpToComDbgFD14Tx_FD14_Tstr_SD_FSL_SensorBlkgClrCounter: accessed-variable=PpToComDbgFD14Tx.FD14_Tstr_SD_FSL_SensorBlkgClrCounter
            SEND_PpToComDbgFD14Tx_FD14_Tstr_SD_FSL_SensorBlkgSetCounter: accessed-variable=PpToComDbgFD14Tx.FD14_Tstr_SD_FSL_SensorBlkgSetCounter
            SEND_PpToComDbgFD14Tx_FD14_Tstr_SD_FSL_Unfiltered_DirDist1: accessed-variable=PpToComDbgFD14Tx.FD14_Tstr_SD_FSL_Unfiltered_DirDist1
            SEND_PpToComDbgFD14Tx_FD14_Tstr_SD_FSL_Unfiltered_DirDist2: accessed-variable=PpToComDbgFD14Tx.FD14_Tstr_SD_FSL_Unfiltered_DirDist2
            SEND_PpToComDbgFD14Tx_FD14_Tstr_SD_FSR_DrvFreq: accessed-variable=PpToComDbgFD14Tx.FD14_Tstr_SD_FSR_DrvFreq
            SEND_PpToComDbgFD14Tx_FD14_Tstr_SD_FSR_EchoHeight_adc: accessed-variable=PpToComDbgFD14Tx.FD14_Tstr_SD_FSR_EchoHeight_adc
            SEND_PpToComDbgFD14Tx_FD14_Tstr_SD_FSR_RingFreq: accessed-variable=PpToComDbgFD14Tx.FD14_Tstr_SD_FSR_RingFreq
            SEND_PpToComDbgFD14Tx_FD14_Tstr_SD_FSR_Ringtime_us: accessed-variable=PpToComDbgFD14Tx.FD14_Tstr_SD_FSR_Ringtime_us
            SEND_PpToComDbgFD14Tx_FD14_Tstr_SD_FSR_SensorBlkgClrCounter: accessed-variable=PpToComDbgFD14Tx.FD14_Tstr_SD_FSR_SensorBlkgClrCounter
            SEND_PpToComDbgFD14Tx_FD14_Tstr_SD_FSR_SensorBlkgSetCounter: accessed-variable=PpToComDbgFD14Tx.FD14_Tstr_SD_FSR_SensorBlkgSetCounter
            SEND_PpToComDbgFD14Tx_FD14_Tstr_SD_FSR_Unfiltered_DirDist1: accessed-variable=PpToComDbgFD14Tx.FD14_Tstr_SD_FSR_Unfiltered_DirDist1
            SEND_PpToComDbgFD14Tx_FD14_Tstr_SD_FSR_Unfiltered_DirDist2: accessed-variable=PpToComDbgFD14Tx.FD14_Tstr_SD_FSR_Unfiltered_DirDist2
            SEND_PpToComDbgFD14Tx_FD14_Tstr_SD_RIL_DrvFreq: accessed-variable=PpToComDbgFD14Tx.FD14_Tstr_SD_RIL_DrvFreq
            SEND_PpToComDbgFD14Tx_FD14_Tstr_SD_RIL_EchoHeight_adc: accessed-variable=PpToComDbgFD14Tx.FD14_Tstr_SD_RIL_EchoHeight_adc
            SEND_PpToComDbgFD14Tx_FD14_Tstr_SD_RIL_RingFreq: accessed-variable=PpToComDbgFD14Tx.FD14_Tstr_SD_RIL_RingFreq
            SEND_PpToComDbgFD14Tx_FD14_Tstr_SD_RIL_Ringtime_us: accessed-variable=PpToComDbgFD14Tx.FD14_Tstr_SD_RIL_Ringtime_us
            SEND_PpToComDbgFD14Tx_FD14_Tstr_SD_RIL_SensorBlkgClrCounter: accessed-variable=PpToComDbgFD14Tx.FD14_Tstr_SD_RIL_SensorBlkgClrCounter
            SEND_PpToComDbgFD14Tx_FD14_Tstr_SD_RIL_SensorBlkgSetCounter: accessed-variable=PpToComDbgFD14Tx.FD14_Tstr_SD_RIL_SensorBlkgSetCounter
            SEND_PpToComDbgFD14Tx_FD14_Tstr_SD_RIL_Unfiltered_DirDist1: accessed-variable=PpToComDbgFD14Tx.FD14_Tstr_SD_RIL_Unfiltered_DirDist1
            SEND_PpToComDbgFD14Tx_FD14_Tstr_SD_RIL_Unfiltered_DirDist2: accessed-variable=PpToComDbgFD14Tx.FD14_Tstr_SD_RIL_Unfiltered_DirDist2
            SEND_PpToComDbgFD14Tx_FD14_Tstr_SD_RIR_DrvFreq: accessed-variable=PpToComDbgFD14Tx.FD14_Tstr_SD_RIR_DrvFreq
            SEND_PpToComDbgFD14Tx_FD14_Tstr_SD_RIR_EchoHeight_adc: accessed-variable=PpToComDbgFD14Tx.FD14_Tstr_SD_RIR_EchoHeight_adc
            SEND_PpToComDbgFD14Tx_FD14_Tstr_SD_RIR_RingFreq: accessed-variable=PpToComDbgFD14Tx.FD14_Tstr_SD_RIR_RingFreq
            SEND_PpToComDbgFD14Tx_FD14_Tstr_SD_RIR_Ringtime_us: accessed-variable=PpToComDbgFD14Tx.FD14_Tstr_SD_RIR_Ringtime_us
            SEND_PpToComDbgFD14Tx_FD14_Tstr_SD_RIR_SensorBlkgClrCounter: accessed-variable=PpToComDbgFD14Tx.FD14_Tstr_SD_RIR_SensorBlkgClrCounter
            SEND_PpToComDbgFD14Tx_FD14_Tstr_SD_RIR_SensorBlkgSetCounter: accessed-variable=PpToComDbgFD14Tx.FD14_Tstr_SD_RIR_SensorBlkgSetCounter
            SEND_PpToComDbgFD14Tx_FD14_Tstr_SD_RIR_Unfiltered_DirDist1: accessed-variable=PpToComDbgFD14Tx.FD14_Tstr_SD_RIR_Unfiltered_DirDist1
            SEND_PpToComDbgFD14Tx_FD14_Tstr_SD_RIR_Unfiltered_DirDist2: accessed-variable=PpToComDbgFD14Tx.FD14_Tstr_SD_RIR_Unfiltered_DirDist2
            SEND_PpToComDbgFD14Tx_FD14_Tstr_SD_ROL_DrvFreq: accessed-variable=PpToComDbgFD14Tx.FD14_Tstr_SD_ROL_DrvFreq
            SEND_PpToComDbgFD14Tx_FD14_Tstr_SD_ROL_EchoHeight_adc: accessed-variable=PpToComDbgFD14Tx.FD14_Tstr_SD_ROL_EchoHeight_adc
            SEND_PpToComDbgFD14Tx_FD14_Tstr_SD_ROL_RingFreq: accessed-variable=PpToComDbgFD14Tx.FD14_Tstr_SD_ROL_RingFreq
            SEND_PpToComDbgFD14Tx_FD14_Tstr_SD_ROL_Ringtime_us: accessed-variable=PpToComDbgFD14Tx.FD14_Tstr_SD_ROL_Ringtime_us
            SEND_PpToComDbgFD14Tx_FD14_Tstr_SD_ROL_SensorBlkgClrCounter: accessed-variable=PpToComDbgFD14Tx.FD14_Tstr_SD_ROL_SensorBlkgClrCounter
            SEND_PpToComDbgFD14Tx_FD14_Tstr_SD_ROL_SensorBlkgSetCounter: accessed-variable=PpToComDbgFD14Tx.FD14_Tstr_SD_ROL_SensorBlkgSetCounter
            SEND_PpToComDbgFD14Tx_FD14_Tstr_SD_ROL_Unfiltered_DirDist1: accessed-variable=PpToComDbgFD14Tx.FD14_Tstr_SD_ROL_Unfiltered_DirDist1
            SEND_PpToComDbgFD14Tx_FD14_Tstr_SD_ROL_Unfiltered_DirDist2: accessed-variable=PpToComDbgFD14Tx.FD14_Tstr_SD_ROL_Unfiltered_DirDist2
            SEND_PpToComDbgFD14Tx_FD14_Tstr_SD_ROR_DrvFreq: accessed-variable=PpToComDbgFD14Tx.FD14_Tstr_SD_ROR_DrvFreq
            SEND_PpToComDbgFD14Tx_FD14_Tstr_SD_ROR_EchoHeight_adc: accessed-variable=PpToComDbgFD14Tx.FD14_Tstr_SD_ROR_EchoHeight_adc
            SEND_PpToComDbgFD14Tx_FD14_Tstr_SD_ROR_RingFreq: accessed-variable=PpToComDbgFD14Tx.FD14_Tstr_SD_ROR_RingFreq
            SEND_PpToComDbgFD14Tx_FD14_Tstr_SD_ROR_Ringtime_us: accessed-variable=PpToComDbgFD14Tx.FD14_Tstr_SD_ROR_Ringtime_us
            SEND_PpToComDbgFD14Tx_FD14_Tstr_SD_ROR_SensorBlkgClrCounter: accessed-variable=PpToComDbgFD14Tx.FD14_Tstr_SD_ROR_SensorBlkgClrCounter
            SEND_PpToComDbgFD14Tx_FD14_Tstr_SD_ROR_SensorBlkgSetCounter: accessed-variable=PpToComDbgFD14Tx.FD14_Tstr_SD_ROR_SensorBlkgSetCounter
            SEND_PpToComDbgFD14Tx_FD14_Tstr_SD_ROR_Unfiltered_DirDist1: accessed-variable=PpToComDbgFD14Tx.FD14_Tstr_SD_ROR_Unfiltered_DirDist1
            SEND_PpToComDbgFD14Tx_FD14_Tstr_SD_ROR_Unfiltered_DirDist2: accessed-variable=PpToComDbgFD14Tx.FD14_Tstr_SD_ROR_Unfiltered_DirDist2
            SEND_PpToComDbgFD14Tx_FD14_Tstr_SD_RSL_DrvFreq: accessed-variable=PpToComDbgFD14Tx.FD14_Tstr_SD_RSL_DrvFreq
            SEND_PpToComDbgFD14Tx_FD14_Tstr_SD_RSL_EchoHeight_adc: accessed-variable=PpToComDbgFD14Tx.FD14_Tstr_SD_RSL_EchoHeight_adc
            SEND_PpToComDbgFD14Tx_FD14_Tstr_SD_RSL_RingFreq: accessed-variable=PpToComDbgFD14Tx.FD14_Tstr_SD_RSL_RingFreq
            SEND_PpToComDbgFD14Tx_FD14_Tstr_SD_RSL_Ringtime_us: accessed-variable=PpToComDbgFD14Tx.FD14_Tstr_SD_RSL_Ringtime_us
            SEND_PpToComDbgFD14Tx_FD14_Tstr_SD_RSL_SensorBlkgClrCounter: accessed-variable=PpToComDbgFD14Tx.FD14_Tstr_SD_RSL_SensorBlkgClrCounter
            SEND_PpToComDbgFD14Tx_FD14_Tstr_SD_RSL_SensorBlkgSetCounter: accessed-variable=PpToComDbgFD14Tx.FD14_Tstr_SD_RSL_SensorBlkgSetCounter
            SEND_PpToComDbgFD14Tx_FD14_Tstr_SD_RSL_Unfiltered_DirDist1: accessed-variable=PpToComDbgFD14Tx.FD14_Tstr_SD_RSL_Unfiltered_DirDist1
            SEND_PpToComDbgFD14Tx_FD14_Tstr_SD_RSL_Unfiltered_DirDist2: accessed-variable=PpToComDbgFD14Tx.FD14_Tstr_SD_RSL_Unfiltered_DirDist2
            SEND_PpToComDbgFD14Tx_FD14_Tstr_SD_RSR_DrvFreq: accessed-variable=PpToComDbgFD14Tx.FD14_Tstr_SD_RSR_DrvFreq
            SEND_PpToComDbgFD14Tx_FD14_Tstr_SD_RSR_EchoHeight_adc: accessed-variable=PpToComDbgFD14Tx.FD14_Tstr_SD_RSR_EchoHeight_adc
            SEND_PpToComDbgFD14Tx_FD14_Tstr_SD_RSR_RingFreq: accessed-variable=PpToComDbgFD14Tx.FD14_Tstr_SD_RSR_RingFreq
            SEND_PpToComDbgFD14Tx_FD14_Tstr_SD_RSR_Ringtime_us: accessed-variable=PpToComDbgFD14Tx.FD14_Tstr_SD_RSR_Ringtime_us
            SEND_PpToComDbgFD14Tx_FD14_Tstr_SD_RSR_SensorBlkgClrCounter: accessed-variable=PpToComDbgFD14Tx.FD14_Tstr_SD_RSR_SensorBlkgClrCounter
            SEND_PpToComDbgFD14Tx_FD14_Tstr_SD_RSR_SensorBlkgSetCounter: accessed-variable=PpToComDbgFD14Tx.FD14_Tstr_SD_RSR_SensorBlkgSetCounter
            SEND_PpToComDbgFD14Tx_FD14_Tstr_SD_RSR_Unfiltered_DirDist1: accessed-variable=PpToComDbgFD14Tx.FD14_Tstr_SD_RSR_Unfiltered_DirDist1
            SEND_PpToComDbgFD14Tx_FD14_Tstr_SD_RSR_Unfiltered_DirDist2: accessed-variable=PpToComDbgFD14Tx.FD14_Tstr_SD_RSR_Unfiltered_DirDist2
            SEND_PpToComDbgFD14Tx_FD14_USS_MPAZoneB{00..03}: accessed-variable=PpToComDbgFD14Tx.FD14_USS_MPAZoneB{00..03}
            SEND_PpToComDbgFD14Tx_FD14_USS_MPAZoneF{00..03}: accessed-variable=PpToComDbgFD14Tx.FD14_USS_MPAZoneF{00..03}
            SEND_PpToComDbgFD14Tx_FD14_ValidFeatures_Front_u32: accessed-variable=PpToComDbgFD14Tx.FD14_ValidFeatures_Front_u32
            SEND_PpToComDbgFD14Tx_FD14_ValidFeatures_Left_u32: accessed-variable=PpToComDbgFD14Tx.FD14_ValidFeatures_Left_u32
            SEND_PpToComDbgFD14Tx_FD14_ValidFeatures_Rear_u32: accessed-variable=PpToComDbgFD14Tx.FD14_ValidFeatures_Rear_u32
            SEND_PpToComDbgFD14Tx_FD14_ValidFeatures_Right_u32: accessed-variable=PpToComDbgFD14Tx.FD14_ValidFeatures_Right_u32
            SEND_PpToComDbgFD14Tx_FD14_View_Error_e: accessed-variable=PpToComDbgFD14Tx.FD14_View_Error_e
            SEND_PpToComDbgFD14Tx_FD14_XIcon_b: accessed-variable=PpToComDbgFD14Tx.FD14_XIcon_b
            SEND_PpToComDbgFD14Tx_FD14_X_BTN_PRESSED_b: accessed-variable=PpToComDbgFD14Tx.FD14_X_BTN_PRESSED_b
            SEND_PpToComDbgFD14Tx_FD14_X_f32_Current_Rear: accessed-variable=PpToComDbgFD14Tx.FD14_X_f32_Current_Rear
            SEND_PpToComDbgFD14Tx_FD14_X_f32_Current_Right: accessed-variable=PpToComDbgFD14Tx.FD14_X_f32_Current_Right
            SEND_PpToComDbgFD14Tx_FD14_X_f32_EOL_Front: accessed-variable=PpToComDbgFD14Tx.FD14_X_f32_EOL_Front
            SEND_PpToComDbgFD14Tx_FD14_X_f32_EOL_Left: accessed-variable=PpToComDbgFD14Tx.FD14_X_f32_EOL_Left
            SEND_PpToComDbgFD14Tx_FD14_X_f32_EOL_Rear: accessed-variable=PpToComDbgFD14Tx.FD14_X_f32_EOL_Rear
            SEND_PpToComDbgFD14Tx_FD14_X_f32_EOL_Right: accessed-variable=PpToComDbgFD14Tx.FD14_X_f32_EOL_Right
            SEND_PpToComDbgFD14Tx_FD14_Y_f32_Current_Rear: accessed-variable=PpToComDbgFD14Tx.FD14_Y_f32_Current_Rear
            SEND_PpToComDbgFD14Tx_FD14_Y_f32_Current_Right: accessed-variable=PpToComDbgFD14Tx.FD14_Y_f32_Current_Right
            SEND_PpToComDbgFD14Tx_FD14_Y_f32_EOL_Front: accessed-variable=PpToComDbgFD14Tx.FD14_Y_f32_EOL_Front
            SEND_PpToComDbgFD14Tx_FD14_Y_f32_EOL_Left: accessed-variable=PpToComDbgFD14Tx.FD14_Y_f32_EOL_Left
            SEND_PpToComDbgFD14Tx_FD14_Y_f32_EOL_Rear: accessed-variable=PpToComDbgFD14Tx.FD14_Y_f32_EOL_Rear
            SEND_PpToComDbgFD14Tx_FD14_Y_f32_EOL_Right: accessed-variable=PpToComDbgFD14Tx.FD14_Y_f32_EOL_Right
            SEND_PpToComDbgFD14Tx_FD14_Yaw_f32_Current_Rear: accessed-variable=PpToComDbgFD14Tx.FD14_Yaw_f32_Current_Rear
            SEND_PpToComDbgFD14Tx_FD14_Yaw_f32_Current_Right: accessed-variable=PpToComDbgFD14Tx.FD14_Yaw_f32_Current_Right
            SEND_PpToComDbgFD14Tx_FD14_Yaw_f32_EOL_Front: accessed-variable=PpToComDbgFD14Tx.FD14_Yaw_f32_EOL_Front
            SEND_PpToComDbgFD14Tx_FD14_Yaw_f32_EOL_Left: accessed-variable=PpToComDbgFD14Tx.FD14_Yaw_f32_EOL_Left
            SEND_PpToComDbgFD14Tx_FD14_Yaw_f32_EOL_Rear: accessed-variable=PpToComDbgFD14Tx.FD14_Yaw_f32_EOL_Rear
            SEND_PpToComDbgFD14Tx_FD14_Yaw_f32_EOL_Right: accessed-variable=PpToComDbgFD14Tx.FD14_Yaw_f32_EOL_Right
            SEND_PpToComDbgFD14Tx_FD14_Yaw_f32_OC_Front: accessed-variable=PpToComDbgFD14Tx.FD14_Yaw_f32_OC_Front
            SEND_PpToComDbgFD14Tx_FD14_Yaw_f32_OC_Left: accessed-variable=PpToComDbgFD14Tx.FD14_Yaw_f32_OC_Left
            SEND_PpToComDbgFD14Tx_FD14_Yaw_f32_OC_Rear: accessed-variable=PpToComDbgFD14Tx.FD14_Yaw_f32_OC_Rear
            SEND_PpToComDbgFD14Tx_FD14_Yaw_f32_OC_Right: accessed-variable=PpToComDbgFD14Tx.FD14_Yaw_f32_OC_Right
            SEND_PpToComDbgFD14Tx_FD14_Yaw_f32_SC_Front: accessed-variable=PpToComDbgFD14Tx.FD14_Yaw_f32_SC_Front
            SEND_PpToComDbgFD14Tx_FD14_Yaw_f32_SC_Left: accessed-variable=PpToComDbgFD14Tx.FD14_Yaw_f32_SC_Left
            SEND_PpToComDbgFD14Tx_FD14_Yaw_f32_SC_Rear: accessed-variable=PpToComDbgFD14Tx.FD14_Yaw_f32_SC_Rear
            SEND_PpToComDbgFD14Tx_FD14_Yaw_f32_SC_Right: accessed-variable=PpToComDbgFD14Tx.FD14_Yaw_f32_SC_Right
            SEND_PpToComDbgFD14Tx_FD14_Z_f32_Current_Rear: accessed-variable=PpToComDbgFD14Tx.FD14_Z_f32_Current_Rear
            SEND_PpToComDbgFD14Tx_FD14_Z_f32_Current_Right: accessed-variable=PpToComDbgFD14Tx.FD14_Z_f32_Current_Right
            SEND_PpToComDbgFD14Tx_FD14_Z_f32_EOL_Front: accessed-variable=PpToComDbgFD14Tx.FD14_Z_f32_EOL_Front
            SEND_PpToComDbgFD14Tx_FD14_Z_f32_EOL_Left: accessed-variable=PpToComDbgFD14Tx.FD14_Z_f32_EOL_Left
            SEND_PpToComDbgFD14Tx_FD14_Z_f32_EOL_Rear: accessed-variable=PpToComDbgFD14Tx.FD14_Z_f32_EOL_Rear
            SEND_PpToComDbgFD14Tx_FD14_Z_f32_EOL_Right: accessed-variable=PpToComDbgFD14Tx.FD14_Z_f32_EOL_Right
            SEND_PpToComDbgFD14Tx_FD14_ZoomButtonDisable_b: accessed-variable=PpToComDbgFD14Tx.FD14_ZoomButtonDisable_b
            SEND_PpToComDbgFD14Tx_FD14_ZoomFactor_u8: accessed-variable=PpToComDbgFD14Tx.FD14_ZoomFactor_u8
            SEND_PpToComDbgFD14Tx_FD14_ZoomMinusIcon_b: accessed-variable=PpToComDbgFD14Tx.FD14_ZoomMinusIcon_b
            SEND_PpToComDbgFD14Tx_FD14_ZoomPlusIcon_b: accessed-variable=PpToComDbgFD14Tx.FD14_ZoomPlusIcon_b
            SEND_PpToComDbgFD14Tx_FD14__JackKnifeAngle: accessed-variable=PpToComDbgFD14Tx.FD14__JackKnifeAngle
            SEND_PpToComDbgFD14Tx_FD14_calibrationCompleted: accessed-variable=PpToComDbgFD14Tx.FD14_calibrationCompleted
            SEND_PpToComDbgFD14Tx_FD14_calibrationSubState: accessed-variable=PpToComDbgFD14Tx.FD14_calibrationSubState
            SEND_PpToComDbgFD14Tx_FD14_cntrCvpamFdData1_u16: accessed-variable=PpToComDbgFD14Tx.FD14_cntrCvpamFdData1_u16
            SEND_PpToComDbgFD14Tx_FD14_crcCvpamFdData1_u8: accessed-variable=PpToComDbgFD14Tx.FD14_crcCvpamFdData1_u8
            SEND_PpToComDbgFD14Tx_FD14_curState: accessed-variable=PpToComDbgFD14Tx.FD14_curState
            SEND_PpToComDbgFD14Tx_FD14_hitchLength: accessed-variable=PpToComDbgFD14Tx.FD14_hitchLength
            SEND_PpToComDbgFD14Tx_FD14_ignitionStatus_e: accessed-variable=PpToComDbgFD14Tx.FD14_ignitionStatus_e
            SEND_PpToComDbgFD14Tx_FD14_isPLDInitSuccess_b: accessed-variable=PpToComDbgFD14Tx.FD14_isPLDInitSuccess_b
            SEND_PpToComDbgFD14Tx_FD14_isUSSInitSuccess_b: accessed-variable=PpToComDbgFD14Tx.FD14_isUSSInitSuccess_b
            SEND_PpToComDbgFD14Tx_FD14_leLMD_e_HealthStatus: accessed-variable=PpToComDbgFD14Tx.FD14_leLMD_e_HealthStatus
            SEND_PpToComDbgFD14Tx_FD14_lrwsST_e: accessed-variable=PpToComDbgFD14Tx.FD14_lrwsST_e
            SEND_PpToComDbgFD14Tx_FD14_m_FPAInfoToPLDSlotID: accessed-variable=PpToComDbgFD14Tx.FD14_m_FPAInfoToPLDSlotID
            SEND_PpToComDbgFD14Tx_FD14_m_FPAInfoToUSSOMSlotID: accessed-variable=PpToComDbgFD14Tx.FD14_m_FPAInfoToUSSOMSlotID
            SEND_PpToComDbgFD14Tx_FD14_m_FPAToNVMParkInStyle: accessed-variable=PpToComDbgFD14Tx.FD14_m_FPAToNVMParkInStyle
            SEND_PpToComDbgFD14Tx_FD14_m_FPAToNVMReadNVMParam_b: accessed-variable=PpToComDbgFD14Tx.FD14_m_FPAToNVMReadNVMParam_b
            SEND_PpToComDbgFD14Tx_FD14_m_FPAToNVMWriteNVMParam_b: accessed-variable=PpToComDbgFD14Tx.FD14_m_FPAToNVMWriteNVMParam_b
            SEND_PpToComDbgFD14Tx_FD14_m_FpaInfoToVCParkOutStyle: accessed-variable=PpToComDbgFD14Tx.FD14_m_FpaInfoToVCParkOutStyle
            SEND_PpToComDbgFD14Tx_FD14_m_QM_FID_TRSC_ASCMDef: accessed-variable=PpToComDbgFD14Tx.FD14_m_QM_FID_TRSC_ASCMDef
            SEND_PpToComDbgFD14Tx_FD14_m_QM_FID_TRSC_CAM_CAL_ABORT: accessed-variable=PpToComDbgFD14Tx.FD14_m_QM_FID_TRSC_CAM_CAL_ABORT
            SEND_PpToComDbgFD14Tx_FD14_m_QM_FID_TRSC_DISABLED: accessed-variable=PpToComDbgFD14Tx.FD14_m_QM_FID_TRSC_DISABLED
            SEND_PpToComDbgFD14Tx_FD14_m_QM_FID_TRSC_LIMITED_DefView: accessed-variable=PpToComDbgFD14Tx.FD14_m_QM_FID_TRSC_LIMITED_DefView
            SEND_PpToComDbgFD14Tx_FD14_m_QM_FID_TRSC_LIMITED_View: accessed-variable=PpToComDbgFD14Tx.FD14_m_QM_FID_TRSC_LIMITED_View
            SEND_PpToComDbgFD14Tx_FD14_macCvpamFdData1_u64: accessed-variable=PpToComDbgFD14Tx.FD14_macCvpamFdData1_u64
            SEND_PpToComDbgFD14Tx_FD14_msgcntrCvpamFdData1_u8: accessed-variable=PpToComDbgFD14Tx.FD14_msgcntrCvpamFdData1_u8
            SEND_PpToComDbgFD14Tx_FD14_objConf_e: accessed-variable=PpToComDbgFD14Tx.FD14_objConf_e
            SEND_PpToComDbgFD14Tx_FD14_obj_Pos_Lat: accessed-variable=PpToComDbgFD14Tx.FD14_obj_Pos_Lat
            SEND_PpToComDbgFD14Tx_FD14_obj_Pos_Longi: accessed-variable=PpToComDbgFD14Tx.FD14_obj_Pos_Longi
            SEND_PpToComDbgFD14Tx_FD14_parkExtSideSel: accessed-variable=PpToComDbgFD14Tx.FD14_parkExtSideSel
            SEND_PpToComDbgFD14Tx_FD14_parkingDirection: accessed-variable=PpToComDbgFD14Tx.FD14_parkingDirection
            SEND_PpToComDbgFD14Tx_FD14_parkingSlotType: accessed-variable=PpToComDbgFD14Tx.FD14_parkingSlotType
            SEND_PpToComDbgFD14Tx_FD14_perpParkDirectionSel: accessed-variable=PpToComDbgFD14Tx.FD14_perpParkDirectionSel
            SEND_PpToComDbgFD14Tx_FD14_prndStatus_e: accessed-variable=PpToComDbgFD14Tx.FD14_prndStatus_e
            SEND_PpToComDbgFD14Tx_FD14_revGear_e: accessed-variable=PpToComDbgFD14Tx.FD14_revGear_e
            SEND_PpToComDbgFD14Tx_FD14_slotSide: accessed-variable=PpToComDbgFD14Tx.FD14_slotSide
            SEND_PpToComDbgFD14Tx_FD14_stFPAInfoToHMISlot{1..6}Valid: accessed-variable=PpToComDbgFD14Tx.FD14_stFPAInfoToHMISlot{1..6}Valid
            SEND_PpToComDbgFD14Tx_FD14_stFPAInfoToVCLockedSlotFrntLeftX: accessed-variable=PpToComDbgFD14Tx.FD14_stFPAInfoToVCLockedSlotFrntLeftX
            SEND_PpToComDbgFD14Tx_FD14_stFPAInfoToVCLockedSlotFrntLeftY: accessed-variable=PpToComDbgFD14Tx.FD14_stFPAInfoToVCLockedSlotFrntLeftY
            SEND_PpToComDbgFD14Tx_FD14_stFPAInfoToVCLockedSlotID: accessed-variable=PpToComDbgFD14Tx.FD14_stFPAInfoToVCLockedSlotID
            SEND_PpToComDbgFD14Tx_FD14_stFPAInfoToVCLockedSlotRearRghtX: accessed-variable=PpToComDbgFD14Tx.FD14_stFPAInfoToVCLockedSlotRearRghtX
            SEND_PpToComDbgFD14Tx_FD14_stFPAInfoToVCLockedSlotRearRghtY: accessed-variable=PpToComDbgFD14Tx.FD14_stFPAInfoToVCLockedSlotRearRghtY
            SEND_PpToComDbgFD14Tx_FD14_stFPAInfoToVCLockedSlotSide: accessed-variable=PpToComDbgFD14Tx.FD14_stFPAInfoToVCLockedSlotSide
            SEND_PpToComDbgFD14Tx_FD14_stFPAInfoToVCLockedSlotType: accessed-variable=PpToComDbgFD14Tx.FD14_stFPAInfoToVCLockedSlotType
            SEND_PpToComDbgFD14Tx_FD14_stFPAInfoToVCLockedSlotValid: accessed-variable=PpToComDbgFD14Tx.FD14_stFPAInfoToVCLockedSlotValid
            SEND_PpToComDbgFD14Tx_FD14_stLeftObjectList{1..4}Valid: accessed-variable=PpToComDbgFD14Tx.FD14_stLeftObjectList{1..4}Valid
            SEND_PpToComDbgFD14Tx_FD14_stPLDLockedSlotDataFrontLeftX: accessed-variable=PpToComDbgFD14Tx.FD14_stPLDLockedSlotDataFrontLeftX
            SEND_PpToComDbgFD14Tx_FD14_stPLDLockedSlotDataFrontLeftY: accessed-variable=PpToComDbgFD14Tx.FD14_stPLDLockedSlotDataFrontLeftY
            SEND_PpToComDbgFD14Tx_FD14_stPLDLockedSlotDataRearRightX: accessed-variable=PpToComDbgFD14Tx.FD14_stPLDLockedSlotDataRearRightX
            SEND_PpToComDbgFD14Tx_FD14_stPLDLockedSlotDataRearRightY: accessed-variable=PpToComDbgFD14Tx.FD14_stPLDLockedSlotDataRearRightY
            SEND_PpToComDbgFD14Tx_FD14_stPLDLockedSlotDataSlotID: accessed-variable=PpToComDbgFD14Tx.FD14_stPLDLockedSlotDataSlotID
            SEND_PpToComDbgFD14Tx_FD14_stPLDLockedSlotDataSlotSide: accessed-variable=PpToComDbgFD14Tx.FD14_stPLDLockedSlotDataSlotSide
            SEND_PpToComDbgFD14Tx_FD14_stPLDLockedSlotDataSlotType: accessed-variable=PpToComDbgFD14Tx.FD14_stPLDLockedSlotDataSlotType
            SEND_PpToComDbgFD14Tx_FD14_stPLDLockedSlotDataSlotValid: accessed-variable=PpToComDbgFD14Tx.FD14_stPLDLockedSlotDataSlotValid
            SEND_PpToComDbgFD14Tx_FD14_stPLDParkingSlot1DataSlotID: accessed-variable=PpToComDbgFD14Tx.FD14_stPLDParkingSlot1DataSlotID
            SEND_PpToComDbgFD14Tx_FD14_stPLDParkingSlot1DataSlotSide: accessed-variable=PpToComDbgFD14Tx.FD14_stPLDParkingSlot1DataSlotSide
            SEND_PpToComDbgFD14Tx_FD14_stPLDParkingSlot1FrontLeftX: accessed-variable=PpToComDbgFD14Tx.FD14_stPLDParkingSlot1FrontLeftX
            SEND_PpToComDbgFD14Tx_FD14_stPLDParkingSlot1FrontLeftY: accessed-variable=PpToComDbgFD14Tx.FD14_stPLDParkingSlot1FrontLeftY
            SEND_PpToComDbgFD14Tx_FD14_stPLDParkingSlot1RearRightX: accessed-variable=PpToComDbgFD14Tx.FD14_stPLDParkingSlot1RearRightX
            SEND_PpToComDbgFD14Tx_FD14_stPLDParkingSlot1RearRightY: accessed-variable=PpToComDbgFD14Tx.FD14_stPLDParkingSlot1RearRightY
            SEND_PpToComDbgFD14Tx_FD14_stPLDParkingSlot1SlotType: accessed-variable=PpToComDbgFD14Tx.FD14_stPLDParkingSlot1SlotType
            SEND_PpToComDbgFD14Tx_FD14_stPLDParkingSlot{1..3}SlotValid: accessed-variable=PpToComDbgFD14Tx.FD14_stPLDParkingSlot{1..3}SlotValid
            SEND_PpToComDbgFD14Tx_FD14_stPLDParkingSlot4DataSlotID: accessed-variable=PpToComDbgFD14Tx.FD14_stPLDParkingSlot4DataSlotID
            SEND_PpToComDbgFD14Tx_FD14_stPLDParkingSlot4DataSlotSide: accessed-variable=PpToComDbgFD14Tx.FD14_stPLDParkingSlot4DataSlotSide
            SEND_PpToComDbgFD14Tx_FD14_stPLDParkingSlot4FrontLeftX: accessed-variable=PpToComDbgFD14Tx.FD14_stPLDParkingSlot4FrontLeftX
            SEND_PpToComDbgFD14Tx_FD14_stPLDParkingSlot4FrontLeftY: accessed-variable=PpToComDbgFD14Tx.FD14_stPLDParkingSlot4FrontLeftY
            SEND_PpToComDbgFD14Tx_FD14_stPLDParkingSlot4RearRightX: accessed-variable=PpToComDbgFD14Tx.FD14_stPLDParkingSlot4RearRightX
            SEND_PpToComDbgFD14Tx_FD14_stPLDParkingSlot4RearRightY: accessed-variable=PpToComDbgFD14Tx.FD14_stPLDParkingSlot4RearRightY
            SEND_PpToComDbgFD14Tx_FD14_stPLDParkingSlot4SlotType: accessed-variable=PpToComDbgFD14Tx.FD14_stPLDParkingSlot4SlotType
            SEND_PpToComDbgFD14Tx_FD14_stPLDParkingSlot{4..6}SlotValid: accessed-variable=PpToComDbgFD14Tx.FD14_stPLDParkingSlot{4..6}SlotValid
            SEND_PpToComDbgFD14Tx_FD14_stRightObjectList{1..4}Valid: accessed-variable=PpToComDbgFD14Tx.FD14_stRightObjectList{1..4}Valid
            SEND_PpToComDbgFD14Tx_FD14_stUSSLockedSlotDataFrontLeftX: accessed-variable=PpToComDbgFD14Tx.FD14_stUSSLockedSlotDataFrontLeftX
            SEND_PpToComDbgFD14Tx_FD14_stUSSLockedSlotDataFrontLeftY: accessed-variable=PpToComDbgFD14Tx.FD14_stUSSLockedSlotDataFrontLeftY
            SEND_PpToComDbgFD14Tx_FD14_stUSSLockedSlotDataRearRightX: accessed-variable=PpToComDbgFD14Tx.FD14_stUSSLockedSlotDataRearRightX
            SEND_PpToComDbgFD14Tx_FD14_stUSSLockedSlotDataRearRightY: accessed-variable=PpToComDbgFD14Tx.FD14_stUSSLockedSlotDataRearRightY
            SEND_PpToComDbgFD14Tx_FD14_stUSSLockedSlotDataSlotID: accessed-variable=PpToComDbgFD14Tx.FD14_stUSSLockedSlotDataSlotID
            SEND_PpToComDbgFD14Tx_FD14_stUSSLockedSlotDataSlotSide: accessed-variable=PpToComDbgFD14Tx.FD14_stUSSLockedSlotDataSlotSide
            SEND_PpToComDbgFD14Tx_FD14_stUSSLockedSlotDataSlotType: accessed-variable=PpToComDbgFD14Tx.FD14_stUSSLockedSlotDataSlotType
            SEND_PpToComDbgFD14Tx_FD14_stUSSLockedSlotDataSlotValid: accessed-variable=PpToComDbgFD14Tx.FD14_stUSSLockedSlotDataSlotValid
            SEND_PpToComDbgFD14Tx_FD14_stUSSParkingSlot1DataSlotID: accessed-variable=PpToComDbgFD14Tx.FD14_stUSSParkingSlot1DataSlotID
            SEND_PpToComDbgFD14Tx_FD14_stUSSParkingSlot1DataSlotSide: accessed-variable=PpToComDbgFD14Tx.FD14_stUSSParkingSlot1DataSlotSide
            SEND_PpToComDbgFD14Tx_FD14_stUSSParkingSlot1FrontLeftX: accessed-variable=PpToComDbgFD14Tx.FD14_stUSSParkingSlot1FrontLeftX
            SEND_PpToComDbgFD14Tx_FD14_stUSSParkingSlot1FrontLeftY: accessed-variable=PpToComDbgFD14Tx.FD14_stUSSParkingSlot1FrontLeftY
            SEND_PpToComDbgFD14Tx_FD14_stUSSParkingSlot1RearRightX: accessed-variable=PpToComDbgFD14Tx.FD14_stUSSParkingSlot1RearRightX
            SEND_PpToComDbgFD14Tx_FD14_stUSSParkingSlot1RearRightY: accessed-variable=PpToComDbgFD14Tx.FD14_stUSSParkingSlot1RearRightY
            SEND_PpToComDbgFD14Tx_FD14_stUSSParkingSlot1SlotType: accessed-variable=PpToComDbgFD14Tx.FD14_stUSSParkingSlot1SlotType
            SEND_PpToComDbgFD14Tx_FD14_stUSSParkingSlot{1..3}SlotValid: accessed-variable=PpToComDbgFD14Tx.FD14_stUSSParkingSlot{1..3}SlotValid
            SEND_PpToComDbgFD14Tx_FD14_stUSSParkingSlot4DataSlotSide: accessed-variable=PpToComDbgFD14Tx.FD14_stUSSParkingSlot4DataSlotSide
            SEND_PpToComDbgFD14Tx_FD14_stUSSParkingSlot4FrontLeftX: accessed-variable=PpToComDbgFD14Tx.FD14_stUSSParkingSlot4FrontLeftX
            SEND_PpToComDbgFD14Tx_FD14_stUSSParkingSlot4FrontLeftY: accessed-variable=PpToComDbgFD14Tx.FD14_stUSSParkingSlot4FrontLeftY
            SEND_PpToComDbgFD14Tx_FD14_stUSSParkingSlot4RearRightX: accessed-variable=PpToComDbgFD14Tx.FD14_stUSSParkingSlot4RearRightX
            SEND_PpToComDbgFD14Tx_FD14_stUSSParkingSlot4RearRightY: accessed-variable=PpToComDbgFD14Tx.FD14_stUSSParkingSlot4RearRightY
            SEND_PpToComDbgFD14Tx_FD14_stUSSParkingSlot4SlotType: accessed-variable=PpToComDbgFD14Tx.FD14_stUSSParkingSlot4SlotType
            SEND_PpToComDbgFD14Tx_FD14_stUSSParkingSlot{4..6}SlotValid: accessed-variable=PpToComDbgFD14Tx.FD14_stUSSParkingSlot{4..6}SlotValid
            SEND_PpToComDbgFD14Tx_FD14_steeringWheelAngle_f32: accessed-variable=PpToComDbgFD14Tx.FD14_steeringWheelAngle_f32
            SEND_PpToComDbgFD14Tx_FD14_stnumPointsL: accessed-variable=PpToComDbgFD14Tx.FD14_stnumPointsL
            SEND_PpToComDbgFD14Tx_FD14_stnumPointsR: accessed-variable=PpToComDbgFD14Tx.FD14_stnumPointsR
            SEND_PpToComDbgFD14Tx_FD14_tchScrnCoord_s_X_u16: accessed-variable=PpToComDbgFD14Tx.FD14_tchScrnCoord_s_X_u16
            SEND_PpToComDbgFD14Tx_FD14_tchScrnCoord_s_Y_u16: accessed-variable=PpToComDbgFD14Tx.FD14_tchScrnCoord_s_Y_u16
            SEND_PpToComDbgFD14Tx_FD14_tchScrnStatus_e: accessed-variable=PpToComDbgFD14Tx.FD14_tchScrnStatus_e
            SEND_PpToComDbgFD14Tx_FD14_tgwDispStatus_e: accessed-variable=PpToComDbgFD14Tx.FD14_tgwDispStatus_e
            SEND_PpToComDbgFD14Tx_FD14_trailerAngle: accessed-variable=PpToComDbgFD14Tx.FD14_trailerAngle
            SEND_PpToComDbgFD14Tx_FD14_trailerCalibrationCount: accessed-variable=PpToComDbgFD14Tx.FD14_trailerCalibrationCount
            SEND_PpToComDbgFD14Tx_FD14_trailerCalibrationDelay: accessed-variable=PpToComDbgFD14Tx.FD14_trailerCalibrationDelay
            SEND_PpToComDbgFD14Tx_FD14_transEquipped_e: accessed-variable=PpToComDbgFD14Tx.FD14_transEquipped_e
            SEND_PpToComDbgFD14Tx_FD14_trscStat_e: accessed-variable=PpToComDbgFD14Tx.FD14_trscStat_e
            SEND_PpToComDbgFD14Tx_FD14_turnaroundSubState: accessed-variable=PpToComDbgFD14Tx.FD14_turnaroundSubState
            SEND_PpToComDbgFD14Tx_FD14_vehicleLine_e: accessed-variable=PpToComDbgFD14Tx.FD14_vehicleLine_e
            SEND_PpToComDbgFD14Tx_FD14_vehicleSpeed_f32: accessed-variable=PpToComDbgFD14Tx.FD14_vehicleSpeed_f32
            SEND_PpToComFD02Tx_CurrentCanNMState_FD02_PAM: accessed-variable=PpToComFD02Tx.CurrentCanNMState_FD02_PAM
            SEND_PpToComFD02Tx_CurrentFailSts_FD02_PAM: accessed-variable=PpToComFD02Tx.CurrentFailSts_FD02_PAM
            SEND_PpToComFD02Tx_DES_FD02_PAM: accessed-variable=PpToComFD02Tx.DES_FD02_PAM
            SEND_PpToComFD02Tx_Digit_{01..11}_PAM: accessed-variable=PpToComFD02Tx.Digit_{01..11}_PAM
            SEND_PpToComFD02Tx_EOL_FD02_PAM: accessed-variable=PpToComFD02Tx.EOL_FD02_PAM
            SEND_PpToComFD02Tx_GenericFailSts_FD02_PAM: accessed-variable=PpToComFD02Tx.GenericFailSts_FD02_PAM
            SEND_PpToComFD02Tx_N_PDU: accessed-variable=PpToComFD02Tx.N_PDU
            SEND_PpToComFD02Tx_PreviousCanNMState_FD02_PAM: accessed-variable=PpToComFD02Tx.PreviousCanNMState_FD02_PAM
            SEND_PpToComFD02Tx_StayActiveSource_FD02_PAM: accessed-variable=PpToComFD02Tx.StayActiveSource_FD02_PAM
            SEND_PpToComFD02Tx_THA_EPB_Req: accessed-variable=PpToComFD02Tx.THA_EPB_Req
            SEND_PpToComFD02Tx_THA_STAT: accessed-variable=PpToComFD02Tx.THA_STAT
            SEND_PpToComFD02Tx_THA_SpeedLimit_Req: accessed-variable=PpToComFD02Tx.THA_SpeedLimit_Req
            SEND_PpToComFD02Tx_THA_Speed_Limit: accessed-variable=PpToComFD02Tx.THA_Speed_Limit
            SEND_PpToComFD02Tx_THA_SteeringDamping: accessed-variable=PpToComFD02Tx.THA_SteeringDamping
            SEND_PpToComFD02Tx_THA_SteeringTorqueInfo: accessed-variable=PpToComFD02Tx.THA_SteeringTorqueInfo
            SEND_PpToComFD02Tx_THA_SteeringTorqueReq: accessed-variable=PpToComFD02Tx.THA_SteeringTorqueReq
            SEND_PpToComFD02Tx_TRSCMoreCamRQSts: accessed-variable=PpToComFD02Tx.TRSCMoreCamRQSts
            SEND_PpToComFD02Tx_TRSC_PopupDisp_Info: accessed-variable=PpToComFD02Tx.TRSC_PopupDisp_Info
            SEND_PpToComFD02Tx_TRSC_STAT: accessed-variable=PpToComFD02Tx.TRSC_STAT
            SEND_PpToComFD02Tx_TRSC_SpeedLimit_Req: accessed-variable=PpToComFD02Tx.TRSC_SpeedLimit_Req
            SEND_PpToComFD02Tx_TRSC_SteeringDamping: accessed-variable=PpToComFD02Tx.TRSC_SteeringDamping
            SEND_PpToComFD02Tx_TRSC_SteeringTorqueInfo: accessed-variable=PpToComFD02Tx.TRSC_SteeringTorqueInfo
            SEND_PpToComFD02Tx_TRSC_SteeringTorqueReq: accessed-variable=PpToComFD02Tx.TRSC_SteeringTorqueReq
            SEND_PpToComFD02Tx_TRSC_VehicleStop_Req: accessed-variable=PpToComFD02Tx.TRSC_VehicleStop_Req
            SEND_PpToComFD02Tx_Trailer_Angle: accessed-variable=PpToComFD02Tx.Trailer_Angle
            SEND_PpToComFD02Tx_Trailer_Angle_Sign: accessed-variable=PpToComFD02Tx.Trailer_Angle_Sign
            SEND_PpToComFD02Tx_Trailer_Calibration: accessed-variable=PpToComFD02Tx.Trailer_Calibration
            SEND_PpToComFD02Tx_TrlrHitchLight_Cntrl: accessed-variable=PpToComFD02Tx.TrlrHitchLight_Cntrl
            SEND_PpToComFD02Tx_WakeupSource_FD02_PAM: accessed-variable=PpToComFD02Tx.WakeupSource_FD02_PAM
            SEND_PpToComFD14Tx_FD14_THA_EPB_Req: accessed-variable=PpToComFD14Tx.FD14_THA_EPB_Req
            SEND_PpToComFD14Tx_FD14_THA_STAT: accessed-variable=PpToComFD14Tx.FD14_THA_STAT
            SEND_PpToComFD14Tx_FD14_THA_SpeedLimit_Req: accessed-variable=PpToComFD14Tx.FD14_THA_SpeedLimit_Req
            SEND_PpToComFD14Tx_FD14_THA_Speed_Limit: accessed-variable=PpToComFD14Tx.FD14_THA_Speed_Limit
            SEND_PpToComFD14Tx_FD14_THA_SteeringDamping: accessed-variable=PpToComFD14Tx.FD14_THA_SteeringDamping
            SEND_PpToComFD14Tx_FD14_THA_SteeringTorqueInfo: accessed-variable=PpToComFD14Tx.FD14_THA_SteeringTorqueInfo
            SEND_PpToComFD14Tx_FD14_THA_SteeringTorqueReq: accessed-variable=PpToComFD14Tx.FD14_THA_SteeringTorqueReq
            SEND_PpToComFD14Tx_FD14_TRSC_STAT: accessed-variable=PpToComFD14Tx.FD14_TRSC_STAT
            SEND_PpToComFD14Tx_FD14_TRSC_SpeedLimit_Req: accessed-variable=PpToComFD14Tx.FD14_TRSC_SpeedLimit_Req
            SEND_PpToComFD14Tx_FD14_TRSC_SteeringDamping: accessed-variable=PpToComFD14Tx.FD14_TRSC_SteeringDamping
            SEND_PpToComFD14Tx_FD14_TRSC_SteeringTorqueInfo: accessed-variable=PpToComFD14Tx.FD14_TRSC_SteeringTorqueInfo
            SEND_PpToComFD14Tx_FD14_TRSC_SteeringTorqueReq: accessed-variable=PpToComFD14Tx.FD14_TRSC_SteeringTorqueReq
            SEND_PpToComFD14Tx_FD14_TRSC_VehicleStop_Req: accessed-variable=PpToComFD14Tx.FD14_TRSC_VehicleStop_Req
            SEND_PpToSwcFD02Tx_CurrentCanNMState_FD02_PAM: accessed-variable=PpToSwcFD02Tx.CurrentCanNMState_FD02_PAM
            SEND_PpToSwcFD02Tx_CurrentFailSts_FD02_PAM: accessed-variable=PpToSwcFD02Tx.CurrentFailSts_FD02_PAM
            SEND_PpToSwcFD02Tx_DES_FD02_PAM: accessed-variable=PpToSwcFD02Tx.DES_FD02_PAM
            SEND_PpToSwcFD02Tx_Digit_{01..11}_PAM: accessed-variable=PpToSwcFD02Tx.Digit_{01..11}_PAM
            SEND_PpToSwcFD02Tx_EOL_FD02_PAM: accessed-variable=PpToSwcFD02Tx.EOL_FD02_PAM
            SEND_PpToSwcFD02Tx_GenericFailSts_FD02_PAM: accessed-variable=PpToSwcFD02Tx.GenericFailSts_FD02_PAM
            SEND_PpToSwcFD02Tx_N_PDU: accessed-variable=PpToSwcFD02Tx.N_PDU
            SEND_PpToSwcFD02Tx_PreviousCanNMState_FD02_PAM: accessed-variable=PpToSwcFD02Tx.PreviousCanNMState_FD02_PAM
            SEND_PpToSwcFD02Tx_StayActiveSource_FD02_PAM: accessed-variable=PpToSwcFD02Tx.StayActiveSource_FD02_PAM
            SEND_PpToSwcFD02Tx_THA_EPB_Req: accessed-variable=PpToSwcFD02Tx.THA_EPB_Req
            SEND_PpToSwcFD02Tx_THA_STAT: accessed-variable=PpToSwcFD02Tx.THA_STAT
            SEND_PpToSwcFD02Tx_THA_SpeedLimit_Req: accessed-variable=PpToSwcFD02Tx.THA_SpeedLimit_Req
            SEND_PpToSwcFD02Tx_THA_Speed_Limit: accessed-variable=PpToSwcFD02Tx.THA_Speed_Limit
            SEND_PpToSwcFD02Tx_THA_SteeringDamping: accessed-variable=PpToSwcFD02Tx.THA_SteeringDamping
            SEND_PpToSwcFD02Tx_THA_SteeringTorqueInfo: accessed-variable=PpToSwcFD02Tx.THA_SteeringTorqueInfo
            SEND_PpToSwcFD02Tx_THA_SteeringTorqueReq: accessed-variable=PpToSwcFD02Tx.THA_SteeringTorqueReq
            SEND_PpToSwcFD02Tx_TRSCMoreCamRQSts: accessed-variable=PpToSwcFD02Tx.TRSCMoreCamRQSts
            SEND_PpToSwcFD02Tx_TRSC_PopupDisp_Info: accessed-variable=PpToSwcFD02Tx.TRSC_PopupDisp_Info
            SEND_PpToSwcFD02Tx_TRSC_STAT: accessed-variable=PpToSwcFD02Tx.TRSC_STAT
            SEND_PpToSwcFD02Tx_TRSC_SpeedLimit_Req: accessed-variable=PpToSwcFD02Tx.TRSC_SpeedLimit_Req
            SEND_PpToSwcFD02Tx_TRSC_SteeringDamping: accessed-variable=PpToSwcFD02Tx.TRSC_SteeringDamping
            SEND_PpToSwcFD02Tx_TRSC_SteeringTorqueInfo: accessed-variable=PpToSwcFD02Tx.TRSC_SteeringTorqueInfo
            SEND_PpToSwcFD02Tx_TRSC_SteeringTorqueReq: accessed-variable=PpToSwcFD02Tx.TRSC_SteeringTorqueReq
            SEND_PpToSwcFD02Tx_TRSC_VehicleStop_Req: accessed-variable=PpToSwcFD02Tx.TRSC_VehicleStop_Req
            SEND_PpToSwcFD02Tx_Trailer_Angle: accessed-variable=PpToSwcFD02Tx.Trailer_Angle
            SEND_PpToSwcFD02Tx_Trailer_Angle_Sign: accessed-variable=PpToSwcFD02Tx.Trailer_Angle_Sign
            SEND_PpToSwcFD02Tx_Trailer_Calibration: accessed-variable=PpToSwcFD02Tx.Trailer_Calibration
            SEND_PpToSwcFD02Tx_TrlrHitchLight_Cntrl: accessed-variable=PpToSwcFD02Tx.TrlrHitchLight_Cntrl
            SEND_PpToSwcFD02Tx_WakeupSource_FD02_PAM: accessed-variable=PpToSwcFD02Tx.WakeupSource_FD02_PAM
            SEND_PpToSwcFD14Tx_FD14_THA_EPB_Req: accessed-variable=PpToSwcFD14Tx.FD14_THA_EPB_Req
            SEND_PpToSwcFD14Tx_FD14_THA_STAT: accessed-variable=PpToSwcFD14Tx.FD14_THA_STAT
            SEND_PpToSwcFD14Tx_FD14_THA_SpeedLimit_Req: accessed-variable=PpToSwcFD14Tx.FD14_THA_SpeedLimit_Req
            SEND_PpToSwcFD14Tx_FD14_THA_Speed_Limit: accessed-variable=PpToSwcFD14Tx.FD14_THA_Speed_Limit
            SEND_PpToSwcFD14Tx_FD14_THA_SteeringDamping: accessed-variable=PpToSwcFD14Tx.FD14_THA_SteeringDamping
            SEND_PpToSwcFD14Tx_FD14_THA_SteeringTorqueInfo: accessed-variable=PpToSwcFD14Tx.FD14_THA_SteeringTorqueInfo
            SEND_PpToSwcFD14Tx_FD14_THA_SteeringTorqueReq: accessed-variable=PpToSwcFD14Tx.FD14_THA_SteeringTorqueReq
            SEND_PpToSwcFD14Tx_FD14_TRSC_STAT: accessed-variable=PpToSwcFD14Tx.FD14_TRSC_STAT
            SEND_PpToSwcFD14Tx_FD14_TRSC_SpeedLimit_Req: accessed-variable=PpToSwcFD14Tx.FD14_TRSC_SpeedLimit_Req
            SEND_PpToSwcFD14Tx_FD14_TRSC_SteeringDamping: accessed-variable=PpToSwcFD14Tx.FD14_TRSC_SteeringDamping
            SEND_PpToSwcFD14Tx_FD14_TRSC_SteeringTorqueInfo: accessed-variable=PpToSwcFD14Tx.FD14_TRSC_SteeringTorqueInfo
            SEND_PpToSwcFD14Tx_FD14_TRSC_SteeringTorqueReq: accessed-variable=PpToSwcFD14Tx.FD14_TRSC_SteeringTorqueReq
            SEND_PpToSwcFD14Tx_FD14_TRSC_VehicleStop_Req: accessed-variable=PpToSwcFD14Tx.FD14_TRSC_VehicleStop_Req
            SEND_PpToComDbgFD14Tx_FD14_CsmLocalErrOrEventId: accessed-variable=PpToComDbgFD14Tx.FD14_CsmLocalErrOrEventId
            SEND_PpToComDbgFD14Tx_FD14_CsmLocalErrOrEventState: accessed-variable=PpToComDbgFD14Tx.FD14_CsmLocalErrOrEventState
            SEND_PpToComDbgFD14Tx_FD14_CsmLocalModuleId: accessed-variable=PpToComDbgFD14Tx.FD14_CsmLocalModuleId
            SEND_PpToComDbgFD14Tx_FD14_CsmLocalModuleInstanceId: accessed-variable=PpToComDbgFD14Tx.FD14_CsmLocalModuleInstanceId
            SEND_PpToComDbgFD14Tx_FD14_CsmStateCurrent: accessed-variable=PpToComDbgFD14Tx.FD14_CsmStateCurrent
            SEND_PpToComDbgFD14Tx_FD14_CsmStatePrevious: accessed-variable=PpToComDbgFD14Tx.FD14_CsmStatePrevious
            SEND_PpToComDbgFD14Tx_FD14_MeTRSC_b_OTBLReset: accessed-variable=PpToComDbgFD14Tx.FD14_MeTRSC_b_OTBLReset
            SEND_PpToComDbgFD14Tx_FD14_MeTRSC_b_TBLComputationDone: accessed-variable=PpToComDbgFD14Tx.FD14_MeTRSC_b_TBLComputationDone
            SEND_PpToComDbgFD14Tx_FD14_MeTRSC_deg_StrCMD: accessed-variable=PpToComDbgFD14Tx.FD14_MeTRSC_deg_StrCMD
            SEND_PpToComDbgFD14Tx_FD14_averageIllumination: accessed-variable=PpToComDbgFD14Tx.FD14_averageIllumination
            SEND_PpToComDbgFD14Tx_FD14_hitchCalibrationAngle: accessed-variable=PpToComDbgFD14Tx.FD14_hitchCalibrationAngle
            SEND_PpToComDbgFD14Tx_FD14_leftCalibrationAngle: accessed-variable=PpToComDbgFD14Tx.FD14_leftCalibrationAngle
            SEND_PpToComDbgFD14Tx_FD14_rightCalibrationAngle: accessed-variable=PpToComDbgFD14Tx.FD14_rightCalibrationAngle
            SEND_PpToComFD02Tx_TRSC_PopupDisp_Info2: accessed-variable=PpToComFD02Tx.TRSC_PopupDisp_Info2
            SEND_PpToSwcFD02Tx_TRSC_PopupDisp_Info2: accessed-variable=PpToSwcFD02Tx.TRSC_PopupDisp_Info2
            SEND_PpToComDbgFD14Tx_FD14_MeTRSC_cnt_TRSCAliveCounter: accessed-variable=PpToComDbgFD14Tx.FD14_MeTRSC_cnt_TRSCAliveCounter
            SEND_PpToComDbgFD14Tx_FD14_MeTRSC_deg_TADAngleSMVC: accessed-variable=PpToComDbgFD14Tx.FD14_MeTRSC_deg_TADAngleSMVC
            SEND_PpToComDbgFD14Tx_FD14_MeTRSC_e_TrlrCalInfoSMVC: accessed-variable=PpToComDbgFD14Tx.FD14_MeTRSC_e_TrlrCalInfoSMVC
            SEND_PpToComDbgFD14Tx_FD14_MeTRSC_s_TRSCPeriodicity: accessed-variable=PpToComDbgFD14Tx.FD14_MeTRSC_s_TRSCPeriodicity
            SEND_PpToComDbgFD14Tx_FD14_MeTRSC_s_TRSCTimeTaken: accessed-variable=PpToComDbgFD14Tx.FD14_MeTRSC_s_TRSCTimeTaken
            SEND_PpToComDbgFD14Tx_FD14_ReservedSignal1: accessed-variable=PpToComDbgFD14Tx.FD14_ReservedSignal1
            SEND_PpToComDbgFD14Tx_FD14_ReservedSignal2: accessed-variable=PpToComDbgFD14Tx.FD14_ReservedSignal2
            SEND_PpToComDbgFD14Tx_FD14_ReservedTRSCSig1: accessed-variable=PpToComDbgFD14Tx.FD14_ReservedTRSCSig1
            SEND_PpToComDbgFD14Tx_FD14_ReservedTRSCSig2: accessed-variable=PpToComDbgFD14Tx.FD14_ReservedTRSCSig2
        sync call SC_RpE2EServices_ME_E2E_Protect: operation=RpE2EServices.ME_E2E_Protect
  swc implementation SWC_VCANTx_Implementation: behavior=SWC_VCANTx_InternalBehavior
