AUTOSAR XML (schema 00050)
package /FCADT/Constant
  8 x constant specification:
    init_VINLockStatus: value-spec=0
    init_VINOdoCounter: value-spec=0
    init_VINCurrentData: value-spec=17 x 255
    init_VINOriginalData: value-spec=17 x 255
    init_GetTemperatureVal: value-spec=0
    init_BatteryVoltageStatus: value-spec=0
    init_Variant: value-spec=0
    init_SensorFunctionalTestFlag: value-spec=nan
package /Pkg_DegManager_B/Constant
  constant specification init_FID_B: value-spec=[0, 0]
  constant specification init_RES_B: value-spec=[0]
package /Pkg_DegManager_QM/Constant
  constant specification init_FID_QM: value-spec=[0]
  constant specification init_RES_QM: value-spec=[0]
package /Pkg_ErrorMgrAgg_1_0_B/Constant
  8 x constant specification:
    init_Data_ErrorMgr_ErrorCommPack_1_0_B: value-spec=fields=[0, 0, 400 x 0, 400 x fields=[0, 0, 0, 0]]
    init_Data_ErrorMgr_ErrorCommPack_2_0_B: value-spec=fields=[0, 0, 144 x 0, 144 x fields=[0, 0, 0, 0]]
    init_Data_ErrorMgr_ErrorCommPack_2_1_B: value-spec=fields=[0, 0, 548 x 0, 548 x fields=[0, 0, 0, 0]]
    init_Data_ErrorMgr_ErrorCommPack_QNX_B: value-spec=fields=[0, 0, 8 x 0, 8 x fields=[0, 0, 0, 0]]
    init_SafeStateOp: value-spec=fields=16 x 0
    init_Errors_B: value-spec=35 x 0
    init_Data_DtcAddData_B: value-spec=fields=[[0, 0, 0, 0], [0, 0, 0, 0], [0, 0, 0, 0], [0, 0, 0, 0], [0, 0, 0, 0], [0, 0, 0, 0], [0, 0, 0, 0], [0, 0, 0, 0], [0, 0, 0, 0], [0, 0, 0, 0], [0, 0, 0, 0], [0, 0, 0, 0], [0, 0, 0, 0], [0, 0, 0, 0], [0, 0, 0, 0], [0, 0, 0, 0], [0, 0, 0, 0], [0, 0, 0, 0], [0, 0, 0, 0], [0, 0, 0, 0], [0, 0, 0, 0], [0, 0, 0, 0], [0, 0, 0, 0], [0, 0, 0, 0], [0, 0, 0, 0], [0, 0, 0, 0], [0, 0, 0, 0], [0, 0, 0, 0], [0, 0, 0, 0], [0, 0, 0, 0], [0, 0, 0, 0], [0, 0, 0, 0], [0, 0, 0, 0], [0, 0, 0, 0], [0, 0, 0, 0], [0, 0, 0, 0], [0, 0, 0, 0], [0, 0, 0, 0], [0, 0, 0, 0], [0, 0, 0, 0], [0, 0, 0, 0], [0, 0, 0, 0], [0, 0, 0, 0], [0, 0, 0, 0], [0, 0, 0, 0], [0, 0, 0, 0], [0, 0, 0, 0], [0, 0, 0, 0], [0, 0, 0, 0], [0, 0, 0, 0], [0, 0, 0, 0], [0, 0, 0, 0], [0, 0, 0, 0], [0, 0, 0, 0], [0, 0, 0, 0], [0, 0, 0, 0], [0, 0, 0, 0], [0, 0, 0, 0], [0, 0, 0, 0], [0, 0, 0, 0], [0, 0, 0, 0], [0, 0, 0, 0]]
    init_Data_DtcStatus_B: value-spec=fields=[0, 0, 0, 0, 0, 0, 0, 0, 0, 0, 0, 0, 0, 0, 0, 0, 0, 0, 0, 0, 0, 0, 0, 0, 0, 0, 0, 0, 0, 0, 0, 0, 0, 0, 0, 0, 0, 0, 0, 0, 0, 0, 0, 0, 0, 0, 0, 0, 0, 0, 0, 0, 0, 0, 0, 0, 0, 0, 0, 0, 0, 0]
package /Pkg_ErrorMgrAgg_1_0_QM/Constant
  8 x constant specification:
    init_SafeStateOp: value-spec=fields=16 x 0
    init_Errors_QM: value-spec=[0]
    init_Data_ErrorMgr_ErrorCommPack_1_0_QM: value-spec=fields=[0, 0, 12 x 0, 12 x fields=[0, 0, 0, 0]]
    init_Data_ErrorMgr_ErrorCommPack_2_0_QM: value-spec=fields=[0, 0, [0], [0, 0, 0], [fields=[0, 0, 0, 0]]]
    init_Data_ErrorMgr_ErrorCommPack_2_1_QM: value-spec=fields=[0, 0, [0], [0, 0, 0], [fields=[0, 0, 0, 0]]]
    init_Data_ErrorMgr_ErrorCommPack_QNX_QM: value-spec=fields=[0, 0, [0], [0, 0, 0], [fields=[0, 0, 0, 0]]]
    init_Data_DtcStatus_QM: value-spec=fields=[0, 0, 0, 0]
    init_Data_DtcAddData_QM: value-spec=fields=[[0, 0, 0, 0], [0, 0, 0, 0], [0, 0, 0, 0], [0, 0, 0, 0]]
package /Pkg_DegManager_A/Constant
  constant specification init_RES_A: value-spec=19 x 0
