AUTOSAR XML (schema 00048)
package /MICROSAR/Os_ib_bswmd/SwAddrMethods
  60 x sw addr method:
    SystemApplication_OsCore0_CONST: section-type=CONST
    SystemApplication_OsCore0_CONST_FAST: section-type=CONST
    SystemApplication_OsCore0_VAR_SAVED_ZONE: section-initialization-policy=NO_INIT, section-type=VAR
    SystemApplication_OsCore0_VAR_INIT: section-initialization-policy=INIT, section-type=VAR
    SystemApplication_OsCore0_VAR_FAST_INIT: section-initialization-policy=INIT, section-type=VAR-FAST
    SystemApplication_OsCore0_VAR_NOCACHE_INIT: section-initialization-policy=INIT, section-type=VAR
    SystemApplication_OsCore0_VAR_NO_INIT: section-initialization-policy=NO_INIT, section-type=VAR
    SystemApplication_OsCore0_VAR_FAST_NO_INIT: section-initialization-policy=NO_INIT, section-type=VAR-FAST
    SystemApplication_OsCore0_VAR_NOCACHE_NO_INIT: section-initialization-policy=NO_INIT, section-type=VAR
    SystemApplication_OsCore0_VAR_CLEARED: section-initialization-policy=CLEARED, section-type=VAR
    SystemApplication_OsCore0_VAR_FAST_CLEARED: section-initialization-policy=CLEARED, section-type=VAR-FAST
    SystemApplication_OsCore0_VAR_NOCACHE_CLEARED: section-initialization-policy=CLEARED, section-type=VAR
    GLOBALSHARED_CONST: section-type=CONST
    GLOBALSHARED_CONST_FAST: section-type=CONST
    GLOBALSHARED_VAR_SAVED_ZONE: section-initialization-policy=NO_INIT, section-type=VAR
    GLOBALSHARED_VAR_INIT: section-initialization-policy=INIT, section-type=VAR
    GLOBALSHARED_VAR_FAST_INIT: section-initialization-policy=INIT, section-type=VAR-FAST
    GLOBALSHARED_VAR_NOCACHE_INIT: section-initialization-policy=INIT, section-type=VAR
    GLOBALSHARED_VAR_NO_INIT: section-initialization-policy=NO_INIT, section-type=VAR
    GLOBALSHARED_VAR_FAST_NO_INIT: section-initialization-policy=NO_INIT, section-type=VAR-FAST
    GLOBALSHARED_VAR_NOCACHE_NO_INIT: section-initialization-policy=NO_INIT, section-type=VAR
    GLOBALSHARED_VAR_CLEARED: section-initialization-policy=CLEARED, section-type=VAR
    GLOBALSHARED_VAR_FAST_CLEARED: section-initialization-policy=CLEARED, section-type=VAR-FAST
    GLOBALSHARED_VAR_NOCACHE_CLEARED: section-initialization-policy=CLEARED, section-type=VAR
    OsApplication_Trusted_Core0_CONST: section-type=CONST
    OsApplication_Trusted_Core0_CONST_FAST: section-type=CONST
    OsApplication_Trusted_Core0_VAR_SAVED_ZONE: section-initialization-policy=NO_INIT, section-type=VAR
    OsApplication_Trusted_Core0_VAR_INIT: section-initialization-policy=INIT, section-type=VAR
    OsApplication_Trusted_Core0_VAR_FAST_INIT: section-initialization-policy=INIT, section-type=VAR-FAST
    OsApplication_Trusted_Core0_VAR_NOCACHE_INIT: section-initialization-policy=INIT, section-type=VAR
    OsApplication_Trusted_Core0_VAR_NO_INIT: section-initialization-policy=NO_INIT, section-type=VAR
    OsApplication_Trusted_Core0_VAR_FAST_NO_INIT: section-initialization-policy=NO_INIT, section-type=VAR-FAST
    OsApplication_Trusted_Core0_VAR_NOCACHE_NO_INIT: section-initialization-policy=NO_INIT, section-type=VAR
    OsApplication_Trusted_Core0_VAR_CLEARED: section-initialization-policy=CLEARED, section-type=VAR
    OsApplication_Trusted_Core0_VAR_FAST_CLEARED: section-initialization-policy=CLEARED, section-type=VAR-FAST
    OsApplication_Trusted_Core0_VAR_NOCACHE_CLEARED: section-initialization-policy=CLEARED, section-type=VAR
    OsApplication_Safety_CONST: section-type=CONST
    OsApplication_Safety_CONST_FAST: section-type=CONST
    OsApplication_Safety_VAR_SAVED_ZONE: section-initialization-policy=NO_INIT, section-type=VAR
    OsApplication_Safety_VAR_INIT: section-initialization-policy=INIT, section-type=VAR
    OsApplication_Safety_VAR_FAST_INIT: section-initialization-policy=INIT, section-type=VAR-FAST
    OsApplication_Safety_VAR_NOCACHE_INIT: section-initialization-policy=INIT, section-type=VAR
    OsApplication_Safety_VAR_NO_INIT: section-initialization-policy=NO_INIT, section-type=VAR
    OsApplication_Safety_VAR_FAST_NO_INIT: section-initialization-policy=NO_INIT, section-type=VAR-FAST
    OsApplication_Safety_VAR_NOCACHE_NO_INIT: section-initialization-policy=NO_INIT, section-type=VAR
    OsApplication_Safety_VAR_CLEARED: section-initialization-policy=CLEARED, section-type=VAR
    OsApplication_Safety_VAR_FAST_CLEARED: section-initialization-policy=CLEARED, section-type=VAR-FAST
    OsApplication_Safety_VAR_NOCACHE_CLEARED: section-initialization-policy=CLEARED, section-type=VAR
    OsApplication_QM_CONST: section-type=CONST
    OsApplication_QM_CONST_FAST: section-type=CONST
    OsApplication_QM_VAR_SAVED_ZONE: section-initialization-policy=NO_INIT, section-type=VAR
    OsApplication_QM_VAR_INIT: section-initialization-policy=INIT, section-type=VAR
    OsApplication_QM_VAR_FAST_INIT: section-initialization-policy=INIT, section-type=VAR-FAST
    OsApplication_QM_VAR_NOCACHE_INIT: section-initialization-policy=INIT, section-type=VAR
    OsApplication_QM_VAR_NO_INIT: section-initialization-policy=NO_INIT, section-type=VAR
    OsApplication_QM_VAR_FAST_NO_INIT: section-initialization-policy=NO_INIT, section-type=VAR-FAST
    OsApplication_QM_VAR_NOCACHE_NO_INIT: section-initialization-policy=NO_INIT, section-type=VAR
    OsApplication_QM_VAR_CLEARED: section-initialization-policy=CLEARED, section-type=VAR
    OsApplication_QM_VAR_FAST_CLEARED: section-initialization-policy=CLEARED, section-type=VAR-FAST
    OsApplication_QM_VAR_NOCACHE_CLEARED: section-initialization-policy=CLEARED, section-type=VAR
