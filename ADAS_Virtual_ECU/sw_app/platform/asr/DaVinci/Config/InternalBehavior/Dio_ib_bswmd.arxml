AUTOSAR XML (schema 00044)
package /TI_J7/Dio_ib_bswmd/BswModuleDescriptions
  bsw module description Dio
    bsw internal behavior DioBehavior
      exclusive area DIO_EXCLUSIVE_AREA_0
