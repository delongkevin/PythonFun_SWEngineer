AUTOSAR XML (schema 00048)
package /TI_J7/Wdg_ib_bswmd/BswModuleDescriptions
  bsw module description Wdg
    bsw internal behavior WdgBehavior
      exclusive area WDG_EXCLUSIVE_AREA_0
