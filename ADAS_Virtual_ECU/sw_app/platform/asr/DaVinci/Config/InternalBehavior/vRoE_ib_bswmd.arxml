AUTOSAR XML (schema 00048)
package /MICROSAR/vRoE_ib_bswmd/BswModuleDescriptions
  bsw module description vRoE: provided-entrys=vRoE_MainFunction
    bsw internal behavior vRoEBehavior
      exclusive area VROE_EXCLUSIVE_AREA_0
      bsw schedulable entity vRoE_MainFunction: implemented-entry=vRoE_MainFunction
      bsw timing event vRoE_MainFunctionTimingEvent0: starts-on-event=vRoE_MainFunction, period=0.2
  bsw module entry vRoE_MainFunction: call-type=SCHEDULED, execution-context=TASK
