AUTOSAR XML (schema 00048)
package /MICROSAR
  bsw implementation IpduM_Impl: programming-language=C, sw-version=11.02.01, used-code-generator=DaVinci Configurator, vendor-id=30, ar-release-version=4.03.01
