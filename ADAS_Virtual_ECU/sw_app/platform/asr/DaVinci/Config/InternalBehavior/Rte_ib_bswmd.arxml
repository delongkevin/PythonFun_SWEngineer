AUTOSAR XML (schema 00048)
standard types defined: uint16, uint32, uint8, boolean, float32
package /MICROSAR
  bsw implementation Rte_Impl: programming-language=C, sw-version=4.31.00, used-code-generator=DaVinci Configurator, vendor-id=30, ar-release-version=4.03.01
    mc-parameter-instances:
      33 x mc data instance:
        CalDataProvider_SVSCamCurrentCalibData_DefaultValue: category=STRUCTURE, flat-map-entry=CalDataProvider_SVSCamCurrentCalibData_DefaultValue, symbol=Rte_CalDataProvider_SVSCamCurrentCalibData_DefaultValue
          mc data instance calibrated: category=VALUE, resulting-properties={base-type=uint8, sw-calibration-access=READ-WRITE, data-constr=uint8_DataConstr}
          mc data instance data: category=STRUCTURE
            4 x mc data instance, all with category=STRUCTURE:
              CamFrontCurrent
                mc data instance CamCalibData_STM: category=STRUCTURE
                  6 x mc data instance:
                    calibdata: category=STRUCTURE
                      6 x mc data instance, all with category=VALUE:
                        Pitch_f32: resulting-properties={base-type=float32, sw-calibration-access=READ-WRITE, data-constr=float32_DataConstr}
                        Yaw_f32: resulting-properties={base-type=float32, sw-calibration-access=READ-WRITE, data-constr=float32_DataConstr}
                        Roll_f32: resulting-properties={base-type=float32, sw-calibration-access=READ-WRITE, data-constr=float32_DataConstr}
                        CalibStatus_e: resulting-properties={base-type=uint32, sw-calibration-access=READ-WRITE, compu-method=ME_Hydra3defs_E_CalibStatus_t, range raw 0..4294967295}
                        NewValueAvailable_b: resulting-properties={base-type=boolean, sw-calibration-access=READ-WRITE, compu-method=boolean_CompuMethod, data-constr=boolean_DataConstr}
                        OverwriteStatus_b: resulting-properties={base-type=boolean, sw-calibration-access=READ-WRITE, compu-method=boolean_CompuMethod, data-constr=boolean_DataConstr}
                    X_f32: category=VALUE, resulting-properties={base-type=float32, sw-calibration-access=READ-WRITE, data-constr=float32_DataConstr}
                    Y_f32: category=VALUE, resulting-properties={base-type=float32, sw-calibration-access=READ-WRITE, data-constr=float32_DataConstr}
                    Z_f32: category=VALUE, resulting-properties={base-type=float32, sw-calibration-access=READ-WRITE, data-constr=float32_DataConstr}
                    EOLIterationData_au8: category=ARRAY, array-size=5, resulting-properties={base-type=uint8, sw-calibration-access=READ-WRITE, data-constr=uint8_DataConstr}
                    Reserved_au8: category=ARRAY, array-size=7, resulting-properties={base-type=uint8, sw-calibration-access=READ-WRITE, data-constr=uint8_DataConstr}
                mc data instance CamCalibIDs_STM: category=VALUE, resulting-properties={base-type=uint32, sw-calibration-access=READ-WRITE, compu-method=ME_Hydra3defs_E_CalibrationID_t, range raw 0..4294967295}
              CamLeftCurrent
                mc data instance CamCalibData_STM: category=STRUCTURE
                  6 x mc data instance:
                    calibdata: category=STRUCTURE
                      6 x mc data instance, all with category=VALUE:
                        Pitch_f32: resulting-properties={base-type=float32, sw-calibration-access=READ-WRITE, data-constr=float32_DataConstr}
                        Yaw_f32: resulting-properties={base-type=float32, sw-calibration-access=READ-WRITE, data-constr=float32_DataConstr}
                        Roll_f32: resulting-properties={base-type=float32, sw-calibration-access=READ-WRITE, data-constr=float32_DataConstr}
                        CalibStatus_e: resulting-properties={base-type=uint32, sw-calibration-access=READ-WRITE, compu-method=ME_Hydra3defs_E_CalibStatus_t, range raw 0..4294967295}
                        NewValueAvailable_b: resulting-properties={base-type=boolean, sw-calibration-access=READ-WRITE, compu-method=boolean_CompuMethod, data-constr=boolean_DataConstr}
                        OverwriteStatus_b: resulting-properties={base-type=boolean, sw-calibration-access=READ-WRITE, compu-method=boolean_CompuMethod, data-constr=boolean_DataConstr}
                    X_f32: category=VALUE, resulting-properties={base-type=float32, sw-calibration-access=READ-WRITE, data-constr=float32_DataConstr}
                    Y_f32: category=VALUE, resulting-properties={base-type=float32, sw-calibration-access=READ-WRITE, data-constr=float32_DataConstr}
                    Z_f32: category=VALUE, resulting-properties={base-type=float32, sw-calibration-access=READ-WRITE, data-constr=float32_DataConstr}
                    EOLIterationData_au8: category=ARRAY, array-size=5, resulting-properties={base-type=uint8, sw-calibration-access=READ-WRITE, data-constr=uint8_DataConstr}
                    Reserved_au8: category=ARRAY, array-size=7, resulting-properties={base-type=uint8, sw-calibration-access=READ-WRITE, data-constr=uint8_DataConstr}
                mc data instance CamCalibIDs_STM: category=VALUE, resulting-properties={base-type=uint32, sw-calibration-access=READ-WRITE, compu-method=ME_Hydra3defs_E_CalibrationID_t, range raw 0..4294967295}
              CamRearCurrent
                mc data instance CamCalibData_STM: category=STRUCTURE
                  6 x mc data instance:
                    calibdata: category=STRUCTURE
                      6 x mc data instance, all with category=VALUE:
                        Pitch_f32: resulting-properties={base-type=float32, sw-calibration-access=READ-WRITE, data-constr=float32_DataConstr}
                        Yaw_f32: resulting-properties={base-type=float32, sw-calibration-access=READ-WRITE, data-constr=float32_DataConstr}
                        Roll_f32: resulting-properties={base-type=float32, sw-calibration-access=READ-WRITE, data-constr=float32_DataConstr}
                        CalibStatus_e: resulting-properties={base-type=uint32, sw-calibration-access=READ-WRITE, compu-method=ME_Hydra3defs_E_CalibStatus_t, range raw 0..4294967295}
                        NewValueAvailable_b: resulting-properties={base-type=boolean, sw-calibration-access=READ-WRITE, compu-method=boolean_CompuMethod, data-constr=boolean_DataConstr}
                        OverwriteStatus_b: resulting-properties={base-type=boolean, sw-calibration-access=READ-WRITE, compu-method=boolean_CompuMethod, data-constr=boolean_DataConstr}
                    X_f32: category=VALUE, resulting-properties={base-type=float32, sw-calibration-access=READ-WRITE, data-constr=float32_DataConstr}
                    Y_f32: category=VALUE, resulting-properties={base-type=float32, sw-calibration-access=READ-WRITE, data-constr=float32_DataConstr}
                    Z_f32: category=VALUE, resulting-properties={base-type=float32, sw-calibration-access=READ-WRITE, data-constr=float32_DataConstr}
                    EOLIterationData_au8: category=ARRAY, array-size=5, resulting-properties={base-type=uint8, sw-calibration-access=READ-WRITE, data-constr=uint8_DataConstr}
                    Reserved_au8: category=ARRAY, array-size=7, resulting-properties={base-type=uint8, sw-calibration-access=READ-WRITE, data-constr=uint8_DataConstr}
                mc data instance CamCalibIDs_STM: category=VALUE, resulting-properties={base-type=uint32, sw-calibration-access=READ-WRITE, compu-method=ME_Hydra3defs_E_CalibrationID_t, range raw 0..4294967295}
              CamRightCurrent
                mc data instance CamCalibData_STM: category=STRUCTURE
                  6 x mc data instance:
                    calibdata: category=STRUCTURE
                      6 x mc data instance, all with category=VALUE:
                        Pitch_f32: resulting-properties={base-type=float32, sw-calibration-access=READ-WRITE, data-constr=float32_DataConstr}
                        Yaw_f32: resulting-properties={base-type=float32, sw-calibration-access=READ-WRITE, data-constr=float32_DataConstr}
                        Roll_f32: resulting-properties={base-type=float32, sw-calibration-access=READ-WRITE, data-constr=float32_DataConstr}
                        CalibStatus_e: resulting-properties={base-type=uint32, sw-calibration-access=READ-WRITE, compu-method=ME_Hydra3defs_E_CalibStatus_t, range raw 0..4294967295}
                        NewValueAvailable_b: resulting-properties={base-type=boolean, sw-calibration-access=READ-WRITE, compu-method=boolean_CompuMethod, data-constr=boolean_DataConstr}
                        OverwriteStatus_b: resulting-properties={base-type=boolean, sw-calibration-access=READ-WRITE, compu-method=boolean_CompuMethod, data-constr=boolean_DataConstr}
                    X_f32: category=VALUE, resulting-properties={base-type=float32, sw-calibration-access=READ-WRITE, data-constr=float32_DataConstr}
                    Y_f32: category=VALUE, resulting-properties={base-type=float32, sw-calibration-access=READ-WRITE, data-constr=float32_DataConstr}
                    Z_f32: category=VALUE, resulting-properties={base-type=float32, sw-calibration-access=READ-WRITE, data-constr=float32_DataConstr}
                    EOLIterationData_au8: category=ARRAY, array-size=5, resulting-properties={base-type=uint8, sw-calibration-access=READ-WRITE, data-constr=uint8_DataConstr}
                    Reserved_au8: category=ARRAY, array-size=7, resulting-properties={base-type=uint8, sw-calibration-access=READ-WRITE, data-constr=uint8_DataConstr}
                mc data instance CamCalibIDs_STM: category=VALUE, resulting-properties={base-type=uint32, sw-calibration-access=READ-WRITE, compu-method=ME_Hydra3defs_E_CalibrationID_t, range raw 0..4294967295}
          mc data instance PrevOdoValue: category=VALUE, resulting-properties={base-type=uint16, sw-calibration-access=READ-WRITE, data-constr=uint16_DataConstr}
        CalDataProvider_SVSCamEOLCalibData_DefaultValue: category=STRUCTURE, flat-map-entry=CalDataProvider_SVSCamEOLCalibData_DefaultValue, symbol=Rte_CalDataProvider_SVSCamEOLCalibData_DefaultValue
          mc data instance calibrated: category=VALUE, resulting-properties={base-type=uint8, sw-calibration-access=READ-WRITE, data-constr=uint8_DataConstr}
          mc data instance data: category=STRUCTURE
            4 x mc data instance, all with category=STRUCTURE:
              CamFrontEOL
                mc data instance CamCalibData_STM: category=STRUCTURE
                  6 x mc data instance:
                    calibdata: category=STRUCTURE
                      6 x mc data instance, all with category=VALUE:
                        Pitch_f32: resulting-properties={base-type=float32, sw-calibration-access=READ-WRITE, data-constr=float32_DataConstr}
                        Yaw_f32: resulting-properties={base-type=float32, sw-calibration-access=READ-WRITE, data-constr=float32_DataConstr}
                        Roll_f32: resulting-properties={base-type=float32, sw-calibration-access=READ-WRITE, data-constr=float32_DataConstr}
                        CalibStatus_e: resulting-properties={base-type=uint32, sw-calibration-access=READ-WRITE, compu-method=ME_Hydra3defs_E_CalibStatus_t, range raw 0..4294967295}
                        NewValueAvailable_b: resulting-properties={base-type=boolean, sw-calibration-access=READ-WRITE, compu-method=boolean_CompuMethod, data-constr=boolean_DataConstr}
                        OverwriteStatus_b: resulting-properties={base-type=boolean, sw-calibration-access=READ-WRITE, compu-method=boolean_CompuMethod, data-constr=boolean_DataConstr}
                    X_f32: category=VALUE, resulting-properties={base-type=float32, sw-calibration-access=READ-WRITE, data-constr=float32_DataConstr}
                    Y_f32: category=VALUE, resulting-properties={base-type=float32, sw-calibration-access=READ-WRITE, data-constr=float32_DataConstr}
                    Z_f32: category=VALUE, resulting-properties={base-type=float32, sw-calibration-access=READ-WRITE, data-constr=float32_DataConstr}
                    EOLIterationData_au8: category=ARRAY, array-size=5, resulting-properties={base-type=uint8, sw-calibration-access=READ-WRITE, data-constr=uint8_DataConstr}
                    Reserved_au8: category=ARRAY, array-size=7, resulting-properties={base-type=uint8, sw-calibration-access=READ-WRITE, data-constr=uint8_DataConstr}
                mc data instance CamCalibIDs_STM: category=VALUE, resulting-properties={base-type=uint32, sw-calibration-access=READ-WRITE, compu-method=ME_Hydra3defs_E_CalibrationID_t, range raw 0..4294967295}
              CamLeftEOL
                mc data instance CamCalibData_STM: category=STRUCTURE
                  6 x mc data instance:
                    calibdata: category=STRUCTURE
                      6 x mc data instance, all with category=VALUE:
                        Pitch_f32: resulting-properties={base-type=float32, sw-calibration-access=READ-WRITE, data-constr=float32_DataConstr}
                        Yaw_f32: resulting-properties={base-type=float32, sw-calibration-access=READ-WRITE, data-constr=float32_DataConstr}
                        Roll_f32: resulting-properties={base-type=float32, sw-calibration-access=READ-WRITE, data-constr=float32_DataConstr}
                        CalibStatus_e: resulting-properties={base-type=uint32, sw-calibration-access=READ-WRITE, compu-method=ME_Hydra3defs_E_CalibStatus_t, range raw 0..4294967295}
                        NewValueAvailable_b: resulting-properties={base-type=boolean, sw-calibration-access=READ-WRITE, compu-method=boolean_CompuMethod, data-constr=boolean_DataConstr}
                        OverwriteStatus_b: resulting-properties={base-type=boolean, sw-calibration-access=READ-WRITE, compu-method=boolean_CompuMethod, data-constr=boolean_DataConstr}
                    X_f32: category=VALUE, resulting-properties={base-type=float32, sw-calibration-access=READ-WRITE, data-constr=float32_DataConstr}
                    Y_f32: category=VALUE, resulting-properties={base-type=float32, sw-calibration-access=READ-WRITE, data-constr=float32_DataConstr}
                    Z_f32: category=VALUE, resulting-properties={base-type=float32, sw-calibration-access=READ-WRITE, data-constr=float32_DataConstr}
                    EOLIterationData_au8: category=ARRAY, array-size=5, resulting-properties={base-type=uint8, sw-calibration-access=READ-WRITE, data-constr=uint8_DataConstr}
                    Reserved_au8: category=ARRAY, array-size=7, resulting-properties={base-type=uint8, sw-calibration-access=READ-WRITE, data-constr=uint8_DataConstr}
                mc data instance CamCalibIDs_STM: category=VALUE, resulting-properties={base-type=uint32, sw-calibration-access=READ-WRITE, compu-method=ME_Hydra3defs_E_CalibrationID_t, range raw 0..4294967295}
              CamRearEOL
                mc data instance CamCalibData_STM: category=STRUCTURE
                  6 x mc data instance:
                    calibdata: category=STRUCTURE
                      6 x mc data instance, all with category=VALUE:
                        Pitch_f32: resulting-properties={base-type=float32, sw-calibration-access=READ-WRITE, data-constr=float32_DataConstr}
                        Yaw_f32: resulting-properties={base-type=float32, sw-calibration-access=READ-WRITE, data-constr=float32_DataConstr}
                        Roll_f32: resulting-properties={base-type=float32, sw-calibration-access=READ-WRITE, data-constr=float32_DataConstr}
                        CalibStatus_e: resulting-properties={base-type=uint32, sw-calibration-access=READ-WRITE, compu-method=ME_Hydra3defs_E_CalibStatus_t, range raw 0..4294967295}
                        NewValueAvailable_b: resulting-properties={base-type=boolean, sw-calibration-access=READ-WRITE, compu-method=boolean_CompuMethod, data-constr=boolean_DataConstr}
                        OverwriteStatus_b: resulting-properties={base-type=boolean, sw-calibration-access=READ-WRITE, compu-method=boolean_CompuMethod, data-constr=boolean_DataConstr}
                    X_f32: category=VALUE, resulting-properties={base-type=float32, sw-calibration-access=READ-WRITE, data-constr=float32_DataConstr}
                    Y_f32: category=VALUE, resulting-properties={base-type=float32, sw-calibration-access=READ-WRITE, data-constr=float32_DataConstr}
                    Z_f32: category=VALUE, resulting-properties={base-type=float32, sw-calibration-access=READ-WRITE, data-constr=float32_DataConstr}
                    EOLIterationData_au8: category=ARRAY, array-size=5, resulting-properties={base-type=uint8, sw-calibration-access=READ-WRITE, data-constr=uint8_DataConstr}
                    Reserved_au8: category=ARRAY, array-size=7, resulting-properties={base-type=uint8, sw-calibration-access=READ-WRITE, data-constr=uint8_DataConstr}
                mc data instance CamCalibIDs_STM: category=VALUE, resulting-properties={base-type=uint32, sw-calibration-access=READ-WRITE, compu-method=ME_Hydra3defs_E_CalibrationID_t, range raw 0..4294967295}
              CamRightEOL
                mc data instance CamCalibData_STM: category=STRUCTURE
                  6 x mc data instance:
                    calibdata: category=STRUCTURE
                      6 x mc data instance, all with category=VALUE:
                        Pitch_f32: resulting-properties={base-type=float32, sw-calibration-access=READ-WRITE, data-constr=float32_DataConstr}
                        Yaw_f32: resulting-properties={base-type=float32, sw-calibration-access=READ-WRITE, data-constr=float32_DataConstr}
                        Roll_f32: resulting-properties={base-type=float32, sw-calibration-access=READ-WRITE, data-constr=float32_DataConstr}
                        CalibStatus_e: resulting-properties={base-type=uint32, sw-calibration-access=READ-WRITE, compu-method=ME_Hydra3defs_E_CalibStatus_t, range raw 0..4294967295}
                        NewValueAvailable_b: resulting-properties={base-type=boolean, sw-calibration-access=READ-WRITE, compu-method=boolean_CompuMethod, data-constr=boolean_DataConstr}
                        OverwriteStatus_b: resulting-properties={base-type=boolean, sw-calibration-access=READ-WRITE, compu-method=boolean_CompuMethod, data-constr=boolean_DataConstr}
                    X_f32: category=VALUE, resulting-properties={base-type=float32, sw-calibration-access=READ-WRITE, data-constr=float32_DataConstr}
                    Y_f32: category=VALUE, resulting-properties={base-type=float32, sw-calibration-access=READ-WRITE, data-constr=float32_DataConstr}
                    Z_f32: category=VALUE, resulting-properties={base-type=float32, sw-calibration-access=READ-WRITE, data-constr=float32_DataConstr}
                    EOLIterationData_au8: category=ARRAY, array-size=5, resulting-properties={base-type=uint8, sw-calibration-access=READ-WRITE, data-constr=uint8_DataConstr}
                    Reserved_au8: category=ARRAY, array-size=7, resulting-properties={base-type=uint8, sw-calibration-access=READ-WRITE, data-constr=uint8_DataConstr}
                mc data instance CamCalibIDs_STM: category=VALUE, resulting-properties={base-type=uint32, sw-calibration-access=READ-WRITE, compu-method=ME_Hydra3defs_E_CalibrationID_t, range raw 0..4294967295}
          mc data instance PlantOdoValue: category=VALUE, resulting-properties={base-type=uint16, sw-calibration-access=READ-WRITE, data-constr=uint16_DataConstr}
        CalDataProvider_SVSCamOCCalibData_DefaultValue: category=STRUCTURE, flat-map-entry=CalDataProvider_SVSCamOCCalibData_DefaultValue, symbol=Rte_CalDataProvider_SVSCamOCCalibData_DefaultValue
          mc data instance calibrated: category=VALUE, resulting-properties={base-type=uint8, sw-calibration-access=READ-WRITE, data-constr=uint8_DataConstr}
          mc data instance data: category=STRUCTURE
            4 x mc data instance, all with category=STRUCTURE:
              CamFrontOC
                mc data instance CamCalibData_STM: category=STRUCTURE
                  6 x mc data instance, all with category=VALUE:
                    Pitch_f32: resulting-properties={base-type=float32, sw-calibration-access=READ-WRITE, data-constr=float32_DataConstr}
                    Yaw_f32: resulting-properties={base-type=float32, sw-calibration-access=READ-WRITE, data-constr=float32_DataConstr}
                    Roll_f32: resulting-properties={base-type=float32, sw-calibration-access=READ-WRITE, data-constr=float32_DataConstr}
                    CalibStatus_e: resulting-properties={base-type=uint32, sw-calibration-access=READ-WRITE, compu-method=ME_Hydra3defs_E_CalibStatus_t, range raw 0..4294967295}
                    NewValueAvailable_b: resulting-properties={base-type=boolean, sw-calibration-access=READ-WRITE, compu-method=boolean_CompuMethod, data-constr=boolean_DataConstr}
                    OverwriteStatus_b: resulting-properties={base-type=boolean, sw-calibration-access=READ-WRITE, compu-method=boolean_CompuMethod, data-constr=boolean_DataConstr}
                mc data instance CamCalibIDs_STM: category=VALUE, resulting-properties={base-type=uint32, sw-calibration-access=READ-WRITE, compu-method=ME_Hydra3defs_E_CalibrationID_t, range raw 0..4294967295}
              CamLeftOC
                mc data instance CamCalibData_STM: category=STRUCTURE
                  6 x mc data instance, all with category=VALUE:
                    Pitch_f32: resulting-properties={base-type=float32, sw-calibration-access=READ-WRITE, data-constr=float32_DataConstr}
                    Yaw_f32: resulting-properties={base-type=float32, sw-calibration-access=READ-WRITE, data-constr=float32_DataConstr}
                    Roll_f32: resulting-properties={base-type=float32, sw-calibration-access=READ-WRITE, data-constr=float32_DataConstr}
                    CalibStatus_e: resulting-properties={base-type=uint32, sw-calibration-access=READ-WRITE, compu-method=ME_Hydra3defs_E_CalibStatus_t, range raw 0..4294967295}
                    NewValueAvailable_b: resulting-properties={base-type=boolean, sw-calibration-access=READ-WRITE, compu-method=boolean_CompuMethod, data-constr=boolean_DataConstr}
                    OverwriteStatus_b: resulting-properties={base-type=boolean, sw-calibration-access=READ-WRITE, compu-method=boolean_CompuMethod, data-constr=boolean_DataConstr}
                mc data instance CamCalibIDs_STM: category=VALUE, resulting-properties={base-type=uint32, sw-calibration-access=READ-WRITE, compu-method=ME_Hydra3defs_E_CalibrationID_t, range raw 0..4294967295}
              CamRearOC
                mc data instance CamCalibData_STM: category=STRUCTURE
                  6 x mc data instance, all with category=VALUE:
                    Pitch_f32: resulting-properties={base-type=float32, sw-calibration-access=READ-WRITE, data-constr=float32_DataConstr}
                    Yaw_f32: resulting-properties={base-type=float32, sw-calibration-access=READ-WRITE, data-constr=float32_DataConstr}
                    Roll_f32: resulting-properties={base-type=float32, sw-calibration-access=READ-WRITE, data-constr=float32_DataConstr}
                    CalibStatus_e: resulting-properties={base-type=uint32, sw-calibration-access=READ-WRITE, compu-method=ME_Hydra3defs_E_CalibStatus_t, range raw 0..4294967295}
                    NewValueAvailable_b: resulting-properties={base-type=boolean, sw-calibration-access=READ-WRITE, compu-method=boolean_CompuMethod, data-constr=boolean_DataConstr}
                    OverwriteStatus_b: resulting-properties={base-type=boolean, sw-calibration-access=READ-WRITE, compu-method=boolean_CompuMethod, data-constr=boolean_DataConstr}
                mc data instance CamCalibIDs_STM: category=VALUE, resulting-properties={base-type=uint32, sw-calibration-access=READ-WRITE, compu-method=ME_Hydra3defs_E_CalibrationID_t, range raw 0..4294967295}
              CamRightOC
                mc data instance CamCalibData_STM: category=STRUCTURE
                  6 x mc data instance, all with category=VALUE:
                    Pitch_f32: resulting-properties={base-type=float32, sw-calibration-access=READ-WRITE, data-constr=float32_DataConstr}
                    Yaw_f32: resulting-properties={base-type=float32, sw-calibration-access=READ-WRITE, data-constr=float32_DataConstr}
                    Roll_f32: resulting-properties={base-type=float32, sw-calibration-access=READ-WRITE, data-constr=float32_DataConstr}
                    CalibStatus_e: resulting-properties={base-type=uint32, sw-calibration-access=READ-WRITE, compu-method=ME_Hydra3defs_E_CalibStatus_t, range raw 0..4294967295}
                    NewValueAvailable_b: resulting-properties={base-type=boolean, sw-calibration-access=READ-WRITE, compu-method=boolean_CompuMethod, data-constr=boolean_DataConstr}
                    OverwriteStatus_b: resulting-properties={base-type=boolean, sw-calibration-access=READ-WRITE, compu-method=boolean_CompuMethod, data-constr=boolean_DataConstr}
                mc data instance CamCalibIDs_STM: category=VALUE, resulting-properties={base-type=uint32, sw-calibration-access=READ-WRITE, compu-method=ME_Hydra3defs_E_CalibrationID_t, range raw 0..4294967295}
        CalDataProvider_SVSCamSCCalibData_DefaultValue: category=STRUCTURE, flat-map-entry=CalDataProvider_SVSCamSCCalibData_DefaultValue, symbol=Rte_CalDataProvider_SVSCamSCCalibData_DefaultValue
          mc data instance calibrated: category=VALUE, resulting-properties={base-type=uint8, sw-calibration-access=READ-WRITE, data-constr=uint8_DataConstr}
          mc data instance data: category=STRUCTURE
            4 x mc data instance, all with category=STRUCTURE:
              CamFrontSC
                mc data instance CamCalibData_STM: category=STRUCTURE
                  6 x mc data instance, all with category=VALUE:
                    Pitch_f32: resulting-properties={base-type=float32, sw-calibration-access=READ-WRITE, data-constr=float32_DataConstr}
                    Yaw_f32: resulting-properties={base-type=float32, sw-calibration-access=READ-WRITE, data-constr=float32_DataConstr}
                    Roll_f32: resulting-properties={base-type=float32, sw-calibration-access=READ-WRITE, data-constr=float32_DataConstr}
                    CalibStatus_e: resulting-properties={base-type=uint32, sw-calibration-access=READ-WRITE, compu-method=ME_Hydra3defs_E_CalibStatus_t, range raw 0..4294967295}
                    NewValueAvailable_b: resulting-properties={base-type=boolean, sw-calibration-access=READ-WRITE, compu-method=boolean_CompuMethod, data-constr=boolean_DataConstr}
                    OverwriteStatus_b: resulting-properties={base-type=boolean, sw-calibration-access=READ-WRITE, compu-method=boolean_CompuMethod, data-constr=boolean_DataConstr}
                mc data instance CamCalibIDs_STM: category=VALUE, resulting-properties={base-type=uint32, sw-calibration-access=READ-WRITE, compu-method=ME_Hydra3defs_E_CalibrationID_t, range raw 0..4294967295}
              CamLeftSC
                mc data instance CamCalibData_STM: category=STRUCTURE
                  6 x mc data instance, all with category=VALUE:
                    Pitch_f32: resulting-properties={base-type=float32, sw-calibration-access=READ-WRITE, data-constr=float32_DataConstr}
                    Yaw_f32: resulting-properties={base-type=float32, sw-calibration-access=READ-WRITE, data-constr=float32_DataConstr}
                    Roll_f32: resulting-properties={base-type=float32, sw-calibration-access=READ-WRITE, data-constr=float32_DataConstr}
                    CalibStatus_e: resulting-properties={base-type=uint32, sw-calibration-access=READ-WRITE, compu-method=ME_Hydra3defs_E_CalibStatus_t, range raw 0..4294967295}
                    NewValueAvailable_b: resulting-properties={base-type=boolean, sw-calibration-access=READ-WRITE, compu-method=boolean_CompuMethod, data-constr=boolean_DataConstr}
                    OverwriteStatus_b: resulting-properties={base-type=boolean, sw-calibration-access=READ-WRITE, compu-method=boolean_CompuMethod, data-constr=boolean_DataConstr}
                mc data instance CamCalibIDs_STM: category=VALUE, resulting-properties={base-type=uint32, sw-calibration-access=READ-WRITE, compu-method=ME_Hydra3defs_E_CalibrationID_t, range raw 0..4294967295}
              CamRearSC
                mc data instance CamCalibData_STM: category=STRUCTURE
                  6 x mc data instance, all with category=VALUE:
                    Pitch_f32: resulting-properties={base-type=float32, sw-calibration-access=READ-WRITE, data-constr=float32_DataConstr}
                    Yaw_f32: resulting-properties={base-type=float32, sw-calibration-access=READ-WRITE, data-constr=float32_DataConstr}
                    Roll_f32: resulting-properties={base-type=float32, sw-calibration-access=READ-WRITE, data-constr=float32_DataConstr}
                    CalibStatus_e: resulting-properties={base-type=uint32, sw-calibration-access=READ-WRITE, compu-method=ME_Hydra3defs_E_CalibStatus_t, range raw 0..4294967295}
                    NewValueAvailable_b: resulting-properties={base-type=boolean, sw-calibration-access=READ-WRITE, compu-method=boolean_CompuMethod, data-constr=boolean_DataConstr}
                    OverwriteStatus_b: resulting-properties={base-type=boolean, sw-calibration-access=READ-WRITE, compu-method=boolean_CompuMethod, data-constr=boolean_DataConstr}
                mc data instance CamCalibIDs_STM: category=VALUE, resulting-properties={base-type=uint32, sw-calibration-access=READ-WRITE, compu-method=ME_Hydra3defs_E_CalibrationID_t, range raw 0..4294967295}
              CamRightSC
                mc data instance CamCalibData_STM: category=STRUCTURE
                  6 x mc data instance, all with category=VALUE:
                    Pitch_f32: resulting-properties={base-type=float32, sw-calibration-access=READ-WRITE, data-constr=float32_DataConstr}
                    Yaw_f32: resulting-properties={base-type=float32, sw-calibration-access=READ-WRITE, data-constr=float32_DataConstr}
                    Roll_f32: resulting-properties={base-type=float32, sw-calibration-access=READ-WRITE, data-constr=float32_DataConstr}
                    CalibStatus_e: resulting-properties={base-type=uint32, sw-calibration-access=READ-WRITE, compu-method=ME_Hydra3defs_E_CalibStatus_t, range raw 0..4294967295}
                    NewValueAvailable_b: resulting-properties={base-type=boolean, sw-calibration-access=READ-WRITE, compu-method=boolean_CompuMethod, data-constr=boolean_DataConstr}
                    OverwriteStatus_b: resulting-properties={base-type=boolean, sw-calibration-access=READ-WRITE, compu-method=boolean_CompuMethod, data-constr=boolean_DataConstr}
                mc data instance CamCalibIDs_STM: category=VALUE, resulting-properties={base-type=uint32, sw-calibration-access=READ-WRITE, compu-method=ME_Hydra3defs_E_CalibrationID_t, range raw 0..4294967295}
        SWC_DIDMgr_DID_191D_PowerLatch_DefaultValue: category=VALUE, flat-map-entry=SWC_DIDMgr_DID_191D_PowerLatch_DefaultValue, resulting-properties={base-type=uint8, sw-calibration-access=READ-WRITE, data-constr=uint8_DataConstr}, symbol=Rte_SWC_DIDMgr_DID_191D_PowerLatch_DefaultValue
        SWC_DIDMgr_DID_2002_OdoFlashing_DefaultValue: category=VALUE, flat-map-entry=SWC_DIDMgr_DID_2002_OdoFlashing_DefaultValue, resulting-properties={base-type=uint16, sw-calibration-access=READ-WRITE, data-constr=uint16_DataConstr}, symbol=Rte_SWC_DIDMgr_DID_2002_OdoFlashing_DefaultValue
        SWC_DIDMgr_DID_2002_ProgReqFlag_DefaultValue: category=VALUE, flat-map-entry=SWC_DIDMgr_DID_2002_ProgReqFlag_DefaultValue, resulting-properties={base-type=uint8, sw-calibration-access=READ-WRITE, data-constr=uint8_DataConstr}, symbol=Rte_SWC_DIDMgr_DID_2002_ProgReqFlag_DefaultValue
        SWC_DIDMgr_DID_200A_IgOnCounter_DefaultValue: category=VALUE, flat-map-entry=SWC_DIDMgr_DID_200A_IgOnCounter_DefaultValue, resulting-properties={base-type=uint16, sw-calibration-access=READ-WRITE, data-constr=uint16_DataConstr}, symbol=Rte_SWC_DIDMgr_DID_200A_IgOnCounter_DefaultValue
        SWC_DIDMgr_DID_200B_TimeSinceFirstDTC_DefaultValue: category=VALUE, flat-map-entry=SWC_DIDMgr_DID_200B_TimeSinceFirstDTC_DefaultValue, resulting-properties={base-type=uint32, sw-calibration-access=READ-WRITE, data-constr=uint32_DataConstr}, symbol=Rte_SWC_DIDMgr_DID_200B_TimeSinceFirstDTC_DefaultValue
        SWC_DIDMgr_DID_200C_TimeSinceIgnOnFirstDTC_DefaultValue: category=VALUE, flat-map-entry=SWC_DIDMgr_DID_200C_TimeSinceIgnOnFirstDTC_DefaultValue, resulting-properties={base-type=uint16, sw-calibration-access=READ-WRITE, data-constr=uint16_DataConstr}, symbol=Rte_SWC_DIDMgr_DID_200C_TimeSinceIgnOnFirstDTC_DefaultValue
        SWC_DIDMgr_DID_200D_LastClearDTCOdo_DefaultValue: category=VALUE, flat-map-entry=SWC_DIDMgr_DID_200D_LastClearDTCOdo_DefaultValue, resulting-properties={base-type=uint16, sw-calibration-access=READ-WRITE, data-constr=uint16_DataConstr}, symbol=Rte_SWC_DIDMgr_DID_200D_LastClearDTCOdo_DefaultValue
        SWC_DIDMgr_DID_FD01_PrevCalibDataCopy_DefaultValue: category=STRUCTURE, flat-map-entry=SWC_DIDMgr_DID_FD01_PrevCalibDataCopy_DefaultValue, symbol=Rte_SWC_DIDMgr_DID_FD01_PrevCalibDataCopy_DefaultValue
          4 x mc data instance, all with category=STRUCTURE:
            CamFrontCurrent
              mc data instance CamCalibData_STM: category=STRUCTURE
                6 x mc data instance:
                  calibdata: category=STRUCTURE
                    6 x mc data instance, all with category=VALUE:
                      Pitch_f32: resulting-properties={base-type=float32, sw-calibration-access=READ-WRITE, data-constr=float32_DataConstr}
                      Yaw_f32: resulting-properties={base-type=float32, sw-calibration-access=READ-WRITE, data-constr=float32_DataConstr}
                      Roll_f32: resulting-properties={base-type=float32, sw-calibration-access=READ-WRITE, data-constr=float32_DataConstr}
                      CalibStatus_e: resulting-properties={base-type=uint32, sw-calibration-access=READ-WRITE, compu-method=ME_Hydra3defs_E_CalibStatus_t, range raw 0..4294967295}
                      NewValueAvailable_b: resulting-properties={base-type=boolean, sw-calibration-access=READ-WRITE, compu-method=boolean_CompuMethod, data-constr=boolean_DataConstr}
                      OverwriteStatus_b: resulting-properties={base-type=boolean, sw-calibration-access=READ-WRITE, compu-method=boolean_CompuMethod, data-constr=boolean_DataConstr}
                  X_f32: category=VALUE, resulting-properties={base-type=float32, sw-calibration-access=READ-WRITE, data-constr=float32_DataConstr}
                  Y_f32: category=VALUE, resulting-properties={base-type=float32, sw-calibration-access=READ-WRITE, data-constr=float32_DataConstr}
                  Z_f32: category=VALUE, resulting-properties={base-type=float32, sw-calibration-access=READ-WRITE, data-constr=float32_DataConstr}
                  EOLIterationData_au8: category=ARRAY, array-size=5, resulting-properties={base-type=uint8, sw-calibration-access=READ-WRITE, data-constr=uint8_DataConstr}
                  Reserved_au8: category=ARRAY, array-size=7, resulting-properties={base-type=uint8, sw-calibration-access=READ-WRITE, data-constr=uint8_DataConstr}
              mc data instance CamCalibIDs_STM: category=VALUE, resulting-properties={base-type=uint32, sw-calibration-access=READ-WRITE, compu-method=ME_Hydra3defs_E_CalibrationID_t, range raw 0..4294967295}
            CamLeftCurrent
              mc data instance CamCalibData_STM: category=STRUCTURE
                6 x mc data instance:
                  calibdata: category=STRUCTURE
                    6 x mc data instance, all with category=VALUE:
                      Pitch_f32: resulting-properties={base-type=float32, sw-calibration-access=READ-WRITE, data-constr=float32_DataConstr}
                      Yaw_f32: resulting-properties={base-type=float32, sw-calibration-access=READ-WRITE, data-constr=float32_DataConstr}
                      Roll_f32: resulting-properties={base-type=float32, sw-calibration-access=READ-WRITE, data-constr=float32_DataConstr}
                      CalibStatus_e: resulting-properties={base-type=uint32, sw-calibration-access=READ-WRITE, compu-method=ME_Hydra3defs_E_CalibStatus_t, range raw 0..4294967295}
                      NewValueAvailable_b: resulting-properties={base-type=boolean, sw-calibration-access=READ-WRITE, compu-method=boolean_CompuMethod, data-constr=boolean_DataConstr}
                      OverwriteStatus_b: resulting-properties={base-type=boolean, sw-calibration-access=READ-WRITE, compu-method=boolean_CompuMethod, data-constr=boolean_DataConstr}
                  X_f32: category=VALUE, resulting-properties={base-type=float32, sw-calibration-access=READ-WRITE, data-constr=float32_DataConstr}
                  Y_f32: category=VALUE, resulting-properties={base-type=float32, sw-calibration-access=READ-WRITE, data-constr=float32_DataConstr}
                  Z_f32: category=VALUE, resulting-properties={base-type=float32, sw-calibration-access=READ-WRITE, data-constr=float32_DataConstr}
                  EOLIterationData_au8: category=ARRAY, array-size=5, resulting-properties={base-type=uint8, sw-calibration-access=READ-WRITE, data-constr=uint8_DataConstr}
                  Reserved_au8: category=ARRAY, array-size=7, resulting-properties={base-type=uint8, sw-calibration-access=READ-WRITE, data-constr=uint8_DataConstr}
              mc data instance CamCalibIDs_STM: category=VALUE, resulting-properties={base-type=uint32, sw-calibration-access=READ-WRITE, compu-method=ME_Hydra3defs_E_CalibrationID_t, range raw 0..4294967295}
            CamRearCurrent
              mc data instance CamCalibData_STM: category=STRUCTURE
                6 x mc data instance:
                  calibdata: category=STRUCTURE
                    6 x mc data instance, all with category=VALUE:
                      Pitch_f32: resulting-properties={base-type=float32, sw-calibration-access=READ-WRITE, data-constr=float32_DataConstr}
                      Yaw_f32: resulting-properties={base-type=float32, sw-calibration-access=READ-WRITE, data-constr=float32_DataConstr}
                      Roll_f32: resulting-properties={base-type=float32, sw-calibration-access=READ-WRITE, data-constr=float32_DataConstr}
                      CalibStatus_e: resulting-properties={base-type=uint32, sw-calibration-access=READ-WRITE, compu-method=ME_Hydra3defs_E_CalibStatus_t, range raw 0..4294967295}
                      NewValueAvailable_b: resulting-properties={base-type=boolean, sw-calibration-access=READ-WRITE, compu-method=boolean_CompuMethod, data-constr=boolean_DataConstr}
                      OverwriteStatus_b: resulting-properties={base-type=boolean, sw-calibration-access=READ-WRITE, compu-method=boolean_CompuMethod, data-constr=boolean_DataConstr}
                  X_f32: category=VALUE, resulting-properties={base-type=float32, sw-calibration-access=READ-WRITE, data-constr=float32_DataConstr}
                  Y_f32: category=VALUE, resulting-properties={base-type=float32, sw-calibration-access=READ-WRITE, data-constr=float32_DataConstr}
                  Z_f32: category=VALUE, resulting-properties={base-type=float32, sw-calibration-access=READ-WRITE, data-constr=float32_DataConstr}
                  EOLIterationData_au8: category=ARRAY, array-size=5, resulting-properties={base-type=uint8, sw-calibration-access=READ-WRITE, data-constr=uint8_DataConstr}
                  Reserved_au8: category=ARRAY, array-size=7, resulting-properties={base-type=uint8, sw-calibration-access=READ-WRITE, data-constr=uint8_DataConstr}
              mc data instance CamCalibIDs_STM: category=VALUE, resulting-properties={base-type=uint32, sw-calibration-access=READ-WRITE, compu-method=ME_Hydra3defs_E_CalibrationID_t, range raw 0..4294967295}
            CamRightCurrent
              mc data instance CamCalibData_STM: category=STRUCTURE
                6 x mc data instance:
                  calibdata: category=STRUCTURE
                    6 x mc data instance, all with category=VALUE:
                      Pitch_f32: resulting-properties={base-type=float32, sw-calibration-access=READ-WRITE, data-constr=float32_DataConstr}
                      Yaw_f32: resulting-properties={base-type=float32, sw-calibration-access=READ-WRITE, data-constr=float32_DataConstr}
                      Roll_f32: resulting-properties={base-type=float32, sw-calibration-access=READ-WRITE, data-constr=float32_DataConstr}
                      CalibStatus_e: resulting-properties={base-type=uint32, sw-calibration-access=READ-WRITE, compu-method=ME_Hydra3defs_E_CalibStatus_t, range raw 0..4294967295}
                      NewValueAvailable_b: resulting-properties={base-type=boolean, sw-calibration-access=READ-WRITE, compu-method=boolean_CompuMethod, data-constr=boolean_DataConstr}
                      OverwriteStatus_b: resulting-properties={base-type=boolean, sw-calibration-access=READ-WRITE, compu-method=boolean_CompuMethod, data-constr=boolean_DataConstr}
                  X_f32: category=VALUE, resulting-properties={base-type=float32, sw-calibration-access=READ-WRITE, data-constr=float32_DataConstr}
                  Y_f32: category=VALUE, resulting-properties={base-type=float32, sw-calibration-access=READ-WRITE, data-constr=float32_DataConstr}
                  Z_f32: category=VALUE, resulting-properties={base-type=float32, sw-calibration-access=READ-WRITE, data-constr=float32_DataConstr}
                  EOLIterationData_au8: category=ARRAY, array-size=5, resulting-properties={base-type=uint8, sw-calibration-access=READ-WRITE, data-constr=uint8_DataConstr}
                  Reserved_au8: category=ARRAY, array-size=7, resulting-properties={base-type=uint8, sw-calibration-access=READ-WRITE, data-constr=uint8_DataConstr}
              mc data instance CamCalibIDs_STM: category=VALUE, resulting-properties={base-type=uint32, sw-calibration-access=READ-WRITE, compu-method=ME_Hydra3defs_E_CalibrationID_t, range raw 0..4294967295}
        SWC_DIDMgr_DID_FD33_MagnaTesting_DefaultValue: category=ARRAY, array-size=10, flat-map-entry=SWC_DIDMgr_DID_FD33_MagnaTesting_DefaultValue, resulting-properties={base-type=uint8, sw-calibration-access=READ-WRITE, data-constr=uint8_DataConstr}, symbol=Rte_SWC_DIDMgr_DID_FD33_MagnaTesting_DefaultValue
        SWC_DIDMgr_DID_FD42_FailsafeDebug_DefaultValue: category=VALUE, flat-map-entry=SWC_DIDMgr_DID_FD42_FailsafeDebug_DefaultValue, resulting-properties={base-type=uint8, sw-calibration-access=READ-WRITE, data-constr=uint8_DataConstr}, symbol=Rte_SWC_DIDMgr_DID_FD42_FailsafeDebug_DefaultValue
        SWC_DIDMgr_DID_RearBrakeEvent_DefaultValue: category=STRUCTURE, flat-map-entry=SWC_DIDMgr_DID_RearBrakeEvent_DefaultValue, symbol=Rte_SWC_DIDMgr_DID_RearBrakeEvent_DefaultValue
          mc data instance BlockIdx_u8: category=VALUE, resulting-properties={base-type=uint8, sw-calibration-access=READ-WRITE, data-constr=uint8_DataConstr}
          mc data instance RearBrkEvent_Arr: category=ARRAY, array-size=3
            mc data instance Element_0: category=STRUCTURE, symbol=[0]
              7 x mc data instance, all with category=VALUE:
                Odometer_u16: resulting-properties={base-type=uint16, sw-calibration-access=READ-ONLY, range raw 0..65535}
                GasPedalPosEvntStart_u16: resulting-properties={base-type=uint16, sw-calibration-access=READ-ONLY, range raw 0..65535}
                StreeringWhlAngEvntStart_u16: resulting-properties={base-type=uint16, sw-calibration-access=READ-ONLY, range raw 0..65535}
                VehicleSpeed_u16: resulting-properties={base-type=uint16, sw-calibration-access=READ-ONLY, range raw 0..65535}
                ExtTemp_u8: resulting-properties={base-type=uint8, sw-calibration-access=READ-ONLY, range raw 0..255}
                DistToObjEvntStart_u16: resulting-properties={base-type=uint16, sw-calibration-access=READ-ONLY, range raw 0..65535}
                DistToObjEvntEnd_u16: resulting-properties={base-type=uint16, sw-calibration-access=READ-ONLY, range raw 0..65535}
            mc data instance Element_1: category=STRUCTURE, symbol=[1]
              7 x mc data instance, all with category=VALUE:
                Odometer_u16: resulting-properties={base-type=uint16, sw-calibration-access=READ-ONLY, range raw 0..65535}
                GasPedalPosEvntStart_u16: resulting-properties={base-type=uint16, sw-calibration-access=READ-ONLY, range raw 0..65535}
                StreeringWhlAngEvntStart_u16: resulting-properties={base-type=uint16, sw-calibration-access=READ-ONLY, range raw 0..65535}
                VehicleSpeed_u16: resulting-properties={base-type=uint16, sw-calibration-access=READ-ONLY, range raw 0..65535}
                ExtTemp_u8: resulting-properties={base-type=uint8, sw-calibration-access=READ-ONLY, range raw 0..255}
                DistToObjEvntStart_u16: resulting-properties={base-type=uint16, sw-calibration-access=READ-ONLY, range raw 0..65535}
                DistToObjEvntEnd_u16: resulting-properties={base-type=uint16, sw-calibration-access=READ-ONLY, range raw 0..65535}
            mc data instance Element_2: category=STRUCTURE, symbol=[2]
              7 x mc data instance, all with category=VALUE:
                Odometer_u16: resulting-properties={base-type=uint16, sw-calibration-access=READ-ONLY, range raw 0..65535}
                GasPedalPosEvntStart_u16: resulting-properties={base-type=uint16, sw-calibration-access=READ-ONLY, range raw 0..65535}
                StreeringWhlAngEvntStart_u16: resulting-properties={base-type=uint16, sw-calibration-access=READ-ONLY, range raw 0..65535}
                VehicleSpeed_u16: resulting-properties={base-type=uint16, sw-calibration-access=READ-ONLY, range raw 0..65535}
                ExtTemp_u8: resulting-properties={base-type=uint8, sw-calibration-access=READ-ONLY, range raw 0..255}
                DistToObjEvntStart_u16: resulting-properties={base-type=uint16, sw-calibration-access=READ-ONLY, range raw 0..65535}
                DistToObjEvntEnd_u16: resulting-properties={base-type=uint16, sw-calibration-access=READ-ONLY, range raw 0..65535}
        SWC_DIDMgr_DID_SPMAbrtEvent_DefaultValue: category=STRUCTURE, flat-map-entry=SWC_DIDMgr_DID_SPMAbrtEvent_DefaultValue, symbol=Rte_SWC_DIDMgr_DID_SPMAbrtEvent_DefaultValue
          mc data instance BlockIdx_u8: category=VALUE, resulting-properties={base-type=uint8, sw-calibration-access=READ-WRITE, data-constr=uint8_DataConstr}
          mc data instance SPMAbrtEvent_Arr: category=ARRAY, array-size=3
            mc data instance Element_0: category=STRUCTURE, symbol=[0]
              13 x mc data instance, all with category=VALUE:
                ManeuverType_u8: resulting-properties={base-type=uint8, sw-calibration-access=READ-ONLY, range raw 0..255}
                CurbDetected_u8: resulting-properties={base-type=uint8, sw-calibration-access=READ-ONLY, range raw 0..255}
                SideofVehicle_u8: resulting-properties={base-type=uint8, sw-calibration-access=READ-ONLY, range raw 0..255}
                Reserved_u8: resulting-properties={base-type=uint8, sw-calibration-access=READ-ONLY, range raw 0..255}
                MeasuredSlotSize_u16: resulting-properties={base-type=uint16, sw-calibration-access=READ-ONLY, range raw 0..65535}
                SWA_State_u8: resulting-properties={base-type=uint8, sw-calibration-access=READ-ONLY, range raw 0..255}
                TTC_State_u8: resulting-properties={base-type=uint8, sw-calibration-access=READ-ONLY, range raw 0..255}
                YRS_State_u8: resulting-properties={base-type=uint8, sw-calibration-access=READ-ONLY, range raw 0..255}
                ExternalTemperature_u16: resulting-properties={base-type=uint16, sw-calibration-access=READ-ONLY, range raw 0..65535}
                Reserved1_u8: resulting-properties={base-type=uint8, sw-calibration-access=READ-ONLY, range raw 0..255}
                CalculatedTireSize_u16: resulting-properties={base-type=uint16, sw-calibration-access=READ-ONLY, range raw 0..65535}
                NumofManeuvers_u8: resulting-properties={base-type=uint8, sw-calibration-access=READ-ONLY, range raw 0..255}
                AbortCnd_u8: resulting-properties={base-type=uint8, sw-calibration-access=READ-ONLY, range raw 0..255}
            mc data instance Element_1: category=STRUCTURE, symbol=[1]
              13 x mc data instance, all with category=VALUE:
                ManeuverType_u8: resulting-properties={base-type=uint8, sw-calibration-access=READ-ONLY, range raw 0..255}
                CurbDetected_u8: resulting-properties={base-type=uint8, sw-calibration-access=READ-ONLY, range raw 0..255}
                SideofVehicle_u8: resulting-properties={base-type=uint8, sw-calibration-access=READ-ONLY, range raw 0..255}
                Reserved_u8: resulting-properties={base-type=uint8, sw-calibration-access=READ-ONLY, range raw 0..255}
                MeasuredSlotSize_u16: resulting-properties={base-type=uint16, sw-calibration-access=READ-ONLY, range raw 0..65535}
                SWA_State_u8: resulting-properties={base-type=uint8, sw-calibration-access=READ-ONLY, range raw 0..255}
                TTC_State_u8: resulting-properties={base-type=uint8, sw-calibration-access=READ-ONLY, range raw 0..255}
                YRS_State_u8: resulting-properties={base-type=uint8, sw-calibration-access=READ-ONLY, range raw 0..255}
                ExternalTemperature_u16: resulting-properties={base-type=uint16, sw-calibration-access=READ-ONLY, range raw 0..65535}
                Reserved1_u8: resulting-properties={base-type=uint8, sw-calibration-access=READ-ONLY, range raw 0..255}
                CalculatedTireSize_u16: resulting-properties={base-type=uint16, sw-calibration-access=READ-ONLY, range raw 0..65535}
                NumofManeuvers_u8: resulting-properties={base-type=uint8, sw-calibration-access=READ-ONLY, range raw 0..255}
                AbortCnd_u8: resulting-properties={base-type=uint8, sw-calibration-access=READ-ONLY, range raw 0..255}
            mc data instance Element_2: category=STRUCTURE, symbol=[2]
              13 x mc data instance, all with category=VALUE:
                ManeuverType_u8: resulting-properties={base-type=uint8, sw-calibration-access=READ-ONLY, range raw 0..255}
                CurbDetected_u8: resulting-properties={base-type=uint8, sw-calibration-access=READ-ONLY, range raw 0..255}
                SideofVehicle_u8: resulting-properties={base-type=uint8, sw-calibration-access=READ-ONLY, range raw 0..255}
                Reserved_u8: resulting-properties={base-type=uint8, sw-calibration-access=READ-ONLY, range raw 0..255}
                MeasuredSlotSize_u16: resulting-properties={base-type=uint16, sw-calibration-access=READ-ONLY, range raw 0..65535}
                SWA_State_u8: resulting-properties={base-type=uint8, sw-calibration-access=READ-ONLY, range raw 0..255}
                TTC_State_u8: resulting-properties={base-type=uint8, sw-calibration-access=READ-ONLY, range raw 0..255}
                YRS_State_u8: resulting-properties={base-type=uint8, sw-calibration-access=READ-ONLY, range raw 0..255}
                ExternalTemperature_u16: resulting-properties={base-type=uint16, sw-calibration-access=READ-ONLY, range raw 0..65535}
                Reserved1_u8: resulting-properties={base-type=uint8, sw-calibration-access=READ-ONLY, range raw 0..255}
                CalculatedTireSize_u16: resulting-properties={base-type=uint16, sw-calibration-access=READ-ONLY, range raw 0..65535}
                NumofManeuvers_u8: resulting-properties={base-type=uint8, sw-calibration-access=READ-ONLY, range raw 0..255}
                AbortCnd_u8: resulting-properties={base-type=uint8, sw-calibration-access=READ-ONLY, range raw 0..255}
        SWC_DIDMgr_ECU_LifeTime_DefaultValue: category=VALUE, flat-map-entry=SWC_DIDMgr_ECU_LifeTime_DefaultValue, resulting-properties={base-type=uint32, sw-calibration-access=READ-WRITE, data-constr=uint32_DataConstr}, symbol=Rte_SWC_DIDMgr_ECU_LifeTime_DefaultValue
        SWC_DIDMgr_vRoE_Activation_State_DefaultValue: category=VALUE, flat-map-entry=SWC_DIDMgr_vRoE_Activation_State_DefaultValue, resulting-properties={base-type=uint8, sw-calibration-access=READ-WRITE, data-constr=uint8_DataConstr}, symbol=Rte_SWC_DIDMgr_vRoE_Activation_State_DefaultValue
        SWC_PartNumMgr_DID_F110_Ecu_Diag_Info_DefaultValue: category=ARRAY, array-size=6, flat-map-entry=SWC_PartNumMgr_DID_F110_Ecu_Diag_Info_DefaultValue, resulting-properties={base-type=uint8, sw-calibration-access=READ-WRITE, data-constr=uint8_DataConstr}, symbol=Rte_SWC_PartNumMgr_DID_F110_Ecu_Diag_Info_DefaultValue
        SWC_PartNumMgr_DID_F132_EBOM_Ecu_PartNum_DefaultValue: category=ARRAY, array-size=10, flat-map-entry=SWC_PartNumMgr_DID_F132_EBOM_Ecu_PartNum_DefaultValue, resulting-properties={base-type=uint8, sw-calibration-access=READ-WRITE, data-constr=uint8_DataConstr}, symbol=Rte_SWC_PartNumMgr_DID_F132_EBOM_Ecu_PartNum_DefaultValue
        SWC_PartNumMgr_DID_F133_EBOM_Asm_PartNum_DefaultValue: category=ARRAY, array-size=10, flat-map-entry=SWC_PartNumMgr_DID_F133_EBOM_Asm_PartNum_DefaultValue, resulting-properties={base-type=uint8, sw-calibration-access=READ-WRITE, data-constr=uint8_DataConstr}, symbol=Rte_SWC_PartNumMgr_DID_F133_EBOM_Asm_PartNum_DefaultValue
        SWC_PartNumMgr_DID_F134_CODEP_Asm_PartNum_DefaultValue: category=ARRAY, array-size=11, flat-map-entry=SWC_PartNumMgr_DID_F134_CODEP_Asm_PartNum_DefaultValue, resulting-properties={base-type=uint8, sw-calibration-access=READ-WRITE, data-constr=uint8_DataConstr}, symbol=Rte_SWC_PartNumMgr_DID_F134_CODEP_Asm_PartNum_DefaultValue
        SWC_PartNumMgr_DID_F180_Boot_SW_Ver_Info_DefaultValue: category=ARRAY, array-size=13, flat-map-entry=SWC_PartNumMgr_DID_F180_Boot_SW_Ver_Info_DefaultValue, resulting-properties={base-type=uint8, sw-calibration-access=READ-WRITE, data-constr=uint8_DataConstr}, symbol=Rte_SWC_PartNumMgr_DID_F180_Boot_SW_Ver_Info_DefaultValue
        SWC_PartNumMgr_DID_F187_CODEP_Ecu_PartNum_DefaultValue: category=ARRAY, array-size=11, flat-map-entry=SWC_PartNumMgr_DID_F187_CODEP_Ecu_PartNum_DefaultValue, resulting-properties={base-type=uint8, sw-calibration-access=READ-WRITE, data-constr=uint8_DataConstr}, symbol=Rte_SWC_PartNumMgr_DID_F187_CODEP_Ecu_PartNum_DefaultValue
        SWC_PartNumMgr_DID_F188_FCA_ESLM_Ecu_SW_Num_DefaultValue: category=ARRAY, array-size=11, flat-map-entry=SWC_PartNumMgr_DID_F188_FCA_ESLM_Ecu_SW_Num_DefaultValue, resulting-properties={base-type=uint8, sw-calibration-access=READ-WRITE, data-constr=uint8_DataConstr}, symbol=Rte_SWC_PartNumMgr_DID_F188_FCA_ESLM_Ecu_SW_Num_DefaultValue
        SWC_PartNumMgr_DID_F18A_FCA_ESLM_Ecu_SW_Cal_Num_DefaultValue: category=ARRAY, array-size=10, flat-map-entry=SWC_PartNumMgr_DID_F18A_FCA_ESLM_Ecu_SW_Cal_Num_DefaultValue, resulting-properties={base-type=uint8, sw-calibration-access=READ-WRITE, data-constr=uint8_DataConstr}, symbol=Rte_SWC_PartNumMgr_DID_F18A_FCA_ESLM_Ecu_SW_Cal_Num_DefaultValue
        SWC_PartNumMgr_DID_F18B_FCA_ESLM_ECU_SW_App_Num_DefaultValue: category=ARRAY, array-size=10, flat-map-entry=SWC_PartNumMgr_DID_F18B_FCA_ESLM_ECU_SW_App_Num_DefaultValue, resulting-properties={base-type=uint8, sw-calibration-access=READ-WRITE, data-constr=uint8_DataConstr}, symbol=Rte_SWC_PartNumMgr_DID_F18B_FCA_ESLM_ECU_SW_App_Num_DefaultValue
        SWC_PartNumMgr_DID_F194_Supplier_Ecu_SW_PartNum_DefaultValue: category=ARRAY, array-size=11, flat-map-entry=SWC_PartNumMgr_DID_F194_Supplier_Ecu_SW_PartNum_DefaultValue, resulting-properties={base-type=uint8, sw-calibration-access=READ-WRITE, data-constr=uint8_DataConstr}, symbol=Rte_SWC_PartNumMgr_DID_F194_Supplier_Ecu_SW_PartNum_DefaultValue
        SWC_PartNumMgr_DID_F195_Supplier_Ecu_SW_VerNum_DefaultValue: category=ARRAY, array-size=2, flat-map-entry=SWC_PartNumMgr_DID_F195_Supplier_Ecu_SW_VerNum_DefaultValue, resulting-properties={base-type=uint8, sw-calibration-access=READ-WRITE, data-constr=uint8_DataConstr}, symbol=Rte_SWC_PartNumMgr_DID_F195_Supplier_Ecu_SW_VerNum_DefaultValue
        SWC_PartNumMgr_DID_FD31_EOLCodingState_DefaultValue: category=ARRAY, array-size=4, flat-map-entry=SWC_PartNumMgr_DID_FD31_EOLCodingState_DefaultValue, resulting-properties={base-type=uint8, sw-calibration-access=READ-WRITE, data-constr=uint8_DataConstr}, symbol=Rte_SWC_PartNumMgr_DID_FD31_EOLCodingState_DefaultValue
        SWC_PartNumMgr_UssSensorMarrData_DefaultValue: category=STRUCTURE, flat-map-entry=SWC_PartNumMgr_UssSensorMarrData_DefaultValue, symbol=Rte_SWC_PartNumMgr_UssSensorMarrData_DefaultValue
          mc data instance bValid: category=VALUE, resulting-properties={base-type=boolean, sw-calibration-access=READ-WRITE, compu-method=boolean_CompuMethod, data-constr=boolean_DataConstr}
          mc data instance uMarriageStatus: category=VALUE, resulting-properties={base-type=uint32, sw-calibration-access=READ-WRITE, data-constr=uint32_DataConstr}
          mc data instance uSavedSensorIDs: category=ARRAY, array-size=12, resulting-properties={base-type=uint32, sw-calibration-access=READ-WRITE, data-constr=uint32_DataConstr}
        SWC_ProxiConfigMgr_ProxiConfigTable_DefaultValue: category=STRUCTURE, flat-map-entry=SWC_ProxiConfigMgr_ProxiConfigTable_DefaultValue, symbol=Rte_SWC_ProxiConfigMgr_ProxiConfigTable_DefaultValue
          42 x mc data instance:
            bValid: category=VALUE, resulting-properties={base-type=boolean, sw-calibration-access=READ-WRITE, compu-method=boolean_CompuMethod, data-constr=boolean_DataConstr}
            ConfigCode: category=ARRAY, array-size=11, resulting-properties={base-type=uint8, sw-calibration-access=READ-WRITE, data-constr=uint8_DataConstr}
            TesterCode: category=ARRAY, array-size=10, resulting-properties={base-type=uint8, sw-calibration-access=READ-WRITE, data-constr=uint8_DataConstr}
            ProductionDate: category=ARRAY, array-size=4, resulting-properties={base-type=uint8, sw-calibration-access=READ-WRITE, data-constr=uint8_DataConstr}
            CanNode14trscm_uint8: category=VALUE, resulting-properties={base-type=uint8, sw-calibration-access=READ-WRITE, data-constr=uint8_DataConstr}
            Variant_ID: category=VALUE, resulting-properties={base-type=uint8, sw-calibration-access=READ-WRITE, data-constr=uint8_DataConstr}
            CanNode27Asm_uint8: category=VALUE, resulting-properties={base-type=uint8, sw-calibration-access=READ-WRITE, data-constr=uint8_DataConstr}
            CanNode63ttm_uint8: category=VALUE, resulting-properties={base-type=uint8, sw-calibration-access=READ-WRITE, data-constr=uint8_DataConstr}
            CanNode67dtcm_uint8: category=VALUE, resulting-properties={base-type=uint8, sw-calibration-access=READ-WRITE, data-constr=uint8_DataConstr}
            CanNode95itcm_uint8: category=VALUE, resulting-properties={base-type=uint8, sw-calibration-access=READ-WRITE, data-constr=uint8_DataConstr}
            StopandStart: category=VALUE, resulting-properties={base-type=uint8, sw-calibration-access=READ-WRITE, data-constr=uint8_DataConstr}
            DriverSide: category=VALUE, resulting-properties={base-type=uint8, sw-calibration-access=READ-WRITE, data-constr=uint8_DataConstr}
            Tyresize_uint16: category=VALUE, resulting-properties={base-type=uint16, sw-calibration-access=READ-WRITE, data-constr=uint16_DataConstr}
            Wheelbase: category=VALUE, resulting-properties={base-type=uint8, sw-calibration-access=READ-WRITE, data-constr=uint8_DataConstr}
            Rearviewcamera: category=VALUE, resulting-properties={base-type=uint8, sw-calibration-access=READ-WRITE, data-constr=uint8_DataConstr}
            Parkwithstop: category=VALUE, resulting-properties={base-type=uint8, sw-calibration-access=READ-WRITE, data-constr=uint8_DataConstr}
            SteeringRatio_uint8: category=VALUE, resulting-properties={base-type=uint8, sw-calibration-access=READ-WRITE, data-constr=uint8_DataConstr}
            Gearboxtype: category=VALUE, resulting-properties={base-type=uint8, sw-calibration-access=READ-WRITE, data-constr=uint8_DataConstr}
            Drivetypevariant: category=VALUE, resulting-properties={base-type=uint8, sw-calibration-access=READ-WRITE, data-constr=uint8_DataConstr}
            Pamtuningset: category=VALUE, resulting-properties={base-type=uint8, sw-calibration-access=READ-WRITE, data-constr=uint8_DataConstr}
            Semiautopark: category=VALUE, resulting-properties={base-type=uint8, sw-calibration-access=READ-WRITE, data-constr=uint8_DataConstr}
            VehicleLineConfiguration_uint8: category=VALUE, resulting-properties={base-type=uint8, sw-calibration-access=READ-WRITE, data-constr=uint8_DataConstr}
            CountryCode_uint8: category=VALUE, resulting-properties={base-type=uint8, sw-calibration-access=READ-WRITE, data-constr=uint8_DataConstr}
            Srt: category=VALUE, resulting-properties={base-type=uint8, sw-calibration-access=READ-WRITE, data-constr=uint8_DataConstr}
            PAMConfig_uint8: category=VALUE, resulting-properties={base-type=uint8, sw-calibration-access=READ-WRITE, data-constr=uint8_DataConstr}
            ModelYear_uint8: category=VALUE, resulting-properties={base-type=uint8, sw-calibration-access=READ-WRITE, data-constr=uint8_DataConstr}
            Hybridtype: category=VALUE, resulting-properties={base-type=uint8, sw-calibration-access=READ-WRITE, data-constr=uint8_DataConstr}
            Pulloutcontrol: category=VALUE, resulting-properties={base-type=uint8, sw-calibration-access=READ-WRITE, data-constr=uint8_DataConstr}
            Surroundviewcamera: category=VALUE, resulting-properties={base-type=uint8, sw-calibration-access=READ-WRITE, data-constr=uint8_DataConstr}
            Forwardfacingcamera: category=VALUE, resulting-properties={base-type=uint8, sw-calibration-access=READ-WRITE, data-constr=uint8_DataConstr}
            Autonomylevel: category=VALUE, resulting-properties={base-type=uint8, sw-calibration-access=READ-WRITE, data-constr=uint8_DataConstr}
            Fullautomaticparking: category=VALUE, resulting-properties={base-type=uint8, sw-calibration-access=READ-WRITE, data-constr=uint8_DataConstr}
            Radiodisplay: category=VALUE, resulting-properties={base-type=uint8, sw-calibration-access=READ-WRITE, data-constr=uint8_DataConstr}
            Mirrortype: category=VALUE, resulting-properties={base-type=uint8, sw-calibration-access=READ-WRITE, data-constr=uint8_DataConstr}
            Auxiliarycamera: category=VALUE, resulting-properties={base-type=uint8, sw-calibration-access=READ-WRITE, data-constr=uint8_DataConstr}
            Trailerreverseguide: category=VALUE, resulting-properties={base-type=uint8, sw-calibration-access=READ-WRITE, data-constr=uint8_DataConstr}
            Trailersurround: category=VALUE, resulting-properties={base-type=uint8, sw-calibration-access=READ-WRITE, data-constr=uint8_DataConstr}
            Trailerreversesteering: category=VALUE, resulting-properties={base-type=uint8, sw-calibration-access=READ-WRITE, data-constr=uint8_DataConstr}
            Trailerhitchassist: category=VALUE, resulting-properties={base-type=uint8, sw-calibration-access=READ-WRITE, data-constr=uint8_DataConstr}
            CVPAM_Presence_uint8: category=VALUE, resulting-properties={base-type=uint8, sw-calibration-access=READ-WRITE, data-constr=uint8_DataConstr}
            SideDistanceWarning: category=VALUE, resulting-properties={base-type=uint8, sw-calibration-access=READ-WRITE, data-constr=uint8_DataConstr}
            PROXIWriteCounter: category=VALUE, resulting-properties={base-type=uint8, sw-calibration-access=READ-WRITE, data-constr=uint8_DataConstr}
        SWC_ProxiConfigMgr_ProxiErrorData_DefaultValue: category=STRUCTURE, flat-map-entry=SWC_ProxiConfigMgr_ProxiErrorData_DefaultValue, symbol=Rte_SWC_ProxiConfigMgr_ProxiErrorData_DefaultValue
          mc data instance ErrorFound: category=ARRAY, array-size=3, resulting-properties={base-type=uint8, sw-calibration-access=READ-WRITE, data-constr=uint8_DataConstr}
          mc data instance ByteWithError: category=ARRAY, array-size=3, resulting-properties={base-type=uint8, sw-calibration-access=READ-WRITE, data-constr=uint8_DataConstr}
          mc data instance BitInformationMask: category=ARRAY, array-size=3, resulting-properties={base-type=uint8, sw-calibration-access=READ-WRITE, data-constr=uint8_DataConstr}
    resource consumption ResourceConsumption
      87 x memory section:
        CODE: sw-addrmethod=CODE
        VAR_NOINIT_UNSPECIFIED: sw-addrmethod=OsApplication_QM_VAR_NO_INIT
        VAR_ZERO_INIT_UNSPECIFIED: sw-addrmethod=OsApplication_QM_VAR_CLEARED
        VAR_ZERO_INIT_8BIT: sw-addrmethod=OsApplication_QM_VAR_CLEARED
        VAR_INIT_UNSPECIFIED: sw-addrmethod=OsApplication_QM_VAR_INIT
        CONST_UNSPECIFIED: sw-addrmethod=CONST
        APPL_CODE: sw-addrmethod=CODE
        BSWM_APPL_CODE: sw-addrmethod=CODE
        DET_APPL_CODE: sw-addrmethod=CODE
        ECUM_APPL_CODE: sw-addrmethod=CODE
        OS_OSCORE0_SWC_APPL_CODE: sw-addrmethod=CODE
        BOOTAPPOSTASK_CODE: sw-addrmethod=CODE
        IDLETASK_OSCORE0_CODE: sw-addrmethod=CODE
        SCISERVERHIGHOSTASK_CODE: sw-addrmethod=CODE
        SCISERVERLOWOSTASK_CODE: sw-addrmethod=CODE
        STARTUPTASK_CODE: sw-addrmethod=CODE
        SYSTEMAPPLICATION_OSCORE0_CODE: sw-addrmethod=CODE
        VAR_SystemApplication_OsCore0_NOINIT_UNSPECIFIED: sw-addrmethod=SystemApplication_OsCore0_VAR_NO_INIT
        VAR_SystemApplication_OsCore0_ZERO_INIT_UNSPECIFIED: sw-addrmethod=SystemApplication_OsCore0_VAR_CLEARED
        VAR_SystemApplication_OsCore0_INIT_UNSPECIFIED: sw-addrmethod=SystemApplication_OsCore0_VAR_INIT
        IOHWAB_APPL_CODE: sw-addrmethod=CODE
        NVM_APPL_CODE: sw-addrmethod=CODE
        DEMMASTER_0_APPL_CODE: sw-addrmethod=CODE
        DEMSATELLITE_0_APPL_CODE: sw-addrmethod=CODE
        VROE_APPL_CODE: sw-addrmethod=CODE
        COMM_APPL_CODE: sw-addrmethod=CODE
        DCM_APPL_CODE: sw-addrmethod=CODE
        CDD_PMIC_APPL_CODE: sw-addrmethod=CODE
        SWC_DIDMGR_APPL_CODE: sw-addrmethod=CODE
        SWC_KINEMATICMODULE_APPL_CODE: sw-addrmethod=CODE
        SWC_PARTNUMMGR_APPL_CODE: sw-addrmethod=CODE
        SWC_PROXICONFIGMGR_APPL_CODE: sw-addrmethod=CODE
        CDD_GENERICBSWM_APPL_CODE: sw-addrmethod=CODE
        SWC_DTCMGR_APPL_CODE: sw-addrmethod=CODE
        SWC_RIDMGR_APPL_CODE: sw-addrmethod=CODE
        SWC_VOLTAGEMGR_APPL_CODE: sw-addrmethod=CODE
        CDD_E2EWRAPPER_APPL_CODE: sw-addrmethod=CODE
        CDD_IPCHANDLER_APPL_CODE: sw-addrmethod=CODE
        DEGMANAGER_B_APPL_CODE: sw-addrmethod=CODE
        DEGMANAGER_QM_APPL_CODE: sw-addrmethod=CODE
        ERRORMGRAGG_1_0_B_APPL_CODE: sw-addrmethod=CODE
        ERRORMGRAGG_1_0_QM_APPL_CODE: sw-addrmethod=CODE
        ERRORMGRSAT_1_0_B_APPL_CODE: sw-addrmethod=CODE
        ERRORMGRSAT_1_0_QM_APPL_CODE: sw-addrmethod=CODE
        CONST_DEFAULT_RTE_CDATA_GROUP_UNSPECIFIED: sw-addrmethod=CONST
        SSM_MASTER_APPL_CODE: sw-addrmethod=CODE
        SSM_SLAVE_1_0_APPL_CODE: sw-addrmethod=CODE
        CALDATAPROVIDER_APPL_CODE: sw-addrmethod=CODE
        CDD_WDG_APPL_CODE: sw-addrmethod=CODE
        CDD_CRYPTOMGR_APPL_CODE: sw-addrmethod=CODE
        CSM_APPL_CODE: sw-addrmethod=CODE
        WDGM_SYSTEMAPPLICATION_OSCORE0_APPL_CODE: sw-addrmethod=CODE
        QM_COMTASK_10MS_CODE: sw-addrmethod=CODE
        QM_COMTASK_5MS_CODE: sw-addrmethod=CODE
        QM_DIAGTASK_10MS_CODE: sw-addrmethod=CODE
        QM_MEMTASK_10MS_CODE: sw-addrmethod=CODE
        QM_TASK_00_10MS_CODE: sw-addrmethod=CODE
        QM_TASK_01_10MS_CODE: sw-addrmethod=CODE
        QM_TASK_200MS_CODE: sw-addrmethod=CODE
        QM_TASK_INIT_CODE: sw-addrmethod=CODE
        SAFETY_TASK_00_10MS_CODE: sw-addrmethod=CODE
        SAFETY_TASK_01_10MS_CODE: sw-addrmethod=CODE
        SAFETY_TASK_200MS_CODE: sw-addrmethod=CODE
        SAFETY_TASK_INIT_CODE: sw-addrmethod=CODE
        SHUTDOWNTASK_CODE: sw-addrmethod=CODE
        SWC_SAFEVCANRX_APPL_CODE: sw-addrmethod=CODE
        SWC_SAFEVCANTX_APPL_CODE: sw-addrmethod=CODE
        SWC_VCANRX_APPL_CODE: sw-addrmethod=CODE
        SWC_VCANTX_APPL_CODE: sw-addrmethod=CODE
        SWC_WDGFW_APPL_CODE: sw-addrmethod=CODE
        CDD_SAFETY_APPL_CODE: sw-addrmethod=CODE
        SAFETY_WDGTASK_10MS_CODE: sw-addrmethod=CODE
        OSAPPLICATION_QM_CODE: sw-addrmethod=CODE
        VAR_OsApplication_QM_NOINIT_UNSPECIFIED: sw-addrmethod=OsApplication_QM_VAR_NO_INIT
        VAR_OsApplication_QM_ZERO_INIT_UNSPECIFIED: sw-addrmethod=OsApplication_QM_VAR_CLEARED
        VAR_OsApplication_QM_INIT_UNSPECIFIED: sw-addrmethod=OsApplication_QM_VAR_INIT
        OSAPPLICATION_SAFETY_CODE: sw-addrmethod=CODE
        VAR_OsApplication_Safety_NOINIT_UNSPECIFIED: sw-addrmethod=OsApplication_Safety_VAR_NO_INIT
        VAR_OsApplication_Safety_ZERO_INIT_UNSPECIFIED: sw-addrmethod=OsApplication_Safety_VAR_CLEARED
        VAR_OsApplication_Safety_INIT_UNSPECIFIED: sw-addrmethod=OsApplication_Safety_VAR_INIT
        VAR_DEFAULT_RTE_OsApplication_QM_PIM_GROUP_INIT_UNSPECIFIED: sw-addrmethod=OsApplication_QM_VAR_INIT
        VAR_DEFAULT_RTE_OsApplication_QM_PIM_GROUP_UNSPECIFIED: sw-addrmethod=OsApplication_QM_VAR_NO_INIT
        VAR_DEFAULT_RTE_OsApplication_Safety_PIM_GROUP_UNSPECIFIED: sw-addrmethod=OsApplication_Safety_VAR_NO_INIT
        SAFETY_GUARD_APPL_CODE: sw-addrmethod=CODE
        VAR_DEFAULT_RTE_OsApplication_Safety_PIM_GROUP_INIT_UNSPECIFIED: sw-addrmethod=OsApplication_Safety_VAR_INIT
        CDD_RUNTIMESTATS_B_APPL_CODE: sw-addrmethod=CODE
        CDD_RUNTIMESTATS_QM_APPL_CODE: sw-addrmethod=CODE
package /MICROSAR/Rte_ib_bswmd/BswModuleDescriptions
  bsw module description Rte: provided-entrys=Rte_ComSendSignalProxyPeriodic
    bsw internal behavior RteBehavior
      bsw schedulable entity Rte_ComSendSignalProxyPeriodic: implemented-entry=Rte_ComSendSignalProxyPeriodic
      bsw timing event Rte_ComSendSignalProxyPeriodicTimingEvent0: starts-on-event=Rte_ComSendSignalProxyPeriodic, period=0.005
  bsw module entry Rte_ComSendSignalProxyPeriodic: call-type=SCHEDULED, execution-context=TASK
