AUTOSAR XML (schema 00048)
package /MICROSAR/Can_Mpc5700Mcan_ib_bswmd/BswModuleDescriptions
  bsw module description Can: provided-entrys=[Can_30_Mcan_MainFunction_BusOff, Can_30_Mcan_MainFunction_Wakeup, Can_30_Mcan_MainFunction_Mode]
    bsw internal behavior Can_Can_Mpc5700McanBehavior
      8 x exclusive area:
        CAN_30_MCAN_EXCLUSIVE_AREA_{0..7}
      bsw schedulable entity Can_30_Mcan_MainFunction_BusOff: implemented-entry=Can_30_Mcan_MainFunction_BusOff
      bsw schedulable entity Can_30_Mcan_MainFunction_Wakeup: implemented-entry=Can_30_Mcan_MainFunction_Wakeup
      bsw schedulable entity Can_30_Mcan_MainFunction_Mode: implemented-entry=Can_30_Mcan_MainFunction_Mode
      bsw timing event Can_30_Mcan_MainFunction_BusOffTimingEvent0: starts-on-event=Can_30_Mcan_MainFunction_BusOff, period=0.01
      bsw timing event Can_30_Mcan_MainFunction_WakeupTimingEvent0: starts-on-event=Can_30_Mcan_MainFunction_Wakeup, period=0.01
      bsw timing event Can_30_Mcan_MainFunction_ModeTimingEvent0: starts-on-event=Can_30_Mcan_MainFunction_Mode, period=0.01
  bsw module entry Can_30_Mcan_MainFunction_BusOff: call-type=SCHEDULED, execution-context=TASK
  bsw module entry Can_30_Mcan_MainFunction_Wakeup: call-type=SCHEDULED, execution-context=TASK
  bsw module entry Can_30_Mcan_MainFunction_Mode: call-type=SCHEDULED, execution-context=TASK
