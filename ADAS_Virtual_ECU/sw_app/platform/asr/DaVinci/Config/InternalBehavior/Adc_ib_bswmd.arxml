AUTOSAR XML (schema 00044)
package /TI_J7/Adc_ib_bswmd/BswModuleDescriptions
  bsw module description Adc
    bsw internal behavior AdcBehavior
      exclusive area ADC_EXCLUSIVE_AREA_0
