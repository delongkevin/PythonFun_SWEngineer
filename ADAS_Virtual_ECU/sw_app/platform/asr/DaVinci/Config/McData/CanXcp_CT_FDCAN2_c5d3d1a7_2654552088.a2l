/**********************************************************************************************************************
* COPYRIGHT
* \verbatim
* This software is copyright protected and proprietary to Vector Informatik GmbH.
* Vector Informatik GmbH grants to you only those rights as set out in the license conditions.
* All other rights remain with Vector Informatik GmbH.
* \endverbatim
* LICENSE
* Module: Xcp
* Program: MSR FCA SLP5 (MSR_Fca_SLP5)
* Customer: Magna Electronics
* Expiry Date: Not restricted
* Ordered Derivat.: TDA4VE88
* License Scope : The usage is restricted to CBD2101089_D08
* FILE DESCRIPTION
* File: CanXcp_CT_FDCAN2_c5d3d1a7_2654552088.a2l
* Generation Time: 2024-02-13 13:07:49
* Project: L2H4060_CVADAS_MCU1_0 - Version 1.0
* Delivery: CBD2101089_D08
* Tool Version: DaVinci Configurator Classic 5.25.50 SP5
*********************************************************************************************************************/
/begin XCP_ON_CAN 0x0102 /* XCP on CAN version */ CAN_ID_MASTER 2654552088 /* CMD/STIM */ CAN_ID_SLAVE 3728556056 /* RES/ERR/EV/SERV/DAQ */ BAUDRATE 500000 /* BAUDRATE */ SAMPLE_POINT 80 /* SAMPLE_POINT */ SAMPLE_RATE SINGLE /* SAMPLE_RATE */ BTL_CYCLES 10 /* BTL_CYCLES */ SJW 1 /* length synchr. segment */ MAX_DLC_REQUIRED /* master to slave frames always to have DLC = MAX_DLC = 8 */
 /begin CAN_FD MAX_DLC 8 /* DLC of CAN frame */ CAN_FD_DATA_TRANSFER_BAUDRATE 2000000 /* Baudrate [Hz] */ SAMPLE_POINT 80 /* Sample Point Receiver */ BTL_CYCLES 10 /* BTL_CYCLES */ SJW 2 /* length synchr. segment */ MAX_DLC_REQUIRED /* Master to Slave Max DLC */ SECONDARY_SAMPLE_POINT 0 /* Sender Sample Point */ TRANSCEIVER_DELAY_COMPENSATION OFF /end CAN_FD
 /begin PROTOCOL_LAYER 0x0104 2000 10000 2000 2000 2000 2000 0 8 /* kXcpMaxCto */ 8 /* kXcpMaxDto */ BYTE_ORDER_MSB_LAST /* Byte Order */ ADDRESS_GRANULARITY_BYTE OPTIONAL_CMD GET_COMM_MODE_INFO OPTIONAL_CMD SET_MTA OPTIONAL_CMD UPLOAD OPTIONAL_CMD SHORT_UPLOAD OPTIONAL_CMD DOWNLOAD OPTIONAL_CMD DOWNLOAD_MAX OPTIONAL_CMD MODIFY_BITS OPTIONAL_CMD SET_DAQ_PTR OPTIONAL_CMD WRITE_DAQ OPTIONAL_CMD SET_DAQ_LIST_MODE OPTIONAL_CMD GET_DAQ_LIST_MODE OPTIONAL_CMD START_STOP_DAQ_LIST OPTIONAL_CMD START_STOP_SYNCH OPTIONAL_CMD GET_DAQ_PROCESSOR_INFO OPTIONAL_CMD GET_DAQ_RESOLUTION_INFO OPTIONAL_CMD GET_DAQ_EVENT_INFO OPTIONAL_CMD FREE_DAQ OPTIONAL_CMD ALLOC_DAQ OPTIONAL_CMD ALLOC_ODT OPTIONAL_CMD ALLOC_ODT_ENTRY /end PROTOCOL_LAYER
/end XCP_ON_CAN
