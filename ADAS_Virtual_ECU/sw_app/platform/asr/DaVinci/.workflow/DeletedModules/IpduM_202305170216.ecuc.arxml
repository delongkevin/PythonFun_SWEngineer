AUTOSAR XML (schema 00048)
package /ActiveEcuC
  module config IpduM: implementation-config-variant=VARIANT-PRE-COMPILE, module-description=IpduM_Impl
    IpduMPublishedInformation: IpduMRxDirectComInvocation=false
    IpduMGeneral:
      IpduMStaticPartExists = false
      IpduMConfigurationTimeBase = 0.01
      IpduMRxTimeBase = 0.01
      IpduMTxTimeBase = 0.01
      IpduMDevErrorDetect = true
      IpduMHeaderByteOrder = IPDUM_BIG_ENDIAN
      IpduMVersionInfoApi = false
      IpduMSafeBswChecks = false
    IpduMConfig
      ME_Tester_SensorData_1_oFDCAN14_4dd3a7b7_Tx (IpduMTxPathway)
        IpduMTxRequest_0402fb89 (IpduMTxRequest):
          IpduMByteOrder = LITTLE_ENDIAN
          IpduMIPduUnusedAreasDefault = 0
          IpduMTxTriggerMode = DYNAMIC_PART_TRIGGER
          IpduMTxConfirmationPduId = 0
          IpduMInitialDynamicPart = ME_Tester_SensorData_1_oFDCAN14_528d778b
          IpduMOutgoingPduRef = ME_Tester_SensorData_1_oFDCAN14_4dd3a7b7_Tx
          10 x IpduMTxDynamicPart, all with IpduMJitUpdate=false, IpduMTxDynamicConfirmation=false:
            ME_Tester_SensorData_1_oFDCAN14_5b66d7f1: IpduMTxDynamicHandleId=2, IpduMTxDynamicPduRef=ME_Tester_SensorData_1_Mx04_oFDCAN14_d8104af3_Tx
              IpduMSegment_0 (IpduMSegment): IpduMSegmentLength=64, IpduMSegmentPosition=0
            ME_Tester_SensorData_1_oFDCAN14_9303a84b: IpduMTxDynamicHandleId=8, IpduMTxDynamicPduRef=ME_Tester_SensorData_1_Mx10_oFDCAN14_10753549_Tx
              IpduMSegment_0 (IpduMSegment): IpduMSegmentLength=64, IpduMSegmentPosition=0
            ME_Tester_SensorData_1_oFDCAN14_42ed3957: IpduMTxDynamicHandleId=4, IpduMTxDynamicPduRef=ME_Tester_SensorData_1_Mx0E_oFDCAN14_c19ba455_Tx
              IpduMSegment_0 (IpduMSegment): IpduMSegmentLength=64, IpduMSegmentPosition=0
            ME_Tester_SensorData_1_oFDCAN14_b9bacc88: IpduMTxDynamicHandleId=14, IpduMTxDynamicPduRef=ME_Tester_SensorData_1_Mx03_oFDCAN14_3acc518a_Tx
              IpduMSegment_0 (IpduMSegment): IpduMSegmentLength=64, IpduMSegmentPosition=0
            ME_Tester_SensorData_1_oFDCAN14_b4a4bccf: IpduMTxDynamicHandleId=13, IpduMTxDynamicPduRef=ME_Tester_SensorData_1_Mx05_oFDCAN14_37d221cd_Tx
              IpduMSegment_0 (IpduMSegment): IpduMSegmentLength=64, IpduMSegmentPosition=0
            ME_Tester_SensorData_1_oFDCAN14_4ff34910: IpduMTxDynamicHandleId=1, IpduMTxDynamicPduRef=ME_Tester_SensorData_1_Mx0C_oFDCAN14_cc85d412_Tx
              IpduMSegment_0 (IpduMSegment): IpduMSegmentLength=64, IpduMSegmentPosition=0
            ME_Tester_SensorData_1_oFDCAN14_528d778b: IpduMTxDynamicHandleId=6, IpduMTxDynamicPduRef=ME_Tester_SensorData_1_Mx00_oFDCAN14_d1fbea89_Tx
              IpduMSegment_0 (IpduMSegment): IpduMSegmentLength=64, IpduMSegmentPosition=0
            ME_Tester_SensorData_1_oFDCAN14_5678a7b6: IpduMTxDynamicHandleId=7, IpduMTxDynamicPduRef=ME_Tester_SensorData_1_Mx02_oFDCAN14_d50e3ab4_Tx
              IpduMSegment_0 (IpduMSegment): IpduMSegmentLength=64, IpduMSegmentPosition=0
            ME_Tester_SensorData_1_oFDCAN14_a9da8254: IpduMTxDynamicHandleId=9, IpduMTxDynamicPduRef=ME_Tester_SensorData_1_Mx0F_oFDCAN14_2aac1f56_Tx
              IpduMSegment_0 (IpduMSegment): IpduMSegmentLength=64, IpduMSegmentPosition=0
            ME_Tester_SensorData_1_oFDCAN14_415a377f: IpduMTxDynamicHandleId=5, IpduMTxDynamicPduRef=ME_Tester_SensorData_1_Mx08_oFDCAN14_c22caa7d_Tx
              IpduMSegment_0 (IpduMSegment): IpduMSegmentLength=64, IpduMSegmentPosition=0
          IpduMSelectorFieldPosition: IpduMSelectorFieldLength=8, IpduMSelectorFieldPosition=0
          7 x IpduMTxDynamicPart, all with IpduMJitUpdate=false, IpduMTxDynamicConfirmation=false:
            ME_Tester_SensorData_1_oFDCAN14_5f9307cc: IpduMTxDynamicHandleId=3, IpduMTxDynamicPduRef=ME_Tester_SensorData_1_Mx06_oFDCAN14_dce59ace_Tx
              IpduMSegment_0 (IpduMSegment): IpduMSegmentLength=64, IpduMSegmentPosition=0
            ME_Tester_SensorData_1_oFDCAN14_4b06992d: IpduMTxDynamicHandleId=0, IpduMTxDynamicPduRef=ME_Tester_SensorData_1_Mx0A_oFDCAN14_c870042f_Tx
              IpduMSegment_0 (IpduMSegment): IpduMSegmentLength=64, IpduMSegmentPosition=0
            ME_Tester_SensorData_1_oFDCAN14_a031222e: IpduMTxDynamicHandleId=10, IpduMTxDynamicPduRef=ME_Tester_SensorData_1_Mx0B_oFDCAN14_2347bf2c_Tx
              IpduMSegment_0 (IpduMSegment): IpduMSegmentLength=64, IpduMSegmentPosition=0
            ME_Tester_SensorData_1_oFDCAN14_b0516cf2: IpduMTxDynamicHandleId=15, IpduMTxDynamicPduRef=ME_Tester_SensorData_1_Mx07_oFDCAN14_3327f1f0_Tx
              IpduMSegment_0 (IpduMSegment): IpduMSegmentLength=64, IpduMSegmentPosition=0
            ME_Tester_SensorData_1_oFDCAN14_ad2f5269: IpduMTxDynamicHandleId=11, IpduMTxDynamicPduRef=ME_Tester_SensorData_1_Mx0D_oFDCAN14_2e59cf6b_Tx
              IpduMSegment_0 (IpduMSegment): IpduMSegmentLength=64, IpduMSegmentPosition=0
            ME_Tester_SensorData_1_oFDCAN14_bd4f1cb5: IpduMTxDynamicHandleId=16, IpduMTxDynamicPduRef=ME_Tester_SensorData_1_Mx01_oFDCAN14_3e3981b7_Tx
              IpduMSegment_0 (IpduMSegment): IpduMSegmentLength=64, IpduMSegmentPosition=0
            ME_Tester_SensorData_1_oFDCAN14_ae985c41: IpduMTxDynamicHandleId=12, IpduMTxDynamicPduRef=ME_Tester_SensorData_1_Mx09_oFDCAN14_2deec143_Tx
              IpduMSegment_0 (IpduMSegment): IpduMSegmentLength=64, IpduMSegmentPosition=0
      ME_Tester_SensorData_2_oFDCAN14_a6e41cb4_Tx (IpduMTxPathway)
        IpduMTxRequest_32b36038 (IpduMTxRequest):
          IpduMByteOrder = LITTLE_ENDIAN
          IpduMIPduUnusedAreasDefault = 0
          IpduMTxTriggerMode = DYNAMIC_PART_TRIGGER
          IpduMTxConfirmationPduId = 1
          IpduMInitialDynamicPart = ME_Tester_SensorData_2_oFDCAN14_f9a519e5
          IpduMOutgoingPduRef = ME_Tester_SensorData_2_oFDCAN14_a6e41cb4_Tx
          5 x IpduMTxDynamicPart, all with IpduMJitUpdate=false, IpduMTxDynamicConfirmation=false:
            ME_Tester_SensorData_2_oFDCAN14_166772db: IpduMTxDynamicHandleId=25, IpduMTxDynamicPduRef=ME_Tester_SensorData_2_Mx01_oFDCAN14_2f44ebce_Tx
              IpduMSegment_0 (IpduMSegment): IpduMSegmentLength=64, IpduMSegmentPosition=0
            ME_Tester_SensorData_2_oFDCAN14_1b79029c: IpduMTxDynamicHandleId=18, IpduMTxDynamicPduRef=ME_Tester_SensorData_2_Mx07_oFDCAN14_225a9b89_Tx
              IpduMSegment_0 (IpduMSegment): IpduMSegmentLength=64, IpduMSegmentPosition=0
            ME_Tester_SensorData_2_oFDCAN14_02f2ec3a: IpduMTxDynamicHandleId=20, IpduMTxDynamicPduRef=ME_Tester_SensorData_2_Mx0F_oFDCAN14_3bd1752f_Tx
              IpduMSegment_0 (IpduMSegment): IpduMSegmentLength=64, IpduMSegmentPosition=0
            ME_Tester_SensorData_2_oFDCAN14_382bc625: IpduMTxDynamicHandleId=22, IpduMTxDynamicPduRef=ME_Tester_SensorData_2_Mx10_oFDCAN14_01085f30_Tx
              IpduMSegment_0 (IpduMSegment): IpduMSegmentLength=64, IpduMSegmentPosition=0
            ME_Tester_SensorData_2_oFDCAN14_fd50c9d8: IpduMTxDynamicHandleId=33, IpduMTxDynamicPduRef=ME_Tester_SensorData_2_Mx02_oFDCAN14_c47350cd_Tx
              IpduMSegment_0 (IpduMSegment): IpduMSegmentLength=64, IpduMSegmentPosition=0
          IpduMSelectorFieldPosition: IpduMSelectorFieldLength=8, IpduMSelectorFieldPosition=0
          12 x IpduMTxDynamicPart, all with IpduMJitUpdate=false, IpduMTxDynamicConfirmation=false:
            ME_Tester_SensorData_2_oFDCAN14_ea725911: IpduMTxDynamicHandleId=29, IpduMTxDynamicPduRef=ME_Tester_SensorData_2_Mx08_oFDCAN14_d351c004_Tx
              IpduMSegment_0 (IpduMSegment): IpduMSegmentLength=64, IpduMSegmentPosition=0
            ME_Tester_SensorData_2_oFDCAN14_1f8cd2a1: IpduMTxDynamicHandleId=19, IpduMTxDynamicPduRef=ME_Tester_SensorData_2_Mx05_oFDCAN14_26af4bb4_Tx
              IpduMSegment_0 (IpduMSegment): IpduMSegmentLength=64, IpduMSegmentPosition=0
            ME_Tester_SensorData_2_oFDCAN14_06073c07: IpduMTxDynamicHandleId=24, IpduMTxDynamicPduRef=ME_Tester_SensorData_2_Mx0D_oFDCAN14_3f24a512_Tx
              IpduMSegment_0 (IpduMSegment): IpduMSegmentLength=64, IpduMSegmentPosition=0
            ME_Tester_SensorData_2_oFDCAN14_f4bb69a2: IpduMTxDynamicHandleId=30, IpduMTxDynamicPduRef=ME_Tester_SensorData_2_Mx06_oFDCAN14_cd98f0b7_Tx
              IpduMSegment_0 (IpduMSegment): IpduMSegmentLength=64, IpduMSegmentPosition=0
            ME_Tester_SensorData_2_oFDCAN14_05b0322f: IpduMTxDynamicHandleId=21, IpduMTxDynamicPduRef=ME_Tester_SensorData_2_Mx09_oFDCAN14_3c93ab3a_Tx
              IpduMSegment_0 (IpduMSegment): IpduMSegmentLength=64, IpduMSegmentPosition=0
            ME_Tester_SensorData_2_oFDCAN14_0b194c40: IpduMTxDynamicHandleId=17, IpduMTxDynamicPduRef=ME_Tester_SensorData_2_Mx0B_oFDCAN14_323ad555_Tx
              IpduMSegment_0 (IpduMSegment): IpduMSegmentLength=64, IpduMSegmentPosition=0
            ME_Tester_SensorData_2_oFDCAN14_f9a519e5: IpduMTxDynamicHandleId=31, IpduMTxDynamicPduRef=ME_Tester_SensorData_2_Mx00_oFDCAN14_c08680f0_Tx
              IpduMSegment_0 (IpduMSegment): IpduMSegmentLength=64, IpduMSegmentPosition=0
            ME_Tester_SensorData_2_oFDCAN14_e02ef743: IpduMTxDynamicHandleId=28, IpduMTxDynamicPduRef=ME_Tester_SensorData_2_Mx0A_oFDCAN14_d90d6e56_Tx
              IpduMSegment_0 (IpduMSegment): IpduMSegmentLength=64, IpduMSegmentPosition=0
            ME_Tester_SensorData_2_oFDCAN14_1292a2e6: IpduMTxDynamicHandleId=23, IpduMTxDynamicPduRef=ME_Tester_SensorData_2_Mx03_oFDCAN14_2bb13bf3_Tx
              IpduMSegment_0 (IpduMSegment): IpduMSegmentLength=64, IpduMSegmentPosition=0
            ME_Tester_SensorData_2_oFDCAN14_e9c55739: IpduMTxDynamicHandleId=27, IpduMTxDynamicPduRef=ME_Tester_SensorData_2_Mx0E_oFDCAN14_d0e6ce2c_Tx
              IpduMSegment_0 (IpduMSegment): IpduMSegmentLength=64, IpduMSegmentPosition=0
            ME_Tester_SensorData_2_oFDCAN14_f04eb99f: IpduMTxDynamicHandleId=32, IpduMTxDynamicPduRef=ME_Tester_SensorData_2_Mx04_oFDCAN14_c96d208a_Tx
              IpduMSegment_0 (IpduMSegment): IpduMSegmentLength=64, IpduMSegmentPosition=0
            ME_Tester_SensorData_2_oFDCAN14_e4db277e: IpduMTxDynamicHandleId=26, IpduMTxDynamicPduRef=ME_Tester_SensorData_2_Mx0C_oFDCAN14_ddf8be6b_Tx
              IpduMSegment_0 (IpduMSegment): IpduMSegmentLength=64, IpduMSegmentPosition=0
    IpduMGeneration:
      IpduMOutOfBoundsWriteProtectionStrategy = NONE
      IpduMOutOfBoundsWriteSanitizer = false
      IpduMOutOfBoundsReadSanitizer = false
      IpduMReduceConstantData2Define = false
      IpduMBoolDataInArrayOfStructStrategy = BITMASKING
      IpduMDeduplicateIndirectedData = true
      IpduMDataDeduplicationStrategy = WITH_CAST
      IpduMReduceBoolDataByNegationThreshold = 2
      IpduMReduceBoolDataByNumericalComparisonThreshold = 2
      IpduMReduceBoolDataByNumericalRelationThreshold = 2
      IpduMReduceBoolDataByNumericalOperandStrategy = WITH_ANY_VALUE
      IpduMReduceNumericalDataByOffsetThreshold = 2
      IpduMReduceNumericalDataByArraySubtractionThreshold = 2
      IpduMReduceDataByStreaming = false
      IpduMShortSymbols = false
      IpduMInterfacesForDeactivatedData = false
      IpduMReferringKeysInComments = false
