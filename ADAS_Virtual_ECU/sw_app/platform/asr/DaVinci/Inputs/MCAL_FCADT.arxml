AUTOSAR XML (schema 00048)
package /ActiveEcuC
  module config Adc: implementation-config-variant=VARIANT-PRE-COMPILE, module-description=Adc_Impl
    AdcConfigSet
      AdcHwUnit_0 (AdcHwUnit): AdcHwUnitId=ADC_UNIT_0, AdcClockSource=undefined
        AdcChannel_MCU_ADC0_AN0 (AdcChannel):
          AdcChannelId = 0
          AdcChannelOpenDelay = 0
          AdcChannelSampleDelay = 0
          AdcChannelRangeCheckEnable = false
          AdcChannelAveragingMode = ADC_AVERAGING_MODE_2_SAMPLES
        AdcGroup_0 (AdcGroup):
          AdcGroupAccessMode = ADC_ACCESS_MODE_SINGLE
          AdcGroupConversionMode = ADC_CONV_MODE_ONESHOT
          AdcGroupId = 0
          AdcGroupTriggSrc = ADC_TRIGG_SRC_SW
          AdcStreamingBufferMode = ADC_STREAM_BUFFER_LINEAR
          AdcStreamingNumSamples = 1
          AdcGroupHighRange = 4095
          AdcGroupLowRange = 1
          AdcGroupReplacement = ADC_GROUP_REPL_SUSPEND_RESUME
          AdcGroupPriority = 0
          AdcHwTrigSignal = ADC_HW_TRIG_FALLING_EDGE
          AdcHwTrigTimer = 0
          AdcNotification = AdcApp_HwUnit0_Group0EndNotification
          AdcGroupDefinition = AdcChannel_MCU_ADC0_AN{0..7}
        7 x AdcChannel, all with AdcChannelOpenDelay=0, AdcChannelSampleDelay=0, AdcChannelRangeCheckEnable=false, AdcChannelAveragingMode=ADC_AVERAGING_MODE_2_SAMPLES:
          AdcChannel_MCU_ADC0_AN{1..7}: AdcChannelId={1..7}
      AdcHwUnit_1 (AdcHwUnit): AdcHwUnitId=ADC_UNIT_1, AdcClockSource=undefined
        AdcChannel_MCU_ADC1_AN0 (AdcChannel):
          AdcChannelId = 0
          AdcChannelOpenDelay = 0
          AdcChannelSampleDelay = 0
          AdcChannelRangeCheckEnable = false
          AdcChannelAveragingMode = ADC_AVERAGING_MODE_2_SAMPLES
        AdcGroup_1 (AdcGroup):
          AdcGroupAccessMode = ADC_ACCESS_MODE_SINGLE
          AdcGroupConversionMode = ADC_CONV_MODE_ONESHOT
          AdcGroupId = 1
          AdcGroupTriggSrc = ADC_TRIGG_SRC_SW
          AdcStreamingBufferMode = ADC_STREAM_BUFFER_LINEAR
          AdcStreamingNumSamples = 1
          AdcGroupHighRange = 4095
          AdcGroupLowRange = 1
          AdcGroupReplacement = ADC_GROUP_REPL_SUSPEND_RESUME
          AdcGroupPriority = 1
          AdcHwTrigSignal = ADC_HW_TRIG_FALLING_EDGE
          AdcHwTrigTimer = 0
          AdcNotification = AdcApp_HwUnit1_Group1EndNotification
          AdcGroupDefinition = AdcChannel_MCU_ADC1_AN0
          AdcGroupDefinition = AdcChannel_MCU_ADC1_AN2
          AdcGroupDefinition = AdcChannel_MCU_ADC1_AN3
        AdcChannel_MCU_ADC1_AN2 (AdcChannel):
          AdcChannelId = 2
          AdcChannelOpenDelay = 0
          AdcChannelSampleDelay = 0
          AdcChannelRangeCheckEnable = false
          AdcChannelAveragingMode = ADC_AVERAGING_MODE_2_SAMPLES
        AdcChannel_MCU_ADC1_AN3 (AdcChannel):
          AdcChannelId = 3
          AdcChannelOpenDelay = 0
          AdcChannelSampleDelay = 0
          AdcChannelRangeCheckEnable = false
          AdcChannelAveragingMode = ADC_AVERAGING_MODE_2_SAMPLES
    AdcGeneral:
      AdcDeInitApi = true
      AdcDevErrorDetect = true
      AdcEnableQueuing = true
      AdcEnableStartStopGroupApi = true
      AdcGrpNotifCapability = true
      AdcPriorityImplementation = ADC_PRIORITY_HW_SW
      AdcReadGroupApi = true
      AdcResultAlignment = ADC_ALIGN_RIGHT
      AdcVersionInfoApi = true
      AdcGroupLog = true
      AdcGroupLogMaxLen = 100
      AdcFifoErrLog = true
      AdcFifoErrLogMaxLen = 100
      AdcMaxGroupCount = 2
      AdcMaxHwUnitCount = 2
      AdcEnableRegisterReadbackApi = true
      AdcTypeofInterruptFunction = ADC_ISR_CAT2
      AdcDefaultOSCounterId = 0
      AdcTimeoutDuration = 10000
      AdcDeviceVariant = J721S2
      AdcOwnProcId = MCU1_0
      AdcOsCounterRef = SystemTimer
    AdcPublishedInformation:
      AdcChannelValueSigned = false
      AdcGroupFirstChannelFixed = false
      AdcMaxChannelResolution = 12
      AdcMaxRange = 4095
      AdcMinRange = 0
      AdcMaxNumChannels = 10
      AdcMaxHwChannelId = 9
      AdcMinHwChannelId = 0
      AdcMaxOpenDelay = 262143
      AdcMinOpenDelay = 0
      AdcMaxSampleDelay = 255
      AdcMinSampleDelay = 0
  module config Mcu: implementation-config-variant=VARIANT-PRE-COMPILE
    McuGeneralConfiguration: McuDevErrorDetect=false, McuGetRamStateApi=false, McuInitClock=true, McuNoPll=true, McuVersionInfoApi=false, McuPerformResetApi=false
    McuModuleConfiguration: McuClockSrcFailureNotification=ENABLED, McuNumberOfMcuModes=1, McuRamSectors=1
      McuClockSettingConfig: McuClockSettingId=1
        McuClockReferencePoint: McuClockReferencePointFrequency=80000000
      McuModeSettingConf: McuMode=1
    McuPublishedInformation
      McuResetReasonConf: McuResetReason=0
package /Dio
  module config Dio: implementation-config-variant=VARIANT-LINK-TIME, module-description=Dio_Impl
    DioConfig
      DioPort_WKUP_GPIO0_BANK0 (DioPort): DioPortId=0
        3 x DioChannel:
          DioChannel_pinEN: DioChannelId=15
          DioChannel_PinSTB: DioChannelId=1
          DioChannel_PinERR: DioChannelId=6
        WKUP_GPIO0_B0 (DioChannelGroup): DioChannelGroupIdentification=WKUP_GPIO0_B0_PTR, DioPortMask=4294967295, DioPortOffset=0
        DioChannel_MCU_LED (DioChannel): DioChannelId=31
      DioPort_WKUP_GPIO0_BANK23 (DioPort): DioPortId=1
        18 x DioChannel:
          WKUP_GPIO0_B23_Ch0: DioChannelId=43
          WKUP_GPIO0_B23_Ch1: DioChannelId=44
          WKUP_GPIO0_B23_Ch10: DioChannelId=53
          WKUP_GPIO0_B23_Ch11: DioChannelId=54
          WKUP_GPIO0_B23_Ch12: DioChannelId=55
          pinFDCAN14_Enable: DioChannelId=56
          WKUP_GPIO0_B23_Ch14: DioChannelId=57
          WKUP_GPIO0_B23_Ch15: DioChannelId=58
          WKUP_GPIO0_B23_Ch16: DioChannelId=59
          DioChannel_PINRXD: DioChannelId=61
          WKUP_GPIO0_B23_Ch2: DioChannelId=45
          WKUP_GPIO0_B23_Ch3: DioChannelId=46
          WKUP_GPIO0_B23_Ch4: DioChannelId=47
          WKUP_GPIO0_B23_Ch5: DioChannelId=48
          WKUP_GPIO0_B23_Ch6: DioChannelId=49
          WKUP_GPIO0_B23_Ch7: DioChannelId=50
          WKUP_GPIO0_B23_Ch8: DioChannelId=51
          WKUP_GPIO0_B23_Ch9: DioChannelId=52
        WKUP_GPIO0_B23 (DioChannelGroup): DioChannelGroupIdentification=WKUP_GPIO0_B23_PTR, DioPortMask=4294967295, DioPortOffset=0
    DioDemEventParameterRef
    DioGeneral: DioDevErrorDetect=true, DioDeviceVariant=J721S2, DioFlipChannelApi=true, DioOwnProcId=MCU1_0, DioRegisterReadbackApi=true, DioVersionInfoApi=true
