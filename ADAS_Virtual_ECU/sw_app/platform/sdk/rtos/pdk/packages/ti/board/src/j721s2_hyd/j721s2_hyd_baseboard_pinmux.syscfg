/**
 * @cliArgs --device "J721S2_TDA4VE_TDA4AL_TDA4VL" --package "ALZ" --part "Default"
 * @versions {"tool":"1.12.1+2446"}
 */

/**
 * These are the peripherals and settings in this configuration
 */
const iAUXPHY1                          = scripting.addPeripheral("AUXPHY");
iAUXPHY1.$name                          = "AUXPHY0";
iAUXPHY1.$assign                        = "AUXPHY_0";
iAUXPHY1.AUXN.$assign                   = "ball.AG11";
iAUXPHY1.AUXP.$assign                   = "ball.AF11";
const iCPSW2G1                          = scripting.addPeripheral("CPSW2G");
iCPSW2G1.$name                          = "CPSW2G0";
iCPSW2G1.$assign                        = "CPSW2G_0";
iCPSW2G1.CLKOUT.rx                      = false;
iCPSW2G1.CLKOUT.$used                   = false;
iCPSW2G1.CRS_DV.rx                      = false;
iCPSW2G1.CRS_DV.$used                   = false;
iCPSW2G1.MDC.rx                         = false;
iCPSW2G1.MDC.$assign                    = "ball.T28";
iCPSW2G1.MDIO.$assign                   = "ball.V28";
iCPSW2G1.RD0.$assign                    = "ball.AA24";
iCPSW2G1.RD1.$assign                    = "ball.AB25";
iCPSW2G1.RD2.$assign                    = "ball.T23";
iCPSW2G1.RD3.$assign                    = "ball.U24";
iCPSW2G1.RMII_REF_CLK.rx                = false;
iCPSW2G1.RMII_REF_CLK.$used             = false;
iCPSW2G1.RXC.$assign                    = "ball.AD26";
iCPSW2G1.RXD0.rx                        = false;
iCPSW2G1.RXD0.$used                     = false;
iCPSW2G1.RXD1.rx                        = false;
iCPSW2G1.RXD1.$used                     = false;
iCPSW2G1.RX_CTL.$assign                 = "ball.AC25";
iCPSW2G1.RX_ER.rx                       = false;
iCPSW2G1.RX_ER.$used                    = false;
iCPSW2G1.TD0.rx                         = false;
iCPSW2G1.TD0.$assign                    = "ball.T25";
iCPSW2G1.TD1.rx                         = false;
iCPSW2G1.TD1.$assign                    = "ball.W24";
iCPSW2G1.TD2.rx                         = false;
iCPSW2G1.TD2.$assign                    = "ball.AA25";
iCPSW2G1.TD3.rx                         = false;
iCPSW2G1.TD3.$assign                    = "ball.V25";
iCPSW2G1.TXC.rx                         = false;
iCPSW2G1.TXC.$assign                    = "ball.U25";
iCPSW2G1.TXD0.rx                        = false;
iCPSW2G1.TXD0.$used                     = false;
iCPSW2G1.TXD1.rx                        = false;
iCPSW2G1.TXD1.$used                     = false;
iCPSW2G1.TX_CTL.rx                      = false;
iCPSW2G1.TX_CTL.$assign                 = "ball.T24";
iCPSW2G1.TX_EN.rx                       = false;
iCPSW2G1.TX_EN.$used                    = false;
const iCSI1                             = scripting.addPeripheral("CSI");
iCSI1.$name                             = "CSIRX0";
iCSI1.$assign                           = "CSI_RX_0";
iCSI1.RXCLKN.$assign                    = "ball.AH19";
iCSI1.RXCLKP.$assign                    = "ball.AH20";
iCSI1.RXN0.$assign                      = "ball.AG18";
iCSI1.RXN1.$assign                      = "ball.AF19";
iCSI1.RXN2.$assign                      = "ball.AE18";
iCSI1.RXN3.$assign                      = "ball.AD19";
iCSI1.RXP0.$assign                      = "ball.AG19";
iCSI1.RXP1.$assign                      = "ball.AF20";
iCSI1.RXP2.$assign                      = "ball.AE19";
iCSI1.RXP3.$assign                      = "ball.AD20";
iCSI1.RXRCALIB.$assign                  = "ball.AC18";
iCSI1.TXCLKN.$used                      = false;
iCSI1.TXCLKP.$used                      = false;
iCSI1.TXN0.$used                        = false;
iCSI1.TXN1.$used                        = false;
iCSI1.TXN2.$used                        = false;
iCSI1.TXN3.$used                        = false;
iCSI1.TXP0.$used                        = false;
iCSI1.TXP1.$used                        = false;
iCSI1.TXP2.$used                        = false;
iCSI1.TXP3.$used                        = false;
const iCSI2                             = scripting.addPeripheral("CSI");
iCSI2.$name                             = "CSIRX1";
iCSI2.$assign                           = "CSI_RX_1";
iCSI2.RXCLKN.$assign                    = "ball.AH22";
iCSI2.RXCLKP.$assign                    = "ball.AH23";
iCSI2.RXN0.$assign                      = "ball.AG21";
iCSI2.RXN1.$assign                      = "ball.AF22";
iCSI2.RXN2.$assign                      = "ball.AE21";
iCSI2.RXN3.$assign                      = "ball.AD22";
iCSI2.RXP0.$assign                      = "ball.AG22";
iCSI2.RXP1.$assign                      = "ball.AF23";
iCSI2.RXP2.$assign                      = "ball.AE22";
iCSI2.RXP3.$assign                      = "ball.AD23";
iCSI2.RXRCALIB.$assign                  = "ball.AC21";
iCSI2.TXCLKN.$used                      = false;
iCSI2.TXCLKP.$used                      = false;
iCSI2.TXN0.$used                        = false;
iCSI2.TXN1.$used                        = false;
iCSI2.TXN2.$used                        = false;
iCSI2.TXN3.$used                        = false;
iCSI2.TXP0.$used                        = false;
iCSI2.TXP1.$used                        = false;
iCSI2.TXP2.$used                        = false;
iCSI2.TXP3.$used                        = false;
const iCSI3                             = scripting.addPeripheral("CSI");
iCSI3.$name                             = "CSITX0";
iCSI3.$assign                           = "CSI_TX_0";
iCSI3.RXCLKN.$used                      = false;
iCSI3.RXCLKP.$used                      = false;
iCSI3.RXN0.$used                        = false;
iCSI3.RXN1.$used                        = false;
iCSI3.RXN2.$used                        = false;
iCSI3.RXN3.$used                        = false;
iCSI3.RXP0.$used                        = false;
iCSI3.RXP1.$used                        = false;
iCSI3.RXP2.$used                        = false;
iCSI3.RXP3.$used                        = false;
iCSI3.RXRCALIB.$used                    = false;
iCSI3.TXCLKN.$assign                    = "ball.AH13";
iCSI3.TXCLKP.$assign                    = "ball.AH14";
iCSI3.TXN0.$assign                      = "ball.AG12";
iCSI3.TXN1.$assign                      = "ball.AF13";
iCSI3.TXN2.$assign                      = "ball.AE12";
iCSI3.TXN3.$assign                      = "ball.AD13";
iCSI3.TXP0.$assign                      = "ball.AG13";
iCSI3.TXP1.$assign                      = "ball.AF14";
iCSI3.TXP2.$assign                      = "ball.AE13";
iCSI3.TXP3.$assign                      = "ball.AD14";
const iDDRSS1                           = scripting.addPeripheral("DDRSS");
iDDRSS1.$name                           = "DDR0";
iDDRSS1.$assign                         = "DDR_0";
iDDRSS1.CA0.$assign                     = "ball.P3";
iDDRSS1.CA1.$assign                     = "ball.P5";
iDDRSS1.CA2.$assign                     = "ball.N5";
iDDRSS1.CA3.$assign                     = "ball.P2";
iDDRSS1.CA4.$assign                     = "ball.P4";
iDDRSS1.CA5.$assign                     = "ball.R3";
iDDRSS1.CAL0.$assign                    = "ball.R8";
iDDRSS1.CKE0.$assign                    = "ball.R2";
iDDRSS1.CKE1.$assign                    = "ball.R4";
iDDRSS1.CKN.$assign                     = "ball.R1";
iDDRSS1.CKP.$assign                     = "ball.P1";
iDDRSS1.CSn0_0.$assign                  = "ball.V5";
iDDRSS1.CSn0_1.$assign                  = "ball.W5";
iDDRSS1.CSn1_0.$assign                  = "ball.T5";
iDDRSS1.CSn1_1.$assign                  = "ball.U6";
iDDRSS1.DM0.$assign                     = "ball.H5";
iDDRSS1.DM1.$assign                     = "ball.M3";
iDDRSS1.DM2.$assign                     = "ball.U4";
iDDRSS1.DM3.$assign                     = "ball.AD1";
iDDRSS1.DQ0.$assign                     = "ball.F3";
iDDRSS1.DQ1.$assign                     = "ball.G4";
iDDRSS1.DQ10.$assign                    = "ball.K3";
iDDRSS1.DQ11.$assign                    = "ball.K1";
iDDRSS1.DQ12.$assign                    = "ball.N4";
iDDRSS1.DQ13.$assign                    = "ball.N2";
iDDRSS1.DQ14.$assign                    = "ball.L4";
iDDRSS1.DQ15.$assign                    = "ball.L2";
iDDRSS1.DQ16.$assign                    = "ball.T1";
iDDRSS1.DQ17.$assign                    = "ball.T3";
iDDRSS1.DQ18.$assign                    = "ball.V3";
iDDRSS1.DQ19.$assign                    = "ball.U2";
iDDRSS1.DQ2.$assign                     = "ball.F5";
iDDRSS1.DQ20.$assign                    = "ball.W2";
iDDRSS1.DQ21.$assign                    = "ball.W4";
iDDRSS1.DQ22.$assign                    = "ball.Y1";
iDDRSS1.DQ23.$assign                    = "ball.Y3";
iDDRSS1.DQ24.$assign                    = "ball.AB3";
iDDRSS1.DQ25.$assign                    = "ball.AA2";
iDDRSS1.DQ26.$assign                    = "ball.AA4";
iDDRSS1.DQ27.$assign                    = "ball.Y5";
iDDRSS1.DQ28.$assign                    = "ball.AC2";
iDDRSS1.DQ29.$assign                    = "ball.AB5";
iDDRSS1.DQ3.$assign                     = "ball.F1";
iDDRSS1.DQ30.$assign                    = "ball.AD2";
iDDRSS1.DQ31.$assign                    = "ball.AC4";
iDDRSS1.DQ4.$assign                     = "ball.J4";
iDDRSS1.DQ5.$assign                     = "ball.H3";
iDDRSS1.DQ6.$assign                     = "ball.J2";
iDDRSS1.DQ7.$assign                     = "ball.G2";
iDDRSS1.DQ8.$assign                     = "ball.K5";
iDDRSS1.DQ9.$assign                     = "ball.M5";
iDDRSS1.DQS0N.$assign                   = "ball.H1";
iDDRSS1.DQS0P.$assign                   = "ball.G1";
iDDRSS1.DQS1N.$assign                   = "ball.M1";
iDDRSS1.DQS1P.$assign                   = "ball.L1";
iDDRSS1.DQS2N.$assign                   = "ball.U1";
iDDRSS1.DQS2P.$assign                   = "ball.V1";
iDDRSS1.DQS3N.$assign                   = "ball.AC1";
iDDRSS1.DQS3P.$assign                   = "ball.AB1";
iDDRSS1.RESETn.$assign                  = "ball.R5";
iDDRSS1.RET.$assign                     = "ball.T8";
const iDDRSS2                           = scripting.addPeripheral("DDRSS");
iDDRSS2.$name                           = "DDR1";
iDDRSS2.$assign                         = "DDR_1";
iDDRSS2.CA0.$assign                     = "ball.C10";
iDDRSS2.CA1.$assign                     = "ball.E10";
iDDRSS2.CA2.$assign                     = "ball.E9";
iDDRSS2.CA3.$assign                     = "ball.B10";
iDDRSS2.CA4.$assign                     = "ball.D10";
iDDRSS2.CA5.$assign                     = "ball.C9";
iDDRSS2.CAL0.$assign                    = "ball.E8";
iDDRSS2.CKE0.$assign                    = "ball.B9";
iDDRSS2.CKE1.$assign                    = "ball.D9";
iDDRSS2.CKN.$assign                     = "ball.A9";
iDDRSS2.CKP.$assign                     = "ball.A10";
iDDRSS2.CSn0_0.$assign                  = "ball.F9";
iDDRSS2.CSn0_1.$assign                  = "ball.F8";
iDDRSS2.CSn1_0.$assign                  = "ball.F11";
iDDRSS2.CSn1_1.$assign                  = "ball.F10";
iDDRSS2.DM0.$assign                     = "ball.D16";
iDDRSS2.DM1.$assign                     = "ball.E13";
iDDRSS2.DM2.$assign                     = "ball.F7";
iDDRSS2.DM3.$assign                     = "ball.B3";
iDDRSS2.DQ0.$assign                     = "ball.B18";
iDDRSS2.DQ1.$assign                     = "ball.E17";
iDDRSS2.DQ10.$assign                    = "ball.C13";
iDDRSS2.DQ11.$assign                    = "ball.C11";
iDDRSS2.DQ12.$assign                    = "ball.E11";
iDDRSS2.DQ13.$assign                    = "ball.A11";
iDDRSS2.DQ14.$assign                    = "ball.B12";
iDDRSS2.DQ15.$assign                    = "ball.D12";
iDDRSS2.DQ16.$assign                    = "ball.B7";
iDDRSS2.DQ17.$assign                    = "ball.D7";
iDDRSS2.DQ18.$assign                    = "ball.C8";
iDDRSS2.DQ19.$assign                    = "ball.A8";
iDDRSS2.DQ2.$assign                     = "ball.D18";
iDDRSS2.DQ20.$assign                    = "ball.C6";
iDDRSS2.DQ21.$assign                    = "ball.E6";
iDDRSS2.DQ22.$assign                    = "ball.B5";
iDDRSS2.DQ23.$assign                    = "ball.D5";
iDDRSS2.DQ24.$assign                    = "ball.B1";
iDDRSS2.DQ25.$assign                    = "ball.A4";
iDDRSS2.DQ26.$assign                    = "ball.C4";
iDDRSS2.DQ27.$assign                    = "ball.E4";
iDDRSS2.DQ28.$assign                    = "ball.D1";
iDDRSS2.DQ29.$assign                    = "ball.D3";
iDDRSS2.DQ3.$assign                     = "ball.A17";
iDDRSS2.DQ30.$assign                    = "ball.C2";
iDDRSS2.DQ31.$assign                    = "ball.E2";
iDDRSS2.DQ4.$assign                     = "ball.E15";
iDDRSS2.DQ5.$assign                     = "ball.B16";
iDDRSS2.DQ6.$assign                     = "ball.C15";
iDDRSS2.DQ7.$assign                     = "ball.C17";
iDDRSS2.DQ8.$assign                     = "ball.B14";
iDDRSS2.DQ9.$assign                     = "ball.D14";
iDDRSS2.DQS0N.$assign                   = "ball.A15";
iDDRSS2.DQS0P.$assign                   = "ball.A16";
iDDRSS2.DQS1N.$assign                   = "ball.A12";
iDDRSS2.DQS1P.$assign                   = "ball.A13";
iDDRSS2.DQS2N.$assign                   = "ball.A7";
iDDRSS2.DQS2P.$assign                   = "ball.A6";
iDDRSS2.DQS3N.$assign                   = "ball.A2";
iDDRSS2.DQS3P.$assign                   = "ball.A3";
iDDRSS2.RESETn.$assign                  = "ball.F12";
iDDRSS2.RET.$assign                     = "ball.J10";
const iDEBUGSS1                         = scripting.addPeripheral("DEBUGSS");
iDEBUGSS1.$name                         = "DEBUGSS";
iDEBUGSS1.$assign                       = "DEBUG_0";
iDEBUGSS1.CLK.rx                        = false;
iDEBUGSS1.CLK.$assign                   = "ball.W25";
iDEBUGSS1.CTL.rx                        = false;
iDEBUGSS1.CTL.$assign                   = "ball.AC24";
iDEBUGSS1.DATA0.rx                      = false;
iDEBUGSS1.DATA0.$assign                 = "ball.AE28";
iDEBUGSS1.DATA1.rx                      = false;
iDEBUGSS1.DATA1.$assign                 = "ball.AF28";
iDEBUGSS1.DATA10.rx                     = false;
iDEBUGSS1.DATA10.$used                  = false;
iDEBUGSS1.DATA11.rx                     = false;
iDEBUGSS1.DATA11.$used                  = false;
iDEBUGSS1.DATA12.rx                     = false;
iDEBUGSS1.DATA12.$used                  = false;
iDEBUGSS1.DATA13.rx                     = false;
iDEBUGSS1.DATA13.$used                  = false;
iDEBUGSS1.DATA14.rx                     = false;
iDEBUGSS1.DATA14.$used                  = false;
iDEBUGSS1.DATA15.rx                     = false;
iDEBUGSS1.DATA15.$used                  = false;
iDEBUGSS1.DATA16.rx                     = false;
iDEBUGSS1.DATA16.$used                  = false;
iDEBUGSS1.DATA17.rx                     = false;
iDEBUGSS1.DATA17.$used                  = false;
iDEBUGSS1.DATA18.rx                     = false;
iDEBUGSS1.DATA18.$used                  = false;
iDEBUGSS1.DATA19.rx                     = false;
iDEBUGSS1.DATA19.$used                  = false;
iDEBUGSS1.DATA2.rx                      = false;
iDEBUGSS1.DATA2.$assign                 = "ball.AD25";
iDEBUGSS1.DATA20.rx                     = false;
iDEBUGSS1.DATA20.$used                  = false;
iDEBUGSS1.DATA21.rx                     = false;
iDEBUGSS1.DATA21.$used                  = false;
iDEBUGSS1.DATA22.rx                     = false;
iDEBUGSS1.DATA22.$used                  = false;
iDEBUGSS1.DATA23.rx                     = false;
iDEBUGSS1.DATA23.$used                  = false;
iDEBUGSS1.DATA24.rx                     = false;
iDEBUGSS1.DATA24.$used                  = false;
iDEBUGSS1.DATA25.rx                     = false;
iDEBUGSS1.DATA25.$used                  = false;
iDEBUGSS1.DATA3.rx                      = false;
iDEBUGSS1.DATA3.$assign                 = "ball.W23";
iDEBUGSS1.DATA4.rx                      = false;
iDEBUGSS1.DATA4.$assign                 = "ball.Y27";
iDEBUGSS1.DATA5.rx                      = false;
iDEBUGSS1.DATA5.$assign                 = "ball.R27";
iDEBUGSS1.DATA6.rx                      = false;
iDEBUGSS1.DATA6.$used                   = false;
iDEBUGSS1.DATA7.rx                      = false;
iDEBUGSS1.DATA7.$used                   = false;
iDEBUGSS1.DATA8.rx                      = false;
iDEBUGSS1.DATA8.$used                   = false;
iDEBUGSS1.DATA9.rx                      = false;
iDEBUGSS1.DATA9.$used                   = false;
iDEBUGSS1.TDI.pu_pd                     = "pu";
iDEBUGSS1.TDI.$assign                   = "ball.AG28";
iDEBUGSS1.TDO.pu_pd                     = "pu";
iDEBUGSS1.TDO.rx                        = false;
iDEBUGSS1.TDO.$assign                   = "ball.AE26";
iDEBUGSS1.TMS.pu_pd                     = "pu";
iDEBUGSS1.TMS.$assign                   = "ball.AG27";
const iDP1                              = scripting.addPeripheral("DP");
iDP1.$name                              = "DP0";
iDP1.$assign                            = "DP_0";
iDP1.HPD.rx                             = false;
iDP1.HPD.$used                          = false;
iDP1.TXN0.$assign                       = "ball.AH7";
iDP1.TXN1.$assign                       = "ball.AG8";
iDP1.TXN2.$assign                       = "ball.AG5";
iDP1.TXN3.$assign                       = "ball.AD7";
iDP1.TXP0.$assign                       = "ball.AH8";
iDP1.TXP1.$assign                       = "ball.AG9";
iDP1.TXP2.$assign                       = "ball.AG6";
iDP1.TXP3.$assign                       = "ball.AD8";
const iDSI1                             = scripting.addPeripheral("DSI");
iDSI1.$name                             = "DSI1";
iDSI1.$assign                           = "DSI_TX_1";
iDSI1.TXCLKN.$assign                    = "ball.AH16";
iDSI1.TXCLKP.$assign                    = "ball.AH17";
iDSI1.TXN0.$assign                      = "ball.AG15";
iDSI1.TXN1.$assign                      = "ball.AF16";
iDSI1.TXN2.$assign                      = "ball.AE15";
iDSI1.TXN3.$assign                      = "ball.AD16";
iDSI1.TXP0.$assign                      = "ball.AG16";
iDSI1.TXP1.$assign                      = "ball.AF17";
iDSI1.TXP2.$assign                      = "ball.AE16";
iDSI1.TXP3.$assign                      = "ball.AD17";
iDSI1.TXRCALIB.$assign                  = "ball.AC15";
const iDSI2                             = scripting.addPeripheral("DSI");
iDSI2.$name                             = "DSI0";
iDSI2.$assign                           = "DSI_TX_0";
iDSI2.TXCLKN.$used                      = false;
iDSI2.TXCLKP.$used                      = false;
iDSI2.TXN0.$used                        = false;
iDSI2.TXN1.$used                        = false;
iDSI2.TXN2.$used                        = false;
iDSI2.TXN3.$used                        = false;
iDSI2.TXP0.$used                        = false;
iDSI2.TXP1.$used                        = false;
iDSI2.TXP2.$used                        = false;
iDSI2.TXP3.$used                        = false;
iDSI2.TXRCALIB.$assign                  = "ball.AC13";
const iECAP1                            = scripting.addPeripheral("ECAP");
iECAP1.$name                            = "ECAP2";
iECAP1.$assign                          = "ECAP_2";
iECAP1.IN_APWM_OUT.rx                   = false;
iECAP1.IN_APWM_OUT.$assign              = "ball.AG25";
const iEHRPWM1                          = scripting.addPeripheral("EHRPWM");
iEHRPWM1.$name                          = "EHRPWM1";
iEHRPWM1.$assign                        = "EHRPWM_1";
iEHRPWM1.A.rx                           = false;
iEHRPWM1.A.$assign                      = "ball.AC27";
iEHRPWM1.B.rx                           = false;
iEHRPWM1.B.$used                        = false;
iEHRPWM1.SOCA.rx                        = false;
iEHRPWM1.SOCA.$used                     = false;
iEHRPWM1.SOCB.rx                        = false;
iEHRPWM1.SOCB.$used                     = false;
iEHRPWM1.SYNCI.rx                       = false;
iEHRPWM1.SYNCI.$used                    = false;
iEHRPWM1.SYNCO.rx                       = false;
iEHRPWM1.SYNCO.$used                    = false;
iEHRPWM1.TZn_IN0.rx                     = false;
iEHRPWM1.TZn_IN0.$used                  = false;
iEHRPWM1.TZn_IN1.rx                     = false;
iEHRPWM1.TZn_IN1.$used                  = false;
iEHRPWM1.TZn_IN2.rx                     = false;
iEHRPWM1.TZn_IN2.$used                  = false;
iEHRPWM1.TZn_IN3.rx                     = false;
iEHRPWM1.TZn_IN3.$used                  = false;
iEHRPWM1.TZn_IN4.rx                     = false;
iEHRPWM1.TZn_IN4.$used                  = false;
iEHRPWM1.TZn_IN5.rx                     = false;
iEHRPWM1.TZn_IN5.$used                  = false;
const iEHRPWM2                          = scripting.addPeripheral("EHRPWM");
iEHRPWM2.$name                          = "EHRPWM2";
iEHRPWM2.$assign                        = "EHRPWM_2";
iEHRPWM2.A.rx                           = false;
iEHRPWM2.A.$assign                      = "ball.AC28";
iEHRPWM2.B.rx                           = false;
iEHRPWM2.B.$used                        = false;
iEHRPWM2.SOCA.rx                        = false;
iEHRPWM2.SOCA.$used                     = false;
iEHRPWM2.SOCB.rx                        = false;
iEHRPWM2.SOCB.$used                     = false;
iEHRPWM2.SYNCI.rx                       = false;
iEHRPWM2.SYNCI.$used                    = false;
iEHRPWM2.SYNCO.rx                       = false;
iEHRPWM2.SYNCO.$used                    = false;
iEHRPWM2.TZn_IN0.rx                     = false;
iEHRPWM2.TZn_IN0.$used                  = false;
iEHRPWM2.TZn_IN1.rx                     = false;
iEHRPWM2.TZn_IN1.$used                  = false;
iEHRPWM2.TZn_IN2.rx                     = false;
iEHRPWM2.TZn_IN2.$used                  = false;
iEHRPWM2.TZn_IN3.rx                     = false;
iEHRPWM2.TZn_IN3.$used                  = false;
iEHRPWM2.TZn_IN4.rx                     = false;
iEHRPWM2.TZn_IN4.$used                  = false;
iEHRPWM2.TZn_IN5.rx                     = false;
iEHRPWM2.TZn_IN5.$used                  = false;
const iGPIO1                            = scripting.addPeripheral("GPIO");
iGPIO1["0"].rx                          = false;
iGPIO1["0"].$assign                     = "ball.AG24";
iGPIO1["1"].rx                          = false;
iGPIO1["1"].$used                       = false;
iGPIO1["2"].rx                          = false;
iGPIO1["2"].$used                       = false;
iGPIO1["3"].rx                          = false;
iGPIO1["3"].$used                       = false;
iGPIO1["4"].rx                          = false;
iGPIO1["4"].$used                       = false;
iGPIO1["5"].rx                          = false;
iGPIO1["5"].$used                       = false;
iGPIO1["6"].rx                          = false;
iGPIO1["6"].$used                       = false;
iGPIO1["7"].rx                          = false;
iGPIO1["7"].$used                       = false;
iGPIO1["8"].rx                          = false;
iGPIO1["8"].$used                       = false;
iGPIO1["9"].rx                          = false;
iGPIO1["9"].$used                       = false;
iGPIO1["10"].rx                         = false;
iGPIO1["10"].$used                      = false;
iGPIO1["11"].$assign                    = "ball.V23";
iGPIO1["12"].$assign                    = "ball.T26";
iGPIO1["13"].rx                         = false;
iGPIO1["13"].$assign                    = "ball.AD24";
iGPIO1["14"].rx                         = false;
iGPIO1["14"].$used                      = false;
iGPIO1["15"].rx                         = false;
iGPIO1["15"].$used                      = false;
iGPIO1["16"].rx                         = false;
iGPIO1["16"].$used                      = false;
iGPIO1["17"].pu_pd                      = "pu";
iGPIO1["17"].$assign                    = "ball.Y26";
iGPIO1["18"].$assign                    = "ball.AB27";
iGPIO1["19"].$assign                    = "ball.V27";
iGPIO1["20"].rx                         = false;
iGPIO1["20"].$assign                    = "ball.W27";
iGPIO1["21"].rx                         = false;
iGPIO1["21"].$used                      = false;
iGPIO1["22"].$assign                    = "ball.AA27";
iGPIO1["23"].pu_pd                      = "pu";
iGPIO1["23"].$assign                    = "ball.AA26";
iGPIO1["24"].rx                         = false;
iGPIO1["24"].$used                      = false;
iGPIO1["25"].rx                         = false;
iGPIO1["25"].$used                      = false;
iGPIO1["26"].rx                         = false;
iGPIO1["26"].$used                      = false;
iGPIO1["27"].rx                         = false;
iGPIO1["27"].$assign                    = "ball.V26";
iGPIO1["28"].rx                         = false;
iGPIO1["28"].$used                      = false;
iGPIO1["29"].rx                         = false;
iGPIO1["29"].$used                      = false;
iGPIO1["30"].rx                         = false;
iGPIO1["30"].$used                      = false;
iGPIO1["31"].$assign                    = "ball.T27";
iGPIO1["32"].rx                         = false;
iGPIO1["32"].$used                      = false;
iGPIO1["33"].rx                         = false;
iGPIO1["33"].$used                      = false;
iGPIO1["34"].rx                         = false;
iGPIO1["34"].$assign                    = "ball.AD27";
iGPIO1["35"].rx                         = false;
iGPIO1["35"].$used                      = false;
iGPIO1["36"].rx                         = false;
iGPIO1["36"].$used                      = false;
iGPIO1["37"].rx                         = false;
iGPIO1["37"].$used                      = false;
iGPIO1["38"].rx                         = false;
iGPIO1["38"].$used                      = false;
iGPIO1["39"].rx                         = false;
iGPIO1["39"].$used                      = false;
iGPIO1["40"].rx                         = false;
iGPIO1["40"].$used                      = false;
iGPIO1["41"].rx                         = false;
iGPIO1["41"].$used                      = false;
iGPIO1["42"].rx                         = false;
iGPIO1["42"].$used                      = false;
iGPIO1["43"].rx                         = false;
iGPIO1["43"].$used                      = false;
iGPIO1["44"].rx                         = false;
iGPIO1["44"].$used                      = false;
iGPIO1["45"].rx                         = false;
iGPIO1["45"].$used                      = false;
iGPIO1["46"].rx                         = false;
iGPIO1["46"].$used                      = false;
iGPIO1["47"].rx                         = false;
iGPIO1["47"].$used                      = false;
iGPIO1["48"].rx                         = false;
iGPIO1["48"].$used                      = false;
iGPIO1["49"].rx                         = false;
iGPIO1["49"].$used                      = false;
iGPIO1["50"].rx                         = false;
iGPIO1["50"].$used                      = false;
iGPIO1["51"].rx                         = false;
iGPIO1["51"].$used                      = false;
iGPIO1["52"].rx                         = false;
iGPIO1["52"].$used                      = false;
iGPIO1["53"].rx                         = false;
iGPIO1["53"].$used                      = false;
iGPIO1["54"].rx                         = false;
iGPIO1["54"].$used                      = false;
iGPIO1["55"].rx                         = false;
iGPIO1["55"].$used                      = false;
iGPIO1["56"].rx                         = false;
iGPIO1["56"].$used                      = false;
iGPIO1["57"].rx                         = false;
iGPIO1["57"].$used                      = false;
iGPIO1["58"].rx                         = false;
iGPIO1["58"].$assign                    = "ball.AE25";
iGPIO1["59"].rx                         = false;
iGPIO1["59"].$used                      = false;
iGPIO1["60"].rx                         = false;
iGPIO1["60"].$used                      = false;
iGPIO1["61"].rx                         = false;
iGPIO1["61"].$used                      = false;
iGPIO1["62"].rx                         = false;
iGPIO1["62"].$used                      = false;
iGPIO1["63"].rx                         = false;
iGPIO1["63"].$used                      = false;
iGPIO1["64"].rx                         = false;
iGPIO1["64"].$used                      = false;
iGPIO1["65"].rx                         = false;
iGPIO1["65"].$used                      = false;
iGPIO1.$name                            = "GPIO0";
iGPIO1.$assign                          = "GPIO_0";
const iI2C1                             = scripting.addPeripheral("I2C");
iI2C1.$name                             = "I2C0";
iI2C1.$assign                           = "I2C_0";
iI2C1.SCL.rx                            = false;
iI2C1.SCL.$assign                       = "ball.AH25";
iI2C1.SDA.$assign                       = "ball.AE24";
const iI2C2                             = scripting.addPeripheral("I2C");
iI2C2.$name                             = "I2C1";
iI2C2.$assign                           = "I2C_1";
iI2C2.SCL.rx                            = false;
iI2C2.SCL.$assign                       = "ball.AB26";
iI2C2.SDA.$assign                       = "ball.AD28";
const iI2C3                             = scripting.addPeripheral("I2C");
iI2C3.$name                             = "I2C4";
iI2C3.$assign                           = "I2C_4";
iI2C3.SCL.rx                            = false;
iI2C3.SCL.$assign                       = "ball.AA28";
iI2C3.SDA.$assign                       = "ball.U26";
const iI2C4                             = scripting.addPeripheral("I2C");
iI2C4.$name                             = "I2C5";
iI2C4.$assign                           = "I2C_5";
iI2C4.SCL.rx                            = false;
iI2C4.SCL.$assign                       = "ball.R28";
iI2C4.SDA.$assign                       = "ball.Y25";
const iMCAN1                            = scripting.addPeripheral("MCAN");
iMCAN1.$name                            = "MCAN15";
iMCAN1.$assign                          = "MCAN_15";
iMCAN1.RX.$assign                       = "ball.AA23";
iMCAN1.TX.rx                            = false;
iMCAN1.TX.$assign                       = "ball.Y24";
const iMCAN2                            = scripting.addPeripheral("MCAN");
iMCAN2.$name                            = "MCAN16";
iMCAN2.$assign                          = "MCAN_16";
iMCAN2.RX.pu_pd                         = "pd";
iMCAN2.RX.$assign                       = "ball.AB24";
iMCAN2.TX.rx                            = false;
iMCAN2.TX.$assign                       = "ball.Y28";
const iMCU_ADC1                         = scripting.addPeripheral("MCU_ADC");
iMCU_ADC1.$name                         = "MCU_ADC0";
iMCU_ADC1.$assign                       = "MCU_ADC_0";
iMCU_ADC1.AIN0.$assign                  = "ball.L25";
iMCU_ADC1.AIN1.$assign                  = "ball.K25";
iMCU_ADC1.AIN2.$assign                  = "ball.M24";
iMCU_ADC1.AIN3.$assign                  = "ball.L24";
iMCU_ADC1.AIN4.$assign                  = "ball.L27";
iMCU_ADC1.AIN5.$assign                  = "ball.K24";
iMCU_ADC1.AIN6.$assign                  = "ball.M27";
iMCU_ADC1.AIN7.$assign                  = "ball.M26";
const iMCU_ADC2                         = scripting.addPeripheral("MCU_ADC");
iMCU_ADC2.$name                         = "MCU_ADC1";
iMCU_ADC2.$assign                       = "MCU_ADC_1";
iMCU_ADC2.AIN0.$assign                  = "ball.P25";
iMCU_ADC2.AIN1.$assign                  = "ball.R25";
iMCU_ADC2.AIN2.$assign                  = "ball.P28";
iMCU_ADC2.AIN3.$assign                  = "ball.P27";
iMCU_ADC2.AIN4.$assign                  = "ball.N25";
iMCU_ADC2.AIN5.$assign                  = "ball.P26";
iMCU_ADC2.AIN6.$assign                  = "ball.N26";
iMCU_ADC2.AIN7.$assign                  = "ball.N27";
const iMCU_CPSW2G1                      = scripting.addPeripheral("MCU_CPSW2G");
iMCU_CPSW2G1.$name                      = "MCU_CPSW2G0";
iMCU_CPSW2G1.$assign                    = "MCU_CPSW2G_0";
iMCU_CPSW2G1.CRS_DV.rx                  = false;
iMCU_CPSW2G1.CRS_DV.$used               = false;
iMCU_CPSW2G1.RD0.$assign                = "ball.B22";
iMCU_CPSW2G1.RD1.$assign                = "ball.B21";
iMCU_CPSW2G1.RD2.$assign                = "ball.C22";
iMCU_CPSW2G1.RD3.$assign                = "ball.D23";
iMCU_CPSW2G1.REF_CLK.rx                 = false;
iMCU_CPSW2G1.REF_CLK.$used              = false;
iMCU_CPSW2G1.RXC.$assign                = "ball.D22";
iMCU_CPSW2G1.RXD0.rx                    = false;
iMCU_CPSW2G1.RXD0.$used                 = false;
iMCU_CPSW2G1.RXD1.rx                    = false;
iMCU_CPSW2G1.RXD1.$used                 = false;
iMCU_CPSW2G1.RX_CTL.$assign             = "ball.E23";
iMCU_CPSW2G1.RX_ER.rx                   = false;
iMCU_CPSW2G1.RX_ER.$used                = false;
iMCU_CPSW2G1.TD0.rx                     = false;
iMCU_CPSW2G1.TD0.$assign                = "ball.F23";
iMCU_CPSW2G1.TD1.rx                     = false;
iMCU_CPSW2G1.TD1.$assign                = "ball.G22";
iMCU_CPSW2G1.TD2.rx                     = false;
iMCU_CPSW2G1.TD2.$assign                = "ball.E21";
iMCU_CPSW2G1.TD3.rx                     = false;
iMCU_CPSW2G1.TD3.$assign                = "ball.E22";
iMCU_CPSW2G1.TXC.rx                     = false;
iMCU_CPSW2G1.TXC.$assign                = "ball.F21";
iMCU_CPSW2G1.TXD0.rx                    = false;
iMCU_CPSW2G1.TXD0.$used                 = false;
iMCU_CPSW2G1.TXD1.rx                    = false;
iMCU_CPSW2G1.TXD1.$used                 = false;
iMCU_CPSW2G1.TX_CTL.rx                  = false;
iMCU_CPSW2G1.TX_CTL.$assign             = "ball.F22";
iMCU_CPSW2G1.TX_EN.rx                   = false;
iMCU_CPSW2G1.TX_EN.$used                = false;
const iMCU_I2C1                         = scripting.addPeripheral("MCU_I2C");
iMCU_I2C1.$name                         = "MCU_I2C1";
iMCU_I2C1.$assign                       = "MCU_I2C_1";
iMCU_I2C1.SCL.rx                        = false;
iMCU_I2C1.SCL.$assign                   = "ball.F24";
iMCU_I2C1.SDA.$assign                   = "ball.H26";
const iMCU_MCAN1                        = scripting.addPeripheral("MCU_MCAN");
iMCU_MCAN1.$name                        = "MCU_MCAN0";
iMCU_MCAN1.$assign                      = "MCU_MCAN_0";
iMCU_MCAN1.RX.$assign                   = "ball.E28";
iMCU_MCAN1.TX.rx                        = false;
iMCU_MCAN1.TX.$assign                   = "ball.E27";
const iMCU_MDIO1                        = scripting.addPeripheral("MCU_MDIO");
iMCU_MDIO1.$name                        = "MCU_MDIO0";
iMCU_MDIO1.$assign                      = "MCU_MDIO_0";
iMCU_MDIO1.MDC.rx                       = false;
iMCU_MDIO1.MDC.$assign                  = "ball.A21";
iMCU_MDIO1.MDIO.$assign                 = "ball.A22";
const iMCU_OSPI1                        = scripting.addPeripheral("MCU_OSPI");
iMCU_OSPI1.$name                        = "MCU_OSPI0";
iMCU_OSPI1.$assign                      = "MCU_OSPI_0";
iMCU_OSPI1.CLK.rx                       = false;
iMCU_OSPI1.CLK.$assign                  = "ball.D19";
iMCU_OSPI1.CSn0.rx                      = false;
iMCU_OSPI1.CSn0.$assign                 = "ball.F15";
iMCU_OSPI1.CSn1.rx                      = false;
iMCU_OSPI1.CSn1.$used                   = false;
iMCU_OSPI1.CSn2.rx                      = false;
iMCU_OSPI1.CSn2.$used                   = false;
iMCU_OSPI1.CSn3.rx                      = false;
iMCU_OSPI1.CSn3.$used                   = false;
iMCU_OSPI1.D0.$assign                   = "ball.C19";
iMCU_OSPI1.D1.$assign                   = "ball.F16";
iMCU_OSPI1.D2.$assign                   = "ball.G15";
iMCU_OSPI1.D3.$assign                   = "ball.F18";
iMCU_OSPI1.D4.rx                        = false;
iMCU_OSPI1.D4.$used                     = false;
iMCU_OSPI1.D5.rx                        = false;
iMCU_OSPI1.D5.$used                     = false;
iMCU_OSPI1.D6.rx                        = false;
iMCU_OSPI1.D6.$used                     = false;
iMCU_OSPI1.D7.rx                        = false;
iMCU_OSPI1.D7.$used                     = false;
iMCU_OSPI1.DQS.$assign                  = "ball.E18";
iMCU_OSPI1.ECC_FAIL.rx                  = false;
iMCU_OSPI1.ECC_FAIL.$used               = false;
iMCU_OSPI1.LBCLKO.rx                    = false;
iMCU_OSPI1.LBCLKO.$assign               = "ball.E20";
iMCU_OSPI1.RESET_OUT0.rx                = false;
iMCU_OSPI1.RESET_OUT0.$used             = false;
iMCU_OSPI1.RESET_OUT1.rx                = false;
iMCU_OSPI1.RESET_OUT1.$used             = false;
const iMCU_UART1                        = scripting.addPeripheral("MCU_UART");
iMCU_UART1.$name                        = "MCU_UART0";
iMCU_UART1.$assign                      = "MCU_USART_0";
iMCU_UART1.CTSn.rx                      = false;
iMCU_UART1.CTSn.$used                   = false;
iMCU_UART1.RTSn.rx                      = false;
iMCU_UART1.RTSn.$used                   = false;
iMCU_UART1.RXD.$assign                  = "ball.C24";
iMCU_UART1.TXD.rx                       = false;
iMCU_UART1.TXD.$assign                  = "ball.C25";
const iMMCSD1                           = scripting.addPeripheral("MMCSD");
iMMCSD1.$name                           = "MMCSD0";
iMMCSD1.$assign                         = "MMC_0";
iMMCSD1.CALPAD.$assign                  = "ball.AF1";
iMMCSD1.CLK.rx                          = false;
iMMCSD1.CLK.$assign                     = "ball.AC6";
iMMCSD1.CMD.$assign                     = "ball.AF2";
iMMCSD1.DAT0.$assign                    = "ball.AF4";
iMMCSD1.DAT1.$assign                    = "ball.AD3";
iMMCSD1.DAT2.$assign                    = "ball.AD4";
iMMCSD1.DAT3.$assign                    = "ball.AF3";
iMMCSD1.DAT4.$assign                    = "ball.AE2";
iMMCSD1.DAT5.$assign                    = "ball.AG3";
iMMCSD1.DAT6.$assign                    = "ball.AE1";
iMMCSD1.DAT7.$assign                    = "ball.AG1";
iMMCSD1.DS.$assign                      = "ball.AE3";
iMMCSD1.SDCD.rx                         = false;
iMMCSD1.SDCD.$used                      = false;
iMMCSD1.SDWP.rx                         = false;
iMMCSD1.SDWP.$used                      = false;
const iMMCSD2                           = scripting.addPeripheral("MMCSD");
iMMCSD2.$name                           = "MMCSD1";
iMMCSD2.$assign                         = "MMC_1";
iMMCSD2.CALPAD.rx                       = false;
iMMCSD2.CALPAD.$used                    = false;
iMMCSD2.CLK.rx                          = false;
iMMCSD2.CLK.$assign                     = "ball.P23";
iMMCSD2.CMD.$assign                     = "ball.N24";
iMMCSD2.DAT0.$assign                    = "ball.M23";
iMMCSD2.DAT1.$assign                    = "ball.P24";
iMMCSD2.DAT2.$assign                    = "ball.R24";
iMMCSD2.DAT3.$assign                    = "ball.R22";
iMMCSD2.DAT4.rx                         = false;
iMMCSD2.DAT4.$used                      = false;
iMMCSD2.DAT5.rx                         = false;
iMMCSD2.DAT5.$used                      = false;
iMMCSD2.DAT6.rx                         = false;
iMMCSD2.DAT6.$used                      = false;
iMMCSD2.DAT7.rx                         = false;
iMMCSD2.DAT7.$used                      = false;
iMMCSD2.DS.rx                           = false;
iMMCSD2.DS.$used                        = false;
iMMCSD2.SDCD.rx                         = false;
iMMCSD2.SDCD.$used                      = false;
iMMCSD2.SDWP.rx                         = false;
iMMCSD2.SDWP.$used                      = false;
const iOSC1                             = scripting.addPeripheral("OSC");
iOSC1.$name                             = "OSC1";
iOSC1.$assign                           = "OSC_1";
iOSC1.XI.$assign                        = "ball.M28";
iOSC1.XO.$assign                        = "ball.L28";
const iPCIE1                            = scripting.addPeripheral("PCIE");
iPCIE1.$name                            = "PCIE1";
iPCIE1.$assign                          = "PCIE_1";
iPCIE1.REFCLKN.$assign                  = "ball.AH10";
iPCIE1.REFCLKP.$assign                  = "ball.AH11";
iPCIE1.CLKREQn.rx                       = false;
iPCIE1.CLKREQn.$used                    = false;
iPCIE1.RXN0.$assign                     = "ball.AF9";
iPCIE1.RXN1.$assign                     = "ball.AE8";
iPCIE1.RXN2.$assign                     = "ball.AF6";
iPCIE1.RXN3.$assign                     = "ball.AE5";
iPCIE1.RXP0.$assign                     = "ball.AF10";
iPCIE1.RXP1.$assign                     = "ball.AE9";
iPCIE1.RXP2.$assign                     = "ball.AF7";
iPCIE1.RXP3.$assign                     = "ball.AE6";
iPCIE1.TXN0.$used                       = false;
iPCIE1.TXN1.$used                       = false;
iPCIE1.TXN2.$used                       = false;
iPCIE1.TXN3.$used                       = false;
iPCIE1.TXP0.$used                       = false;
iPCIE1.TXP1.$used                       = false;
iPCIE1.TXP2.$used                       = false;
iPCIE1.TXP3.$used                       = false;
const iSERDES1                          = scripting.addPeripheral("SERDES");
iSERDES1.$name                          = "SERDES0";
iSERDES1.$assign                        = "SERDES_0";
iSERDES1.REFCLK_N.$assign               = "ball.AH4";
iSERDES1.REFCLK_P.$assign               = "ball.AH5";
iSERDES1.REXT.$assign                   = "ball.AC10";
const iSPI1                             = scripting.addPeripheral("SPI");
iSPI1.$name                             = "SPI0";
iSPI1.$assign                           = "SPI_0";
iSPI1.CLK.rx                            = false;
iSPI1.CLK.$assign                       = "ball.AH27";
iSPI1.CS0.rx                            = false;
iSPI1.CS0.$assign                       = "ball.AE27";
iSPI1.CS1.rx                            = false;
iSPI1.CS1.$assign                       = "ball.AF26";
iSPI1.CS2.rx                            = false;
iSPI1.CS2.$used                         = false;
iSPI1.CS3.rx                            = false;
iSPI1.CS3.$used                         = false;
iSPI1.D0.rx                             = false;
iSPI1.D0.$assign                        = "ball.AG26";
iSPI1.D1.$assign                        = "ball.AH26";
const iSYSTEM1                          = scripting.addPeripheral("SYSTEM");
iSYSTEM1.$name                          = "SYSTEM";
iSYSTEM1.$assign                        = "SYSTEM_0";
iSYSTEM1.MCU_ADC_EXT_TRIGGER0.rx        = false;
iSYSTEM1.MCU_ADC_EXT_TRIGGER0.$used     = false;
iSYSTEM1.MCU_ADC_EXT_TRIGGER1.rx        = false;
iSYSTEM1.MCU_ADC_EXT_TRIGGER1.$used     = false;
iSYSTEM1.AUDIO_EXT_REFCLK0.rx           = false;
iSYSTEM1.AUDIO_EXT_REFCLK0.$used        = false;
iSYSTEM1.AUDIO_EXT_REFCLK1.rx           = false;
iSYSTEM1.AUDIO_EXT_REFCLK1.$used        = false;
iSYSTEM1.EXTINTn.rx                     = false;
iSYSTEM1.EXTINTn.$used                  = false;
iSYSTEM1.EXT_REFCLK1.rx                 = false;
iSYSTEM1.EXT_REFCLK1.$used              = false;
iSYSTEM1.FCLK_MUX.rx                    = false;
iSYSTEM1.FCLK_MUX.$used                 = false;
iSYSTEM1.OBSCLK0.rx                     = false;
iSYSTEM1.OBSCLK0.$used                  = false;
iSYSTEM1.OBSCLK1.rx                     = false;
iSYSTEM1.OBSCLK1.$used                  = false;
iSYSTEM1.RESETSTATz.rx                  = false;
iSYSTEM1.RESETSTATz.$assign             = "ball.AF27";
iSYSTEM1.SOC_SAFETY_ERRORn.$assign      = "ball.AF25";
iSYSTEM1.SYSCLKOUT0.rx                  = false;
iSYSTEM1.SYSCLKOUT0.$used               = false;
const iUART1                            = scripting.addPeripheral("UART");
iUART1.$name                            = "UART2";
iUART1.$assign                          = "USART_2";
iUART1.CTSn.rx                          = false;
iUART1.CTSn.$used                       = false;
iUART1.DCDn.rx                          = false;
iUART1.DCDn.$used                       = false;
iUART1.DSRn.rx                          = false;
iUART1.DSRn.$used                       = false;
iUART1.DTRn.rx                          = false;
iUART1.DTRn.$used                       = false;
iUART1.RIn.rx                           = false;
iUART1.RIn.$used                        = false;
iUART1.RTSn.rx                          = false;
iUART1.RTSn.$used                       = false;
iUART1.RXD.pu_pd                        = "pd";
iUART1.RXD.$assign                      = "ball.W28";
iUART1.TXD.rx                           = false;
iUART1.TXD.$assign                      = "ball.U28";
const iUART2                            = scripting.addPeripheral("UART");
iUART2.$name                            = "UART8";
iUART2.$assign                          = "USART_8";
iUART2.CTSn.rx                          = false;
iUART2.CTSn.$used                       = false;
iUART2.DCDn.rx                          = false;
iUART2.DCDn.$used                       = false;
iUART2.DSRn.rx                          = false;
iUART2.DSRn.$used                       = false;
iUART2.DTRn.rx                          = false;
iUART2.DTRn.$used                       = false;
iUART2.RIn.rx                           = false;
iUART2.RIn.$used                        = false;
iUART2.RTSn.rx                          = false;
iUART2.RTSn.$used                       = false;
iUART2.RXD.pu_pd                        = "pd";
iUART2.RXD.$assign                      = "ball.AB28";
iUART2.TXD.rx                           = false;
iUART2.TXD.$assign                      = "ball.U27";
const iUSB1                             = scripting.addPeripheral("USB");
iUSB1.$name                             = "USB0";
iUSB1.$assign                           = "USB_0";
iUSB1.DM.$assign                        = "ball.AG2";
iUSB1.DP.$assign                        = "ball.AH2";
iUSB1.DRVVBUS.rx                        = false;
iUSB1.DRVVBUS.$used                     = false;
iUSB1.ID.$assign                        = "ball.AC9";
iUSB1.RCALIB.$assign                    = "ball.AA6";
iUSB1.SSRX1N.$used                      = false;
iUSB1.SSRX1P.$used                      = false;
iUSB1.SSRX2N.$used                      = false;
iUSB1.SSRX2P.$used                      = false;
iUSB1.SSTX1N.$used                      = false;
iUSB1.SSTX1P.$used                      = false;
iUSB1.SSTX2N.$used                      = false;
iUSB1.SSTX2P.$used                      = false;
iUSB1.VBUS.$assign                      = "ball.AA8";
const iWKUP_DEBUGSS1                    = scripting.addPeripheral("WKUP_DEBUGSS");
iWKUP_DEBUGSS1.$name                    = "WKUP_DEBUGSS";
iWKUP_DEBUGSS1.$assign                  = "WKUP_DEBUG_0";
iWKUP_DEBUGSS1.EMU0.pu_pd               = "pu";
iWKUP_DEBUGSS1.EMU0.$assign             = "ball.A27";
iWKUP_DEBUGSS1.EMU1.pu_pd               = "pu";
iWKUP_DEBUGSS1.EMU1.$assign             = "ball.C26";
iWKUP_DEBUGSS1.TCK.pu_pd                = "pu";
iWKUP_DEBUGSS1.TCK.$assign              = "ball.A25";
iWKUP_DEBUGSS1.TRSTn.pu_pd              = "pd";
iWKUP_DEBUGSS1.TRSTn.$assign            = "ball.B28";
const iWKUP_GPIO1                       = scripting.addPeripheral("WKUP_GPIO");
iWKUP_GPIO1["0"].rx                     = false;
iWKUP_GPIO1["0"].$assign                = "ball.D26";
iWKUP_GPIO1["1"].rx                     = false;
iWKUP_GPIO1["1"].$assign                = "ball.E24";
iWKUP_GPIO1["2"].rx                     = false;
iWKUP_GPIO1["2"].$assign                = "ball.C28";
iWKUP_GPIO1["3"].pu_pd                  = "pu";
iWKUP_GPIO1["3"].$assign                = "ball.C27";
iWKUP_GPIO1["4"].rx                     = false;
iWKUP_GPIO1["4"].$assign                = "ball.C23";
iWKUP_GPIO1["5"].rx                     = false;
iWKUP_GPIO1["5"].$assign                = "ball.F26";
iWKUP_GPIO1["6"].pu_pd                  = "pd";
iWKUP_GPIO1["6"].$assign                = "ball.E25";
iWKUP_GPIO1["7"].$assign                = "ball.F28";
iWKUP_GPIO1["8"].rx                     = false;
iWKUP_GPIO1["8"].$used                  = false;
iWKUP_GPIO1["9"].rx                     = false;
iWKUP_GPIO1["9"].$used                  = false;
iWKUP_GPIO1["10"].rx                    = false;
iWKUP_GPIO1["10"].$assign               = "ball.F27";
iWKUP_GPIO1["11"].pu_pd                 = "pu";
iWKUP_GPIO1["11"].$assign               = "ball.F25";
iWKUP_GPIO1["12"].rx                    = false;
iWKUP_GPIO1["12"].$used                 = false;
iWKUP_GPIO1["13"].rx                    = false;
iWKUP_GPIO1["13"].$used                 = false;
iWKUP_GPIO1["14"].rx                    = false;
iWKUP_GPIO1["14"].$assign               = "ball.B24";
iWKUP_GPIO1["15"].rx                    = false;
iWKUP_GPIO1["15"].$assign               = "ball.D25";
iWKUP_GPIO1["16"].rx                    = false;
iWKUP_GPIO1["16"].$used                 = false;
iWKUP_GPIO1["17"].rx                    = false;
iWKUP_GPIO1["17"].$used                 = false;
iWKUP_GPIO1["18"].rx                    = false;
iWKUP_GPIO1["18"].$used                 = false;
iWKUP_GPIO1["19"].rx                    = false;
iWKUP_GPIO1["19"].$used                 = false;
iWKUP_GPIO1["20"].rx                    = false;
iWKUP_GPIO1["20"].$used                 = false;
iWKUP_GPIO1["21"].rx                    = false;
iWKUP_GPIO1["21"].$used                 = false;
iWKUP_GPIO1["22"].rx                    = false;
iWKUP_GPIO1["22"].$used                 = false;
iWKUP_GPIO1["23"].$assign               = "ball.E19";
iWKUP_GPIO1["24"].$assign               = "ball.G19";
iWKUP_GPIO1["25"].pu_pd                 = "pd";
iWKUP_GPIO1["25"].$assign               = "ball.F19";
iWKUP_GPIO1["26"].pu_pd                 = "pd";
iWKUP_GPIO1["26"].$assign               = "ball.F20";
iWKUP_GPIO1["27"].rx                    = false;
iWKUP_GPIO1["27"].$used                 = false;
iWKUP_GPIO1["28"].rx                    = false;
iWKUP_GPIO1["28"].$assign               = "ball.G17";
iWKUP_GPIO1["29"].rx                    = false;
iWKUP_GPIO1["29"].$assign               = "ball.F14";
iWKUP_GPIO1["30"].rx                    = false;
iWKUP_GPIO1["30"].$assign               = "ball.F17";
iWKUP_GPIO1["31"].rx                    = false;
iWKUP_GPIO1["31"].$assign               = "ball.A19";
iWKUP_GPIO1["32"].rx                    = false;
iWKUP_GPIO1["32"].$assign               = "ball.B20";
iWKUP_GPIO1["33"].rx                    = false;
iWKUP_GPIO1["33"].$assign               = "ball.B19";
iWKUP_GPIO1["34"].$assign               = "ball.D21";
iWKUP_GPIO1["35"].$assign               = "ball.G20";
iWKUP_GPIO1["36"].$assign               = "ball.C20";
iWKUP_GPIO1["37"].$assign               = "ball.A20";
iWKUP_GPIO1["38"].rx                    = false;
iWKUP_GPIO1["38"].$assign               = "ball.D20";
iWKUP_GPIO1["39"].rx                    = false;
iWKUP_GPIO1["39"].$assign               = "ball.C21";
iWKUP_GPIO1["40"].rx                    = false;
iWKUP_GPIO1["40"].$used                 = false;
iWKUP_GPIO1["41"].rx                    = false;
iWKUP_GPIO1["41"].$used                 = false;
iWKUP_GPIO1["42"].rx                    = false;
iWKUP_GPIO1["42"].$used                 = false;
iWKUP_GPIO1["43"].rx                    = false;
iWKUP_GPIO1["43"].$used                 = false;
iWKUP_GPIO1["44"].rx                    = false;
iWKUP_GPIO1["44"].$used                 = false;
iWKUP_GPIO1["45"].rx                    = false;
iWKUP_GPIO1["45"].$used                 = false;
iWKUP_GPIO1["46"].rx                    = false;
iWKUP_GPIO1["46"].$used                 = false;
iWKUP_GPIO1["47"].rx                    = false;
iWKUP_GPIO1["47"].$used                 = false;
iWKUP_GPIO1["48"].rx                    = false;
iWKUP_GPIO1["48"].$used                 = false;
iWKUP_GPIO1["49"].rx                    = false;
iWKUP_GPIO1["49"].$assign               = "ball.K26";
iWKUP_GPIO1["50"].rx                    = false;
iWKUP_GPIO1["50"].$used                 = false;
iWKUP_GPIO1["51"].rx                    = false;
iWKUP_GPIO1["51"].$used                 = false;
iWKUP_GPIO1["52"].rx                    = false;
iWKUP_GPIO1["52"].$used                 = false;
iWKUP_GPIO1["53"].rx                    = false;
iWKUP_GPIO1["53"].$used                 = false;
iWKUP_GPIO1["54"].rx                    = false;
iWKUP_GPIO1["54"].$assign               = "ball.B27";
iWKUP_GPIO1["55"].rx                    = false;
iWKUP_GPIO1["55"].$assign               = "ball.D24";
iWKUP_GPIO1["56"].pu_pd                 = "pu";
iWKUP_GPIO1["56"].rx                    = false;
iWKUP_GPIO1["56"].$assign               = "ball.G27";
iWKUP_GPIO1["57"].rx                    = false;
iWKUP_GPIO1["57"].$assign               = "ball.J26";
iWKUP_GPIO1["58"].rx                    = false;
iWKUP_GPIO1["58"].$used                 = false;
iWKUP_GPIO1["59"].rx                    = false;
iWKUP_GPIO1["59"].$used                 = false;
iWKUP_GPIO1["60"].rx                    = false;
iWKUP_GPIO1["60"].$used                 = false;
iWKUP_GPIO1["61"].rx                    = false;
iWKUP_GPIO1["61"].$used                 = false;
iWKUP_GPIO1["62"].rx                    = false;
iWKUP_GPIO1["62"].$used                 = false;
iWKUP_GPIO1["63"].rx                    = false;
iWKUP_GPIO1["63"].$used                 = false;
iWKUP_GPIO1["64"].rx                    = false;
iWKUP_GPIO1["64"].$used                 = false;
iWKUP_GPIO1["65"].rx                    = false;
iWKUP_GPIO1["65"].$used                 = false;
iWKUP_GPIO1["66"].rx                    = false;
iWKUP_GPIO1["66"].$assign               = "ball.G25";
iWKUP_GPIO1["67"].rx                    = false;
iWKUP_GPIO1["67"].$assign               = "ball.J27";
iWKUP_GPIO1["68"].rx                    = false;
iWKUP_GPIO1["68"].$used                 = false;
iWKUP_GPIO1["69"].rx                    = false;
iWKUP_GPIO1["69"].$assign               = "ball.B25";
iWKUP_GPIO1["70"].rx                    = false;
iWKUP_GPIO1["70"].$assign               = "ball.B26";
iWKUP_GPIO1["71"].rx                    = false;
iWKUP_GPIO1["71"].$used                 = false;
iWKUP_GPIO1["72"].rx                    = false;
iWKUP_GPIO1["72"].$used                 = false;
iWKUP_GPIO1["73"].rx                    = false;
iWKUP_GPIO1["73"].$used                 = false;
iWKUP_GPIO1["74"].rx                    = false;
iWKUP_GPIO1["74"].$used                 = false;
iWKUP_GPIO1["75"].rx                    = false;
iWKUP_GPIO1["75"].$used                 = false;
iWKUP_GPIO1["76"].rx                    = false;
iWKUP_GPIO1["76"].$used                 = false;
iWKUP_GPIO1["77"].rx                    = false;
iWKUP_GPIO1["77"].$used                 = false;
iWKUP_GPIO1["78"].rx                    = false;
iWKUP_GPIO1["78"].$used                 = false;
iWKUP_GPIO1["79"].rx                    = false;
iWKUP_GPIO1["79"].$used                 = false;
iWKUP_GPIO1["80"].rx                    = false;
iWKUP_GPIO1["80"].$used                 = false;
iWKUP_GPIO1["81"].rx                    = false;
iWKUP_GPIO1["81"].$used                 = false;
iWKUP_GPIO1["82"].rx                    = false;
iWKUP_GPIO1["82"].$used                 = false;
iWKUP_GPIO1["83"].rx                    = false;
iWKUP_GPIO1["83"].$used                 = false;
iWKUP_GPIO1["84"].rx                    = false;
iWKUP_GPIO1["84"].$used                 = false;
iWKUP_GPIO1["85"].rx                    = false;
iWKUP_GPIO1["85"].$used                 = false;
iWKUP_GPIO1["86"].rx                    = false;
iWKUP_GPIO1["86"].$used                 = false;
iWKUP_GPIO1["87"].rx                    = false;
iWKUP_GPIO1["87"].$assign               = "ball.J25";
iWKUP_GPIO1["88"].rx                    = false;
iWKUP_GPIO1["88"].$used                 = false;
iWKUP_GPIO1.$name                       = "WKUP_GPIO0";
iWKUP_GPIO1.$assign                     = "WKUP_GPIO_0";
const iWKUP_I2C1                        = scripting.addPeripheral("WKUP_I2C");
iWKUP_I2C1.$name                        = "WKUP_I2C0";
iWKUP_I2C1.$assign                      = "WKUP_I2C_0";
iWKUP_I2C1.SCL.rx                       = false;
iWKUP_I2C1.SCL.$assign                  = "ball.H24";
iWKUP_I2C1.SDA.$assign                  = "ball.H27";
const iWKUP_OSC1                        = scripting.addPeripheral("WKUP_OSC");
iWKUP_OSC1.$name                        = "WKUP_OSC0";
iWKUP_OSC1.$assign                      = "WKUP_OSC_0";
iWKUP_OSC1.XI.$assign                   = "ball.H28";
iWKUP_OSC1.XO.$assign                   = "ball.J28";
const iWKUP_SYSTEM1                     = scripting.addPeripheral("WKUP_SYSTEM");
iWKUP_SYSTEM1.$name                     = "WKUP_SYSTEM0";
iWKUP_SYSTEM1.$assign                   = "WKUP_SYSTEM_0";
iWKUP_SYSTEM1.LF_CLKIN.rx               = false;
iWKUP_SYSTEM1.LF_CLKIN.$used            = false;
iWKUP_SYSTEM1.MCU_CLKOUT0.rx            = false;
iWKUP_SYSTEM1.MCU_CLKOUT0.$used         = false;
iWKUP_SYSTEM1.MCU_EXT_REFCLK0.rx        = false;
iWKUP_SYSTEM1.MCU_EXT_REFCLK0.$used     = false;
iWKUP_SYSTEM1.MCU_OBSCLK0.rx            = false;
iWKUP_SYSTEM1.MCU_OBSCLK0.$used         = false;
iWKUP_SYSTEM1.MCU_PORz.$assign          = "ball.G23";
iWKUP_SYSTEM1.MCU_RESETSTATz.rx         = false;
iWKUP_SYSTEM1.MCU_RESETSTATz.$assign    = "ball.A23";
iWKUP_SYSTEM1.MCU_RESETz.$assign        = "ball.A26";
iWKUP_SYSTEM1.MCU_SAFETY_ERRORn.$assign = "ball.J23";
iWKUP_SYSTEM1.MCU_SYSCLKOUT0.rx         = false;
iWKUP_SYSTEM1.MCU_SYSCLKOUT0.$used      = false;
iWKUP_SYSTEM1.PMIC_POWER_EN1.rx         = false;
iWKUP_SYSTEM1.PMIC_POWER_EN1.$assign    = "ball.G26";
iWKUP_SYSTEM1.PORz.pu_pd                = "pu";
iWKUP_SYSTEM1.PORz.$assign              = "ball.K23";
iWKUP_SYSTEM1.RESET_REQz.pu_pd          = "pu";
iWKUP_SYSTEM1.RESET_REQz.$assign        = "ball.A24";
iWKUP_SYSTEM1.PMIC_WAKE0n.rx            = false;
iWKUP_SYSTEM1.PMIC_WAKE0n.$used         = false;
iWKUP_SYSTEM1.PMIC_WAKE1n.rx            = false;
iWKUP_SYSTEM1.PMIC_WAKE1n.$used         = false;
const iWKUP_UART1                       = scripting.addPeripheral("WKUP_UART");
iWKUP_UART1.$name                       = "WKUP_UART0";
iWKUP_UART1.$assign                     = "WKUP_USART_0";
iWKUP_UART1.CTSn.rx                     = false;
iWKUP_UART1.CTSn.$used                  = false;
iWKUP_UART1.RTSn.rx                     = false;
iWKUP_UART1.RTSn.$used                  = false;
iWKUP_UART1.RXD.pu_pd                   = "pd";
iWKUP_UART1.RXD.$assign                 = "ball.D28";
iWKUP_UART1.TXD.rx                      = false;
iWKUP_UART1.TXD.$assign                 = "ball.D27";
