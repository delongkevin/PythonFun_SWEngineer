AUTOSAR XML (schema 4-0-3)
package /MICROSAR/Crypto_30_Hwa
  module config Crypto_Pre: definition=Crypto  # Generated pre-configuration for Crypto
    CryptoKeys
    CryptoKeyElements
    CryptoKeyTypes
    CryptoDriverObjects
