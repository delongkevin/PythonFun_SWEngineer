AUTOSAR XML (schema 00050)
package /ActiveEcuC
  module config vSet: implementation-config-variant=VARIANT-PRE-COMPILE, module-description=vSet_Impl
    vSetGeneral: vSetDummyStatementKind=SelfAssignment
    vSetPlatform:
      vSetCPUType = CPU32Bit
      vSetSizeOfROMPointer = Size32Bit
      vSetSizeOfInt = Size32Bit
      vSetByteOrder = LITTLE_ENDIAN
      vSetSizeOfEnum = Size32Bit
      vSetBitOrder = LSB_to_MSB
      vSetSizeOfRAMPointer = Size32Bit
    vSetCalibration
    vSetBswInitialization
      25 x vSetInitFunction:
        vXSpi_InitMemory: vSetHeader=vXSpi.h, vSetModuleRef=vXSpi  # /ActiveEcuC/vXSpi PLAIN_TEXT Initialization of vXSpi
          vSetInitFunctionInstance: vSetInitPhase=INIT_MEMORY
        vXSpi_Init: vSetHeader=vXSpi.h, vSetConfigType=vXSpi_ConfigType, vSetConfigPtrClass=VXSPI_CONST, vSetModuleRef=vXSpi  # /ActiveEcuC/vXSpi PLAIN_TEXT Initialization of vXSpi
          vSetInitFunctionInstance: vSetInitPhase=INIT_TWO_DRV, vSetConfigPtrName=&vXSpi_HwConfig
        vMem_30_vXSpi_Nand_Init: vSetHeader=vMem_30_vXSpi_Nand.h, vSetConfigType=vMem_30_vXSpi_Nand_ConfigType, vSetConfigPtrClass=VMEM_30_VXSPI_NAND_INIT_DATA, vSetModuleRef=vMem_30_vXSpi_Nand  # /ActiveEcuC/vMem_30_vXSpi_Nand PLAIN_TEXT Init function description of vMem_30_vXSpi_Nand in UnfilteredViewInInvariantProject (UnfilteredInvariantProjectModelView) .
          vSetInitFunctionInstance: vSetInitPhase=NO_INIT, vSetConfigPtrName=vMem_30_vXSpi_Nand_Config_Ptr
        vBaseEnv_Init: vSetHeader=, vSetModuleRef=vBaseEnv  # /ActiveEcuC/vBaseEnv PLAIN_TEXT Created vBaseEnv_Init by Extended Init XML Service
          vSetInitFunctionInstance: vSetInitPhase=NO_INIT
        Det_InitMemory: vSetHeader=Det.h, vSetModuleRef=Det  # /ActiveEcuC/Det PLAIN_TEXT InitMemory function description of Det in UnfilteredViewInInvariantProject (UnfilteredInvariantProjectModelView) .
          vSetInitFunctionInstance: vSetInitPhase=INIT_MEMORY
        Det_Init: vSetHeader=Det.h, vSetConfigType=Det_ConfigType, vSetConfigPtrClass=DET_INIT_DATA, vSetModuleRef=Det  # /ActiveEcuC/Det PLAIN_TEXT Init function description of Det in UnfilteredViewInInvariantProject (UnfilteredInvariantProjectModelView) .
          vSetInitFunctionInstance: vSetInitPhase=INIT_ZERO, vSetConfigPtrName=Det_Config_Ptr
        Fee_Init: vSetHeader=Fee.h, vSetModuleRef=Fee  # /ActiveEcuC/Fee PLAIN_TEXT Initialization of the FEE
          vSetInitFunctionInstance: vSetInitPhase=INIT_TWO_IF
        Brs_Init: vSetHeader=, vSetModuleRef=vBRS  # /ActiveEcuC/vBRS PLAIN_TEXT Automatically generated by BswInitFctConfigurationService.
          vSetInitFunctionInstance: vSetInitPhase=NO_INIT
        vLinkGen_Init: vSetHeader=vLinkGen_Lcfg.h, vSetModuleRef=vLinkGen  # /ActiveEcuC/vLinkGen PLAIN_TEXT Dummy initialization of the vLinkGen
          vSetInitFunctionInstance: vSetInitPhase=NO_INIT
        vMemAccM_InitMemory: vSetHeader=vMemAccM.h, vSetModuleRef=vMemAccM  # /ActiveEcuC/vMemAccM PLAIN_TEXT Initializes all *_INIT_* section variables within the vMemAccM.
          vSetInitFunctionInstance: vSetInitPhase=INIT_MEMORY
        vMemAccM_Init: vSetHeader=vMemAccM.h, vSetModuleRef=vMemAccM  # /ActiveEcuC/vMemAccM PLAIN_TEXT Initializes the vMemAccM.
          vSetInitFunctionInstance: vSetInitPhase=INIT_TWO_DRV
        WrapNv_Init: vSetHeader=WrapNv.h, vSetModuleRef=WrapNv  # /ActiveEcuC/WrapNv PLAIN_TEXT WrapNv_Init function description
          vSetInitFunctionInstance: vSetInitPhase=INIT_TWO_SYS
        Ea_Init: vSetHeader=Ea.h, vSetModuleRef=Ea  # /ActiveEcuC/Ea PLAIN_TEXT Initialization of EEPROM Abstraction Module and its internal state machine
          vSetInitFunctionInstance: vSetInitPhase=INIT_TWO_IF
        Eep_30_XXi2c01_Init: vSetHeader=Eep_30_XXi2c01.h, vSetConfigType=Eep_30_XXi2c01_ConfigType, vSetConfigPtrClass=EEP_30_XXSPI01_PBCFG, vSetModuleRef=Eep  # /ActiveEcuC/Eep PLAIN_TEXT Initialization of EEPROM driver Eep_30_XXi2c01
          vSetInitFunctionInstance: vSetInitPhase=INIT_TWO_DRV, vSetConfigPtrName=&Eep_30_XXi2c01_Runtime
        Eep_30_XXi2c01_InitMemory: vSetHeader=Eep_30_XXi2c01.h, vSetModuleRef=Eep  # /ActiveEcuC/Eep PLAIN_TEXT Initialize memory for EEPROM driver Eep_30_XXi2c01
          vSetInitFunctionInstance: vSetInitPhase=INIT_MEMORY
        I2c_Init: vSetHeader=I2c.h, vSetConfigType=I2c_ConfigType, vSetConfigPtrClass=I2C_PBCFG, vSetModuleRef=I2c  # /ActiveEcuC/I2c PLAIN_TEXT Initialization of the I2c
          vSetInitFunctionInstance: vSetInitPhase=INIT_ONE, vSetConfigPtrName=&I2c_ConfigSet[0]
        vMem_30_XXRam_Init: vSetHeader=vMem_30_XXRam.h, vSetConfigType=vMem_30_XXRam_ConfigType, vSetConfigPtrClass=VMEM_30_XXRAM_INIT_DATA, vSetModuleRef=vMem_30_XXRam  # /ActiveEcuC/vMem_30_XXRam PLAIN_TEXT Init function description of vMem_30_XXRam in UnfilteredViewInInvariantProject (UnfilteredInvariantProjectModelView) .
          vSetInitFunctionInstance: vSetInitPhase=NO_INIT, vSetConfigPtrName=vMem_30_XXRam_Config_Ptr
        NvM_Init: vSetHeader=NvM.h, vSetModuleRef=NvM  # /ActiveEcuC/NvM PLAIN_TEXT Initialization of the NVRAM Manager, to make it ready for NvM_ReadAll being requested
          vSetInitFunctionInstance: vSetInitPhase=INIT_TWO_SYS
        Fls_30_vMemAccM_Init: vSetHeader=Fls_30_vMemAccM.h, vSetModuleRef=Fls  # /ActiveEcuC/Fls PLAIN_TEXT Initializes the Fls_30_vMemAccM.
          vSetInitFunctionInstance: vSetInitPhase=INIT_TWO_DRV
        Crypto_30_vHsm_InitMemory: vSetHeader=Crypto_30_vHsm.h, vSetModuleRef=Crypto_30_vHsm  # /ActiveEcuC/Crypto_30_vHsm PLAIN_TEXT Initializes variables of the Crypto Interface
          vSetInitFunctionInstance: vSetInitPhase=INIT_MEMORY
        Crypto_30_vHsm_Init: vSetHeader=Crypto_30_vHsm.h, vSetModuleRef=Crypto_30_vHsm  # /ActiveEcuC/Crypto_30_vHsm PLAIN_TEXT Initializes the Crypto Driver
          vSetInitFunctionInstance: vSetInitPhase=INIT_TWO_DRV
        CryIf_Init: vSetHeader=CryIf.h, vSetModuleRef=CryIf  # /ActiveEcuC/CryIf PLAIN_TEXT Initializes the Crypto Interface
          vSetInitFunctionInstance: vSetInitPhase=INIT_TWO_IF
        CryIf_InitMemory: vSetHeader=CryIf.h, vSetModuleRef=CryIf  # /ActiveEcuC/CryIf PLAIN_TEXT Initializes variables of the Crypto Interface
          vSetInitFunctionInstance: vSetInitPhase=INIT_MEMORY
        Csm_Init: vSetHeader=Csm.h, vSetModuleRef=Csm  # /ActiveEcuC/Csm PLAIN_TEXT Initializes the Crypto Service Manager
          vSetInitFunctionInstance: vSetInitPhase=INIT_TWO_SYS
        Csm_InitMemory: vSetHeader=Csm.h, vSetModuleRef=Csm  # /ActiveEcuC/Csm PLAIN_TEXT Initializes variables of the Crypto Service Manager
          vSetInitFunctionInstance: vSetInitPhase=INIT_MEMORY
