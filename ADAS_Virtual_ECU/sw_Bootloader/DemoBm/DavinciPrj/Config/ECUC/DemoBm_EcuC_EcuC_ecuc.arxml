AUTOSAR XML (schema 00050)
package /ActiveEcuC
  module config EcuC: implementation-config-variant=VARIANT-PRE-COMPILE, module-description=EcuC_Impl
    EcucPduCollection: PduIdTypeEnum=UINT8, PduLengthTypeEnum=UINT16
      9 x Pdu, all with J1939Requestable=false:
        Demo_0_CAN_Request_oDemoFBL_Vector_SLP3_d449ce03_Rx: DynamicLength=true, PduLength=8
        Demo_0_CAN_Request_Tp_oDemoFBL_Vector_SLP3_3a7abdec_Rx: DynamicLength=false, PduLength=8, SysTPduToFrameMappingRef=Demo_0_CAN_Request_Tp
        Demo_0_CAN_Response_oDemoFBL_Vector_SLP3_aa44c06b_Tx: DynamicLength=true, PduLength=8
        Demo_0_CAN_Response_oDemoFBL_Vector_SLP3_366a5b38_Tx: DynamicLength=true, PduLength=8
        Demo_0_CAN_Request_oDemoFBL_Vector_SLP3_51500fe6_Rx: DynamicLength=true, PduLength=8
        Demo_0_CAN_Response_Tp_oDemoFBL_Vector_SLP3_bc15b852_Tx: DynamicLength=false, PduLength=8, SysTPduToFrameMappingRef=Demo_0_CAN_Response_Tp
        Functional_CAN_oDemoFBL_Vector_SLP3_a93996e4_Rx: DynamicLength=true, PduLength=7
        Functional_CAN_oDemoFBL_Vector_SLP3_3a497ac1_Rx: DynamicLength=true, PduLength=7
        Functional_CAN_Tp_oDemoFBL_Vector_SLP3_b4b0ddd4_Rx: DynamicLength=false, PduLength=8, SysTPduToFrameMappingRef=Functional_CAN_Tp
    EcucGeneral:
      CPUType = CPU32Bit
      SizeOfInt = Size32Bit
      ByteOrder = LITTLE_ENDIAN
      BitOrder = LSB_to_MSB
      AtomicBitAccessInBitfield = false
      AtomicVariableAccess = Atomic32BitAccess
      SizeOfEnum = Size32Bit
      SizeOfROMPointer = Size32Bit
      SizeOfRAMPointer = Size32Bit
      BitFieldDataType = INT
      StructAlignment = Auto
      ArrayAlignment = Auto
      StructInArrayAlignment = Auto
      DummyFunction = false
      DummyStatement = true
      DummyStatementKind = SelfAssignment
      ConditionalGenerating = true
      EcucBswImplementationCodeType = EcuCSourceCode
      EcuCUseStdReturnTypeForRte = false
      BswInitialization
        25 x InitFunction:
          Det_Init: Header=Det.h, InitPhase=INIT_ZERO, ConfigType=Det_ConfigType, ConfigPtrName=Det_Config_Ptr, ConfigPtrClass=DET_INIT_DATA, ModuleRef=Det  # /ActiveEcuC/Det PLAIN_TEXT Init function description of Det in UnfilteredViewInInvariantProject (UnfilteredInvariantProjectModelView) .
          Det_InitMemory: Header=Det.h, InitPhase=INIT_MEMORY, ModuleRef=Det  # /ActiveEcuC/Det PLAIN_TEXT InitMemory function description of Det in UnfilteredViewInInvariantProject (UnfilteredInvariantProjectModelView) .
          Brs_Init: Header=, InitPhase=NO_INIT, ModuleRef=vBRS  # /ActiveEcuC/vBRS PLAIN_TEXT Automatically generated by EcuCBswInitFctConfigurationService.
          vBaseEnv_Init: Header=, InitPhase=NO_INIT, ModuleRef=vBaseEnv  # /ActiveEcuC/vBaseEnv PLAIN_TEXT Created vBaseEnv_Init by Extended Init XML Service
          vLinkGen_Init: Header=vLinkGen_Lcfg.h, InitPhase=NO_INIT, ModuleRef=vLinkGen  # /ActiveEcuC/vLinkGen PLAIN_TEXT Dummy initialization of the vLinkGen
          Fee_Init: Header=Fee.h, InitPhase=INIT_TWO_IF, ModuleRef=Fee  # /ActiveEcuC/Fee PLAIN_TEXT Initialization of the FEE
          vMem_30_vXSpi_Nand_Init: Header=vMem_30_vXSpi_Nand.h, InitPhase=NO_INIT, ConfigType=vMem_30_vXSpi_Nand_ConfigType, ConfigPtrClass=VMEM_30_VXSPI_NAND_INIT_DATA, ConfigPtrName=vMem_30_vXSpi_Nand_Config_Ptr, ModuleRef=vMem_30_vXSpi_Nand  # /ActiveEcuC/vMem_30_vXSpi_Nand PLAIN_TEXT Init function description of vMem_30_vXSpi_Nand in UnfilteredViewInInvariantProject (UnfilteredInvariantProjectModelView) .
          vXSpi_Init: Header=vXSpi.h, InitPhase=INIT_TWO_DRV, ConfigType=vXSpi_ConfigType, ConfigPtrClass=VXSPI_CONST, ConfigPtrName=&vXSpi_HwConfig, ModuleRef=vXSpi  # /ActiveEcuC/vXSpi PLAIN_TEXT Initialization of vXSpi
          vXSpi_InitMemory: Header=vXSpi.h, InitPhase=INIT_MEMORY, ModuleRef=vXSpi  # /ActiveEcuC/vXSpi PLAIN_TEXT Initialization of vXSpi
          vMemAccM_Init: Header=vMemAccM.h, InitPhase=INIT_TWO_DRV, ModuleRef=vMemAccM  # /ActiveEcuC/vMemAccM PLAIN_TEXT Initializes the vMemAccM.
          vMemAccM_InitMemory: Header=vMemAccM.h, InitPhase=INIT_MEMORY, ModuleRef=vMemAccM  # /ActiveEcuC/vMemAccM PLAIN_TEXT Initializes all *_INIT_* section variables within the vMemAccM.
          WrapNv_Init: Header=WrapNv.h, InitPhase=INIT_TWO_SYS, ModuleRef=WrapNv  # /ActiveEcuC/WrapNv PLAIN_TEXT WrapNv_Init function description
          Ea_Init: Header=Ea.h, InitPhase=INIT_TWO_IF, ModuleRef=Ea  # /ActiveEcuC/Ea PLAIN_TEXT Initialization of EEPROM Abstraction Module and its internal state machine
          Eep_30_XXi2c01_Init: Header=Eep_30_XXi2c01.h, InitPhase=INIT_TWO_DRV, ConfigType=Eep_30_XXi2c01_ConfigType, ConfigPtrClass=EEP_30_XXSPI01_PBCFG, ConfigPtrName=&Eep_30_XXi2c01_Runtime, ModuleRef=Eep  # /ActiveEcuC/Eep PLAIN_TEXT Initialization of EEPROM driver Eep_30_XXi2c01
          Eep_30_XXi2c01_InitMemory: Header=Eep_30_XXi2c01.h, InitPhase=INIT_MEMORY, ModuleRef=Eep  # /ActiveEcuC/Eep PLAIN_TEXT Initialize memory for EEPROM driver Eep_30_XXi2c01
          I2c_Init: Header=I2c.h, InitPhase=INIT_ONE, ConfigType=I2c_ConfigType, ConfigPtrClass=I2C_PBCFG, ConfigPtrName=&I2c_ConfigSet[0], ModuleRef=I2c  # /ActiveEcuC/I2c PLAIN_TEXT Initialization of the I2c
          vMem_30_XXRam_Init: Header=vMem_30_XXRam.h, InitPhase=NO_INIT, ConfigType=vMem_30_XXRam_ConfigType, ConfigPtrClass=VMEM_30_XXRAM_INIT_DATA, ConfigPtrName=vMem_30_XXRam_Config_Ptr, ModuleRef=vMem_30_XXRam  # /ActiveEcuC/vMem_30_XXRam PLAIN_TEXT Init function description of vMem_30_XXRam in UnfilteredViewInInvariantProject (UnfilteredInvariantProjectModelView) .
          Fls_30_vMemAccM_Init: Header=Fls_30_vMemAccM.h, InitPhase=INIT_TWO_DRV, ModuleRef=Fls  # /ActiveEcuC/Fls PLAIN_TEXT Initializes the Fls_30_vMemAccM.
          NvM_Init: Header=NvM.h, InitPhase=INIT_TWO_SYS, ModuleRef=NvM  # /ActiveEcuC/NvM PLAIN_TEXT Initialization of the NVRAM Manager, to make it ready for NvM_ReadAll being requested
          Crypto_30_vHsm_Init: Header=Crypto_30_vHsm.h, InitPhase=INIT_TWO_DRV, ModuleRef=Crypto_30_vHsm  # /ActiveEcuC/Crypto_30_vHsm PLAIN_TEXT Initializes the Crypto Driver
          Crypto_30_vHsm_InitMemory: Header=Crypto_30_vHsm.h, InitPhase=INIT_MEMORY, ModuleRef=Crypto_30_vHsm  # /ActiveEcuC/Crypto_30_vHsm PLAIN_TEXT Initializes variables of the Crypto Interface
          CryIf_InitMemory: Header=CryIf.h, InitPhase=INIT_MEMORY, ModuleRef=CryIf  # /ActiveEcuC/CryIf PLAIN_TEXT Initializes variables of the Crypto Interface
          CryIf_Init: Header=CryIf.h, InitPhase=INIT_TWO_IF, ModuleRef=CryIf  # /ActiveEcuC/CryIf PLAIN_TEXT Initializes the Crypto Interface
          Csm_InitMemory: Header=Csm.h, InitPhase=INIT_MEMORY, ModuleRef=Csm  # /ActiveEcuC/Csm PLAIN_TEXT Initializes variables of the Crypto Service Manager
          Csm_Init: Header=Csm.h, InitPhase=INIT_TWO_SYS, ModuleRef=Csm  # /ActiveEcuC/Csm PLAIN_TEXT Initializes the Crypto Service Manager
