AUTOSAR XML (schema 00050)
package /ActiveEcuC
  ecuc value collection ActiveEcuC
    ecuc-values:
      Det
      EcuC
      FblBmHdr
      FblBm
      FblHal
      Fbl
      Mcu
      MemMap
      vBRS
      vBaseEnv
      vLinkGen
      vSet
      vXSpi
      vMem_30_XXRam
      Crc
      Eep
      Fee
      Fls
      MemIf
      Ea
      NvM
      I2c
      WrapNv
      Crypto_30_vHsm
      CryIf
      Csm
      vMemAccM
      vMem_30_vXSpi_Nand
      vMem
