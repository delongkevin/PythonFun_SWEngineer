AUTOSAR XML (schema 00050)
package /ActiveEcuC
  module config vBaseEnv: implementation-config-variant=VARIANT-PRE-COMPILE, module-description=vBaseEnv_Impl
    vBaseEnvGeneral: vBaseEnvTestedDerivativeRef=TDA4VE88
      MSMC3 (vBaseEnvMemLayoutHwRegion)
      TDA4VE88 (vBaseEnvDerivativeInformation):
        vBaseEnvAvailableChannels_Can = 20
        vBaseEnvAvailableChannels_Lin = 0
        vBaseEnvAvailableChannels_Ethernet = 2
        vBaseEnvAvailableChannels_Flexray = 0
        vBaseEnvCpuCore = CORTEX_R5F
        vBaseEnvCpuCoreAmount = 6
        vBaseEnvCpuInitCore = 0
        vBaseEnvCpuMaxFrequency = 1000000000
        vBaseEnvTestedDerivative = TDA4VE88
        vBaseEnvTestedDerivativeDescription = TI TDA4VE88
        vBaseEnvAvailableChannels_Hyperbus = 0
        vBaseEnvAvailableChannels_I2c = 10
        vBaseEnvAvailableChannels_Spi = 0
        10 x vBaseEnvMemLayoutHwRegion:
          MSMC3: vBaseEnvHwRegionStartAddress=1879310336, vBaseEnvHwRegionSize=917504, vBaseEnvHwRegionType=RAM
          DDR0: vBaseEnvHwRegionStartAddress=2533359616, vBaseEnvHwRegionSize=16777216
          MCU_MSRAM: vBaseEnvHwRegionStartAddress=1103888384, vBaseEnvHwRegionSize=260816
          MCU_MSRAM_HSM: vBaseEnvHwRegionStartAddress=1103101952, vBaseEnvHwRegionSize=16128, vBaseEnvHwRegionType=RAM
          Protected_RAM: vBaseEnvHwRegionStartAddress=1076363264, vBaseEnvHwRegionSize=18, vBaseEnvHwRegionType=RAM
          MCU_R5_TCMB0_RAM: vBaseEnvHwRegionStartAddress=1090584576, vBaseEnvHwRegionSize=32768, vBaseEnvHwRegionType=RAM
          MCU_MSRAM_BOOT: vBaseEnvHwRegionStartAddress=1103888384, vBaseEnvHwRegionSize=241408, vBaseEnvHwRegionType=RAM
          DDR0_BM_FBL: vBaseEnvHwRegionStartAddress=2424307712, vBaseEnvHwRegionSize=6291456, vBaseEnvHwRegionType=RAM
          MCU_MSRAM_SW_RESET: vBaseEnvHwRegionStartAddress=1104149216, vBaseEnvHwRegionSize=32
          MSMC_SRAM: vBaseEnvHwRegionStartAddress=1880096768, vBaseEnvHwRegionSize=2097152
      9 x vBaseEnvMemLayoutHwRegion:
        DDR0
        MCU_MSRAM
        MCU_MSRAM_HSM
        Protected_RAM
        MCU_R5_TCMB0_RAM
        MCU_MSRAM_BOOT
        DDR0_BM_FBL
        MCU_MSRAM_SW_RESET
        MSMC_SRAM
