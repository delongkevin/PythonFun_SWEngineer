AUTOSAR XML (schema 00050)
package /ActiveEcuC
  module config vMem_30_XXRam: definition=vMem, implementation-config-variant=VARIANT-PRE-COMPILE, module-description=vMem_Impl
    vMem_XXRam_vMemInstance (vMemInstance): vMemInstanceId=0
      vMemSectorList
        vMemSector: vMemNumberOfSectors=1, vMemPageSize=1000, vMemSectorSize=16384000, vMemStartAddress=2533359616
    vMemGeneral: vMemDevErrorDetect=true, vMemSafeBswChecks=false, vMemVersionInfoApi=false, vMemUseInternalRAMBuffer=false, vMemReadOnlyMode=false
