AUTOSAR XML (schema 00050)
package /ActiveEcuC
  module config FblBm: implementation-config-variant=VARIANT-PRE-COMPILE, module-description=FblBm_Impl
    FblBmGeneral:
      FblBmFailsafeUpdater = false
      FblBmExecutionInstance = BootManager
      FblBmIncludeHardwareConfiguration = false
      FblBmInitializeKeys = false
      FblBmSecureBoot = false
      FblBmStandaloneMode = true
      FblBmInitializeMacOfBootloader = false
      FblBmIncludeOemConfiguration = false
      FblBmHeaderAddress = 2424307712
    FblBmBootOrder
      FblBmBootTarget: FblBmBootOrderId=0, FblBmBootTargetRef=Appl
      FblBmBootTarget_Updater (FblBmBootTarget): FblBmBootOrderId=1, FblBmBootTargetRef=FblUpdater
