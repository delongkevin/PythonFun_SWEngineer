AUTOSAR XML (schema 4-2-2)
package /MICROSAR/Fls_30_vMemAccM_ib_bswmd/BswModuleDescriptions
  bsw module description Fls: provided-entrys=Fls_30_vMemAccM_MainFunction
    bsw internal behavior Fls_30_vMemAccMBehavior
      bsw schedulable entity Fls_30_vMemAccM_MainFunction: implemented-entry=Fls_30_vMemAccM_MainFunction
      bsw timing event Fls_30_vMemAccM_MainFunctionTimingEvent0: starts-on-event=Fls_30_vMemAccM_MainFunction, period=0.005
  bsw module entry Fls_30_vMemAccM_MainFunction: call-type=SCHEDULED, execution-context=TASK
