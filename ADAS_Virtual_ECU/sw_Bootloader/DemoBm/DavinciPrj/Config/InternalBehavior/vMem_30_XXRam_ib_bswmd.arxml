AUTOSAR XML (schema 4-0-3)
package /MICROSAR/vMem_30_XXRam_ib_bswmd/BswModuleDescriptions
  bsw module description vMem
    bsw internal behavior vMemBehavior
