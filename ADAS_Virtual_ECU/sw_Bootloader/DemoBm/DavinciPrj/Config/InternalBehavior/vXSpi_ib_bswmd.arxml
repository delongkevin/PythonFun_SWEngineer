AUTOSAR XML (schema 4-0-3)
package /MICROSAR/vXSpi_Jacinto7Ti01_ib_bswmd/BswModuleDescriptions
  bsw module description vXSpi
    bsw internal behavior vXSpi_Behavior
