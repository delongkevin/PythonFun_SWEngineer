AUTOSAR XML (schema 00050)
package /ActiveEcuC
  module config FblBmHdr: implementation-config-variant=VARIANT-PRE-COMPILE, module-description=FblBmHdr_Impl
    FblBmHdrHeader: FblBmHdrBlockStartAddress=3145728, FblBmHdrBlockLength=1572864, FblBmHdrEntryAddress=Brs_ApplicationEntry, FblBmHdrTargetRef=FblUpdater
      FblBmHdrVariant
        FblBmHdrAuthenticationHeader: FblBmHdrAuthenticationHeaderAddress=3145728
    4 x FblBmHdrTarget:
      Appl: FblBmHdrTargetId=2
      Data: FblBmHdrTargetId=3
      Fbl: FblBmHdrTargetId=0
      FblUpdater: FblBmHdrTargetId=1
    FblBmHdrGeneral: FblBmHdrMaxVerificationEntries=1, FblBmHdrSbVerificationList=false
