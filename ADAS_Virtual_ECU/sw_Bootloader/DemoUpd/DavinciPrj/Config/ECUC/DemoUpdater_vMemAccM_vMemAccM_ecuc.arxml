AUTOSAR XML (schema 00050)
package /ActiveEcuC
  module config vMemAccM: implementation-config-variant=VARIANT-PRE-COMPILE, module-description=vMemAccM_Impl
    vMemAccMAddressAreaConfiguration_Active (vMemAccMAddressAreaConfiguration): vMemAccMAddressAreaId=0, vMemAccMAddressAreaPriority=0, vMemAccMReadRequestLength=64
      vMemAccMSubAddressAreaConfiguration_Flash (vMemAccMSubAddressAreaConfiguration):
        vMemAccMNumberOfSectors = 512
        vMemAccMVirtualStartAddress = 0
        vMemAccMPhysicalStartAddress = 0
        vMemAccMvMemFuncPtrTableSymbol = vMem_30_vXSpi_Nand_FunctionPointerTable
        vMemAccMUseEraseBurst = false
        vMemAccMUseWriteBurst = false
        vMemAccMSectorRef = vMemSector
    vMemAccMGeneral:
      vMemAccMVersionInfoApi = false
      vMemAccMMainFunctionPeriod = 0.005
      vMemAccMMainFunctionTriggering = FixedCycleTime
      vMemAccMSafeBswChecks = false
      vMemAccMDevErrorDetect = true
      vMemAccMCompareApi = false
