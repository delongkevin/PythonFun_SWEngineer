AUTOSAR XML (schema 00050)
package /ActiveEcuC
  module config vMem: implementation-config-variant=VARIANT-PRE-COMPILE, module-description=vMem_Impl
    vMemInstance: vMemInstanceId=0
      vMemSectorList
        vMemSector: vMemNumberOfSectors=256, vMemPageSize=256, vMemSectorSize=524288, vMemStartAddress=2533359616  # For NOR FLASH Configuration PLAIN_TEXT This shall not be used in production case for Magna
    vMemInstanceMapping_FlashWrapper (vMemInstanceMapping): vMemFblMemoryDeviceRef=FlashWrapper, vMemvMemInstanceRef=vMemInstance_ExtFlash
    vMemGeneral: vMemUseIsBlank=false, vMemUserMainFunction=false, vMemUserInitFunction=false, vMemCompareAfterWrite=false
