AUTOSAR XML (schema 00050)
package /ActiveEcuC
  ecuc value collection ActiveEcuC
    ecuc-values:
      Crc
      Det
      Ea
      EcuC
      Eep
      FblBmHdr
      FblBm
      FblHal
      Fbl
      Fee
      Fls
      I2c
      Mcu
      MemIf
      MemMap
      NvM
      WrapNv
      vBRS
      vBaseEnv
      vLinkGen
      vMemAccM
      vMem_30_XXRam
      vMem_30_vXSpi_Nand
      vMem
      vSet
      vXSpi
