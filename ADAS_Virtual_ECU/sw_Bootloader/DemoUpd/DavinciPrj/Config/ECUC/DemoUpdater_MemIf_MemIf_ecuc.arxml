AUTOSAR XML (schema 00050)
package /ActiveEcuC
  module config MemIf: implementation-config-variant=VARIANT-PRE-COMPILE, module-description=MemIf_Impl
    MemIfGeneral: MemIfDevErrorDetect=true, MemIfVersionInfoApi=false, MemIfSafeBswChecks=false
    EaGeneral (MemIfMemHwA): MemIfMemHwAId=0, MemIfMemHwARef=EaGeneral
    FeeGeneral (MemIfMemHwA): MemIfMemHwAId=1, MemIfMemHwARef=FeeGeneral
