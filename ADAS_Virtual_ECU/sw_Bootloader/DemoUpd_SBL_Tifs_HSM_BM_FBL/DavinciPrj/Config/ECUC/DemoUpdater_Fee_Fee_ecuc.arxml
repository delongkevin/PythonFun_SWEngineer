AUTOSAR XML (schema 00050)
package /ActiveEcuC
  module config Fee: implementation-config-variant=VARIANT-PRE-COMPILE, module-description=Fee_Impl
    FeeBlockDescriptor_ApplValidity (FeeBlockConfiguration):
      FeeBlockNumber = 4
      FeeBlockSize = 1
      FeeImmediateData = false
      FeeNumberOfWriteCycles = 10000
      FeeNumberOfChunkInstances = 1
      FeeNumberOfDatasets = 1
      FeeBlockIdFixed = false
      FeeBlockId = 0
      FeeBlockIsCritical = false
      FeeIsLookupTableBlock = false
      FeePartition = FeePartitionConfiguration
    FeeGeneral:
      FeeDevErrorDetect = true
      FeeIndex = 0
      FeeNvmJobEndNotification = NULL_PTR
      FeeNvmJobErrorNotification = NULL_PTR
      FeePollingMode = true
      FeeVersionInfoApi = false
      FeeInternalBufferSize = 512
      FeeMainFunctionPeriod = 0.001
      FeeMainFunctionTriggering = FixedCycleTime
      FeeSafeBswChecks = false
      FeeFlsApi:
        FeeFlsIncludeFile = FlsWrapper.h
        FeeFlsSetMode = Fls_SetMode
        FeeFlsRead = FlsWrapper_Read
        FeeFlsWrite = Fls_Write
        FeeFlsCancel = FlsWrapper_Cancel
        FeeFlsGetStatus = Fls_GetStatus
        FeeFlsGetJobResult = Fls_GetJobResult
        FeeFlsErase = Fls_Erase
        FeeFlsCompare = Fls_Compare
        FeeFlsReadBlank = FlsWrapper_Read
        FeeFlsDeviceIndex = Fls_30_vMemAccMGeneral
      FeeDevErrorChecks: FeeDetErrorhook=Det_ReportError, FeeDetIncludeFile=Det.h
    FeePublishedInformation: FeeBlockOverhead=2, FeeMaximumBlockingTime=1, FeePageOverhead=0, FeeChunkHeader=16, FeeChunkLink=8, FeeSectorHeader=8
    FeePartitionConfiguration:
      FeeLowerSectorAddress = 66977792
      FeeLowerSectorSize = 131072
      FeeUpperSectorAddress = 67108864
      FeeUpperSectorSize = 131072
      FeeAddressAlignment = 256
      FeeWriteAlignment = 2048
      FeeBssThresholdReserved = 14337
      FeeFssThresholdReserved = 4096
      FeePartitionDevice = Fls_30_vMemAccMConfigSet
    FeeSpecificFeatures:
      FeeApplErrorCallbackFunction = Appl_CriticalErrorCallback
      FeeApplErrorCallbackIncludeFile = Appl_Include.h
      FeeGetEraseCycleApi = false
      FeeGetWriteCycleApi = false
      FeeUseApplErrorCallback = false
      FeeUseJobCache = false
      FeeForceSectorSwitchApi = false
      FeeDataConversionApi = false
      FeeFblConfig = false
      FeeMaxLinkTableSize = 4095
      FeeFssControlApi = false
      FeeExtendedSectorHeaderCheck = true
      FeeUseReliableEraseProcedure = false
    14 x FeeBlockConfiguration, all with FeeNumberOfWriteCycles=10000, FeeNumberOfChunkInstances=1, FeeBlockIdFixed=false, FeeBlockIsCritical=false, FeeIsLookupTableBlock=false, FeePartition=FeePartitionConfiguration:
      FeeBlockDescriptor_DcmDslRxTesterSourceAddr: FeeBlockNumber=28, FeeBlockSize=2, FeeImmediateData=false, FeeNumberOfDatasets=1, FeeBlockId=1
      FeeBlockDescriptor_MetaData: FeeBlockNumber=16, FeeBlockSize=126, FeeImmediateData=false, FeeNumberOfDatasets=2, FeeBlockId=2
      FeeBlockDescriptor_ProgReqFlag: FeeBlockNumber=20, FeeBlockSize=1, FeeImmediateData=false, FeeNumberOfDatasets=1, FeeBlockId=3
      FeeBlockDescriptor_ResetResponseFlag: FeeBlockNumber=10, FeeBlockSize=1, FeeImmediateData=false, FeeNumberOfDatasets=1, FeeBlockId=4
      FeeBlockDescriptor_SecAccessDelayFlag: FeeBlockNumber=24, FeeBlockSize=1, FeeImmediateData=false, FeeNumberOfDatasets=1, FeeBlockId=5
      FeeBlockDescriptor_SecAccessInvalidCount: FeeBlockNumber=26, FeeBlockSize=1, FeeImmediateData=false, FeeNumberOfDatasets=1, FeeBlockId=6
      FeeBlockDescriptor_ValidityFlags: FeeBlockNumber=30, FeeBlockSize=2, FeeImmediateData=false, FeeNumberOfDatasets=1, FeeBlockId=7
      FeeBlockDescriptor_ApplUpdate: FeeBlockNumber=12, FeeBlockSize=1, FeeImmediateData=false, FeeNumberOfDatasets=1, FeeBlockId=8
      FeeBlockDescriptor_CoDePEcuPartNumber: FeeBlockNumber=18, FeeBlockSize=11, FeeImmediateData=true, FeeNumberOfDatasets=1, FeeBlockId=9
      FeeBlockDescriptor_DiagnosticVersion: FeeBlockNumber=22, FeeBlockSize=2, FeeImmediateData=true, FeeNumberOfDatasets=1, FeeBlockId=10
      FeeBlockDescriptor_EbomEcuPartNumber: FeeBlockNumber=14, FeeBlockSize=10, FeeImmediateData=true, FeeNumberOfDatasets=1, FeeBlockId=11
      FeeBlockDescriptor_ExhaustRegulationTan: FeeBlockNumber=2, FeeBlockSize=6, FeeImmediateData=false, FeeNumberOfDatasets=1, FeeBlockId=12
      FeeBlockDescriptor_ProgrammingStatus: FeeBlockNumber=6, FeeBlockSize=2, FeeImmediateData=true, FeeNumberOfDatasets=1, FeeBlockId=13
      FeeBlockDescriptor_VehicleManufEcuSwNumber: FeeBlockNumber=8, FeeBlockSize=11, FeeImmediateData=true, FeeNumberOfDatasets=1, FeeBlockId=14
