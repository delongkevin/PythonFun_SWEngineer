AUTOSAR XML (schema 00050)
package /ActiveEcuC
  module config Fbl: implementation-config-variant=VARIANT-LINK-TIME, module-description=Fbl_Impl
    FblGeneral:
      FblDataProcessingBufferSize = 256
      FblDiagnosticBufferSize = 4095
      FblFlashDriverUsage = USE_FLASH_DRIVER_FROM_ROM
      FblInternalMemoryCopy = true
      FblMaximumNumberOfSegments = 8
      FblOutputVerification = false
      FblP2Server = 10
      FblP2StarServer = 5000
      FblResponseAfterReset = false
      FblSleepTime = 300000
      FblUnalignedDataTransfer = true
      FblVerificationSegmentation = 256
      FblWriteSegmentation = 4096
      FblApplicationStateTask = true
      FblApplicationTimerTask = true
      FblPresencePattern = true
      FblStartFunction = true
      FblAdaptiveDataTransferRcrrp = false
      FblGatewaySupport = false
      FblInputVerification = false
      FblProcessedVerification = false
      FblS3ServerExtendedSession = 0
      FblS3ServerProgrammingSession = 0
      FblSuspendDriverOperation = false
      FblVerificationFunction = false
      FblReprogrammableLbt = false
      FblProjectState = INTEGRATION
      FblStayInBoot = false
      FblSleepMode = false
      FblHeaderAddress = 2425356736
      FblGapFilling = false
      FblFillCode = 255
      FblCommonData = true
      FblUserSubfunction = false
      FblUserService = false
      FblUserRoutine = false
      FblWatchdogService = false
      FblWatchdogTriggerCycle = 1
      FblEncryptionMode = false
      FblCompressionMode = false
      FblPipelinedVerification = false
      FblPipelinedProgramming = false
      FblMaximumAmountOfLogicalBlocks = 9
      FblBlockStartAddress = 2621440
      FblBlockLength = 524288
      FblOta = false
      FblOneStepUpdater = false
      FblHardwareSwap = false
      FblXcpSupport = false
      FblUserConfigFile = $(DpaProjectFolder)\Config\user_config_development.cfg
    FblMemoryDeviceTable
      5 x FblMemoryDevice, all with FblMdErasedValue=255, FblMdInitHook=false, FblMdDeinitHook=false, FblMdReadHook=false, FblMdEraseHook=false, FblMdWriteHook=false, FblMdVerifyHook=false:
        Flash: FblMdIndex=1, FblMdSegmentSize=1
        FlashWrapper: FblMdIndex=2, FblMdSegmentSize=4096
        Protected: FblMdSegmentSize=1, FblMdIndex=3
        Ram: FblMdIndex=4, FblMdSegmentSize=1
        NandWrapper: FblMdIndex=0, FblMdSegmentSize=4096
    FblFlashBlockTable
      5 x FblFlashBlock, all with FblFbMemoryDeviceRef=NandWrapper:
        Autosar_App_MCU1_0_Flash: FblFbStartAddress=3145728, FblFbEndAddress=6291455, FblFbDescription=AUTOSAR Application in MCU1_0, FblFbLogicalBlockRef=MCU10_Application_LB
        BmFlash: FblFbStartAddress=786432, FblFbEndAddress=2621439, FblFbDescription=Boot Manager and HSM, FblFbLogicalBlockRef=BM_HSM_LB
        FblFlash: FblFbStartAddress=2621440, FblFbEndAddress=3145727, FblFbDescription=Flash Bootloader, FblFbLogicalBlockRef=FBL
        SBL_Flash: FblFbStartAddress=0, FblFbEndAddress=524287, FblFbDescription=SBL, FblFbLogicalBlockRef=SBL_LB
        TIFS_flash: FblFbStartAddress=524288, FblFbEndAddress=786431, FblFbDescription=Tifs, FblFbLogicalBlockRef=TIFS_LB
    FblLogicalBlockTable
      5 x FblLogicalBlock, all with FblLbDisposability=MANDATORY, FblLbMaxReprogAttempts=0, FblLbInputVerification=0, FblLbProcessedVerification=0, FblLbPipelinedVerification=0, FblLbOutputVerification=0, FblLbDescription=:
        FBL: FblLbBlockIndex=0, FblLbBlockType=BOOT, FblLbStartAddress=2621440, FblLbEndAddress=3145727, FblLbBmHeaderAddress=2621440
        MCU10_Application_LB: FblLbBlockIndex=1, FblLbBlockType=CODE, FblLbStartAddress=3145728, FblLbEndAddress=6291455, FblLbBmHeaderAddress=3146304
        BM_HSM_LB: FblLbBlockIndex=2, FblLbBlockType=CODE, FblLbStartAddress=786432, FblLbEndAddress=2621439, FblLbBmHeaderAddress=786432
        SBL_LB: FblLbBlockIndex=3, FblLbBlockType=CODE, FblLbStartAddress=0, FblLbEndAddress=524287, FblLbBmHeaderAddress=0
        TIFS_LB: FblLbBlockIndex=4, FblLbBlockType=CODE, FblLbStartAddress=524288, FblLbEndAddress=786431, FblLbBmHeaderAddress=524288
    FblFca:
      FblCheckProgrammingPreconditionsService = true
      FblApplicationValidityFlag = true
      FblAccessDelayTime = 50
      FblSecurityAccessVariant = Standard
      FblRequestUpload = false
