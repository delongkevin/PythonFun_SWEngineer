AUTOSAR XML (schema 00050)
package /ActiveEcuC
  module config vMem: implementation-config-variant=VARIANT-PRE-COMPILE, module-description=vMem_Impl
    vMemInstance: vMemInstanceId=0
      vMemSectorList
        vMemSector: vMemNumberOfSectors=512, vMemPageSize=4096, vMemSectorSize=262144, vMemStartAddress=0  # For NOR FLASH Configuration PLAIN_TEXT This shall not be used in production case for Magna
    vMemInstanceMapping_FlashWrapper (vMemInstanceMapping): vMemFblMemoryDeviceRef=NandWrapper, vMemvMemInstanceRef=vMemInstance
    vMemGeneral: vMemUseIsBlank=false, vMemUserMainFunction=false, vMemUserInitFunction=false, vMemCompareAfterWrite=false, vMemInitHandling=ALL_DRIVERS_MANDATORY
