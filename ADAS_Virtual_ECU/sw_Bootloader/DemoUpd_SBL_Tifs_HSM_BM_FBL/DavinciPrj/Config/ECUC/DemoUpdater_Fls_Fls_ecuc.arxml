AUTOSAR XML (schema 00050)
package /ActiveEcuC
  module config Fls: implementation-config-variant=VARIANT-PRE-COMPILE, module-description=Fls_Impl
    Fls_30_vMemAccMGeneral (FlsGeneral):
      FlsAcLoadOnJobStart = false
      FlsBaseAddress = 0
      FlsBlankCheckApi = false
      FlsCancelApi = true
      FlsCompareApi = false
      FlsDevErrorDetect = true
      FlsDriverIndex = 0
      FlsGetJobResultApi = true
      FlsGetStatusApi = true
      FlsSetModeApi = true
      FlsTotalSize = 0
      FlsUseInterrupts = false
      FlsVersionInfoApi = false
      FlsSafeBswChecks = false
      FlsWriteRamAlignment = false
      FlsWriteRamAlignmentBufferSize = 256
      FlsReadBlankApi = false
      FlsPollingMode = true
    Fls_30_vMemAccMConfigSet (FlsConfigSet):
      FlsAcErase = 0
      FlsAcWrite = 0
      FlsCallCycle = 0.005
      FlsDefaultMode = MEMIF_MODE_SLOW
      FlsMaxReadFastMode = 0
      FlsMaxReadNormalMode = 0
      FlsMaxWriteFastMode = 0
      FlsMaxWriteNormalMode = 0
      FlsProtection = 0
      FlsMainFunctionTriggering = FixedCycleTime
      FlsSectorList
        FlsSector:
          FlsNumberOfSectors = 512
          FlsPageSize = 4096
          FlsSectorSize = 262144
          FlsSectorStartaddress = 0
          FlsSubAddressAreaRef = vMemAccMSubAddressAreaConfiguration_Flash
    Fls_30_vMemAccMPublishedInformation (FlsPublishedInformation):
      FlsAcLocationErase = 0
      FlsAcLocationWrite = 0
      FlsAcSizeErase = 0
      FlsAcSizeWrite = 0
      FlsEraseTime = 0
      FlsErasedValue = 4294967295
      FlsExpectedHwId = 0
      FlsSpecifiedEraseCycles = 0
      FlsWriteTime = 0
