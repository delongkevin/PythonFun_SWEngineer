AUTOSAR XML (schema 00050)
package /ActiveEcuC
  module config Eep: implementation-config-variant=VARIANT-PRE-COMPILE, module-description=Eep_Impl
    40 x EepDeviceInformation:
      Giantec_GT24C256B: EepAllowedWriteCycles=4000000, EepMinimumAddressType=16, EepTotalSize=32768, EepWriteTime=0.005, EepPageSize=EepPageSize128
      Microchip_24AA02: EepAllowedWriteCycles=1000000, EepMinimumAddressType=8, EepTotalSize=256, EepWriteTime=0.005, EepPageSize=EepPageSize8
      Microchip_24AA64: EepAllowedWriteCycles=1000000, EepMinimumAddressType=16, EepTotalSize=8192, EepWriteTime=0.005, EepPageSize=EepPageSize32
      Microchip_24AA128: EepAllowedWriteCycles=1000000, EepMinimumAddressType=16, EepTotalSize=16384, EepWriteTime=0.005, EepPageSize=EepPageSize64
      Microchip_24C65: EepAllowedWriteCycles=1000000, EepMinimumAddressType=16, EepTotalSize=8192, EepWriteTime=0.005, EepPageSize=EepPageSize64
      Microchip_24LC64: EepAllowedWriteCycles=1000000, EepMinimumAddressType=16, EepTotalSize=8192, EepWriteTime=0.005, EepPageSize=EepPageSize32
      Microchip_24LC128: EepAllowedWriteCycles=1000000, EepMinimumAddressType=16, EepTotalSize=16384, EepWriteTime=0.005, EepPageSize=EepPageSize64
      Microchip_24LC256: EepAllowedWriteCycles=1000000, EepMinimumAddressType=16, EepTotalSize=32768, EepWriteTime=0.005, EepPageSize=EepPageSize64
      ONSemiconductor_CAT24C32: EepAllowedWriteCycles=1000000, EepMinimumAddressType=16, EepTotalSize=4096, EepWriteTime=0.005, EepPageSize=EepPageSize32
      ONSemiconductor_CAT24C64: EepAllowedWriteCycles=1000000, EepMinimumAddressType=16, EepTotalSize=8192, EepWriteTime=0.005, EepPageSize=EepPageSize32
      ONSemiconductor_CAT24C256: EepAllowedWriteCycles=1000000, EepMinimumAddressType=16, EepTotalSize=32768, EepWriteTime=0.005, EepPageSize=EepPageSize64
      ONSemiconductor_CAV24C16: EepAllowedWriteCycles=1000000, EepMinimumAddressType=16, EepTotalSize=2048, EepWriteTime=0.005, EepPageSize=EepPageSize16
      ONSemiconductor_CAV24C32: EepAllowedWriteCycles=1000000, EepMinimumAddressType=16, EepTotalSize=4096, EepWriteTime=0.005, EepPageSize=EepPageSize32
      ONSemiconductor_CAV24C64: EepAllowedWriteCycles=1000000, EepMinimumAddressType=16, EepTotalSize=8192, EepWriteTime=0.005, EepPageSize=EepPageSize32
      ONSemiconductor_CAV24C256: EepAllowedWriteCycles=1000000, EepMinimumAddressType=16, EepTotalSize=32768, EepWriteTime=0.005, EepPageSize=EepPageSize64
      ONSemiconductor_N24C32: EepAllowedWriteCycles=1000000, EepMinimumAddressType=16, EepTotalSize=4096, EepWriteTime=0.004, EepPageSize=EepPageSize32
      ONSemiconductor_N24C64: EepAllowedWriteCycles=1000000, EepMinimumAddressType=16, EepTotalSize=8192, EepWriteTime=0.004, EepPageSize=EepPageSize32
      ONSemiconductor_NV24C32: EepAllowedWriteCycles=1000000, EepMinimumAddressType=16, EepTotalSize=4096, EepWriteTime=0.005, EepPageSize=EepPageSize32
      ONSemiconductor_NV24C64: EepAllowedWriteCycles=1000000, EepMinimumAddressType=16, EepTotalSize=8192, EepWriteTime=0.005, EepPageSize=EepPageSize32
      ONSemiconductor_NV24C512: EepAllowedWriteCycles=1000000, EepMinimumAddressType=16, EepTotalSize=64512, EepWriteTime=0.005, EepPageSize=EepPageSize128
      Rohm_BR24L16: EepAllowedWriteCycles=1000000, EepMinimumAddressType=16, EepTotalSize=2048, EepWriteTime=0.005, EepPageSize=EepPageSize16
      Rohm_BR24T08: EepAllowedWriteCycles=1000000, EepMinimumAddressType=16, EepTotalSize=1024, EepWriteTime=0.005, EepPageSize=EepPageSize8
      Rohm_BR24T16: EepAllowedWriteCycles=1000000, EepMinimumAddressType=16, EepTotalSize=2048, EepWriteTime=0.005, EepPageSize=EepPageSize16
      Ablic_S24C64C: EepAllowedWriteCycles=1000000, EepMinimumAddressType=16, EepTotalSize=8192, EepWriteTime=0.005, EepPageSize=EepPageSize32
      Seiko_S24C128CH: EepAllowedWriteCycles=1000000, EepMinimumAddressType=16, EepTotalSize=16384, EepWriteTime=0.005, EepPageSize=EepPageSize64
      STMicroelectronics_M24C02: EepAllowedWriteCycles=4000000, EepMinimumAddressType=16, EepTotalSize=256, EepWriteTime=0.004, EepPageSize=EepPageSize16
      STMicroelectronics_M24C04: EepAllowedWriteCycles=4000000, EepMinimumAddressType=16, EepTotalSize=512, EepWriteTime=0.005, EepPageSize=EepPageSize16
      STMicroelectronics_M24C16: EepAllowedWriteCycles=4000000, EepMinimumAddressType=16, EepTotalSize=2048, EepWriteTime=0.005, EepPageSize=EepPageSize16
      STMicroelectronics_M24C32: EepAllowedWriteCycles=4000000, EepMinimumAddressType=16, EepTotalSize=4096, EepWriteTime=0.005, EepPageSize=EepPageSize32
      STMicroelectronics_M24C64: EepAllowedWriteCycles=4000000, EepMinimumAddressType=16, EepTotalSize=8192, EepWriteTime=0.005, EepPageSize=EepPageSize32
      STMicroelectronics_M24128: EepAllowedWriteCycles=4000000, EepMinimumAddressType=16, EepTotalSize=16384, EepWriteTime=0.004, EepPageSize=EepPageSize64
      STMicroelectronics_M24256: EepAllowedWriteCycles=4000000, EepMinimumAddressType=16, EepTotalSize=32768, EepWriteTime=0.005, EepPageSize=EepPageSize64
      STMicroelectronics_M24512: EepAllowedWriteCycles=4000000, EepMinimumAddressType=16, EepTotalSize=65536, EepWriteTime=0.005, EepPageSize=EepPageSize128
      STMicroelectronics_M24M01: EepAllowedWriteCycles=4000000, EepMinimumAddressType=16, EepTotalSize=131072, EepWriteTime=0.005, EepPageSize=EepPageSize256
      STMicroelectronics_ST24C16: EepAllowedWriteCycles=4000000, EepMinimumAddressType=16, EepTotalSize=2048, EepWriteTime=0.005, EepPageSize=EepPageSize32
      Atmel_AT24C01: EepAllowedWriteCycles=1000000, EepMinimumAddressType=8, EepTotalSize=128, EepWriteTime=0.005, EepPageSize=EepPageSize8
      Atmel_AT24C08: EepAllowedWriteCycles=1000000, EepMinimumAddressType=16, EepTotalSize=1024, EepWriteTime=0.005, EepPageSize=EepPageSize16
      Atmel_AT24C32: EepAllowedWriteCycles=1000000, EepMinimumAddressType=16, EepTotalSize=4096, EepWriteTime=0.01, EepPageSize=EepPageSize32
      Atmel_AT24C64: EepAllowedWriteCycles=1000000, EepMinimumAddressType=16, EepTotalSize=8192, EepWriteTime=0.01, EepPageSize=EepPageSize32
      Atmel_AT24C256C: EepAllowedWriteCycles=1000000, EepMinimumAddressType=16, EepTotalSize=32768, EepWriteTime=0.005, EepPageSize=EepPageSize64
    EepGeneral:
      EepDevErrorDetect = true
      EepDriverIndex = 0
      EepUseInterrupts = false
      EepVersionInfoApi = false
      EepWriteCycleReduction = false
      EepTestComApi = false
      EepMaxAllowedReadBlockSize = 16
      EepSafeBswChecks = false
      EepExtendedAddressing = false
    EepInitConfiguration:
      EepBaseAddress = 0
      EepDefaultMode = MEMIF_MODE_FAST
      EepFastReadBlockSize = 16
      EepFastWriteBlockSize = 32
      EepJobCallCycle = 0.005
      EepNormalReadBlockSize = 16
      EepNormalWriteBlockSize = 32
      EepSize = 8192
      EepDefaultHandling = EEP_30_XXI2C01_HANDLING_BURST
      EepNbOfBurstQueries = 65535
      EepCfgIncludeList = fbl_inc.h
      EepDeviceInformationRef = ONSemiconductor_N24C64
      EepExternalDriver: EepI2cReference=I2cSequence_Eep_Write, EepI2cReference=I2cSequence_Eep_Read, EepI2cReference=I2cSequence_Eep_Ack
    EepPublishedInformation:
      EepAllowedWriteCycles = 1000000
      EepEraseTime = 0
      EepEraseUnitSize = 1
      EepEraseValue = 255
      EepMinimumAddressType = 16
      EepMinimumLengthType = 0
      EepReadUnitSize = 1
      EepSpecifiedEraseCycles = 0
      EepTotalSize = 8192
      EepWriteTime = 0
      EepWriteUnitSize = 1
    19 x EepDeviceInformation, all with EepWriteTime=0.005:
      ONSemiconductor_NV24C256: EepAllowedWriteCycles=1000000, EepMinimumAddressType=16, EepTotalSize=32768, EepPageSize=EepPageSize64
      STMicroelectronics_M24M02: EepAllowedWriteCycles=4000000, EepMinimumAddressType=16, EepTotalSize=262144, EepPageSize=EepPageSize256
      Microchip_24LC08B: EepAllowedWriteCycles=1000000, EepMinimumAddressType=8, EepTotalSize=1024, EepPageSize=EepPageSize16
      ONSemiconductor_CAV24M01: EepAllowedWriteCycles=1000000, EepMinimumAddressType=16, EepTotalSize=131072, EepPageSize=EepPageSize256
      Rohm_BR24T32: EepAllowedWriteCycles=1000000, EepMinimumAddressType=16, EepTotalSize=4096, EepPageSize=EepPageSize32
      Atmel_AT24C02: EepAllowedWriteCycles=1000000, EepMinimumAddressType=8, EepTotalSize=256, EepPageSize=EepPageSize8
      Microchip_24AA256: EepAllowedWriteCycles=1000000, EepMinimumAddressType=16, EepTotalSize=32768, EepPageSize=EepPageSize64
      Microchip_24AA512: EepAllowedWriteCycles=1000000, EepMinimumAddressType=16, EepTotalSize=65536, EepPageSize=EepPageSize128
      Microchip_24LC512: EepAllowedWriteCycles=1000000, EepMinimumAddressType=16, EepTotalSize=65536, EepPageSize=EepPageSize128
      Rohm_BR24T64: EepAllowedWriteCycles=1000000, EepMinimumAddressType=16, EepTotalSize=8192, EepPageSize=EepPageSize32
      Microchip_24FC02: EepAllowedWriteCycles=1000000, EepMinimumAddressType=8, EepTotalSize=256, EepPageSize=EepPageSize8
      Microchip_24LC02B: EepAllowedWriteCycles=1000000, EepMinimumAddressType=8, EepTotalSize=256, EepPageSize=EepPageSize8
      ONSemiconductor_CAV24C02: EepAllowedWriteCycles=1000000, EepMinimumAddressType=8, EepTotalSize=256, EepPageSize=EepPageSize16
      ONSemiconductor_CAV24C04: EepAllowedWriteCycles=1000000, EepMinimumAddressType=8, EepTotalSize=512, EepPageSize=EepPageSize16
      ONSemiconductor_CAV24C08: EepAllowedWriteCycles=1000000, EepMinimumAddressType=8, EepTotalSize=1024, EepPageSize=EepPageSize16
      ONSemiconductor_CAV24C128: EepAllowedWriteCycles=1000000, EepMinimumAddressType=16, EepTotalSize=16384, EepPageSize=EepPageSize64
      Rohm_BR24G64: EepAllowedWriteCycles=1000000, EepMinimumAddressType=16, EepTotalSize=8192, EepPageSize=EepPageSize32
      Rohm_BR24G128: EepAllowedWriteCycles=1000000, EepMinimumAddressType=16, EepTotalSize=16384, EepPageSize=EepPageSize64
      Atmel_AT24C128C: EepAllowedWriteCycles=1000000, EepMinimumAddressType=16, EepTotalSize=16384, EepPageSize=EepPageSize64
