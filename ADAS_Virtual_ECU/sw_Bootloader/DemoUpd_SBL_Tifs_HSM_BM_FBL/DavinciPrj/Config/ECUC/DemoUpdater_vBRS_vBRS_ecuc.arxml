AUTOSAR XML (schema 00050)
package /ActiveEcuC
  module config vBRS: implementation-config-variant=VARIANT-PRE-COMPILE, module-description=vBRS_Impl
    vBRSGeneral:
      vBRSEnableEcuMStubGeneration = true
      vBRSEnableSchmStubGeneration = true
      vBRSExecutionInstance = FBL_Updater
      vBRSEnableSupportLEDs = false
      vBRSEnableSafeContextSupport = false
      vBRSEnableMultiCoreSupport = false
      vBRSEnableSupportToggleWdPin = false
      vBRSEnableSupportToggleCustomPin = false
      vBRSDisableSetupSupport = false
      vBRSEnableSchmStubSupportDrvCanAN = true
      vBRSFirstInstance = false
      vBRSEnableCoreSpecificVLinkGenConfig = false
      vBRSFblSupportEcuMInit = true
      vBRSFblSupportExceptionTableInRam = false
      vBRSEnableSchmStubEmptyExclusiveAreaHandling = false
      vBRSEnableSmallDevicesOptimization = false
    vBRSHwConfig:
      vBRSEnablePLLClocksHandling = true
      vBRSEnablePortHandling = true
      vBRSEnableWatchdogHandling = true
      vBRSPreferPLLWatchdogInit = false
      vBRSMakefileUserCode = ADDITIONAL_INCLUDES += .
      vBRSMakefileUserCode = ADDITIONAL_LDFLAGS_FROM_VBRS = -L ti/drvlib
      vBRSMakefileUserCode = ADDITIONAL_LDFLAGS_FROM_VBRS += -Xlinker --library=ti.csl.init.aer5f
      vBRSMakefileUserCode = ADDITIONAL_LDFLAGS_FROM_VBRS += -Xlinker --library=ti.csl.aer5f
      vBRSMakefileUserCode = ADDITIONAL_LDFLAGS_FROM_VBRS += -Xlinker --library=sciclient_direct.aer5f
      vBRSMakefileUserCode = ADDITIONAL_LDFLAGS_FROM_VBRS += -Xlinker --library=ti.osal.aer5f
      vBRSMakefileUserCode = ADDITIONAL_LDFLAGS_FROM_VBRS += -Xlinker --library=ti.board.aer5f
      vBRSMakefileUserCode = ADDITIONAL_LDFLAGS_FROM_VBRS += -Xlinker --library=ti.drv.uart.aer5f
      vBRSMakefileUserCode = ADDITIONAL_LDFLAGS_FROM_VBRS += -Xlinker --library=ti.drv.i2c.aer5f
      vBRSMakefileUserCode = ADDITIONAL_LDFLAGS_FROM_VBRS += -Xlinker --library=rm_pm_hal.aer5f
      vBRSOscClock = 19200000
      vBRSPeriphClock = 19200000
      vBRSTimebaseClock = 1000000000
      vBRSCompilerInstructionSet = ARM
      vBRSCompilerEnableFPU = true
      vBRSPeriphClockDescription = SBL powers up the timers and clock sources. Timer: 250MHz, CAN: 80 MHz, LIN: 48MHz
      vBRSMakefileUserCode = ADDITIONAL_LDFLAGS_FROM_VBRS += -Xlinker --library=sbl_lib_cust.aer5f
      vBRSEvaluationBoard = J721S2
      J721EVM (vBRSEvalBoardInfo): vBRSEvalBoard=J721EVM, vBRSEvalBoardDescription=No Led Support, vBRSEvalBoardOscClock=19200000
      J721S2 (vBRSEvalBoardInfo): vBRSEvalBoard=J721S2, vBRSEvalBoardDescription=No Led Support, vBRSEvalBoardOscClock=19200000
    vBRSMemoryInit: vBRSInitPatternBlocks=0, vBRSInitPatternHardResetBlocks=0, vBRSInitPatternAreas=0, vBRSInitPatternHardResetAreas=0
