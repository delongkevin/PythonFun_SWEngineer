AUTOSAR XML (schema 00050)
package /ActiveEcuC
  module config WrapNv: implementation-config-variant=VARIANT-PRE-COMPILE, module-description=WrapNv_Impl
    WrapNvMemoryLayout
      27 x WrapNvDataBlock, all with WrapNvDbAccessMacro=false:
        CertAccessInfo: WrapNvDbCount=10, WrapNvDbDescription=FBL ADA certificate serialNumber, WrapNvDbIndex=27, WrapNvDbType=TABLE
          IssuerNme (WrapNvDataElement):
            WrapNvDeDescription = FBL ADA certificate issuer name
            WrapNvDeLength = 25
            WrapNvDeIndex = 0
            WrapNvDeDefaultValue = 0xFF 0xFF 0xFF 0xFF 0xFF 0xFF 0xFF 0xFF 0xFF 0xFF 0xFF 0xFF 0xFF 0xFF 0xFF 0xFF 0xFF 0xFF 0xFF 0xFF 0xFF 0xFF 0xFF 0xFF 0xFF
            WrapNvDeNVMBlockRef = NvMBlockDescriptor_CertAccessInfo
          SerialNumber (WrapNvDataElement):
            WrapNvDeDescription = FBL ADA certificate serialNumber
            WrapNvDeLength = 20
            WrapNvDeIndex = 25
            WrapNvDeDefaultValue = 0xFF 0xFF 0xFF 0xFF 0xFF 0xFF 0xFF 0xFF 0xFF 0xFF 0xFF 0xFF 0xFF 0xFF 0xFF 0xFF 0xFF 0xFF 0xFF 0xFF
            WrapNvDeNVMBlockRef = NvMBlockDescriptor_CertAccessInfo
        fileHeader: WrapNvDbCount=9, WrapNvDbDescription=fileHeader information for each logical block, WrapNvDbIndex=26, WrapNvDbType=TABLE
          Uuid (WrapNvDataElement):
            WrapNvDeLength = 16
            WrapNvDeDescription = The Uuid field represents a unique identifier of the signed block.
            WrapNvDeIndex = 160
            WrapNvDeDefaultValue = 0xFF 0xFF 0xFF 0xFF 0xFF 0xFF 0xFF 0xFF 0xFF 0xFF 0xFF 0xFF 0xFF 0xFF 0xFF 0xFF
            WrapNvDeNVMBlockRef = NvMBlockDescriptor_FileHeader
          FileHeaderInfo (WrapNvDataElement):
            WrapNvDeDescription = TargetName field is a PrintableString that will equal the identifier for the intended ECU
            WrapNvDeLength = 160
            WrapNvDeIndex = 0
            WrapNvDeDefaultValue = 0xFF 0xFF 0xFF 0xFF 0xFF 0xFF 0xFF 0xFF 0xFF 0xFF 0xFF 0xFF 0xFF 0xFF 0xFF 0xFF 0xFF 0xFF 0xFF 0xFF 0xFF 0xFF 0xFF 0xFF 0xFF 0xFF 0xFF 0xFF 0xFF 0xFF 0xFF 0xFF 0xFF 0xFF 0xFF 0xFF 0xFF 0xFF 0xFF 0xFF 0xFF 0xFF 0xFF 0xFF 0xFF 0xFF 0xFF 0xFF 0xFF 0xFF 0xFF 0xFF 0xFF 0xFF 0xFF 0xFF 0xFF 0xFF 0xFF 0xFF 0xFF 0xFF 0xFF 0xFF 0xFF 0xFF 0xFF 0xFF 0xFF 0xFF 0xFF 0xFF 0xFF 0xFF 0xFF 0xFF 0xFF 0xFF 0xFF 0xFF 0xFF 0xFF 0xFF 0xFF 0xFF 0xFF 0xFF 0xFF 0xFF 0xFF 0xFF 0xFF 0xFF 0xFF 0xFF 0xFF 0xFF 0xFF 0xFF 0xFF 0xFF 0xFF 0xFF 0xFF 0xFF 0xFF 0xFF 0xFF 0xFF 0xFF 0xFF 0xFF 0xFF 0xFF 0xFF 0xFF 0xFF 0xFF 0xFF 0xFF 0xFF 0xFF 0xFF 0xFF 0xFF 0xFF 0xFF 0xFF 0xFF 0xFF 0xFF 0xFF 0xFF 0xFF 0xFF 0xFF 0xFF 0xFF 0xFF 0xFF 0xFF 0xFF 0xFF 0xFF 0xFF 0xFF 0xFF 0xFF 0xFF 0xFF 0xFF 0xFF 0xFF 0xFF 0xFF 0xFF 0xFF 0xFF 0xFF 0xFF
            WrapNvDeNVMBlockRef = NvMBlockDescriptor_FileHeader
        ProgReqFlag: WrapNvDbCount=1, WrapNvDbDescription=Programming request flag, WrapNvDbIndex=3, WrapNvDbType=SINGLE
          ProgReqFlag (WrapNvDataElement):
            WrapNvDeLength = 1
            WrapNvDeDescription = Programming request flag
            WrapNvDeIndex = 0
            WrapNvDeDefaultValue = 0xFF
            WrapNvDeNVMBlockRef = SWC_SysMgrSysM_ProgReqFlag
        ResetResponseFlag: WrapNvDbCount=1, WrapNvDbDescription=Reset response flag, WrapNvDbIndex=10, WrapNvDbType=SINGLE
          ResetResponseFlag (WrapNvDataElement):
            WrapNvDeLength = 1
            WrapNvDeDescription = Reset response flag
            WrapNvDeIndex = 0
            WrapNvDeDefaultValue = 0xFF
            WrapNvDeNVMBlockRef = NvMBlockDescriptor_ResetResponseFlag
        ValidityFlags: WrapNvDbCount=1, WrapNvDbDescription=Logical block validity flagss, WrapNvDbIndex=8, WrapNvDbType=SINGLE
          ValidityFlags (WrapNvDataElement):
            WrapNvDeLength = 2
            WrapNvDeDescription = Logical block validity flagss
            WrapNvDeIndex = 0
            WrapNvDeDefaultValue = 0xFF 0xFF
            WrapNvDeNVMBlockRef = NvMBlockDescriptor_ValidityFlags
        ApplValidity: WrapNvDbCount=1, WrapNvDbDescription=Application validity flag, WrapNvDbIndex=6, WrapNvDbType=SINGLE
          ApplValidity (WrapNvDataElement):
            WrapNvDeLength = 1
            WrapNvDeDescription = Application validity flag
            WrapNvDeIndex = 0
            WrapNvDeDefaultValue = 0xFF
            WrapNvDeNVMBlockRef = NvMBlockDescriptor_ApplValidity
        ApplUpdate: WrapNvDbCount=1, WrapNvDbDescription=Application update flag, WrapNvDbIndex=2, WrapNvDbType=SINGLE
          ApplUpdate (WrapNvDataElement):
            WrapNvDeLength = 1
            WrapNvDeDescription = Application update flag
            WrapNvDeIndex = 0
            WrapNvDeDefaultValue = 0xFF
            WrapNvDeNVMBlockRef = NvMBlockDescriptor_ApplUpdate
        SecAccessDelayFlag: WrapNvDbCount=1, WrapNvDbDescription=Security Access Delay flag, WrapNvDbIndex=4, WrapNvDbType=SINGLE
          SecAccessDelayFlag (WrapNvDataElement):
            WrapNvDeLength = 1
            WrapNvDeDescription = Security Access Delay flag
            WrapNvDeIndex = 0
            WrapNvDeDefaultValue = 0xFF
            WrapNvDeNVMBlockRef = NvMBlockDescriptor_SecAccessDelayFlag
        SecAccessInvalidCount: WrapNvDbCount=1, WrapNvDbDescription=Security Access Invalid count, WrapNvDbIndex=5, WrapNvDbType=SINGLE
          SecAccessInvalidCount (WrapNvDataElement):
            WrapNvDeLength = 1
            WrapNvDeDescription = Security Access Invalid count
            WrapNvDeIndex = 0
            WrapNvDeDefaultValue = 0xFF
            WrapNvDeNVMBlockRef = NvMBlockDescriptor_SecAccessInvalidCount
        DcmDslRxTesterSourceAddr: WrapNvDbCount=1, WrapNvDbDescription=Connection for reset response, WrapNvDbIndex=7, WrapNvDbType=SINGLE
          DcmDslRxTesterSourceAddr (WrapNvDataElement):
            WrapNvDeLength = 2
            WrapNvDeDescription = Connection for reset response
            WrapNvDeIndex = 0
            WrapNvDeDefaultValue = 0xFF 0xFF
            WrapNvDeNVMBlockRef = NvMBlockDescriptor_DcmDslRxTesterSourceAddr
        ProgrammingStatus: WrapNvDbCount=1, WrapNvDbDescription=Programming Status Informationn, WrapNvDbIndex=12, WrapNvDbType=SINGLE
          ProgrammingStatus (WrapNvDataElement):
            WrapNvDeLength = 2
            WrapNvDeDescription = Programming Status Informationn
            WrapNvDeIndex = 0
            WrapNvDeDefaultValue = 0xFF 0xFF
            WrapNvDeNVMBlockRef = NvMBlockDescriptor_DID_2010_ProgrammingStatus
        DiagnosticVersion: WrapNvDbCount=1, WrapNvDbDescription=Diagnostic Version of DID F110h, WrapNvDbIndex=23, WrapNvDbType=SINGLE
          DiagnosticVersion (WrapNvDataElement):
            WrapNvDeLength = 6
            WrapNvDeDescription = Diagnostic Version of DID F110h
            WrapNvDeIndex = 0
            WrapNvDeDefaultValue = 0xFF 0xFF 0xFF 0xFF 0xFF 0xFF
            WrapNvDeNVMBlockRef = SWC_PartNumMgrDID_F110_Ecu_Diag_Info
        VehicleManufEcuSwNumber: WrapNvDbCount=1, WrapNvDbDescription=DID F188 - Vehicle Manufacturer ECU Software Number, WrapNvDbIndex=14, WrapNvDbType=SINGLE
          VehicleManufEcuSwNumber (WrapNvDataElement):
            WrapNvDeDescription = DID F188 - Vehicle Manufacturer ECU Software Number
            WrapNvDeLength = 11
            WrapNvDeIndex = 0
            WrapNvDeDefaultValue = 0xFF 0xFF 0xFF 0xFF 0xFF 0xFF 0xFF 0xFF 0xFF 0xFF 0xFF
            WrapNvDeNVMBlockRef = SWC_PartNumMgrDID_F188_FCA_ESLM_Ecu_SW_Num
        EbomEcuPartNumber: WrapNvDbCount=1, WrapNvDbDescription=DID F132 - EBOM ECU Part Number, WrapNvDbIndex=20, WrapNvDbType=SINGLE
          EbomEcuPartNumber (WrapNvDataElement):
            WrapNvDeLength = 10
            WrapNvDeDescription = DID F132 - EBOM ECU Part Number
            WrapNvDeIndex = 0
            WrapNvDeDefaultValue = 0xFF 0xFF 0xFF 0xFF 0xFF 0xFF 0xFF 0xFF 0xFF 0xFF
            WrapNvDeNVMBlockRef = SWC_PartNumMgrDID_F132_EBOM_Ecu_PartNum
        CoDePEcuPartNumber: WrapNvDbCount=1, WrapNvDbDescription=DID F187 - CoDeP ECU Part Number, WrapNvDbIndex=18, WrapNvDbType=SINGLE
          CoDePEcuPartNumber (WrapNvDataElement):
            WrapNvDeLength = 11
            WrapNvDeDescription = DID F187 - CoDeP ECU Part Number
            WrapNvDeIndex = 0
            WrapNvDeDefaultValue = 0xFF 0xFF 0xFF 0xFF 0xFF 0xFF 0xFF 0xFF 0xFF 0xFF 0xFF
            WrapNvDeNVMBlockRef = SWC_PartNumMgrDID_F187_CODEP_Ecu_PartNum
        ExhaustRegulationTan: WrapNvDbCount=1, WrapNvDbDescription=DID F196 - Exhaust Regulation or Type Approval Number, WrapNvDbIndex=9, WrapNvDbType=SINGLE
          ExhaustRegulationTan (WrapNvDataElement):
            WrapNvDeDescription = DID F196 - Exhaust Regulation or Type Approval Number
            WrapNvDeLength = 6
            WrapNvDeIndex = 0
            WrapNvDeDefaultValue = 0xFF 0xFF 0xFF 0xFF 0xFF 0xFF
            WrapNvDeNVMBlockRef = NvMBlockDescriptor_ExhaustRegulationTan
        Metadata: WrapNvDbCount=10, WrapNvDbDescription=Metadata information for each logical block, WrapNvDbIndex=13, WrapNvDbType=TABLE
          13 x WrapNvDataElement, all with WrapNvDeNVMBlockRef=NvMBlockDescriptor_MetaData:
            Fingerprint: WrapNvDeLength=13, WrapNvDeDescription=Download fingerprint, WrapNvDeIndex=0, WrapNvDeDefaultValue=0xFF 0xFF 0xFF 0xFF 0xFF 0xFF 0xFF 0xFF 0xFF 0xFF 0xFF 0xFF 0xFF
            ProgCounter: WrapNvDeLength=2, WrapNvDeDescription=Successful reprogramming attempts, WrapNvDeIndex=1, WrapNvDeDefaultValue=0xFF 0xFF
            ProgAttempts: WrapNvDeLength=2, WrapNvDeDescription=Reprogramming attempts, WrapNvDeIndex=2, WrapNvDeDefaultValue=0xFF 0xFF
            CRCValue: WrapNvDeLength=1, WrapNvDeDescription=CRC total of logical block, WrapNvDeIndex=3, WrapNvDeDefaultValue=0xFF
            CRCStart: WrapNvDeLength=1, WrapNvDeDescription=Start address of CRC total, WrapNvDeIndex=4, WrapNvDeDefaultValue=0xFF
            CRCLength: WrapNvDeLength=1, WrapNvDeDescription=Length of CRC total, WrapNvDeIndex=5, WrapNvDeDefaultValue=0xFF
            SoftwareIdentification: WrapNvDeLength=13, WrapNvDeDescription=DID F181 or F182 - Application Software- or Application Data Identification, WrapNvDeIndex=6, WrapNvDeDefaultValue=0xFF 0xFF 0xFF 0xFF 0xFF 0xFF 0xFF 0xFF 0xFF 0xFF 0xFF 0xFF 0xFF
            SwEbomPartNumber: WrapNvDeLength=10, WrapNvDeDescription=DID F122 - S/W EBOM Part Number, WrapNvDeIndex=7, WrapNvDeDefaultValue=0xFF 0xFF 0xFF 0xFF 0xFF 0xFF 0xFF 0xFF 0xFF 0xFF
            MemoryStatus: WrapNvDeDescription=Memory status; erased, programmeds, WrapNvDeLength=1, WrapNvDeIndex=8, WrapNvDeDefaultValue=0xFF
            SegmentCount: WrapNvDeDescription=Number of entries in segment list, WrapNvDeLength=1, WrapNvDeIndex=9, WrapNvDeDefaultValue=0xFF
            SegmentAddrList: WrapNvDeDescription=List of segment start addresses, WrapNvDeLength=40, WrapNvDeIndex=10, WrapNvDeDefaultValue=0xFF 0xFF 0xFF 0xFF 0xFF 0xFF 0xFF 0xFF 0xFF 0xFF 0xFF 0xFF 0xFF 0xFF 0xFF 0xFF 0xFF 0xFF 0xFF 0xFF 0xFF 0xFF 0xFF 0xFF 0xFF 0xFF 0xFF 0xFF 0xFF 0xFF 0xFF 0xFF 0xFF 0xFF 0xFF 0xFF 0xFF 0xFF 0xFF 0xFF
            SegmentLengthList: WrapNvDeIndex=11, WrapNvDeDescription=List of segment lengths, WrapNvDeLength=40, WrapNvDeDefaultValue=0xFF 0xFF 0xFF 0xFF 0xFF 0xFF 0xFF 0xFF 0xFF 0xFF 0xFF 0xFF 0xFF 0xFF 0xFF 0xFF 0xFF 0xFF 0xFF 0xFF 0xFF 0xFF 0xFF 0xFF 0xFF 0xFF 0xFF 0xFF 0xFF 0xFF 0xFF 0xFF 0xFF 0xFF 0xFF 0xFF 0xFF 0xFF 0xFF 0xFF
            FlashStatus: WrapNvDeIndex=12, WrapNvDeLength=1, WrapNvDeDescription=Flash Status, WrapNvDeDefaultValue=0xFF
        NvMConfigBlock: WrapNvDbCount=1, WrapNvDbDescription=NvMConfigBlock, WrapNvDbIndex=1, WrapNvDbType=SINGLE
          NvMConfigBlock (WrapNvDataElement): WrapNvDeLength=2, WrapNvDeDescription=NvMConfigBlock, WrapNvDeIndex=0, WrapNvDeDefaultValue=0xFF 0xFF, WrapNvDeNVMBlockRef=NvMConfigBlock
        CodepAssemblyPartNumber: WrapNvDbCount=1, WrapNvDbDescription=CodepAssemblyPartNumber, WrapNvDbIndex=19, WrapNvDbType=SINGLE
          CodepAssemblyPartNumber (WrapNvDataElement):
            WrapNvDeLength = 11
            WrapNvDeDescription = CodepAssemblyPartNumber
            WrapNvDeIndex = 0
            WrapNvDeDefaultValue = 0xFF 0xFF 0xFF 0xFF 0xFF 0xFF 0xFF 0xFF 0xFF 0xFF 0xFF
            WrapNvDeNVMBlockRef = SWC_PartNumMgrDID_F134_CODEP_Asm_PartNum
        DID_F180_Boot_SW_Ver_Info: WrapNvDbCount=1, WrapNvDbDescription=DID_F180_Boot_SW_Ver_Info, WrapNvDbIndex=11, WrapNvDbType=SINGLE
          DID_F180_Boot_SW_Ver_Info (WrapNvDataElement):
            WrapNvDeLength = 13
            WrapNvDeDescription = DID_F180_Boot_SW_Ver_Info
            WrapNvDeIndex = 0
            WrapNvDeDefaultValue = 0xFF 0xFF 0xFF 0xFF 0xFF 0xFF 0xFF 0xFF 0xFF 0xFF 0xFF 0xFF 0xFF
            WrapNvDeNVMBlockRef = SWC_PartNumMgrDID_F180_Boot_SW_Ver_Info
        DID_F18A_FCA_ESLM_Ecu_SW_Cal_Num: WrapNvDbCount=1, WrapNvDbDescription=DID_F18A_FCA_ESLM_Ecu_SW_Cal_Num, WrapNvDbIndex=16, WrapNvDbType=SINGLE
          DID_F18A_FCA_ESLM_Ecu_SW_Cal_Num (WrapNvDataElement):
            WrapNvDeLength = 10
            WrapNvDeDescription = DID_F18A_FCA_ESLM_Ecu_SW_Cal_Num
            WrapNvDeIndex = 0
            WrapNvDeDefaultValue = 0xFF 0xFF 0xFF 0xFF 0xFF 0xFF 0xFF 0xFF 0xFF 0xFF
            WrapNvDeNVMBlockRef = SWC_PartNumMgrDID_F18A_FCA_ESLM_Ecu_SW_Cal_Num
        DID_F18B_FCA_ESLM_ECU_SW_App_Num: WrapNvDbCount=1, WrapNvDbDescription=DID_F18B_FCA_ESLM_ECU_SW_App_Num, WrapNvDbIndex=17, WrapNvDbType=SINGLE
          DID_F18B_FCA_ESLM_ECU_SW_App_Num (WrapNvDataElement):
            WrapNvDeDescription = DID_F18B_FCA_ESLM_ECU_SW_App_Num
            WrapNvDeLength = 10
            WrapNvDeIndex = 0
            WrapNvDeDefaultValue = 0xFF 0xFF 0xFF 0xFF 0xFF 0xFF 0xFF 0xFF 0xFF 0xFF
            WrapNvDeNVMBlockRef = SWC_PartNumMgrDID_F18B_FCA_ESLM_ECU_SW_App_Num
        DID_F194_Supplier_Ecu_SW_PartNum: WrapNvDbType=SINGLE, WrapNvDbIndex=21, WrapNvDbCount=1, WrapNvDbDescription=DID_F194_Supplier_Ecu_SW_PartNum
          DID_F194_Supplier_Ecu_SW_PartNum (WrapNvDataElement):
            WrapNvDeIndex = 0
            WrapNvDeLength = 11
            WrapNvDeDescription = DID_F194_Supplier_Ecu_SW_PartNum
            WrapNvDeDefaultValue = 0xFF 0xFF 0xFF 0xFF 0xFF 0xFF 0xFF 0xFF 0xFF 0xFF 0xFF
            WrapNvDeNVMBlockRef = SWC_PartNumMgrDID_F194_Supplier_Ecu_SW_PartNum
        DID_F195_Supplier_Ecu_SW_VerNum: WrapNvDbType=SINGLE, WrapNvDbIndex=22, WrapNvDbCount=1, WrapNvDbDescription=DID_F195_Supplier_Ecu_SW_VerNum
          DID_F195_Supplier_Ecu_SW_VerNum (WrapNvDataElement):
            WrapNvDeIndex = 0
            WrapNvDeLength = 2
            WrapNvDeDescription = DID_F195_Supplier_Ecu_SW_VerNum
            WrapNvDeDefaultValue = 0xFF 0xFF
            WrapNvDeNVMBlockRef = SWC_PartNumMgrDID_F195_Supplier_Ecu_SW_VerNum
        EbomAssemblyPartNumber: WrapNvDbType=SINGLE, WrapNvDbIndex=15, WrapNvDbCount=1, WrapNvDbDescription=EbomAssemblyPartNumber
          EbomAssemblyPartNumber (WrapNvDataElement):
            WrapNvDeIndex = 0
            WrapNvDeLength = 10
            WrapNvDeDescription = EbomAssemblyPartNumber
            WrapNvDeDefaultValue = 0xFF 0xFF 0xFF 0xFF 0xFF 0xFF 0xFF 0xFF 0xFF 0xFF
            WrapNvDeNVMBlockRef = SWC_PartNumMgrDID_F133_EBOM_Asm_PartNum
        DID_2002_OdoFlashing: WrapNvDbType=SINGLE, WrapNvDbIndex=24, WrapNvDbCount=1, WrapNvDbDescription=DID_2002_OdoFlashing
          DID_2002_OdoFlashing (WrapNvDataElement):
            WrapNvDeIndex = 0
            WrapNvDeLength = 2
            WrapNvDeDescription = DID_2002_OdoFlashing
            WrapNvDeDefaultValue = 0xFF 0xFF
            WrapNvDeNVMBlockRef = SWC_DIDMgrDID_2002_OdoFlashing_MirrorBlock
        SWC_ConfigMgrVIN_OriginalVal: WrapNvDbType=SINGLE, WrapNvDbIndex=25, WrapNvDbCount=1, WrapNvDbDescription=SWC_ConfigMgrVIN_OriginalVal
          SWC_ConfigMgrVIN_OriginalVal (WrapNvDataElement):
            WrapNvDeIndex = 0
            WrapNvDeLength = 17
            WrapNvDeDescription = SWC_ConfigMgrVIN_OriginalVal
            WrapNvDeDefaultValue = 0xFF 0xFF 0xFF 0xFF 0xFF 0xFF 0xFF 0xFF 0xFF 0xFF 0xFF 0xFF 0xFF 0xFF 0xFF 0xFF 0xFF
            WrapNvDeNVMBlockRef = SWC_ConfigMgrVIN_OriginalVal
    WrapNvGeneral: WrapNvEEPROMBaseAddress=2535455488, WrapNvFirstHandle=1, WrapNvNVMDataHandling=MSR_NVM, WrapNvMainFunctionPolling=true, WrapNvDevErrorDetect=true
      3 x WrapNvMainFunctionCycle, all with WrapNvMainFunctionCycleValue=0:
        WrapNvMainFunctionCycle_Ea: WrapNvMainFunctionCycleModuleRef=Ea
        WrapNvMainFunctionCycle_Eep: WrapNvMainFunctionCycleModuleRef=Eep
        WrapNvMainFunctionCycle_Nvm: WrapNvMainFunctionCycleModuleRef=NvM
