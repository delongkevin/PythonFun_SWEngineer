AUTOSAR XML (schema 00050)
package /ActiveEcuC
  module config Mcu: implementation-config-variant=VARIANT-PRE-COMPILE
    McuGeneralConfiguration: McuDevErrorDetect=false, McuGetRamStateApi=false, McuInitClock=true, McuNoPll=true, McuPerformResetApi=false, McuVersionInfoApi=false
    McuModuleConfiguration: McuClockSrcFailureNotification=DISABLED, McuNumberOfMcuModes=1, McuRamSectors=1
      McuClockSettingConfig: McuClockSettingId=1
        McuClockReferencePoint_CAN (McuClockReferencePoint): McuClockReferencePointFrequency=80000000
        McuClockReferencePoint_Timer (McuClockReferencePoint): McuClockReferencePointFrequency=19200000
      McuModeSettingConf: McuMode=1
    McuPublishedInformation
      McuResetReasonConf: McuResetReason=1
