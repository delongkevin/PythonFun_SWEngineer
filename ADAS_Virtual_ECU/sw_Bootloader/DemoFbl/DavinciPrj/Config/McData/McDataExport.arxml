AUTOSAR XML (schema 00048)
package /MICROSAR
  4 x bsw implementation, all with programming-language=C, vendor-id=30, ar-release-version=4.00.03:
    CanIf_Impl: sw-version=8.04.00, used-code-generator=cMSR, behavior=CanIf_Behavior
    CanTp_Impl: sw-version=5.00.00, used-code-generator=DaVinci Configurator, behavior=CanTpBehavior
    Fee_Impl: sw-version=10.00.04, used-code-generator=DaVinci Configurator, behavior=FeeBehavior
    NvM_Impl: sw-version=10.00.00, used-code-generator=DaVinci Configurator, behavior=NvMBehavior
package /MICROSAR/CanIf_ib_bswmd/BswModuleDescriptions
  bsw module description CanIf
    bsw internal behavior CanIf_Behavior
      8 x exclusive area:
        CANIF_EXCLUSIVE_AREA_{0..7}
package /MICROSAR/CanTp_ib_bswmd/BswModuleDescriptions
  bsw module description CanTp
    bsw internal behavior CanTpBehavior
      exclusive area CANTP_EXCLUSIVE_AREA_0
      bsw schedulable entity CanTp_MainFunction: implemented-entry=CanTp_MainFunction
      bsw timing event CanTp_MainFunctionTimingEvent0: starts-on-event=CanTp_MainFunction, period=0.005
  bsw module entry CanTp_MainFunction: call-type=SCHEDULED, execution-context=TASK
package /MICROSAR/Fee_ib_bswmd/BswModuleDescriptions
  bsw module description Fee
    bsw internal behavior FeeBehavior
      exclusive area FEE_EXCLUSIVE_AREA_0
      bsw schedulable entity Fee_MainFunction: implemented-entry=Fee_MainFunction
      bsw timing event Fee_MainFunctionTimingEvent0: starts-on-event=Fee_MainFunction, period=0.001
  bsw module entry Fee_MainFunction: call-type=SCHEDULED, execution-context=TASK
package /MICROSAR/NvM_ib_bswmd/BswModuleDescriptions
  bsw module description NvM
    bsw internal behavior NvMBehavior
      exclusive area NVM_EXCLUSIVE_AREA_0
      bsw schedulable entity NvM_MainFunction: implemented-entry=NvM_MainFunction
      bsw timing event NvM_MainFunctionTimingEvent0: starts-on-event=NvM_MainFunction, period=0.01
  bsw module entry NvM_MainFunction: call-type=SCHEDULED, execution-context=TASK
package /MICROSARFBL
  bsw implementation Dcm_Impl: programming-language=C, sw-version=8.03.00, used-code-generator=DaVinci Configurator, vendor-id=30, ar-release-version=4.00.03, behavior=DcmBehavior
package /MICROSARFBL/Dcm_ib_bswmd/BswModuleDescriptions
  bsw module description Dcm
    bsw internal behavior DcmBehavior
