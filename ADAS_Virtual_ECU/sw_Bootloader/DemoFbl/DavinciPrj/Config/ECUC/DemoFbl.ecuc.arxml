AUTOSAR XML (schema 00050)
package /ActiveEcuC
  ecuc value collection ActiveEcuC
    ecuc-values:
      vXSpi
      MemMap
      vSet
      vBaseEnv
      CanIf
      CanTp
      Can
      Dcm
      Det
      Eep
      FblBmHdr
      FblBm
      FblHal
      Fbl
      Fee
      I2c
      Mcu
      Os
      PduR
      vBRS
      vLinkGen
      EcuC
      WrapNv
      Crc
      MemIf
      Fls
      Ea
      NvM
      CryIf
      Crypto_30_vHsm
      Csm
      Smh
      vMemAccM
      vMem_30_vXSpi_Nand
      vMem
