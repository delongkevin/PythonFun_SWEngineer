AUTOSAR XML (schema 00050)
package /ActiveEcuC
  module config EcuC: implementation-config-variant=VARIANT-PRE-COMPILE, module-description=EcuC_Impl
    EcucPduCollection: PduIdTypeEnum=UINT8, PduLengthTypeEnum=UINT16
      18 x Pdu, all with J1939Requestable=false:
        Functional_CAN_FD_Tp_oDemoFBL_Fca_SLP5_ea53ce90_Rx: DynamicLength=false, PduLength=64, SysTPduToFrameMappingRef=Functional_CAN_FD_Tp
        Functional_CAN_FD_oDemoFBL_Fca_SLP5_a6dc7e27_Rx: DynamicLength=true, PduLength=62
        Functional_CAN_FD_oDemoFBL_Fca_SLP5_b4f709e0_Rx: DynamicLength=true, PduLength=62
        Demo_0_CAN_FD_Request_oDemoFBL_Fca_SLP5_888d0879_Rx: DynamicLength=true, PduLength=64
        Demo_0_CAN_FD_Response_oDemoFBL_Fca_SLP5_55a79f5b_Tx: DynamicLength=true, PduLength=64
        Demo_0_CAN_FD_Response_oDemoFBL_Fca_SLP5_3c1da0e3_Tx: DynamicLength=true, PduLength=64
        Demo_0_CAN_FD_Response_Tp_oDemoFBL_Fca_SLP5_370a354e_Tx: DynamicLength=false, PduLength=64, SysTPduToFrameMappingRef=Demo_0_CAN_FD_Response_Tp
        Demo_0_CAN_FD_Request_oDemoFBL_Fca_SLP5_e6d1155f_Rx: DynamicLength=true, PduLength=64
        Demo_0_CAN_FD_Request_Tp_oDemoFBL_Fca_SLP5_480939e9_Rx: DynamicLength=false, PduLength=64, SysTPduToFrameMappingRef=Demo_0_CAN_FD_Request_Tp
        Demo_0_CAN_20_Request_oDemoFBL_Vector_SLP3_d449ce03_Rx: DynamicLength=true, PduLength=8  # Demo_0_CAN_Request_oDemoFBL_Vector_SLP3
        Demo_0_CAN_20_Request_Tp_oDemoFBL_Vector_SLP3_3a7abdec_Rx: DynamicLength=false, PduLength=8  # Demo_0_CAN_Request_Tp_oDemoFBL_Vector_SLP3
        Demo_0_CAN_20_Response_oDemoFBL_Vector_SLP3_aa44c06b_Tx: DynamicLength=true, PduLength=8  # Demo_0_CAN_Response_oDemoFBL_Vector_SLP3
        Demo_0_CAN_20_Response_oDemoFBL_Vector_SLP3_366a5b38_Tx: DynamicLength=true, PduLength=8  # Demo_0_CAN_Response_oDemoFBL_Vector_SLP3
        Demo_0_CAN_20_Request_oDemoFBL_Vector_SLP3_51500fe6_Rx: DynamicLength=true, PduLength=8  # Demo_0_CAN_Request_oDemoFBL_Vector_SLP3
        Demo_0_CAN_20_Response_Tp_oDemoFBL_Vector_SLP3_bc15b852_Tx: DynamicLength=false, PduLength=8, SysTPduToFrameMappingRef=Demo_0_CAN_Response_Tp  # Demo_0_CAN_Response_Tp_oDemoFBL_Vector_SLP3
        Functional_CAN_20_oDemoFBL_Vector_SLP3_a93996e4_Rx: DynamicLength=true, PduLength=7  # Functional_CAN_oDemoFBL_Vector_SLP3
        Functional_CAN_20_oDemoFBL_Vector_SLP3_3a497ac1_Rx: DynamicLength=true, PduLength=7  # Functional_CAN_oDemoFBL_Vector_SLP3
        Functional_CAN_20_Tp_oDemoFBL_Vector_SLP3_b4b0ddd4_Rx: DynamicLength=false, PduLength=8, SysTPduToFrameMappingRef=Functional_CAN_Tp  # Functional_CAN_Tp_oDemoFBL_Vector_SLP3
    EcucGeneral:
      CPUType = CPU32Bit
      SizeOfInt = Size32Bit
      ByteOrder = LITTLE_ENDIAN
      BitOrder = LSB_to_MSB
      AtomicBitAccessInBitfield = false
      AtomicVariableAccess = Atomic32BitAccess
      SizeOfEnum = Size32Bit
      SizeOfROMPointer = Size32Bit
      SizeOfRAMPointer = Size32Bit
      BitFieldDataType = INT
      StructAlignment = Auto
      ArrayAlignment = Auto
      StructInArrayAlignment = Auto
      DummyFunction = false
      DummyStatement = true
      DummyStatementKind = SelfAssignment
      ConditionalGenerating = true
      EcucBswImplementationCodeType = EcuCSourceCode
      EcuCUseStdReturnTypeForRte = false
      BswInitialization
        36 x InitFunction:
          Can_30_Mcan_Init: Header=Can_30_Mcan.h, InitPhase=INIT_TWO_DRV, ConfigType=Can_30_Mcan_ConfigType, ConfigPtrName=Can_30_Mcan_Config_Ptr, ConfigPtrClass=CAN_30_MCAN_INIT_DATA, ModuleRef=Can  # /ActiveEcuC/Can PLAIN_TEXT Init function description of Can_30_Mcan in UnfilteredViewInInvariantProject (UnfilteredInvariantProjectModelView) .
          Can_30_Mcan_InitMemory: Header=Can_30_Mcan.h, InitPhase=INIT_MEMORY, ModuleRef=Can  # /ActiveEcuC/Can PLAIN_TEXT InitMemory function description of Can_30_Mcan in UnfilteredViewInInvariantProject (UnfilteredInvariantProjectModelView) .
          CanIf_Init: Header=CanIf.h, InitPhase=INIT_TWO_IF, ConfigType=CanIf_ConfigType, ConfigPtrName=CanIf_Config_Ptr, ConfigPtrClass=CANIF_INIT_DATA, ModuleRef=CanIf  # /ActiveEcuC/CanIf PLAIN_TEXT Init function description of CanIf in UnfilteredViewInInvariantProject (UnfilteredInvariantProjectModelView) .
          CanIf_InitMemory: Header=CanIf.h, InitPhase=INIT_MEMORY, ModuleRef=CanIf  # /ActiveEcuC/CanIf PLAIN_TEXT InitMemory function description of CanIf in UnfilteredViewInInvariantProject (UnfilteredInvariantProjectModelView) .
          CanTp_Init: Header=CanTp.h, InitPhase=INIT_TWO_TP, ConfigType=CanTp_ConfigType, ConfigPtrName=CanTp_Config_Ptr, ConfigPtrClass=CANTP_INIT_DATA, ModuleRef=CanTp  # /ActiveEcuC/CanTp PLAIN_TEXT Init function description of CanTp in UnfilteredViewInInvariantProject (UnfilteredInvariantProjectModelView) .
          CanTp_InitMemory: Header=CanTp.h, InitPhase=INIT_MEMORY, ModuleRef=CanTp  # /ActiveEcuC/CanTp PLAIN_TEXT InitMemory function description of CanTp in UnfilteredViewInInvariantProject (UnfilteredInvariantProjectModelView) .
          FblCw_Init: Header=fbl_inc.h, InitPhase=INIT_THREE, ConfigType=FblCw_ConfigType, ConfigPtrName=FblCw_Config_Ptr, ConfigPtrClass=FBLCW_INIT_DATA, ModuleRef=Dcm  # /ActiveEcuC/Dcm PLAIN_TEXT Init function description of FblCw in UnfilteredViewInInvariantProject (UnfilteredInvariantProjectModelView) .
          FblCw_InitMemory: Header=fbl_inc.h, InitPhase=INIT_MEMORY, ModuleRef=Dcm  # /ActiveEcuC/Dcm PLAIN_TEXT InitMemory function description of FblCw in UnfilteredViewInInvariantProject (UnfilteredInvariantProjectModelView) .
          Det_Init: Header=Det.h, InitPhase=INIT_ZERO, ConfigType=Det_ConfigType, ConfigPtrName=Det_Config_Ptr, ConfigPtrClass=DET_INIT_DATA, ModuleRef=Det  # /ActiveEcuC/Det PLAIN_TEXT Init function description of Det in UnfilteredViewInInvariantProject (UnfilteredInvariantProjectModelView) .
          Det_InitMemory: Header=Det.h, InitPhase=INIT_MEMORY, ModuleRef=Det  # /ActiveEcuC/Det PLAIN_TEXT InitMemory function description of Det in UnfilteredViewInInvariantProject (UnfilteredInvariantProjectModelView) .
          PduR_PreInit: Header=PduR.h, InitPhase=INIT_ONE, ConfigType=PduR_PBConfigType, ConfigPtrName=PduR_Config_Ptr, ConfigPtrClass=PDUR_INIT_DATA, ModuleRef=PduR  # /ActiveEcuC/PduR PLAIN_TEXT PreInit function description of PduR in UnfilteredViewInInvariantProject (UnfilteredInvariantProjectModelView) .
          PduR_InitMemory: Header=PduR.h, InitPhase=INIT_MEMORY, ModuleRef=PduR  # /ActiveEcuC/PduR PLAIN_TEXT InitMemory function description of PduR in UnfilteredViewInInvariantProject (UnfilteredInvariantProjectModelView) .
          PduR_Init: Header=PduR.h, InitPhase=INIT_TWO_COM, ConfigType=PduR_PBConfigType, ConfigPtrName=PduR_Config_Ptr, ConfigPtrClass=PDUR_INIT_DATA, ModuleRef=PduR  # /ActiveEcuC/PduR PLAIN_TEXT Init function description of PduR in UnfilteredViewInInvariantProject (UnfilteredInvariantProjectModelView) .
          Brs_Init: Header=, InitPhase=NO_INIT, ModuleRef=vBRS  # /ActiveEcuC/vBRS PLAIN_TEXT Automatically generated by EcuCBswInitFctConfigurationService.
          vBaseEnv_Init: Header=, InitPhase=NO_INIT, ModuleRef=vBaseEnv  # /ActiveEcuC/vBaseEnv PLAIN_TEXT Created vBaseEnv_Init by Extended Init XML Service
          vLinkGen_Init: Header=vLinkGen_Lcfg.h, InitPhase=NO_INIT, ModuleRef=vLinkGen  # /ActiveEcuC/vLinkGen PLAIN_TEXT Dummy initialization of the vLinkGen
          Ea_Init: Header=Ea.h, InitPhase=INIT_TWO_IF, ModuleRef=Ea  # /ActiveEcuC/Ea PLAIN_TEXT Initialization of EEPROM Abstraction Module and its internal state machine
          Eep_30_XXi2c01_InitMemory: Header=Eep_30_XXi2c01.h, InitPhase=INIT_MEMORY, ModuleRef=Eep  # /ActiveEcuC/Eep PLAIN_TEXT Initialize memory for EEPROM driver Eep_30_XXi2c01
          Eep_30_XXi2c01_Init: Header=Eep_30_XXi2c01.h, InitPhase=INIT_TWO_DRV, ConfigType=Eep_30_XXi2c01_ConfigType, ConfigPtrName=&Eep_30_XXi2c01_Runtime, ConfigPtrClass=EEP_30_XXSPI01_PBCFG, ModuleRef=Eep  # /ActiveEcuC/Eep PLAIN_TEXT Initialization of EEPROM driver Eep_30_XXi2c01
          I2c_Init: Header=I2c.h, InitPhase=INIT_ONE, ConfigType=I2c_ConfigType, ConfigPtrName=&I2c_ConfigSet[0], ConfigPtrClass=I2C_PBCFG, ModuleRef=I2c  # /ActiveEcuC/I2c PLAIN_TEXT Initialization of the I2c
          Fee_Init: Header=Fee.h, InitPhase=INIT_TWO_IF, ModuleRef=Fee  # /ActiveEcuC/Fee PLAIN_TEXT Initialization of the FEE
          vMem_30_vXSpi_Nand_Init: Header=vMem_30_vXSpi_Nand.h, InitPhase=NO_INIT, ConfigType=vMem_30_vXSpi_Nand_ConfigType, ConfigPtrClass=VMEM_30_VXSPI_NAND_INIT_DATA, ConfigPtrName=vMem_30_vXSpi_Nand_Config_Ptr, ModuleRef=vMem_30_vXSpi_Nand  # /ActiveEcuC/vMem_30_vXSpi_Nand PLAIN_TEXT Init function description of vMem_30_vXSpi_Nand in UnfilteredViewInInvariantProject (UnfilteredInvariantProjectModelView) .
          vXSpi_Init: Header=vXSpi.h, InitPhase=INIT_TWO_DRV, ConfigType=vXSpi_ConfigType, ConfigPtrClass=VXSPI_CONST, ConfigPtrName=&vXSpi_HwConfig, ModuleRef=vXSpi  # /ActiveEcuC/vXSpi PLAIN_TEXT Initialization of vXSpi
          vXSpi_InitMemory: Header=vXSpi.h, InitPhase=INIT_MEMORY, ModuleRef=vXSpi  # /ActiveEcuC/vXSpi PLAIN_TEXT Initialization of vXSpi
          vMemAccM_Init: Header=vMemAccM.h, InitPhase=INIT_TWO_DRV, ModuleRef=vMemAccM  # /ActiveEcuC/vMemAccM PLAIN_TEXT Initializes the vMemAccM.
          vMemAccM_InitMemory: Header=vMemAccM.h, InitPhase=INIT_MEMORY, ModuleRef=vMemAccM  # /ActiveEcuC/vMemAccM PLAIN_TEXT Initializes all *_INIT_* section variables within the vMemAccM.
          WrapNv_Init: Header=WrapNv.h, InitPhase=INIT_TWO_SYS, ModuleRef=WrapNv  # /ActiveEcuC/WrapNv PLAIN_TEXT WrapNv_Init function description
          NvM_Init: Header=NvM.h, InitPhase=INIT_TWO_SYS, ModuleRef=NvM  # /ActiveEcuC/NvM PLAIN_TEXT Initialization of the NVRAM Manager, to make it ready for NvM_ReadAll being requested
          Fls_30_vMemAccM_Init: Header=Fls_30_vMemAccM.h, InitPhase=INIT_TWO_DRV, ModuleRef=Fls  # /ActiveEcuC/Fls PLAIN_TEXT Initializes the Fls_30_vMemAccM.
          CryIf_InitMemory: Header=CryIf.h, InitPhase=INIT_MEMORY, ModuleRef=CryIf  # /ActiveEcuC/CryIf PLAIN_TEXT Initializes variables of the Crypto Interface
          CryIf_Init: Header=CryIf.h, InitPhase=INIT_TWO_IF, ModuleRef=CryIf  # /ActiveEcuC/CryIf PLAIN_TEXT Initializes the Crypto Interface
          Csm_Init: Header=Csm.h, InitPhase=INIT_TWO_SYS, ModuleRef=Csm  # /ActiveEcuC/Csm PLAIN_TEXT Initializes the Crypto Service Manager
          Csm_InitMemory: Header=Csm.h, InitPhase=INIT_MEMORY, ModuleRef=Csm  # /ActiveEcuC/Csm PLAIN_TEXT Initializes variables of the Crypto Service Manager
          Crypto_30_vHsm_InitMemory: Header=Crypto_30_vHsm.h, InitPhase=INIT_MEMORY, ModuleRef=Crypto_30_vHsm  # /ActiveEcuC/Crypto_30_vHsm PLAIN_TEXT Initializes variables of the Crypto Interface
          Crypto_30_vHsm_Init: Header=Crypto_30_vHsm.h, InitPhase=INIT_TWO_DRV, ModuleRef=Crypto_30_vHsm  # /ActiveEcuC/Crypto_30_vHsm PLAIN_TEXT Initializes the Crypto Driver
          Crypto_30_vHsm_WaitForHsmRam: Header=Crypto_30_vHsm.h, InitPhase=INIT_TWO_DRV, ModuleRef=Crypto_30_vHsm
