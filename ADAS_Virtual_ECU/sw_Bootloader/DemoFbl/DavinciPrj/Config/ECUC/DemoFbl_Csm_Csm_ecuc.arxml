AUTOSAR XML (schema 00050)
package /ActiveEcuC
  module config Csm: implementation-config-variant=VARIANT-PRE-COMPILE, module-description=Csm_Impl
    CsmPrimitives_GVCS_CertStoreUpdate (CsmPrimitives)
      CsmSignatureVerify
        CsmPrimitives_GVCS_CertStoreUpdate (CsmSignatureVerifyConfig):
          CsmSignatureVerifyAlgorithmFamiliy = CRYPTO_ALGOFAM_CUSTOM
          CsmSignatureVerifyAlgorithmFamily = CRYPTO_ALGOFAM_CUSTOM
          CsmSignatureVerifyAlgorithmMode = CRYPTO_ALGOMODE_CUSTOM
          CsmSignatureVerifyAlgorithmSecondaryFamily = CRYPTO_ALGOFAM_CUSTOM
          CsmSignatureVerifyCompareLength = 256
          CsmSignatureVerifyProcessing = CSM_SYNCHRONOUS
          CsmSignatureVerifyKeyLength = 256
          CsmSignatureVerifyAlgorithmFamilyCustom = 190
          CsmSignatureVerifyAlgorithmModeCustom = 178
          CsmSignatureVerifyAlgorithmSecondaryFamilyCustom = 171
    CsmGeneral:
      CsmAsymPrivateKeyMaxLength = 32
      CsmAsymPublicKeyMaxLength = 1024
      CsmDevErrorDetect = true
      CsmMainFunctionPeriod = 0.01
      CsmSymKeyMaxLength = 16
      CsmUseDeprecated = false
      CsmVersionInfoApi = false
      CsmCallbackStartNotification = false
      CsmCancelationDuringProcessing = false
      CsmSafeBswChecks = false
      CsmCustomIncludeFiles = Crypto_30_vHsm_Custom.h
      CsmJobTypeLayout:
        CsmJobTypeLayoutAsr430Compatibility = true
        CsmJobTypeLayoutVarMembers = false
        CsmJobTypeLayoutInput64 = false
        CsmJobTypeLayoutOutput64Ptr = false
        CsmJobTypeLayoutRedirectionInfoRef = false
    CsmKeys
      9 x CsmKey, all with CsmKeyUsePort=false:
        CsmKey_Random: CsmKeyId=2, CsmKeyRef=CryIfKey_Random
        CsmKey_KeyMCertificate_ADA_L4: CsmKeyId=1, CsmKeyRef=CryIfKey_CryIfKey_KeyMCertificate_ADA_L4
        CsmKey_RoleFlag: CsmKeyId=3, CsmKeyRef=CryIfKey_CryIfKey_RoleFlag
        CsmKey_RsaSignatureVerifyKey_ADA_L4: CsmKeyId=4, CsmKeyRef=CryIfKey_CryIfKey_RsaSignatureVerifyKey_ADA_L4
        CsmKey_RsaSignatureVerifyKey_CodeSign_App_L4: CsmKeyId=5, CsmKeyRef=CryIfKey_CryIfKey_RsaSignatureVerifyKey_CodeSign_App_L4
        CsmKey_Sha256Result: CsmKeyId=8, CsmKeyRef=CryIfKey_CryIfKey_Sha256Result
        CsmKey_SecureLog: CsmKeyId=7, CsmKeyRef=CryIfKey_SecureLog
        CsmKey_SecondCounter: CsmKeyId=6, CsmKeyRef=CryIfKey_CryIfKey_SecondCounter
        CsmKey_CurrentTimeStamp: CsmKeyId=0, CsmKeyRef=CryIfKey_CryIfKey_CurrentTimeStamp
    CsmJobs
      9 x CsmJob, all with CsmJobPriority=0, CsmJobUsePort=false, CsmProcessingMode=CRYPTO_PROCESSING_SYNC, CsmJobInterfaceUsePort=CRYPTO_USE_FNC:
        CsmJob_GVCS_UpdateCertStore: CsmJobId=3, CsmJobKeyRef=CsmKey_RsaSignatureVerifyKey_CodeSign_App_L4, CsmJobPrimitiveRef=Csm/CsmPrimitives_GVCS_CertStoreUpdate, CsmJobQueueRef=CsmQueue_Crypto30_vHsm_GVCS
        CsmJob_TRNGGen: CsmJobId=8, CsmJobKeyRef=CsmKey_Random, CsmJobPrimitiveRef=Csm/CsmPrimitives_CsmTrng, CsmJobQueueRef=CsmQueue_Crypto30_vHsm_Hal
        CsmJob_SignatureVerify_ADA: CsmJobId=7, CsmJobPrimitiveCallbackUpdateNotification=false, CsmJobServiceInterfaceContextUsePort=CRYPTO_USE_FUNC, CsmJobKeyRef=CsmKey_RsaSignatureVerifyKey_ADA_L4, CsmJobPrimitiveRef=Csm/CsmPrimitives_CsmSignatureVerify, CsmJobQueueRef=CsmQueue_Crypto30_vHsm_LibCv
        CsmJob_GetRoleFromTesterCertificate: CsmJobId=4, CsmJobKeyRef=CsmKey_KeyMCertificate_ADA_L4, CsmJobPrimitiveRef=Csm/CsmAEADEncryptConfig, CsmJobQueueRef=CsmQueue_vHsm_KeyMRemote
        CsmJob_Fca_HeaderVerify: CsmJobId=2, CsmJobKeyRef=CsmKey_RsaSignatureVerifyKey_CodeSign_App_L4, CsmJobPrimitiveRef=Csm/CsmPrimitives_Fca_HeaderVerify, CsmJobQueueRef=CsmQueue_Crypto30_vHsm_GVCS
        CsmJob_CalculateHash: CsmJobId=1, CsmJobPrimitiveRef=Csm/CsmPrimitives_CsmHash, CsmJobQueueRef=CsmQueue_Crypto30_vHsm_Hal, CsmJobKeyRef=CsmKey_Sha256Result
        CsmJob_MacGenerate: CsmJobId=5, CsmJobServiceInterfaceContextUsePort=CRYPTO_USE_FUNC, CsmJobKeyRef=CsmKey_SecureLog, CsmJobPrimitiveRef=Csm/CsmPrimitives_CsmMacGenerate, CsmJobQueueRef=CsmQueue_Crypto30_vHsm_LibCv
        CsmJob_MacVerify: CsmJobId=6, CsmJobKeyRef=CsmKey_SecureLog, CsmJobPrimitiveRef=Csm/CsmPrimitives_CsmMacVerify, CsmJobQueueRef=CsmQueue_Crypto30_vHsm_LibCv
        CsmJob_ReadDCLEntries: CsmJobId=0, CsmJobKeyRef=CsmKey_Random, CsmJobPrimitiveRef=Csm/CsmPrimitives_ReadDCLEntries, CsmJobQueueRef=CsmQueue_vHsm_Custom
    CsmPrimitives_CsmSignatureVerify (CsmPrimitives)
      CsmSignatureVerify
        CsmPrimitives_CsmSignatureVerify (CsmSignatureVerifyConfig):
          CsmSignatureVerifyAlgorithmFamiliy = CRYPTO_ALGOFAM_RSA
          CsmSignatureVerifyAlgorithmFamily = CRYPTO_ALGOFAM_RSA
          CsmSignatureVerifyAlgorithmMode = CRYPTO_ALGOMODE_RSASSA_PKCS1_v1_5
          CsmSignatureVerifyAlgorithmSecondaryFamily = CRYPTO_ALGOFAM_SHA2_256
          CsmSignatureVerifyCompareLength = 256
          CsmSignatureVerifyProcessing = CSM_SYNCHRONOUS
          CsmSignatureVerifyKeyLength = 256
    CsmQueues
      5 x CsmQueue, all with CsmQueueSize=1, CsmTriggerAsynchJobsInCallback=false, CsmJobSharing=true:
        CsmQueue_Crypto30_vHsm_LibCv: CsmChannelRef=CryIfChannel_vHsm_LibCv
        CsmQueue_Crypto30_vHsm_Hal: CsmChannelRef=CryIfChannel_Hal
        CsmQueue_vHsm_KeyMRemote: CsmChannelRef=CryIfChannel_vHsm_KeyMRemote
        CsmQueue_Crypto30_vHsm_GVCS: CsmChannelRef=CryIfChannel_vHsm_GVCS
        CsmQueue_vHsm_Custom: CsmChannelRef=CryIfChannel_vHsm_Custom
    7 x CsmPrimitives:
      CsmPrimitives_CsmHash
        CsmHash
          CsmPrimitives_CsmHash (CsmHashConfig):
            CsmHashAlgorithmFamiliy = CRYPTO_ALGOFAM_SHA2_256
            CsmHashAlgorithmFamily = CRYPTO_ALGOFAM_SHA2_256
            CsmHashAlgorithmMode = CRYPTO_ALGOMODE_NOT_SET
            CsmHashAlgorithmSecondaryFamily = CRYPTO_ALGOFAM_NOT_SET
            CsmHashProcessing = CSM_SYNCHRONOUS
            CsmHashResultLength = 32
      CsmPrimitives_CsmTrng
        CsmRandomGenerate
          CsmPrimitives_CsmTrng (CsmRandomGenerateConfig):
            CsmRandomGenerateAlgorithmFamiliy = CRYPTO_ALGOFAM_RNG
            CsmRandomGenerateAlgorithmFamily = CRYPTO_ALGOFAM_RNG
            CsmRandomGenerateAlgorithmMode = CRYPTO_ALGOMODE_NOT_SET
            CsmRandomGenerateAlgorithmSecondaryFamily = CRYPTO_ALGOFAM_NOT_SET
            CsmRandomGenerateProcessing = CSM_SYNCHRONOUS
            CsmRandomGenerateResultLength = 32
      CsmPrimitives_CsmMacGenerate
        CsmMacGenerate
          CsmPrimitives_CsmMacGenerate (CsmMacGenerateConfig):
            CsmMacGenerateAlgorithmFamiliy = CRYPTO_ALGOFAM_AES
            CsmMacGenerateAlgorithmFamily = CRYPTO_ALGOFAM_AES
            CsmMacGenerateAlgorithmKeyLength = 16
            CsmMacGenerateAlgorithmMode = CRYPTO_ALGOMODE_CMAC
            CsmMacGenerateAlgorithmSecondaryFamily = CRYPTO_ALGOFAM_NOT_SET
            CsmMacGenerateProcessing = CSM_SYNCHRONOUS
            CsmMacGenerateResultLength = 16
      CsmPrimitives_CsmMacVerify
        CsmMacVerify
          CsmPrimitives_CsmMacVerify (CsmMacVerifyConfig):
            CsmMacVerifyAlgorithmFamiliy = CRYPTO_ALGOFAM_AES
            CsmMacVerifyAlgorithmFamily = CRYPTO_ALGOFAM_AES
            CsmMacVerifyAlgorithmSecondaryFamily = CRYPTO_ALGOFAM_NOT_SET
            CsmMacVerifyCompareLength = 16
            CsmMacVerifyProcessing = CSM_SYNCHRONOUS
            CsmMacVerifyAlgorithmMode = CRYPTO_ALGOMODE_CMAC
            CsmMacVerifyAlgorithmKeyLength = 16
      CsmAEADEncryptConfig
        CsmAEADEncrypt
          CsmAEADEncryptConfig:
            CsmAEADEncryptAlgorithmFamiliy = CRYPTO_ALGOFAM_CUSTOM
            CsmAEADEncryptAlgorithmFamily = CRYPTO_ALGOFAM_CUSTOM
            CsmAEADEncryptAlgorithmKeyLength = 16
            CsmAEADEncryptAlgorithmMode = CRYPTO_ALGOMODE_CUSTOM
            CsmAEADEncryptProcessing = CSM_SYNCHRONOUS
            CsmAEADEncryptTagLength = 4
            CsmAEADEncryptAlgorithmSecondaryFamily = CRYPTO_ALGOFAM_NOT_SET
            CsmAEADEncryptKeyRef = CsmKey_KeyMCertificate_ADA_L4
            CsmAEADEncryptAlgorithmModeCustomRef = Crypto_30_vHsm_KeyM_CertElementGet
            CsmAEADEncryptAlgorithmFamilyCustomRef = Crypto_30_vHsm_KeyM_vHsm_KeyM
      CsmPrimitives_Fca_HeaderVerify
        CsmSignatureVerify
          CsmPrimitives_Fca_HeaderVerify (CsmSignatureVerifyConfig):
            CsmSignatureVerifyAlgorithmFamiliy = CRYPTO_ALGOFAM_CUSTOM
            CsmSignatureVerifyAlgorithmFamily = CRYPTO_ALGOFAM_CUSTOM
            CsmSignatureVerifyAlgorithmMode = CRYPTO_ALGOMODE_CUSTOM
            CsmSignatureVerifyAlgorithmSecondaryFamily = CRYPTO_ALGOFAM_CUSTOM
            CsmSignatureVerifyCompareLength = 256
            CsmSignatureVerifyProcessing = CSM_SYNCHRONOUS
            CsmSignatureVerifyKeyLength = 256
            CsmSignatureVerifyAlgorithmFamilyCustom = 190
            CsmSignatureVerifyAlgorithmModeCustom = 178
            CsmSignatureVerifyAlgorithmSecondaryFamilyCustom = 170
      CsmPrimitives_ReadDCLEntries
        CsmRandomGenerate
          CsmPrimitives_ReadDCLEntries (CsmRandomGenerateConfig):
            CsmRandomGenerateAlgorithmFamiliy = CRYPTO_ALGOFAM_CUSTOM
            CsmRandomGenerateAlgorithmFamily = CRYPTO_ALGOFAM_CUSTOM
            CsmRandomGenerateAlgorithmMode = CRYPTO_ALGOMODE_CUSTOM
            CsmRandomGenerateAlgorithmSecondaryFamily = CRYPTO_ALGOFAM_NOT_SET
            CsmRandomGenerateProcessing = CSM_SYNCHRONOUS
            CsmRandomGenerateResultLength = 1536
            CsmRandomGenerateAlgorithmFamilyCustom = CRYPTO_ALGOFAM_CUSTOM
            CsmRandomGenerateAlgorithmModeCustom = CRYPTO_ALGOMODE_CUSTOM
