AUTOSAR XML (schema 00050)
package /ActiveEcuC
  module config FblHal: implementation-config-variant=VARIANT-LINK-TIME, module-description=FblHal_Impl
    FblHalGeneral:
      FblHalFlashCodeBufferSize = 4
      FblHalDerivativeSpecificDefines = #define V_COMP_LLVMTI
      FblHalDerivativeSpecificDefines = #define V_CPU_JACINTO7
      FblHalDerivativeSpecificDefines = #define V_COMP_LLVMTI_JACINTO7
      FblHalDerivativeSpecificDefines = #define C_CPUTYPE_32BIT
      FblHalDerivativeSpecificDefines = #define VGEN_ENABLE_CANFBL
      FblHalDerivativeSpecificDefines = #define V_SUPPRESS_EXTENDED_VERSION_CHECK
      FblHalDerivativeSpecificDefines = #define C_CPUTYPE_LITTLEENDIAN
      FblHalDerivativeSpecificDefines = #define V_DEF_SUPPORTED_PLATFORM
      FblHalDerivativeSpecificDefines = #define FBL_TIMER_MCU_BASE 0x40400000uL
      FblHalDerivativeSpecificDefines = #define FBL_TIMER_MAIN_BASE 0x02400000uL
      FblHalDerivativeSpecificDefines = #define FBL_GPIO_BASE 0x00600000uL
      FblHalDerivativeSpecificDefines = #define FBL_SFR_BASE_ADRESSES_PRECONFIGURED
      FblHalECCSafeRead = false
      FblHalTimerClockFreq = 19200000
      FblHalTimerClockRef = McuClockReferencePoint_Timer
