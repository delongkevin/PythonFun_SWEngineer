AUTOSAR XML (schema 00050)
package /ActiveEcuC
  module config PduR: implementation-config-variant=VARIANT-PRE-COMPILE, module-description=PduR_Impl
    PduRGeneral:
      PduRVersionInfoApi = false
      PduRDevErrorDetect = true
      PduRMetaDataSupport = false
      PduRPduCallback = false
      PduRSwitching = false
      PduRSafeBswChecks = false
      PduREnableDeferredTransmission = false
      PduREnableDeferredReception = false
      PduRSupportMulticore = false
      PduRRoutingTypeGateway = false
      PduRSpinlockRetryCounter = 4294967295
      PduRExtendedErrorChecks = false
      PduRGeneration:
        PduROutOfBoundsWriteProtectionStrategy = NONE
        PduROutOfBoundsWriteSanitizer = false
        PduROutOfBoundsReadSanitizer = false
        PduRNumericalDataTypeMinimizationStrategy = WITH_CAST
        PduRReduceConstantData2Define = false
        PduRBoolDataInArrayOfStructStrategy = BITMASKING
        PduRDeduplicateIndirectedData = true
        PduRDataDeduplicationStrategy = WITH_CAST
        PduRReduceBoolDataByNegationThreshold = 2
        PduRReduceBoolDataByNumericalComparisonThreshold = 2
        PduRReduceBoolDataByNumericalRelationThreshold = 2
        PduRReduceBoolDataByNumericalOperandStrategy = WITH_ANY_VALUE
        PduRReduceNumericalDataByOffsetThreshold = 2
        PduRReduceNumericalDataByArraySubtractionThreshold = 2
        PduRReduceDataByStreaming = false
        PduRShortSymbols = false
        PduRInterfacesForDeactivatedData = false
        PduRReferringKeysInComments = false
    PduRRoutingTables: PduRConfigurationId=0
      PduRRoutingTable
        6 x PduRRoutingPath, all with PduRRoutingPathCommunicationType=TRANSPORT_PROTOCOL, PduRMulticoreRoutingPath=false, PduRLockRef=PduRLock_PduRExclusiveArea:
          Demo_0_CAN_20_Response_oDemoFBL_Vector_SLP3_aa44c06b_Tx  # Demo_0_CAN_Response_oDemoFBL_Vector_SLP3
            PduRSrcPdu_69f814f0 (PduRSrcPdu):
              PduRSourcePduHandleId = 0
              PduRSrcPduDirection = TRANSMIT
              PduRSrcPduRef = Demo_0_CAN_20_Response_oDemoFBL_Vector_SLP3_aa44c06b_Tx
              PduRSrcPduPduRBswModulesRef = Dcm
            Demo_0_CAN_Response_oDemoFBL_Vector_SLP3_366a5b38_Tx (PduRDestPdu):
              PduRDestPduHandleId = 0
              PduRDestPduDirection = TRANSMIT
              PduRDestPduRoutingType = API_FORWARDING
              PduRDestPduDataProcessing = IMMEDIATE
              PduRPduLengthHandlingStrategy = UNUSED
              PduRDestPduCrossPartitionDestination = false
              PduRDestPduRef = Demo_0_CAN_20_Response_oDemoFBL_Vector_SLP3_366a5b38_Tx
              PduRDestPduPduRBswModulesRef = CanTp
          Functional_CAN_20_oDemoFBL_Vector_SLP3_a93996e4_Rx  # Functional_CAN_oDemoFBL_Vector_SLP3
            Functional_CAN_oDemoFBL_Vector_SLP3_a93996e4_Rx_7d577bc2_Rx (PduRDestPdu):
              PduRDestPduHandleId = 2
              PduRDestPduDirection = RECEIVE
              PduRDestPduRoutingType = API_FORWARDING
              PduRDestPduDataProcessing = IMMEDIATE
              PduRPduLengthHandlingStrategy = UNUSED
              PduRDestPduCrossPartitionDestination = false
              PduRDestPduRef = Functional_CAN_20_oDemoFBL_Vector_SLP3_3a497ac1_Rx
              PduRDestPduPduRBswModulesRef = Dcm
            PduRSrcPdu_7d577bc2 (PduRSrcPdu):
              PduRSourcePduHandleId = 2
              PduRSrcPduDirection = RECEIVE
              PduRSrcPduRef = Functional_CAN_20_oDemoFBL_Vector_SLP3_a93996e4_Rx
              PduRSrcPduPduRBswModulesRef = CanTp
          Demo_0_CAN_20_Request_oDemoFBL_Vector_SLP3_d449ce03_Rx  # Demo_0_CAN_Request_oDemoFBL_Vector_SLP3
            PduRSrcPdu_af53cbd5 (PduRSrcPdu):
              PduRSourcePduHandleId = 0
              PduRSrcPduDirection = RECEIVE
              PduRSrcPduRef = Demo_0_CAN_20_Request_oDemoFBL_Vector_SLP3_d449ce03_Rx
              PduRSrcPduPduRBswModulesRef = CanTp
            Demo_0_CAN_Request_oDemoFBL_Vector_SLP3_d449ce03_Rx_af53cbd5_Rx (PduRDestPdu):
              PduRDestPduHandleId = 0
              PduRDestPduDirection = RECEIVE
              PduRDestPduRoutingType = API_FORWARDING
              PduRDestPduDataProcessing = IMMEDIATE
              PduRPduLengthHandlingStrategy = UNUSED
              PduRDestPduCrossPartitionDestination = false
              PduRDestPduRef = Demo_0_CAN_20_Request_oDemoFBL_Vector_SLP3_51500fe6_Rx
              PduRDestPduPduRBswModulesRef = Dcm
          Functional_CAN_FD_oDemoFBL_Fca_SLP5_a6dc7e27_Rx
            Functional_CAN_FD_oDemoFBL_Fca_SLP5_a6dc7e27_Rx_c6d69dfd_Rx (PduRDestPdu):
              PduRDestPduHandleId = 3
              PduRDestPduDirection = RECEIVE
              PduRDestPduRoutingType = API_FORWARDING
              PduRDestPduDataProcessing = IMMEDIATE
              PduRPduLengthHandlingStrategy = UNUSED
              PduRDestPduCrossPartitionDestination = false
              PduRDestPduRef = Functional_CAN_FD_oDemoFBL_Fca_SLP5_b4f709e0_Rx
              PduRDestPduPduRBswModulesRef = Dcm
            PduRSrcPdu_c6d69dfd (PduRSrcPdu):
              PduRSourcePduHandleId = 3
              PduRSrcPduDirection = RECEIVE
              PduRSrcPduRef = Functional_CAN_FD_oDemoFBL_Fca_SLP5_a6dc7e27_Rx
              PduRSrcPduPduRBswModulesRef = CanTp
          Demo_0_CAN_FD_Request_oDemoFBL_Fca_SLP5_e6d1155f_Rx
            Demo_0_CAN_FD_Request_oDemoFBL_Fca_SLP5_e6d1155f_Rx_6253e517_Rx (PduRDestPdu):
              PduRDestPduHandleId = 1
              PduRDestPduDirection = RECEIVE
              PduRDestPduRoutingType = API_FORWARDING
              PduRDestPduDataProcessing = IMMEDIATE
              PduRPduLengthHandlingStrategy = UNUSED
              PduRDestPduCrossPartitionDestination = false
              PduRDestPduRef = Demo_0_CAN_FD_Request_oDemoFBL_Fca_SLP5_888d0879_Rx
              PduRDestPduPduRBswModulesRef = Dcm
            PduRSrcPdu_6253e517 (PduRSrcPdu):
              PduRSourcePduHandleId = 1
              PduRSrcPduDirection = RECEIVE
              PduRSrcPduRef = Demo_0_CAN_FD_Request_oDemoFBL_Fca_SLP5_e6d1155f_Rx
              PduRSrcPduPduRBswModulesRef = CanTp
          Demo_0_CAN_FD_Response_oDemoFBL_Fca_SLP5_3c1da0e3_Tx
            Demo_0_CAN_FD_Response_oDemoFBL_Fca_SLP5_55a79f5b_Tx (PduRDestPdu):
              PduRDestPduHandleId = 1
              PduRDestPduDirection = TRANSMIT
              PduRDestPduRoutingType = API_FORWARDING
              PduRDestPduDataProcessing = IMMEDIATE
              PduRPduLengthHandlingStrategy = UNUSED
              PduRDestPduCrossPartitionDestination = false
              PduRDestPduRef = Demo_0_CAN_FD_Response_oDemoFBL_Fca_SLP5_55a79f5b_Tx
              PduRDestPduPduRBswModulesRef = CanTp
            PduRSrcPdu_0362c344 (PduRSrcPdu):
              PduRSourcePduHandleId = 1
              PduRSrcPduDirection = TRANSMIT
              PduRSrcPduRef = Demo_0_CAN_FD_Response_oDemoFBL_Fca_SLP5_3c1da0e3_Tx
              PduRSrcPduPduRBswModulesRef = Dcm
      PduRLock_PduRExclusiveArea (PduRLock)
        PduRExclusiveArea: PduRExclusiveAreaId=0
    CanTp (PduRBswModules):
      PduRCancelReceive = false
      PduRCancelTransmit = false
      PduRChangeParameterRequestApi = false
      PduRCommunicationInterface = false
      PduRLowerModule = true
      PduRTransportProtocol = true
      PduRTriggertransmit = false
      PduRTxConfirmation = false
      PduRUpperModule = false
      PduRUseTag = false
      PduRBswModuleRef = CanTp
    Dcm (PduRBswModules):
      PduRCancelReceive = false
      PduRCancelTransmit = false
      PduRChangeParameterRequestApi = false
      PduRCommunicationInterface = false
      PduRLowerModule = false
      PduRTransportProtocol = true
      PduRTriggertransmit = false
      PduRTxConfirmation = false
      PduRUpperModule = true
      PduRUseTag = true
      PduRBswModuleRef = Dcm
