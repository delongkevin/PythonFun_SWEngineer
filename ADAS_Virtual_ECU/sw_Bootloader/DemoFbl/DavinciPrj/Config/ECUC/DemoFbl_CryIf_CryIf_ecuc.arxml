AUTOSAR XML (schema 00050)
package /ActiveEcuC
  module config CryIf: implementation-config-variant=VARIANT-PRE-COMPILE, module-description=CryIf_Impl
    CryIfGeneral:
      CryIfDevErrorDetect = true
      CryIfVersionInfoApi = false
      CryIfMaxNumberOfKeyElements = 10
      CryIfMaxSizeOfKeyElement = 32
      CryIfRedirection = false
      CryIfSafeBswChecks = false
    CryIfKey_Random (CryIfKey): CryIfKeyId=8, CryIfKeyRef=Random
    CryIfKey_Mac_Crypto_30_vHsm (CryIfKey): CryIfKeyId=7, CryIfKeyRef=StartApplication_CryptoKey_vHsm_MAC
    CryIfChannel_Hal (CryIfChannel): CryIfChannelId=1, CryIfDriverObjectRef=Crypto_30_vHsm_Hal
    Crypto_30_vHsm (CryIfCryptoModule): CryIfSupportsKeyElementCopyPartial=true, CryIfCancelJobApiUsesJobType=true, CryIfCryptoModuleRef=Crypto_30_vHsm
    3 x CryIfKey:
      CryIfKey_CryIfKey_KeyMCertificate_ADA_L4: CryIfKeyId=1, CryIfKeyRef=CryIfKey_KeyMCertificate_ADA_L4
      CryIfKey_CryIfKey_RoleFlag: CryIfKeyId=2, CryIfKeyRef=CryIfKey_RoleFlag
      CryIfKey_CryIfKey_RsaSignatureVerifyKey_ADA_L4: CryIfKeyId=3, CryIfKeyRef=CryIfKey_RsaSignatureVerifyKey_ADA_L4
    4 x CryIfChannel:
      CryIfChannel_vHsm_Core: CryIfChannelId=2, CryIfDriverObjectRef=Crypto_30_vHsm_Core
      CryIfChannel_vHsm_KeyMRemote: CryIfChannelId=4, CryIfDriverObjectRef=Crypto_30_vHsm_KeyMRemote
      CryIfChannel_vHsm_LibCv: CryIfChannelId=5, CryIfDriverObjectRef=Crypto_30_vHsm_LibCv
      CryIfChannel_vHsm_GVCS: CryIfChannelId=3, CryIfDriverObjectRef=Crypto_30_vHsm_GVCS
    5 x CryIfKey:
      CryIfKey_CryIfKey_RsaSignatureVerifyKey_CodeSign_App_L4: CryIfKeyId=4, CryIfKeyRef=CryIfKey_RsaSignatureVerifyKey_CodeSign_App_L4
      CryIfKey_CryIfKey_Sha256Result: CryIfKeyId=6, CryIfKeyRef=CryIfKey_Sha256Result
      CryIfKey_SecureLog: CryIfKeyId=9, CryIfKeyRef=CryIfKey_UserSecureLog_Key
      CryIfKey_CryIfKey_SecondCounter: CryIfKeyId=5, CryIfKeyRef=CryIfKey_SecondCounter
      CryIfKey_CryIfKey_CurrentTimeStamp: CryIfKeyId=0, CryIfKeyRef=CryIfKey_CurrentTimeStamp
    CryIfChannel_vHsm_Custom (CryIfChannel): CryIfChannelId=0, CryIfDriverObjectRef=Crypto_30_vHsm_Custom
