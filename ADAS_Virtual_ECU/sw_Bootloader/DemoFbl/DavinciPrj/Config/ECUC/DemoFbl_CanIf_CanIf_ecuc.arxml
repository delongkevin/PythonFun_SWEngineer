AUTOSAR XML (schema 00050)
package /ActiveEcuC
  module config CanIf: implementation-config-variant=VARIANT-PRE-COMPILE, module-description=CanIf_Impl
    CanIfCtrlDrvCfg_7d254554 (CanIfCtrlDrvCfg): CanIfCtrlDrvTxCancellation=false, CanIfCtrlDrvInitHohConfigRef=CanIfInitHohCfg, CanIfCtrlDrvNameRef=CanGeneral
      CT_DemoFBL_Vector_SLP3_d34c962b (CanIfCtrlCfg): CanIfCtrlId=0, CanIfCtrlWakeupSupport=false, CanIfCtrlJ1939DynAddrSupport=DISABLED, CanIfCtrlCanCtrlRef=CT_DemoFBL_Vector_SLP3_d34c962b
    CanIfDispatchCfg:
      CanIfDispatchUserCtrlBusOffName = FblCw_ControllerBusOff
      CanIfDispatchUserCtrlBusOffUL = CDD
      CanIfDispatchUserCtrlModeIndicationName = FblCw_ControllerModeIndication
      CanIfDispatchUserCtrlModeIndicationUL = CDD
    CanIfInitCfg
      CHNL_3b54cc70 (CanIfBufferCfg):
        CanIfBufferSize = 2
        CanIfTxBufferHandlingType = PRIO_BY_CANID
        CanIfTxBufferMappedTxPdus = 2
        CanIfTxBufferMaxPduLength = 64
        CanIfBufferHthRef = CN_DemoFBL_Vector_SLP3_599e8ccc_Tx
      Demo_0_CAN_20_Request_Tp_oDemoFBL_Vector_SLP3_cac44394_Rx (CanIfRxPduCfg):  # Demo_0_CAN_Request_Tp_oDemoFBL_Vector_SLP3
        CanIfRxPduCanId = 416981233
        CanIfRxPduCanIdType = EXTENDED_NO_FD_CAN
        CanIfRxPduDlc = 8
        CanIfRxPduUserRxIndicationName = CanTp_RxIndication
        CanIfRxPduUserRxIndicationType = PDUID_PDUINFOPTR
        CanIfRxPduUserRxIndicationUL = CAN_TP
        CanIfRxPduId = 3
        CanIfRxPduReadData = false
        CanIfRxPduReadNotifyStatus = false
        CanIfRxPduDlcCheck = false
        CanIfRxPduHrhIdRef = CN_DemoFBL_Vector_SLP3_36153a3c_Rx
        CanIfRxPduRef = Demo_0_CAN_20_Request_Tp_oDemoFBL_Vector_SLP3_3a7abdec_Rx
      Demo_0_CAN_20_Response_Tp_oDemoFBL_Vector_SLP3_598c37f0_Tx (CanIfTxPduCfg):  # Demo_0_CAN_Response_Tp_oDemoFBL_Vector_SLP3
        CanIfTxPduCanId = 417001888
        CanIfTxPduCanIdType = EXTENDED_CAN
        CanIfTxPduDlc = 8
        CanIfTxPduUserTxConfirmationName = CanTp_TxConfirmation
        CanIfTxPduUserTxConfirmationUL = CAN_TP
        CanIfTxPduId = 1
        CanIfTxPduReadNotifyStatus = false
        CanIfTxPduType = STATIC
        CanIfTxPduTruncation = true
        CanIfTxPduBufferRef = CHNL_3b54cc70
        CanIfTxPduRef = Demo_0_CAN_20_Response_Tp_oDemoFBL_Vector_SLP3_bc15b852_Tx
      CanIfInitHohCfg: CanIfInitRefCfgSet=CanConfigSet
        CN_DemoFBL_Vector_SLP3_36153a3c_Rx (CanIfHrhCfg): CanIfHrhSoftwareFilter=true, CanIfHrhCanCtrlIdRef=CT_DemoFBL_Vector_SLP3_d34c962b, CanIfHrhIdSymRef=CN_DemoFBL_Vector_SLP3_36153a3c_Rx
        CN_DemoFBL_Vector_SLP3_599e8ccc_Tx (CanIfHthCfg): CanIfHthCanCtrlIdRef=CT_DemoFBL_Vector_SLP3_d34c962b, CanIfHthIdSymRef=CN_DemoFBL_Vector_SLP3_599e8ccc_Tx
      Functional_CAN_20_Tp_oDemoFBL_Vector_SLP3_1fcf9f08_Rx (CanIfRxPduCfg):  # Functional_CAN_Tp_oDemoFBL_Vector_SLP3
        CanIfRxPduCanId = 417070833
        CanIfRxPduCanIdType = EXTENDED_NO_FD_CAN
        CanIfRxPduDlc = 8
        CanIfRxPduUserRxIndicationName = CanTp_RxIndication
        CanIfRxPduUserRxIndicationType = PDUID_PDUINFOPTR
        CanIfRxPduUserRxIndicationUL = CAN_TP
        CanIfRxPduId = 1
        CanIfRxPduReadData = false
        CanIfRxPduReadNotifyStatus = false
        CanIfRxPduDlcCheck = false
        CanIfRxPduHrhIdRef = CN_DemoFBL_Vector_SLP3_36153a3c_Rx
        CanIfRxPduRef = Functional_CAN_20_Tp_oDemoFBL_Vector_SLP3_b4b0ddd4_Rx
      Demo_0_CAN_FD_Response_Tp_oDemoFBL_Fca_SLP5_7e3956da_Tx (CanIfTxPduCfg):
        CanIfTxPduCanId = 417002144
        CanIfTxPduCanIdType = EXTENDED_FD_CAN
        CanIfTxPduDlc = 64
        CanIfTxPduId = 0
        CanIfTxPduReadNotifyStatus = false
        CanIfTxPduType = STATIC
        CanIfTxPduUserTxConfirmationUL = CAN_TP
        CanIfTxPduTruncation = true
        CanIfTxPduUserTxConfirmationName = CanTp_TxConfirmation
        CanIfTxPduBufferRef = CHNL_3b54cc70
        CanIfTxPduRef = Demo_0_CAN_FD_Response_Tp_oDemoFBL_Fca_SLP5_370a354e_Tx
      Demo_0_CAN_FD_Request_Tp_oDemoFBL_Fca_SLP5_68bd9369_Rx (CanIfRxPduCfg):
        CanIfRxPduCanIdType = EXTENDED_FD_CAN
        CanIfRxPduDlc = 64
        CanIfRxPduId = 2
        CanIfRxPduReadData = false
        CanIfRxPduReadNotifyStatus = false
        CanIfRxPduUserRxIndicationName = CanTp_RxIndication
        CanIfRxPduUserRxIndicationUL = CAN_TP
        CanIfRxPduDlcCheck = false
        CanIfRxPduCanId = 416981234
        CanIfRxPduUserRxIndicationType = PDUID_PDUINFOPTR
        CanIfRxPduHrhIdRef = CN_DemoFBL_Vector_SLP3_36153a3c_Rx
        CanIfRxPduRef = Demo_0_CAN_FD_Request_Tp_oDemoFBL_Fca_SLP5_480939e9_Rx
      Functional_CAN_FD_Tp_oDemoFBL_Fca_SLP5_1bf053ab_Rx (CanIfRxPduCfg):
        CanIfRxPduCanIdType = EXTENDED_FD_CAN
        CanIfRxPduDlc = 64
        CanIfRxPduId = 0
        CanIfRxPduReadData = false
        CanIfRxPduReadNotifyStatus = false
        CanIfRxPduUserRxIndicationName = CanTp_RxIndication
        CanIfRxPduUserRxIndicationUL = CAN_TP
        CanIfRxPduDlcCheck = false
        CanIfRxPduCanId = 417070834
        CanIfRxPduUserRxIndicationType = PDUID_PDUINFOPTR
        CanIfRxPduHrhIdRef = CN_DemoFBL_Vector_SLP3_36153a3c_Rx
        CanIfRxPduRef = Functional_CAN_FD_Tp_oDemoFBL_Fca_SLP5_ea53ce90_Rx
    CanIfPrivateCfg:
      CanIfPrivateSoftwareFilterType = LINEAR
      CanIfPrivateDlcCheck = false
      CanIfSupportTTCAN = false
      CanIfTransceiverMapping = false
      CanIfTransceiverHandling = false
      CanIfSupportExtendedIds = true
      CanIfSupportNmOsek = false
      CanIfTxBufferType = BYTE_QUEUE
      CanIfWakeupSupport = false
      CanIfStaticFdTxBufferSupport = true
      CanIfRxSearchConsiderMsgType = true
      CanIfTxBufferFifoSupport = false
      CanIfSetPduReceptionModeSupport = false
      CanIfCheckWakeupCanRetType = false
      CanIfDataChecksumRxSupport = false
      CanIfDataChecksumTxSupport = false
    CanIfPublicCfg:
      CanIfPublicPnSupport = false
      CanIfPublicCddHeaderFile = CanIf_Cdd.h
      CanIfPublicVersionInfoApi = false
      CanIfPublicCancelTransmitSupport = false
      CanIfPublicDevErrorDetect = true
      CanIfPublicHandleTypeEnum = UINT8
      CanIfPublicMultipleDrvSupport = false
      CanIfPublicNumberOfCanHwUnits = 1
      CanIfPublicReadRxPduDataApi = false
      CanIfPublicReadRxPduNotifyStatusApi = false
      CanIfPublicReadTxPduNotifyStatusApi = false
      CanIfPublicSetDynamicTxIdApi = false
      CanIfPublicTxBuffering = true
      CanIfPublicTxConfirmPollingSupport = false
      CanIfPublicWakeupCheckValidSupport = false
      CanIfPnWakeupTxPduFilterSupport = false
      CanIfPnTrcvHandlingSupport = false
      CanIfJ1939DynAddrSupport = DISABLED
      CanIfSafeBswChecks = false
      CanIfBusMirroringSupport = false
      CanIfEnableSecurityEventReporting = false
      CanIfSupportCanDrvAsr440 = false
      CanIfPublicChangeBaudrateSupport = true
      CanIfSetBaudrateApi = false
      CanIfSupportMultipartition = false
