AUTOSAR XML (schema 00050)
package /ActiveEcuC
  module config vLinkGen: implementation-config-variant=VARIANT-PRE-COMPILE, module-description=vLinkGen_Impl
    vLinkGenMemLayout
      MasterSatelliteSharedRamGroup (vLinkGenLogicalVarGroup):
        vLinkGenVarGroupPosition = 5
        vLinkGenVarGroupInitCore = 0
        vLinkGenVarGroupRegion = IPCRAM_BMStack
        vLinkGenVarGroupContentType = SHARED_DATA
        vLinkGenVarGroupRomRegion = FblCodeConstArea
        MasterSatelliteSharedRamSection (vLinkGenVarSectionGroup):
          vLinkGenVarSectionGroupPosition = 0
          vLinkGenVarSectionGroupInit = INIT
          vLinkGenVarSectionGroupInitStage = ONE
          vLinkGenVarSectionGroupAlignment = 4
          vLinkGenVarSectionGroupEndAlignment = 4
          vLinkGenVarSectionGroupRef = FBL_HSM_SHARED_SECTION
      3 x vLinkGenMemoryRegion, all with vLinkGenMemoryRegionAddrOffset=0:
        R5_TCMB0_RAM: vLinkGenMemoryRegionSize=32768, vLinkGenMemoryRegionAddress=1090584576, vLinkGenMemoryRegionAvailable=false, vLinkGenMemoryRegionHwRegion=MCU_R5_TCMB0_RAM
          OCMCRAM_VecExc (vLinkGenMemoryRegionBlock):
            vLinkGenMemoryRegionBlockPosition = 0
            vLinkGenMemoryRegionBlockSize = 512
            vLinkGenMemoryRegionBlockAddress = 1090584576
            vLinkGenMemoryRegionBlockBoundary = LOWER
            vLinkGenMemoryRegionBlockInitStage = NONE
          OCMCRAM_Startup_Code (vLinkGenMemoryRegionBlock):
            vLinkGenMemoryRegionBlockPosition = 1
            vLinkGenMemoryRegionBlockSize = 4096
            vLinkGenMemoryRegionBlockAddress = 1090585088
            vLinkGenMemoryRegionBlockBoundary = LOWER
            vLinkGenMemoryRegionBlockInitStage = NONE
        MagicFlagRegion: vLinkGenMemoryRegionSize=8, vLinkGenMemoryRegionAddress=1076363264, vLinkGenMemoryRegionAvailable=true, vLinkGenMemoryRegionHwRegion=Protected_RAM
          MagicFlagRegion (vLinkGenMemoryRegionBlock):
            vLinkGenMemoryRegionBlockPosition = 0
            vLinkGenMemoryRegionBlockSize = 8
            vLinkGenMemoryRegionBlockAddress = 1076363264
            vLinkGenMemoryRegionBlockBoundary = LOWER
            vLinkGenMemoryRegionBlockInitStage = NONE
        MCU_MSRAM: vLinkGenMemoryRegionSize=110336, vLinkGenMemoryRegionAddress=1103888384, vLinkGenMemoryRegionAvailable=true, vLinkGenMemoryRegionHwRegion=MCU_MSRAM
          5 x vLinkGenMemoryRegionBlock, all with vLinkGenMemoryRegionBlockBoundary=LOWER, vLinkGenMemoryRegionBlockInitStage=NONE:
            OCMCRAM_Common: vLinkGenMemoryRegionBlockSize=43008, vLinkGenMemoryRegionBlockPosition=2, vLinkGenMemoryRegionBlockAddress=1103894528
            OCMRAM_Stack: vLinkGenMemoryRegionBlockPosition=0, vLinkGenMemoryRegionBlockSize=4096, vLinkGenMemoryRegionBlockAddress=1103888384
            OCMCRAM_Common_StartupCode: vLinkGenMemoryRegionBlockSize=2048, vLinkGenMemoryRegionBlockPosition=1, vLinkGenMemoryRegionBlockAddress=1103892480
            OCMCRAM_Common_NonCache: vLinkGenMemoryRegionBlockPosition=3, vLinkGenMemoryRegionBlockSize=1024, vLinkGenMemoryRegionBlockAddress=1103937536
            OCMCRAM_Core0: vLinkGenMemoryRegionBlockPosition=4, vLinkGenMemoryRegionBlockSize=1024, vLinkGenMemoryRegionBlockAddress=1103938560
      vLinkGenLinkerSections
        FBL_HSM_SHARED_SECTION (vLinkGenLinkerVarSection): vLinkGenLinkerVarSectionName=vMemAccMPartition, vLinkGenLinkerVarSectionFast=false
        brsStartup (vLinkGenLinkerCodeSection): vLinkGenLinkerCodeSectionName=brsStartup, vLinkGenLinkerCodeSectionFast=false
        startupCode (vLinkGenLinkerCodeSection): vLinkGenLinkerCodeSectionName=startupCode, vLinkGenLinkerCodeSectionFast=false
        startupData (vLinkGenLinkerConstSection): vLinkGenLinkerConstSectionName=startupData, vLinkGenLinkerConstSectionFast=false
        brsExcVect (vLinkGenLinkerCodeSection): vLinkGenLinkerCodeSectionName=brsExcVect, vLinkGenLinkerCodeSectionFast=false
        3 x vLinkGenLinkerConstSection, all with vLinkGenLinkerConstSectionFast=false, vLinkGenLinkerConstSectionAlignment=0:
          BmHeaderSection: vLinkGenLinkerConstSectionName=BmHeaderSection
          FblHeaderSection: vLinkGenLinkerConstSectionName=FblHeaderSection
          BmHdrHeaderSection: vLinkGenLinkerConstSectionName=BmHdrHeaderSection
        brsResetLabel (vLinkGenLinkerCodeSection): vLinkGenLinkerCodeSectionName=brsResetLabel, vLinkGenLinkerCodeSectionFast=false, vLinkGenLinkerCodeSectionAlignment=0
        5 x vLinkGenLinkerSpecSection, all with vLinkGenLinkerSpecSectionPad=0:
          text: vLinkGenLinkerSpecSectionValue=.text
          const: vLinkGenLinkerSpecSectionValue=.const*
          data: vLinkGenLinkerSpecSectionValue=.data*
          bss: vLinkGenLinkerSpecSectionValue=.bss*
          stack: vLinkGenLinkerSpecSectionValue=.stack
        ApplPresPatternSection (vLinkGenLinkerConstSection): vLinkGenLinkerConstSectionName=ApplPresPatternSection, vLinkGenLinkerConstSectionFast=false
        PresencePatternSection (vLinkGenLinkerConstSection): vLinkGenLinkerConstSectionName=PresencePatternSection, vLinkGenLinkerConstSectionFast=false
        sysmem (vLinkGenLinkerSpecSection): vLinkGenLinkerSpecSectionValue=.sysmem, vLinkGenLinkerSpecSectionPad=0
        boardcfg_data (vLinkGenLinkerConstSection): vLinkGenLinkerConstSectionName=boardcfg_data, vLinkGenLinkerConstSectionFast=false
        9 x vLinkGenLinkerVarSection, all with vLinkGenLinkerVarSectionFast=false:
          ETH_UDMA_SECTION: vLinkGenLinkerVarSectionName=ETH_UDMA_SECTION
          ETH_UDMA_RING_SECTION: vLinkGenLinkerVarSectionName=ETH_UDMA_RING_SECTION
          ETH_UDMA_DESC_SECTION: vLinkGenLinkerVarSectionName=ETH_UDMA_DESC_SECTION
          ETH_TX_DATA_SECTION: vLinkGenLinkerVarSectionName=ETH_TX_DATA_SECTION
          ETH_RX_DATA_SECTION: vLinkGenLinkerVarSectionName=ETH_RX_DATA_SECTION
          CDD_IPC_NOINIT_SECTION: vLinkGenLinkerVarSectionName=CDD_IPC_NOINIT_SECTION
          BRS_SHARED_SECTION: vLinkGenLinkerVarSectionName=BRS_SHARED_SECTION
          EepDummyVarSection: vLinkGenLinkerVarSectionName=EepDummySection
          MagicFlagVarSection: vLinkGenLinkerVarSectionName=MagicFlagSection
        3 x vLinkGenLinkerSpecSection, all with vLinkGenLinkerSpecSectionPad=0:
          rodata: vLinkGenLinkerSpecSectionValue=.rodata*
          vHsmIpcMemory: vLinkGenLinkerSpecSectionValue=.vHsmIpcMemory
          vHsmGlobalRamBuffer: vLinkGenLinkerSpecSectionValue=.vHsmGlobalRamBuffer
        FblFCAHeaderSection (vLinkGenLinkerConstSection): vLinkGenLinkerConstSectionName=FblFCAHeaderSection, vLinkGenLinkerConstSectionFast=false
        SafeShutDownVarSection (vLinkGenLinkerVarSection): vLinkGenLinkerVarSectionName=SafeShutDownSection, vLinkGenLinkerVarSectionFast=false
        FBLAuthVarSection (vLinkGenLinkerVarSection): vLinkGenLinkerVarSectionName=FBLAuthSection, vLinkGenLinkerVarSectionFast=false
      STACK_C0 (vLinkGenLogicalVarGroup): vLinkGenVarGroupInitCore=0, vLinkGenVarGroupPosition=5, vLinkGenVarGroupRegion=OCMRAM_Stack
        STACK_C0 (vLinkGenVarSectionGroup):
          vLinkGenVarSectionGroupAlignment = 4
          vLinkGenVarSectionGroupEndAlignment = 4
          vLinkGenVarSectionGroupSize = 3840
          vLinkGenVarSectionGroupInit = ZERO_INIT
          vLinkGenVarSectionGroupInitStage = EARLY
          vLinkGenVarSectionGroupPosition = 0
          vLinkGenVarSectionGroupGapSize = 0
          vLinkGenVarSectionGroupRef = stack
      Startup_Stack_Symbols (vLinkGenLogicalSymbolGroup): vLinkGenSymbolGroupPosition=5
        Startup_Stack_c0 (vLinkGenLinkerSymbol): vLinkGenLinkerSymbolName=__section_stack_c0_end, vLinkGenLinkerSymbolValue=_STACK_C0_LIMIT, vLinkGenLinkerSymbolPosition=0
      4 x vLinkGenLogicalConstGroup, all with vLinkGenConstGroupPosition=5:
        FblHeaderGroup: vLinkGenConstGroupRegion=FblHeaderArea, vLinkGenConstGroupVariant=DemoFbl
          FblHeaderSecGroup (vLinkGenConstSectionGroup):
            vLinkGenConstSectionGroupPosition = 0
            vLinkGenConstSectionGroupInit = NONE
            vLinkGenConstSectionGroupInitStage = ONE
            vLinkGenConstSectionGroupRef = FblHeaderSection
        BmHeaderGroup: vLinkGenConstGroupRegion=BmHdrArea, vLinkGenConstGroupVariant=DemoBm
          BmHeaderSecGroup (vLinkGenConstSectionGroup):
            vLinkGenConstSectionGroupPosition = 0
            vLinkGenConstSectionGroupInit = NONE
            vLinkGenConstSectionGroupInitStage = ONE
            vLinkGenConstSectionGroupRef = BmHeaderSection
        ApplPresPatternGroup: vLinkGenConstGroupRegion=ApplUpdBlockPPArea, vLinkGenConstGroupVariant=DemoAppl
          ApplPresPatternSecGroup (vLinkGenConstSectionGroup):
            vLinkGenConstSectionGroupPosition = 0
            vLinkGenConstSectionGroupInit = NONE
            vLinkGenConstSectionGroupInitStage = ONE
            vLinkGenConstSectionGroupRef = ApplPresPatternSection
        ApplUpdBmHdrHeaderGroup: vLinkGenConstGroupRegion=ApplUpdBmHdrHeaderArea, vLinkGenConstGroupVariant=DemoAppl, vLinkGenConstGroupVariant=DemoUpd
          ApplUpdBmHdrHeaderSecGroup (vLinkGenConstSectionGroup):
            vLinkGenConstSectionGroupPosition = 0
            vLinkGenConstSectionGroupInit = NONE
            vLinkGenConstSectionGroupInitStage = ONE
            vLinkGenConstSectionGroupRef = BmHdrHeaderSection
      RamBssGroup (vLinkGenLogicalVarGroup): vLinkGenVarGroupPosition=5, vLinkGenVarGroupInitCore=0, vLinkGenVarGroupRegion=DataBssRegion/DataBssRegion
        RamBssSecGroup (vLinkGenVarSectionGroup):
          vLinkGenVarSectionGroupPosition = 0
          vLinkGenVarSectionGroupInit = ZERO_INIT
          vLinkGenVarSectionGroupInitStage = ONE
          vLinkGenVarSectionGroupAlignment = 4
          vLinkGenVarSectionGroupEndAlignment = 4
          vLinkGenVarSectionGroupRef = bss
      ApplUpdCodeConstArea (vLinkGenLogicalConstGroup):
        vLinkGenConstGroupPosition = 5
        vLinkGenConstGroupRegion = ApplUpdRegion/ApplUpdCodeConstArea
        vLinkGenConstGroupVariant = DemoUpd
        vLinkGenConstGroupVariant = DemoAppl
        ApplUpdCodeConstSecArea (vLinkGenConstSectionGroup):
          vLinkGenConstSectionGroupPosition = 0
          vLinkGenConstSectionGroupInit = NONE
          vLinkGenConstSectionGroupInitStage = ONE
          vLinkGenConstSectionGroupRef = const
          vLinkGenConstSectionGroupRef = text
          vLinkGenConstSectionGroupRef = boardcfg_data
          vLinkGenConstSectionGroupRef = rodata
      RamDataGroup (vLinkGenLogicalVarGroup):
        vLinkGenVarGroupPosition = 6
        vLinkGenVarGroupInitCore = 0
        vLinkGenVarGroupRegion = DataBssRegion/DataBssRegion
        vLinkGenVarGroupRomRegion = ApplUpdRegion/ApplUpdCodeConstArea
        vLinkGenVarGroupVariant = DemoAppl
        vLinkGenVarGroupVariant = DemoUpd
        vLinkGenVarGroupVariant = DemoFbl
        vLinkGenVarGroupVariant = DemoBm
        RamDataSecGroup (vLinkGenVarSectionGroup):
          vLinkGenVarSectionGroupPosition = 0
          vLinkGenVarSectionGroupInit = INIT
          vLinkGenVarSectionGroupInitStage = ONE
          vLinkGenVarSectionGroupAlignment = 4
          vLinkGenVarSectionGroupEndAlignment = 4
          vLinkGenVarSectionGroupRef = data
        vLinkGenVarGroupVariantHandling
          3 x vLinkGenVarGroupVariantSpecifics:
            RamDataGroup_ApplUpd: vLinkGenVarGroupSpecificRomRegion=ApplUpdRegion/ApplUpdCodeConstArea, vLinkGenVarGroupSpecificVariant=DemoAppl, vLinkGenVarGroupSpecificVariant=DemoUpd
            RamDataGroup_Fbl: vLinkGenVarGroupSpecificRomRegion=FblCodeConstArea, vLinkGenVarGroupSpecificVariant=DemoFbl
            RamDataGroup_Bm: vLinkGenVarGroupSpecificRomRegion=BmCodeConstArea, vLinkGenVarGroupSpecificVariant=DemoBm
      ApplUpdPresPatternGroup (vLinkGenLogicalConstGroup): vLinkGenConstGroupPosition=5, vLinkGenConstGroupRegion=ApplUpdLBPPArea, vLinkGenConstGroupVariant=DemoAppl, vLinkGenConstGroupVariant=DemoUpd
        ApplUpdPresPatternSecGroup (vLinkGenConstSectionGroup):
          vLinkGenConstSectionGroupPosition = 0
          vLinkGenConstSectionGroupInit = NONE
          vLinkGenConstSectionGroupInitStage = ONE
          vLinkGenConstSectionGroupRef = PresencePatternSection
      ApplUpdRegion (vLinkGenMemoryRegion):
        vLinkGenMemoryRegionAddrOffset = 2097152
        vLinkGenMemoryRegionSize = 4194304
        vLinkGenMemoryRegionAddress = 2426404864
        vLinkGenMemoryRegionAvailable = true
        vLinkGenMemoryRegionHwRegion = DDR0_BM_FBL
        4 x vLinkGenMemoryRegionBlock, all with vLinkGenMemoryRegionBlockInitStage=NONE:
          ApplUpdBlockPPArea: vLinkGenMemoryRegionBlockPosition=0, vLinkGenMemoryRegionBlockSize=512, vLinkGenMemoryRegionBlockAddress=2430598144, vLinkGenMemoryRegionBlockBoundary=UPPER
          ApplUpdLBPPArea: vLinkGenMemoryRegionBlockPosition=1, vLinkGenMemoryRegionBlockSize=512, vLinkGenMemoryRegionBlockAddress=2430598656, vLinkGenMemoryRegionBlockBoundary=UPPER
          ApplUpdBmHdrHeaderArea: vLinkGenMemoryRegionBlockPosition=0, vLinkGenMemoryRegionBlockSize=32, vLinkGenMemoryRegionBlockAddress=2426404864, vLinkGenMemoryRegionBlockBoundary=LOWER
          ApplUpdCodeConstArea: vLinkGenMemoryRegionBlockPosition=1, vLinkGenMemoryRegionBlockSize=4193248, vLinkGenMemoryRegionBlockAddress=2426404896, vLinkGenMemoryRegionBlockBoundary=LOWER
      4 x vLinkGenLogicalConstGroup, all with vLinkGenConstGroupPosition=5, vLinkGenConstGroupVariant=DemoBm:
        BmBrsExcVecGroup: vLinkGenConstGroupRegion=OCMCRAM_Core0
          BmBrsExcVecSecGroup (vLinkGenConstSectionGroup):
            vLinkGenConstSectionGroupPosition = 0
            vLinkGenConstSectionGroupInit = NONE
            vLinkGenConstSectionGroupInitStage = ONE
            vLinkGenConstSectionGroupRef = brsExcVect
        BmCodeConstGroup: vLinkGenConstGroupRegion=BmCodeConstArea
          BmCodeConstSecGroup (vLinkGenConstSectionGroup):
            vLinkGenConstSectionGroupPosition = 0
            vLinkGenConstSectionGroupInit = NONE
            vLinkGenConstSectionGroupInitStage = ONE
            vLinkGenConstSectionGroupRef = const
            vLinkGenConstSectionGroupRef = text
            vLinkGenConstSectionGroupRef = boardcfg_data
        BmR5F_Startup_Code: vLinkGenConstGroupRegion=OCMCRAM_Common
          R5F_Startup_Code (vLinkGenConstSectionGroup):
            vLinkGenConstSectionGroupAlignment = 4
            vLinkGenConstSectionGroupPosition = 0
            vLinkGenConstSectionGroupInit = NONE
            vLinkGenConstSectionGroupInitStage = ONE
            vLinkGenConstSectionGroupRef = startupCode
        BmR5F_Startup_Data: vLinkGenConstGroupRegion=OCMCRAM_Common
          R5F_Startup_Data (vLinkGenConstSectionGroup):
            vLinkGenConstSectionGroupAlignment = 4
            vLinkGenConstSectionGroupPosition = 0
            vLinkGenConstSectionGroupInit = NONE
            vLinkGenConstSectionGroupInitStage = ONE
            vLinkGenConstSectionGroupRef = startupData
      BmRegion (vLinkGenMemoryRegion):
        vLinkGenMemoryRegionAddrOffset = 0
        vLinkGenMemoryRegionSize = 1048576
        vLinkGenMemoryRegionAddress = 2424307712
        vLinkGenMemoryRegionAvailable = true
        vLinkGenMemoryRegionHwRegion = DDR0_BM_FBL
        BmCodeConstArea (vLinkGenMemoryRegionBlock):
          vLinkGenMemoryRegionBlockPosition = 1
          vLinkGenMemoryRegionBlockSize = 1048544
          vLinkGenMemoryRegionBlockAddress = 2424307744
          vLinkGenMemoryRegionBlockBoundary = LOWER
          vLinkGenMemoryRegionBlockInitStage = NONE
        BmHdrArea (vLinkGenMemoryRegionBlock):
          vLinkGenMemoryRegionBlockPosition = 0
          vLinkGenMemoryRegionBlockSize = 32
          vLinkGenMemoryRegionBlockAddress = 2424307712
          vLinkGenMemoryRegionBlockBoundary = LOWER
          vLinkGenMemoryRegionBlockInitStage = NONE
      4 x vLinkGenLogicalConstGroup:
        BmStartup_Code: vLinkGenConstGroupPosition=0, vLinkGenConstGroupRegion=OCMCRAM_Common_StartupCode, vLinkGenConstGroupVariant=DemoBm
          Startup_Code (vLinkGenConstSectionGroup):
            vLinkGenConstSectionGroupAlignment = 4
            vLinkGenConstSectionGroupPosition = 0
            vLinkGenConstSectionGroupInit = NONE
            vLinkGenConstSectionGroupInitStage = ONE
            vLinkGenConstSectionGroupRef = brsResetLabel
            vLinkGenConstSectionGroupRef = brsStartup
        FblBmHdrHeaderGroup: vLinkGenConstGroupPosition=5, vLinkGenConstGroupRegion=FblBmHdrHeaderArea, vLinkGenConstGroupVariant=DemoFbl
          FblBmHdrHeaderSecGroup (vLinkGenConstSectionGroup):
            vLinkGenConstSectionGroupPosition = 0
            vLinkGenConstSectionGroupInit = NONE
            vLinkGenConstSectionGroupInitStage = ONE
            vLinkGenConstSectionGroupRef = BmHdrHeaderSection
        FblCodeConstGroup: vLinkGenConstGroupPosition=5, vLinkGenConstGroupRegion=FblCodeConstArea, vLinkGenConstGroupVariant=DemoFbl
          FblCodeConstSecGroup (vLinkGenConstSectionGroup):
            vLinkGenConstSectionGroupPosition = 0
            vLinkGenConstSectionGroupInit = NONE
            vLinkGenConstSectionGroupInitStage = ONE
            vLinkGenConstSectionGroupRef = const
            vLinkGenConstSectionGroupRef = text
            vLinkGenConstSectionGroupRef = boardcfg_data
            vLinkGenConstSectionGroupRef = rodata
        FblPresPatternGroup: vLinkGenConstGroupPosition=5, vLinkGenConstGroupRegion=FblLBPPArea, vLinkGenConstGroupVariant=DemoFbl
          FblPresPatternSecGroup (vLinkGenConstSectionGroup):
            vLinkGenConstSectionGroupPosition = 0
            vLinkGenConstSectionGroupInit = NONE
            vLinkGenConstSectionGroupInitStage = ONE
            vLinkGenConstSectionGroupRef = PresencePatternSection
      FblRegion (vLinkGenMemoryRegion):
        vLinkGenMemoryRegionAddrOffset = 1048576
        vLinkGenMemoryRegionSize = 524288
        vLinkGenMemoryRegionAddress = 2425356288
        vLinkGenMemoryRegionAvailable = true
        vLinkGenMemoryRegionHwRegion = DDR0_BM_FBL
        7 x vLinkGenMemoryRegionBlock, all with vLinkGenMemoryRegionBlockInitStage=NONE:
          EepDummyArea: vLinkGenMemoryRegionBlockPosition=4, vLinkGenMemoryRegionBlockSize=4096, vLinkGenMemoryRegionBlockAddress=2425856512, vLinkGenMemoryRegionBlockBoundary=LOWER
          FblBmHdrHeaderArea: vLinkGenMemoryRegionBlockPosition=2, vLinkGenMemoryRegionBlockSize=32, vLinkGenMemoryRegionBlockAddress=2425356768, vLinkGenMemoryRegionBlockBoundary=LOWER
          FblHeaderArea: vLinkGenMemoryRegionBlockPosition=1, vLinkGenMemoryRegionBlockSize=32, vLinkGenMemoryRegionBlockAddress=2425356736, vLinkGenMemoryRegionBlockBoundary=LOWER
          FblCodeConstArea: vLinkGenMemoryRegionBlockPosition=3, vLinkGenMemoryRegionBlockSize=499712, vLinkGenMemoryRegionBlockAddress=2425356800, vLinkGenMemoryRegionBlockBoundary=LOWER
          FblBlockPPArea: vLinkGenMemoryRegionBlockPosition=1, vLinkGenMemoryRegionBlockSize=8192, vLinkGenMemoryRegionBlockAddress=2425872384, vLinkGenMemoryRegionBlockBoundary=UPPER
          FblLBPPArea: vLinkGenMemoryRegionBlockPosition=0, vLinkGenMemoryRegionBlockSize=8192, vLinkGenMemoryRegionBlockAddress=2425864192, vLinkGenMemoryRegionBlockBoundary=UPPER
          FblFCAheaderArea: vLinkGenMemoryRegionBlockPosition=0, vLinkGenMemoryRegionBlockSize=448, vLinkGenMemoryRegionBlockAddress=2425356288, vLinkGenMemoryRegionBlockBoundary=LOWER
      SysMem (vLinkGenLogicalVarGroup): vLinkGenVarGroupPosition=5, vLinkGenVarGroupRegion=OCMCRAM_Common_NonCache
        SysMem (vLinkGenVarSectionGroup): vLinkGenVarSectionGroupPosition=0, vLinkGenVarSectionGroupInit=NONE, vLinkGenVarSectionGroupInitStage=ONE, vLinkGenVarSectionGroupRef=sysmem
      SysMem_Symbols (vLinkGenLogicalSymbolGroup): vLinkGenSymbolGroupPosition=10000
        SYSMEM_SIZE (vLinkGenLinkerSymbol): vLinkGenLinkerSymbolPosition=0, vLinkGenLinkerSymbolName=__SYSMEM_SIZE, vLinkGenLinkerSymbolValue=1024
      EthRegion (vLinkGenMemoryRegion):
        vLinkGenMemoryRegionAddrOffset = 0
        vLinkGenMemoryRegionSize = 524288
        vLinkGenMemoryRegionAddress = 1879310336
        vLinkGenMemoryRegionAvailable = true
        vLinkGenMemoryRegionHwRegion = MSMC3
        EthArea (vLinkGenMemoryRegionBlock):
          vLinkGenMemoryRegionBlockPosition = 0
          vLinkGenMemoryRegionBlockSize = 98304
          vLinkGenMemoryRegionBlockAddress = 1879310336
          vLinkGenMemoryRegionBlockBoundary = LOWER
          vLinkGenMemoryRegionBlockInitStage = NONE
        CddIpcArea (vLinkGenMemoryRegionBlock):
          vLinkGenMemoryRegionBlockPosition = 1
          vLinkGenMemoryRegionBlockSize = 425984
          vLinkGenMemoryRegionBlockAddress = 1879408640
          vLinkGenMemoryRegionBlockBoundary = LOWER
          vLinkGenMemoryRegionBlockInitStage = NONE
      McalUdmaEthGroup (vLinkGenLogicalVarGroup): vLinkGenVarGroupPosition=5, vLinkGenVarGroupRegion=EthArea, vLinkGenVarGroupVariant=DemoFbl, vLinkGenVarGroupVariant=DemoAppl
        McalUdmaEthSection (vLinkGenVarSectionGroup):
          vLinkGenVarSectionGroupPosition = 0
          vLinkGenVarSectionGroupInit = NONE
          vLinkGenVarSectionGroupInitStage = ONE
          vLinkGenVarSectionGroupAlignment = 128
          vLinkGenVarSectionGroupEndAlignment = 128
          vLinkGenVarSectionGroupRef = ETH_UDMA_SECTION
          vLinkGenVarSectionGroupRef = ETH_UDMA_DESC_SECTION
          vLinkGenVarSectionGroupRef = ETH_UDMA_RING_SECTION
          vLinkGenVarSectionGroupRef = ETH_TX_DATA_SECTION
          vLinkGenVarSectionGroupRef = ETH_RX_DATA_SECTION
      McalCddIpcDataGroup (vLinkGenLogicalVarGroup): vLinkGenVarGroupPosition=5, vLinkGenVarGroupRegion=CddIpcArea, vLinkGenVarGroupVariant=DemoFbl, vLinkGenVarGroupVariant=DemoAppl
        McalCddIpcDataSection (vLinkGenVarSectionGroup):
          vLinkGenVarSectionGroupPosition = 0
          vLinkGenVarSectionGroupInit = NONE
          vLinkGenVarSectionGroupInitStage = ONE
          vLinkGenVarSectionGroupAlignment = 128
          vLinkGenVarSectionGroupEndAlignment = 128
          vLinkGenVarSectionGroupRef = CDD_IPC_NOINIT_SECTION
      DataBssRegion (vLinkGenMemoryRegion):
        vLinkGenMemoryRegionAddrOffset = 524288
        vLinkGenMemoryRegionSize = 393216
        vLinkGenMemoryRegionAddress = 1879834624
        vLinkGenMemoryRegionAvailable = true
        vLinkGenMemoryRegionHwRegion = MSMC3
        DataBssRegion (vLinkGenMemoryRegionBlock):
          vLinkGenMemoryRegionBlockPosition = 1
          vLinkGenMemoryRegionBlockSize = 392960
          vLinkGenMemoryRegionBlockAddress = 1879834880
          vLinkGenMemoryRegionBlockBoundary = LOWER
          vLinkGenMemoryRegionBlockInitStage = ONE
          vLinkGenMemoryRegionBlockInitCore = 0
        DataBssRegion_Shared (vLinkGenMemoryRegionBlock):
          vLinkGenMemoryRegionBlockPosition = 0
          vLinkGenMemoryRegionBlockSize = 256
          vLinkGenMemoryRegionBlockAddress = 1879834624
          vLinkGenMemoryRegionBlockBoundary = LOWER
          vLinkGenMemoryRegionBlockInitStage = ONE
          vLinkGenMemoryRegionBlockInitCore = 0
      3 x vLinkGenLogicalVarGroup, all with vLinkGenVarGroupPosition=5:
        RamSharedGroup: vLinkGenVarGroupRegion=DataBssRegion_Shared
          RamSharedGroup (vLinkGenVarSectionGroup):
            vLinkGenVarSectionGroupPosition = 0
            vLinkGenVarSectionGroupInit = NONE
            vLinkGenVarSectionGroupInitStage = ONE
            vLinkGenVarSectionGroupRef = BRS_SHARED_SECTION
        EepDummyGroup: vLinkGenVarGroupRegion=EepDummyArea
          EepDummySectionGroup (vLinkGenVarSectionGroup):
            vLinkGenVarSectionGroupPosition = 0
            vLinkGenVarSectionGroupInit = NONE
            vLinkGenVarSectionGroupInitStage = ONE
            vLinkGenVarSectionGroupRef = EepDummyVarSection
        MagicFlagGroup: vLinkGenVarGroupRegion=MagicFlagRegion/MagicFlagRegion
          MagicFlagSectionGroup (vLinkGenVarSectionGroup):
            vLinkGenVarSectionGroupPosition = 0
            vLinkGenVarSectionGroupInit = NONE
            vLinkGenVarSectionGroupInitStage = ONE
            vLinkGenVarSectionGroupRef = MagicFlagVarSection
      MCU_MSRAM_HSM (vLinkGenMemoryRegion):
        vLinkGenMemoryRegionAddrOffset = 0
        vLinkGenMemoryRegionSize = 10504
        vLinkGenMemoryRegionAddress = 1103101952
        vLinkGenMemoryRegionAvailable = true
        vLinkGenMemoryRegionHwRegion = MCU_MSRAM_HSM
        5 x vLinkGenMemoryRegionBlock, all with vLinkGenMemoryRegionBlockBoundary=LOWER, vLinkGenMemoryRegionBlockInitStage=NONE:
          vHsmIpcMemory: vLinkGenMemoryRegionBlockPosition=0, vLinkGenMemoryRegionBlockSize=896, vLinkGenMemoryRegionBlockAddress=1103101952
          vHsmComm_HsmReserved: vLinkGenMemoryRegionBlockPosition=1, vLinkGenMemoryRegionBlockSize=1408, vLinkGenMemoryRegionBlockAddress=1103102848
          vHsmComm_Host2Hsm: vLinkGenMemoryRegionBlockPosition=2, vLinkGenMemoryRegionBlockSize=4, vLinkGenMemoryRegionBlockAddress=1103104256
          vHSMComm_Hsm2Host: vLinkGenMemoryRegionBlockPosition=3, vLinkGenMemoryRegionBlockSize=4, vLinkGenMemoryRegionBlockAddress=1103104260
          vHsmGlobalRamBuffer: vLinkGenMemoryRegionBlockPosition=4, vLinkGenMemoryRegionBlockSize=8192, vLinkGenMemoryRegionBlockAddress=1103104264, vLinkGenMemoryRegionBlockFlag=EXECUTE, vLinkGenMemoryRegionBlockFlag=INIT, vLinkGenMemoryRegionBlockFlag=READ, vLinkGenMemoryRegionBlockFlag=WRITE
      vHsmIpcMemoryGroup (vLinkGenLogicalVarGroup): vLinkGenVarGroupPosition=6, vLinkGenVarGroupRegion=MCU_MSRAM_HSM/vHsmIpcMemory, vLinkGenVarGroupVariant=DemoFbl
        vLinkGenVarSectionGroup:
          vLinkGenVarSectionGroupPosition = 0
          vLinkGenVarSectionGroupInit = NONE
          vLinkGenVarSectionGroupInitStage = ONE
          vLinkGenVarSectionGroupRef = vLinkGenLinkerSections/vHsmIpcMemory
      vHsmGlobalRamBufferGroup (vLinkGenLogicalVarGroup): vLinkGenVarGroupPosition=5, vLinkGenVarGroupRegion=MCU_MSRAM_HSM/vHsmGlobalRamBuffer, vLinkGenVarGroupVariant=DemoFbl
        vHsmGlobalRamBufferGroup (vLinkGenVarSectionGroup):
          vLinkGenVarSectionGroupPosition = 0
          vLinkGenVarSectionGroupInit = NONE
          vLinkGenVarSectionGroupInitStage = ONE
          vLinkGenVarSectionGroupRef = vLinkGenLinkerSections/vHsmGlobalRamBuffer
      FblFCAHeaderGroup (vLinkGenLogicalConstGroup): vLinkGenConstGroupPosition=5, vLinkGenConstGroupRegion=FblFCAheaderArea, vLinkGenConstGroupVariant=DemoFbl
        FblFCAHeaderSecGroup (vLinkGenConstSectionGroup):
          vLinkGenConstSectionGroupPosition = 0
          vLinkGenConstSectionGroupInit = NONE
          vLinkGenConstSectionGroupInitStage = ONE
          vLinkGenConstSectionGroupRef = FblFCAHeaderSection
      MCU_MSRAM_HSM_VMEMACCM (vLinkGenMemoryRegion):
        vLinkGenMemoryRegionAddrOffset = 10512
        vLinkGenMemoryRegionSize = 5120
        vLinkGenMemoryRegionAddress = 1103112464
        vLinkGenMemoryRegionAvailable = true
        vLinkGenMemoryRegionHwRegion = MCU_MSRAM_HSM
        IPCRAM_BMStack (vLinkGenMemoryRegionBlock):
          vLinkGenMemoryRegionBlockPosition = 0
          vLinkGenMemoryRegionBlockSize = 5120
          vLinkGenMemoryRegionBlockAddress = 1103112464
          vLinkGenMemoryRegionBlockBoundary = LOWER
          vLinkGenMemoryRegionBlockInitStage = NONE
      SafeShutDownRegion (vLinkGenMemoryRegion):
        vLinkGenMemoryRegionAddrOffset = 8
        vLinkGenMemoryRegionSize = 4
        vLinkGenMemoryRegionAddress = 1076363272
        vLinkGenMemoryRegionAvailable = true
        vLinkGenMemoryRegionHwRegion = Protected_RAM
        SafeShutDownRegion (vLinkGenMemoryRegionBlock):
          vLinkGenMemoryRegionBlockPosition = 0
          vLinkGenMemoryRegionBlockSize = 4
          vLinkGenMemoryRegionBlockAddress = 1076363272
          vLinkGenMemoryRegionBlockBoundary = LOWER
          vLinkGenMemoryRegionBlockInitStage = NONE
      SafeShutDownGroup (vLinkGenLogicalVarGroup): vLinkGenVarGroupPosition=6, vLinkGenVarGroupRegion=SafeShutDownRegion/SafeShutDownRegion
        SafeShutDownSectionGroup (vLinkGenVarSectionGroup):
          vLinkGenVarSectionGroupPosition = 0
          vLinkGenVarSectionGroupInit = NONE
          vLinkGenVarSectionGroupInitStage = ONE
          vLinkGenVarSectionGroupRef = SafeShutDownVarSection
      FBLAuthRegion (vLinkGenMemoryRegion):
        vLinkGenMemoryRegionAddrOffset = 12
        vLinkGenMemoryRegionSize = 2
        vLinkGenMemoryRegionAddress = 1076363276
        vLinkGenMemoryRegionAvailable = true
        vLinkGenMemoryRegionHwRegion = Protected_RAM
        FBLAuthRegion (vLinkGenMemoryRegionBlock):
          vLinkGenMemoryRegionBlockPosition = 0
          vLinkGenMemoryRegionBlockSize = 2
          vLinkGenMemoryRegionBlockAddress = 1076363276
          vLinkGenMemoryRegionBlockBoundary = LOWER
          vLinkGenMemoryRegionBlockInitStage = NONE
      FBLAuthGroup (vLinkGenLogicalVarGroup): vLinkGenVarGroupPosition=6, vLinkGenVarGroupRegion=FBLAuthRegion/FBLAuthRegion
        FBLAuthSectionGroup (vLinkGenVarSectionGroup):
          vLinkGenVarSectionGroupPosition = 0
          vLinkGenVarSectionGroupInit = NONE
          vLinkGenVarSectionGroupInitStage = ONE
          vLinkGenVarSectionGroupRef = FBLAuthVarSection
    vLinkGenGeneral: vLinkGenFileGeneration=ONE_FILE_PER_VARIANT
    vLinkGenVariantHandling
      4 x vLinkGenVariant:
        DemoBm
        DemoFbl
        DemoAppl
        DemoUpd
    vLinkGenPublishedInformation: vLinkGenGeneration=2, vLinkGenDuplicatedLabels=false
      vLinkGenRegionBlockFlags
        4 x vLinkGenRegionBlockFlag:
          EXECUTE
          READ
          WRITE
          INIT
      vLinkGenConstGroupFlags
        NOLOAD (vLinkGenConstGroupFlag)
        PALIGN_BLOCK (vLinkGenConstGroupFlag)
      vLinkGenVarGroupFlags
        NOLOAD (vLinkGenVarGroupFlag)
        PALIGN_BLOCK (vLinkGenVarGroupFlag)
    vLinkGenContentTypes
      13 x vLinkGenConstContentType:
        GLOBAL_CODE: vLinkGenConstContentTypeLocal=false
        LOCAL_CODE: vLinkGenConstContentTypeLocal=true
        GLOBAL_CONST: vLinkGenConstContentTypeLocal=false
        LOCAL_CONST: vLinkGenConstContentTypeLocal=true
        LOCAL_EXCVEC_CODE: vLinkGenConstContentTypeLocal=true
        LOCAL_EXCVEC_CONST: vLinkGenConstContentTypeLocal=true
        GLOBAL_INTVEC_CODE: vLinkGenConstContentTypeLocal=false
        GLOBAL_INTVEC_CONST: vLinkGenConstContentTypeLocal=false
        LOCAL_INTVEC_CODE: vLinkGenConstContentTypeLocal=true
        LOCAL_INTVEC_CONST: vLinkGenConstContentTypeLocal=true
        STARTUP_CODE: vLinkGenConstContentTypeLocal=false
        RAM_CODE: vLinkGenConstContentTypeLocal=false
        RAM_CONST: vLinkGenConstContentTypeLocal=false
      6 x vLinkGenVarContentType:
        GLOBAL_DATA: vLinkGenVarContentTypeLocal=false
        LOCAL_DATA: vLinkGenVarContentTypeLocal=true
        RETENTION_DATA: vLinkGenVarContentTypeLocal=false
        STACKS: vLinkGenVarContentTypeLocal=true
        RAM_CODE_COPY: vLinkGenVarContentTypeLocal=false
        RAM_CONST_COPY: vLinkGenVarContentTypeLocal=false
      GLOBAL_EXCVEC_CODE (vLinkGenConstContentType): vLinkGenConstContentTypeLocal=false
      GLOBAL_EXCVEC_CONST (vLinkGenConstContentType): vLinkGenConstContentTypeLocal=true
      STARTUP_STACK (vLinkGenVarContentType): vLinkGenVarContentTypeLocal=true
      SHARED_DATA (vLinkGenVarContentType): vLinkGenVarContentTypeLocal=false
      APPLICATION_ENTRY (vLinkGenConstContentType): vLinkGenConstContentTypeLocal=false
