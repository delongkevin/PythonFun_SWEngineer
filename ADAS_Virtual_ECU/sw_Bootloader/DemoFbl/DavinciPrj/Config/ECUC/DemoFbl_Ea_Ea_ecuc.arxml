AUTOSAR XML (schema 00050)
package /ActiveEcuC
  module config Ea: implementation-config-variant=VARIANT-PRE-COMPILE, module-description=Ea_Impl
    EaGeneral:
      EaSetModeSupported = true
      EaDevErrorDetect = true
      EaIndex = 0
      EaPollingMode = true
      EaVersionInfoApi = false
      EaVirtualPageSize = 8
      EaNvMCallbackIncludeFile = NvM_Cbk.h
      EaCorrectSingleBitFlips = true
      EaMainFunctionPeriod = 0.01
      EaMainFunctionTriggering = FixedCycleTime
      EaSafeBswChecks = false
    EaBlockConfiguration:
      EaBlockNumber = 16
      EaBlockSize = 4
      EaImmediateData = false
      EaNumberOfWriteCycles = 10000
      EaNumberOfDatasets = 2
      EaNumberOfInstances = 1
      EaVerifyWrittenData = true
      EaBlockId = 0
      EaPartition = EaPartitionConfiguration
      EaDeviceIndex = EepGeneral
    EaPublishedInformation: EaBlockOverhead=2, EaMaximumBlockingTime=0, EaPageOverhead=0
    EaPartitionConfiguration: EaPartitionStartAddress=0, EaPartitionSize=7113, EaPartitionAddressAlignment=1, EaPartitionWriteAlignment=1, EaPartitionDevice=EepInitConfiguration
    26 x EaBlockConfiguration, all with EaImmediateData=false, EaNumberOfWriteCycles=10000, EaNumberOfInstances=1, EaPartition=EaPartitionConfiguration, EaDeviceIndex=EepGeneral:
      EaSWC_ConfigMgrVIN_OriginalVal: EaBlockNumber=32, EaBlockSize=19, EaNumberOfDatasets=1, EaVerifyWrittenData=false, EaBlockId=25
      EaBlock_ApplUpdate: EaBlockNumber=48, EaBlockSize=3, EaNumberOfDatasets=1, EaVerifyWrittenData=true, EaBlockId=1
      EaBlockDescriptor_SecAccessInvalidCount: EaBlockNumber=64, EaBlockSize=3, EaNumberOfDatasets=1, EaVerifyWrittenData=true, EaBlockId=4
      EaBlockDescriptor_ApplValidity: EaBlockNumber=80, EaBlockSize=3, EaNumberOfDatasets=1, EaVerifyWrittenData=true, EaBlockId=5
      EaBlockDescriptor_DcmDslRxTesterSourceAddr: EaBlockNumber=96, EaBlockSize=4, EaNumberOfDatasets=1, EaVerifyWrittenData=true, EaBlockId=6
      EaBlockDescriptor_ValidityFlags: EaBlockNumber=112, EaBlockSize=4, EaNumberOfDatasets=1, EaVerifyWrittenData=true, EaBlockId=7
      EaBlockDescriptor_ExhaustRegulationTan: EaBlockNumber=128, EaBlockSize=8, EaNumberOfDatasets=1, EaVerifyWrittenData=true, EaBlockId=8
      EaBlockDescriptor_ResetResponseFlag: EaBlockNumber=144, EaBlockSize=3, EaNumberOfDatasets=1, EaVerifyWrittenData=true, EaBlockId=9
      EaBlockDescriptor_DID_F180_Boot_SW_Ver_Info: EaBlockNumber=160, EaBlockSize=15, EaNumberOfDatasets=1, EaVerifyWrittenData=true, EaBlockId=10
      EaBlockDescriptor_DID_2010_ProgrammingStatus: EaBlockNumber=176, EaBlockSize=4, EaNumberOfDatasets=1, EaVerifyWrittenData=true, EaBlockId=11
      EaBlockDescriptor_MetaData: EaBlockNumber=192, EaBlockSize=128, EaNumberOfDatasets=10, EaVerifyWrittenData=true, EaBlockId=12
      EaBlockDescriptor_DID_F188_FCA_ESLM_Ecu_SW_Num: EaBlockNumber=208, EaBlockSize=13, EaNumberOfDatasets=1, EaVerifyWrittenData=true, EaBlockId=15
      EaBlockDescriptor_DID_F133_EBOM_Asm_PartNum: EaBlockNumber=224, EaBlockSize=12, EaNumberOfDatasets=1, EaVerifyWrittenData=true, EaBlockId=16
      EaBlockDescriptor_DID_F18A_FCA_ESLM_Ecu_SW_Cal_Num: EaBlockNumber=240, EaBlockSize=12, EaNumberOfDatasets=1, EaVerifyWrittenData=true, EaBlockId=17
      EaBlockDescriptor_DID_F18B_FCA_ESLM_ECU_SW_App_Num: EaBlockNumber=256, EaBlockSize=12, EaNumberOfDatasets=1, EaVerifyWrittenData=true, EaBlockId=18
      EaBlockDescriptor_DID_F187_CODEP_Ecu_PartNum: EaBlockNumber=272, EaBlockSize=13, EaNumberOfDatasets=1, EaVerifyWrittenData=true, EaBlockId=19
      EaBlockDescriptor_DID_F134_CODEP_Asm_PartNum: EaBlockNumber=288, EaBlockSize=13, EaNumberOfDatasets=1, EaVerifyWrittenData=true, EaBlockId=20
      EaBlockDescriptor_DID_F132_EBOM_Ecu_PartNum: EaBlockNumber=304, EaBlockSize=12, EaNumberOfDatasets=1, EaVerifyWrittenData=true, EaBlockId=21
      EaBlockDescriptor_DID_F194_Supplier_Ecu_SW_PartNum: EaBlockNumber=320, EaBlockSize=13, EaNumberOfDatasets=1, EaVerifyWrittenData=true, EaBlockId=22
      EaBlockDescriptor_DID_F195_Supplier_Ecu_SW_VerNum: EaBlockNumber=336, EaBlockSize=4, EaNumberOfDatasets=1, EaVerifyWrittenData=true, EaBlockId=23
      EaBlockDescriptor_DID_2002_OdoFlashing: EaBlockNumber=352, EaBlockSize=4, EaNumberOfDatasets=1, EaVerifyWrittenData=true, EaBlockId=26
      EaBlockDescriptor_DID_F110_Ecu_Diag_Id_FlashDefinitionNumber: EaBlockNumber=368, EaBlockSize=8, EaNumberOfDatasets=1, EaVerifyWrittenData=true, EaBlockId=24
      EaBlockDescriptor_ProgReqFlag: EaBlockNumber=384, EaBlockSize=3, EaNumberOfDatasets=1, EaVerifyWrittenData=true, EaBlockId=2
      EaBlockDescriptor_SecAccessDelayFlag: EaBlockNumber=400, EaBlockSize=3, EaNumberOfDatasets=1, EaVerifyWrittenData=true, EaBlockId=3
      EaBlockConfiguration_FileHeader: EaBlockNumber=416, EaBlockSize=178, EaNumberOfDatasets=9, EaVerifyWrittenData=true, EaBlockId=13
      EaBlockConfiguration_CertAccessInfo: EaBlockNumber=432, EaBlockSize=48, EaNumberOfDatasets=10, EaVerifyWrittenData=true, EaBlockId=14
    EaPartitionConfiguration_SecureLog (EaPartitionConfiguration):
      EaPartitionStartAddress = 7168
      EaPartitionSize = 1024
      EaPartitionAddressAlignment = 1
      EaPartitionWriteAlignment = 1
      EaPartitionDevice = EepInitConfiguration
    4 x EaBlockConfiguration, all with EaImmediateData=false, EaNumberOfWriteCycles=10000, EaNumberOfDatasets=1, EaNumberOfInstances=1, EaVerifyWrittenData=false:
      EaBlockConfiguration_SecureLogGroup1: EaBlockNumber=448, EaBlockSize=504, EaBlockId=0, EaPartition=EaPartitionConfiguration_SecureLog, EaDeviceIndex=EepGeneral
      EaBlockConfiguration_SecureLogGroup2: EaBlockNumber=464, EaBlockSize=504, EaBlockId=1, EaPartition=EaPartitionConfiguration_SecureLog, EaDeviceIndex=EepGeneral
      EaBlockDescriptor_SecondCounter: EaBlockNumber=480, EaBlockSize=6, EaBlockId=0, EaPartition=EaPartitionConfiguration_Timestamp
      EaBlockDescriptor_SystemTimestamp: EaBlockNumber=496, EaBlockSize=17, EaBlockId=1, EaPartition=EaPartitionConfiguration_Timestamp
    EaPartitionConfiguration_Timestamp (EaPartitionConfiguration): EaPartitionStartAddress=7113, EaPartitionSize=55, EaPartitionAddressAlignment=1, EaPartitionWriteAlignment=1, EaPartitionDevice=EepInitConfiguration
    EaBlockDescriptor_CertificateExpired (EaBlockConfiguration):
      EaBlockNumber = 512
      EaBlockSize = 3
      EaImmediateData = false
      EaNumberOfWriteCycles = 10000
      EaNumberOfDatasets = 1
      EaNumberOfInstances = 1
      EaVerifyWrittenData = false
      EaBlockId = 2
      EaPartition = EaPartitionConfiguration_Timestamp
