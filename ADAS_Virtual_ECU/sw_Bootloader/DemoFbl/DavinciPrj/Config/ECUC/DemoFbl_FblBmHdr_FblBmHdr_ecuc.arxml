AUTOSAR XML (schema 00050)
package /ActiveEcuC
  module config FblBmHdr: implementation-config-variant=VARIANT-PRE-COMPILE, module-description=FblBmHdr_Impl
    FblBmHdrHeader: FblBmHdrBlockStartAddress=2621440, FblBmHdrBlockLength=524288, FblBmHdrEntryAddress=Brs_ApplicationEntry, FblBmHdrTargetRef=Fbl
      FblBmHdrVariant
        FblBmHdrAuthenticationHeader: FblBmHdrAuthenticationHeaderAddress=2621440
    4 x FblBmHdrTarget:
      Appl: FblBmHdrTargetId=2
      Data: FblBmHdrTargetId=3
      Fbl: FblBmHdrTargetId=0
      FblUpdater: FblBmHdrTargetId=1
    FblBmHdrGeneral: FblBmHdrMaxVerificationEntries=1, FblBmHdrSbVerificationList=false
