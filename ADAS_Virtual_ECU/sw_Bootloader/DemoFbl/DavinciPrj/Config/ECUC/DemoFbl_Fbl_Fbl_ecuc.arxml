AUTOSAR XML (schema 00050)
package /ActiveEcuC
  module config Fbl: implementation-config-variant=VARIANT-LINK-TIME, module-description=Fbl_Impl
    FblGeneral:
      FblDataProcessingBufferSize = 256
      FblDiagnosticBufferSize = 4095
      FblFlashDriverUsage = USE_FLASH_DRIVER_FROM_ROM
      FblInternalMemoryCopy = true
      FblMaximumNumberOfSegments = 8
      FblOutputVerification = true
      FblP2Server = 50
      FblP2StarServer = 5000
      FblResponseAfterReset = false
      FblSleepTime = 300000
      FblUnalignedDataTransfer = true
      FblVerificationSegmentation = 256
      FblWriteSegmentation = 4096
      FblApplicationStateTask = true
      FblApplicationTimerTask = true
      FblPresencePattern = true
      FblStartFunction = true
      FblAdaptiveDataTransferRcrrp = false
      FblGatewaySupport = false
      FblInputVerification = false
      FblProcessedVerification = false
      FblS3ServerExtendedSession = 0
      FblS3ServerProgrammingSession = 0
      FblSuspendDriverOperation = false
      FblVerificationFunction = false
      FblReprogrammableLbt = false
      FblProjectState = INTEGRATION
      FblStayInBoot = false
      FblSleepMode = true
      FblHeaderAddress = 2425356736
      FblGapFilling = false
      FblFillCode = 255
      FblCommonData = true
      FblUserSubfunction = false
      FblUserService = false
      FblUserRoutine = false
      FblWatchdogService = false
      FblWatchdogTriggerCycle = 1
      FblEncryptionMode = false
      FblCompressionMode = true
      FblPipelinedVerification = false
      FblPipelinedProgramming = false
      FblBlockStartAddress = 2621440
      FblBlockLength = 524288
      FblOta = false
      FblOneStepUpdater = false
      FblHardwareSwap = false
      FblXcpSupport = false
      FblUserConfigFile = $(DpaProjectFolder)\Config\user_config_development.cfg
      FblMaximumAmountOfLogicalBlocks = 9
    FblMemoryDeviceTable
      3 x FblMemoryDevice, all with FblMdErasedValue=255, FblMdInitHook=false, FblMdDeinitHook=false, FblMdReadHook=false, FblMdEraseHook=false, FblMdWriteHook=false, FblMdVerifyHook=false:
        FlashWrapper: FblMdIndex=0, FblMdSegmentSize=4096
        Protected: FblMdSegmentSize=1, FblMdIndex=1
        RAM: FblMdIndex=2, FblMdSegmentSize=1
    FblFlashBlockTable
      12 x FblFlashBlock, all with FblFbMemoryDeviceRef=FlashWrapper:
        NvM: FblFbStartAddress=107216896, FblFbEndAddress=113508351, FblFbDescription=NvM area to store Certificates and DCL entries
        Autosar_App_MCU1_0_Flash: FblFbStartAddress=3145728, FblFbEndAddress=6291455, FblFbDescription=AUTOSAR Application in MCU1_0, FblFbLogicalBlockRef=MCU10_Application_LB
        BmFlash: FblFbStartAddress=2097152, FblFbEndAddress=2621439, FblFbDescription=
        FblFlash: FblFbStartAddress=2621440, FblFbEndAddress=3145727, FblFbDescription=, FblFbLogicalBlockRef=FBL_LB
        LateApp1_MCU20_MCU21_Flash: FblFbStartAddress=6291456, FblFbEndAddress=19922943, FblFbDescription=Lateapp1 in MCU2_0, FblFbLogicalBlockRef=LateApp1_MCU20_MCU21_LB
        AtfOptee_Flash: FblFbStartAddress=19922944, FblFbEndAddress=20447231, FblFbDescription=Arm Trusted Firmware + OPTEE, FblFbLogicalBlockRef=AtfOptee_LB
        IfsQNX_Flash: FblFbStartAddress=20447232, FblFbEndAddress=62390271, FblFbDescription=QNX Image File system, FblFbLogicalBlockRef=IfsQNX_LB
        C7x_Flash: FblFbStartAddress=62390272, FblFbEndAddress=72876031, FblFbDescription=C7x DSP, FblFbLogicalBlockRef=C7x_LB
        Extended_KeyRing: FblFbStartAddress=73924608, FblFbEndAddress=74186751, FblFbDescription=Extended KeyRing, FblFbLogicalBlockRef=ExtendedKeyRing
        CAL_Flash: FblFbStartAddress=72876032, FblFbEndAddress=73924607, FblFbDescription=Vehicle extrinsics and calibration values, FblFbLogicalBlockRef=CAL_LB
        Security_Cert_Flash: FblFbStartAddress=106954752, FblFbEndAddress=107216895, FblFbDescription=Post-production Security Certificates, FblFbLogicalBlockRef=Security_Cert_LB
        EOL: FblFbStartAddress=113639424, FblFbEndAddress=113770495, FblFbDescription=EOL Data
    FblLogicalBlockTable
      9 x FblLogicalBlock, all with FblLbMaxReprogAttempts=0, FblLbInputVerification=SecM_VerifySignature, FblLbProcessedVerification=SecM_VerifySignature, FblLbPipelinedVerification=SecM_VerifySignature, FblLbOutputVerification=SecM_Verification, FblLbDescription=:
        FBL_LB: FblLbBlockIndex=0, FblLbBlockType=BOOT, FblLbDisposability=MANDATORY, FblLbStartAddress=2621440, FblLbEndAddress=3145727, FblLbBmHeaderAddress=2621920
        MCU10_Application_LB: FblLbBlockIndex=1, FblLbDisposability=MANDATORY, FblLbStartAddress=3145728, FblLbEndAddress=6291455, FblLbBmHeaderAddress=3146304, FblLbBlockType=CODE
        LateApp1_MCU20_MCU21_LB: FblLbBlockIndex=2, FblLbDisposability=OPTIONAL, FblLbStartAddress=6291456, FblLbEndAddress=19922943, FblLbBmHeaderAddress=6291456, FblLbBlockType=CODE
        AtfOptee_LB: FblLbBlockIndex=3, FblLbDisposability=OPTIONAL, FblLbStartAddress=19922944, FblLbEndAddress=20447231, FblLbBmHeaderAddress=19922944, FblLbBlockType=CODE
        IfsQNX_LB: FblLbBlockIndex=4, FblLbDisposability=OPTIONAL, FblLbStartAddress=20447232, FblLbEndAddress=62390271, FblLbBmHeaderAddress=20447232, FblLbBlockType=CODE
        C7x_LB: FblLbBlockIndex=5, FblLbDisposability=OPTIONAL, FblLbStartAddress=62390272, FblLbEndAddress=72876031, FblLbBmHeaderAddress=62390272, FblLbBlockType=CODE
        CAL_LB: FblLbBlockIndex=6, FblLbDisposability=OPTIONAL, FblLbStartAddress=72876032, FblLbEndAddress=73924607, FblLbBmHeaderAddress=72876032, FblLbBlockType=DATA
        ExtendedKeyRing: FblLbBlockIndex=7, FblLbDisposability=OPTIONAL, FblLbStartAddress=73924608, FblLbEndAddress=74186751, FblLbBmHeaderAddress=73924608, FblLbBlockType=DATA
        Security_Cert_LB: FblLbBlockIndex=8, FblLbDisposability=OPTIONAL, FblLbStartAddress=106954752, FblLbEndAddress=107216895, FblLbBmHeaderAddress=106954752, FblLbBlockType=DATA
    FblFca:
      FblCheckProgrammingPreconditionsService = true
      FblApplicationValidityFlag = true
      FblAccessDelayTime = 2000
      FblSecurityAccessVariant = Authenticated
      FblRequestUpload = false
