AUTOSAR XML (schema 00050)
package /ActiveEcuC
  module config vMemAccM: implementation-config-variant=VARIANT-PRE-COMPILE, module-description=vMemAccM_Impl
    vMemAccMAddressAreaConfiguration_Active (vMemAccMAddressAreaConfiguration): vMemAccMAddressAreaId=0, vMemAccMAddressAreaPriority=0, vMemAccMReadRequestLength=4096
      vMemAccMSubAddressAreaConfiguration_Flash (vMemAccMSubAddressAreaConfiguration):
        vMemAccMNumberOfSectors = 502
        vMemAccMVirtualStartAddress = 0
        vMemAccMPhysicalStartAddress = 0
        vMemAccMvMemFuncPtrTableSymbol = vMem_30_vXSpi_Nand_FunctionPointerTable
        vMemAccMUseEraseBurst = false
        vMemAccMUseWriteBurst = false
        vMemAccMNrOfEraseRetries = 0
        vMemAccMNrOfWriteRetries = 1
        vMemAccMSectorRef = vMemSector
      vMemAccMSubAddressAreaConfiguration_BBM (vMemAccMSubAddressAreaConfiguration):
        vMemAccMNumberOfSectors = 10
        vMemAccMVirtualStartAddress = 131596288
        vMemAccMPhysicalStartAddress = 131596288
        vMemAccMvMemFuncPtrTableSymbol = vMem_30_vXSpi_Nand_FunctionPointerTable
        vMemAccMUseEraseBurst = false
        vMemAccMUseWriteBurst = false
        vMemAccMSectorRef = vMemSector_001
    vMemAccMGeneral:
      vMemAccMVersionInfoApi = false
      vMemAccMMainFunctionPeriod = 0.001
      vMemAccMMainFunctionTriggering = FixedCycleTime
      vMemAccMSafeBswChecks = false
      vMemAccMDevErrorDetect = true
      vMemAccMCompareApi = false
    vMemAccMMultiPartitionConfiguration: vMemAccMMultiPartitionUsecase=SynchronizeSingleNVRAMAccessor
      Satellite (vMemAccMPartitionConfiguration): vMemAccMPartitionId=1, vMemAccMNVRAMAccessToken=0x41c0292c, vMemAccMPartitionPublishRequest=0x41c02910, vMemAccMPartitionData=
      vMemAccMMasterPartitionConfiguration: vMemAccMMasterPartitionId=0
