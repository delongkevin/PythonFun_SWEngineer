AUTOSAR XML (schema 00050)
package /ActiveEcuC
  module config FblBm: implementation-config-variant=VARIANT-PRE-COMPILE, module-description=FblBm_Impl
    FblBmGeneral:
      FblBmFailsafeUpdater = false
      FblBmExecutionInstance = FlashBootloader
      FblBmIncludeHardwareConfiguration = false
      FblBmInitializeKeys = false
      FblBmSecureBoot = false
      FblBmStandaloneMode = true
      FblBmInitializeMacOfBootloader = false
      FblBmIncludeOemConfiguration = false
      FblBmHeaderAddress = 2424307712
