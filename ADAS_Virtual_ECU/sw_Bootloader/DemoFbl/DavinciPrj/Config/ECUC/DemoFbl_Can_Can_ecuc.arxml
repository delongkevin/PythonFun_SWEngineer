AUTOSAR XML (schema 00050)
package /ActiveEcuC
  module config Can: implementation-config-variant=VARIANT-PRE-COMPILE, module-description=Can_Impl
    CanGeneral:
      CanIndex = 0
      CanVersionInfoApi = false
      CanUseNestedCANInterrupts = false
      CanChangeBaudrateApi = true
      CanDevErrorDetection = false
      CanHardwareCancellation = false
      CanIdenticalIdCancellation = false
      CanMainFunctionBusoffPeriod = 0.01
      CanMainFunctionModePeriod = 0.01
      CanMainFunctionWakeupPeriod = 0.01
      CanMultiplexedTransmission = false
      CanSetBaudrateApi = false
      CanTimeoutDuration = 0.01
      CanGenericPrecopy = false
      CanHardwareLoopCheck = true
      CanSecureTempBuffer = false
      CanRxFullCANSupport = false
      CanTxFullCANSupport = false
      CanRxBasicCANSupport = true
      CanHardwareCancelByAppl = true
      CanIndividualProcessing = false
      CanGenericConfirmation = false
      CanGenericConfirmationAPI2 = false
      CanRxQueue = false
      CanSupportMixedID = false
      CanRxQueueSize = 10
      CanMultipleBasicCANObjects = false
      CanMultipleBasicCANTxObjects = false
      CanHardwareHandleType = UINT8
      CanOptimizeOneController = true
      CanInterruptCategory = VOIDFUNCVOID
      CanGetStatus = false
      CanInterruptLock = DRIVER
      CanWakeupSupport = false
      CanRamCheck = None
      CanOverrunNotification = None
      CanReinitStart = false
      CanGenericPreTransmit = false
      CanFdSupport = FULL
      CanRuntimeMeasurementSupport = false
      CanMaxRxDataLen = 64
      CanMaxTxDataLen = 64
      CanUsePeripheralAccessApi = false
      CanMirrorModeSupport = false
      CanUseOsInterruptControl = false
      CanSafeBswChecks = false
      CanSilentModeSupport = false
      CanHwTxFifoSupport = false
      CanMcanRevision = M_CAN_REV_315
      CanCheckWakeupCanRetType = false
      CanFdHardwareBufferOptimization = true
      CanEccInit = true
      CanUseVirtualAddressing = false
      CanEnableSecurityEventReporting = false
      CanCounterRef = OsCounter
      CanMainFunctionRWPeriods: CanMainFunctionReadPeriod=0.005, CanMainFunctionWritePeriod=0.005
    CanConfigSet
      CN_DemoFBL_Vector_SLP3_599e8ccc_Tx (CanHardwareObject):
        CanHandleType = BASIC
        CanIdValue = 0
        CanObjectType = TRANSMIT
        CanIdType = EXTENDED
        CanObjectId = 0
        CanHwProcessing = true
        CanObjectHwSize = 1
        CanObjectHwHandle = 0
        CanMaxDataLen = 64
        CanFdPaddingValue = 0
        CanObjectMultiplexedTransmission = false
        CanObjectHwFifo = false
        CanControllerRef = CT_DemoFBL_Vector_SLP3_d34c962b
      CT_DemoFBL_Vector_SLP3_d34c962b (CanController):
        CanControllerActivation = true
        CanBusoffProcessing = POLLING
        CanRxProcessing = POLLING
        CanTxProcessing = POLLING
        CanWakeupProcessing = POLLING
        CanControllerBaseAddress = 1079148544
        CanControllerId = 0
        CanWakeupSupport = false
        CanWakeupSourceId = 0
        CanBasisAddressEnum = M_CAN0
        CanTxBufferElementSize = ES_64
        CanRxBufferElementSize = ES_8
        CanRxFifo0ElementSize = ES_64
        CanRxFifo1ElementSize = ES_8
        CanMaxNrOfRxFifo0Elements = 64
        CanMaxNrOfRxFifo1Elements = 64
        CanMaxNrOfRxBuffers = 64
        CanMaxNrOfTxBuffers = 32
        CanIsTTCAN = false
        CanTxEfBufferElementSize = ES_8
        CanControllerDefaultBaudrate = CanControllerBaudrateConfig
        CanControllerSystemRef = CT_DemoFBL_Vector_SLP3
        CanWakeupSourceRef = CN_DemoFBL_Vector_SLP3_599e8ccc
        CanCpuClockRef = McuClockReferencePoint_CAN
        CanControllerBaudrateConfig:
          CanControllerBaudRate = 500
          CanControllerBaudRateConfigID = 0
          CanControllerPropSeg = 5
          CanControllerSeg1 = 2
          CanControllerSeg2 = 2
          CanControllerSyncJumpWidth = 2
          CanBaudrateClock = 80000
          CanBaudratePrescaler = 16
          CanControllerFdBaudrateConfig:
            CanControllerFdBaudRate = 2000
            CanControllerPropSeg = 3
            CanControllerSeg1 = 4
            CanControllerSeg2 = 2
            CanControllerSyncJumpWidth = 2
            CanControllerTxBitRateSwitch = true
            CanBaudratePrescaler = 4
            CanControllerTrcvDelayCompensationFilter = 32
        CanFilterMask: CanFilterMaskValue=2147483648, CanFilterCodeValue=0, IsLocked=false
      CN_DemoFBL_Vector_SLP3_36153a3c_Rx (CanHardwareObject):
        CanHandleType = BASIC
        CanIdType = EXTENDED
        CanIdValue = 0
        CanObjectType = RECEIVE
        CanObjectId = 1
        CanHwProcessing = true
        CanObjectHwSize = 6
        CanObjectHwHandle = 0
        CanMaxDataLen = 64
        CanFdPaddingValue = 0
        CanObjectMultiplexedTransmission = false
        CanObjectHwFifo = false
        CanControllerRef = CT_DemoFBL_Vector_SLP3_d34c962b
        CanFilterMaskRef = CanFilterMask
