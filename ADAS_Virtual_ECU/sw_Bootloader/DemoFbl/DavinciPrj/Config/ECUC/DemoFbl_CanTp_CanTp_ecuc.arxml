AUTOSAR XML (schema 00050)
package /ActiveEcuC
  module config CanTp: implementation-config-variant=VARIANT-PRE-COMPILE, module-description=CanTp_Impl
    CanTpGeneral:
      CanTpVersionInfoApi = false
      CanTpSupportExtendedAddressing = false
      CanTpSupportMixed11Addressing = false
      CanTpSupportStandardAddressing = true
      CanTpChangeParameterApi = false
      CanTpDevErrorDetect = false
      CanTpPaddingByte = 204
      CanTpReadParameterApi = false
      CanTpHavePaddingByte = true
      CanTpNumRxChannels = 0
      CanTpNumTxChannels = 0
      CanTpEnableSplitMainFunction = false
      CanTpSupportMixed29Addressing = true
      CanTpSupportNormalFixedAddressing = true
      CanTpSupportCustomAddressing = false
      CanTpOnlyNotifyInformedAppl = true
      CanTpRc = false
      CanTpTc = false
      CanTpSafeBswChecks = false
      CanTpEnableSynchronousTransmit = true
      CanTpFlexibleDataRateSupport = true
      CanTpSupportLongFirstFrames = true
      CanTpEnableNonStrictLengthCheck = true
      CanTpPaddingActive = true
    CanTpConfig: CanTpMainFunctionPeriod=0.001
      5 x CanTpChannel, all with CanTpChannelMode=CANTP_MODE_FULL_DUPLEX:
        TPCH_e6e4d627
          CanTpTxNSdu_1ca716a4 (CanTpTxNSdu):
            CanTpTxAddressingFormat = CANTP_STANDARD
            CanTpTxDl = 64
            CanTpTxTaType = CANTP_CANFD_PHYSICAL
            CanTpNas = 0.1
            CanTpNcs = 0.2
            CanTpTc = false
            CanTpTxNSduId = 1
            CanTpTxPaddingActivation = CANTP_OFF
            CanTpNbs = 0.5
            CanTpTxNSduRef = Demo_0_CAN_FD_Response_oDemoFBL_Fca_SLP5_55a79f5b_Tx
            CanTpRxFcNPdu_2987a92d (CanTpRxFcNPdu): CanTpRxFcNPduId=1, CanTpRxFcNPduRef=Demo_0_CAN_FD_Request_Tp_oDemoFBL_Fca_SLP5_480939e9_Rx
            CanTpTxNPdu_2987a92d (CanTpTxNPdu): CanTpTxNPduConfirmationPduId=1, CanTpTxNPduRef=Demo_0_CAN_FD_Response_Tp_oDemoFBL_Fca_SLP5_370a354e_Tx
          CanTpRxNSdu_1ca716a4 (CanTpRxNSdu):
            CanTpRxAddressingFormat = CANTP_STANDARD
            CanTpRxDl = 64
            CanTpRxTaType = CANTP_CANFD_PHYSICAL
            CanTpNbr = 0.1
            CanTpRxNSduId = 2
            CanTpRxPaddingActivation = CANTP_OFF
            CanTpBs = 0
            CanTpNar = 0.1
            CanTpNcr = 0.5
            CanTpRxWftMax = 15
            CanTpSTmin = 0
            CanTpRxNSduRef = Demo_0_CAN_FD_Request_oDemoFBL_Fca_SLP5_e6d1155f_Rx
            CanTpRxNPdu_0b7d7ddf (CanTpRxNPdu): CanTpRxNPduId=1, CanTpRxNPduRef=Demo_0_CAN_FD_Request_Tp_oDemoFBL_Fca_SLP5_480939e9_Rx
            CanTpTxFcNPdu_0b7d7ddf (CanTpTxFcNPdu): CanTpTxFcNPduConfirmationPduId=1, CanTpTxFcNPduRef=Demo_0_CAN_FD_Response_Tp_oDemoFBL_Fca_SLP5_370a354e_Tx
        TPCH_2cf8b8b0
          CanTpRxNSdu_7ae70fe5 (CanTpRxNSdu):
            CanTpRxAddressingFormat = CANTP_STANDARD
            CanTpRxDl = 64
            CanTpRxTaType = CANTP_CANFD_FUNCTIONAL
            CanTpNbr = 0.1
            CanTpRxNSduId = 0
            CanTpRxPaddingActivation = CANTP_OFF
            CanTpRxNSduRef = Functional_CAN_FD_oDemoFBL_Fca_SLP5_a6dc7e27_Rx
            CanTpRxNPdu_d1898b63 (CanTpRxNPdu): CanTpRxNPduId=3, CanTpRxNPduRef=Functional_CAN_FD_Tp_oDemoFBL_Fca_SLP5_ea53ce90_Rx
        TPCH_7d0161ac
          CanTpRxNSdu_b2964663 (CanTpRxNSdu):
            CanTpRxAddressingFormat = CANTP_STANDARD
            CanTpRxDl = 8
            CanTpRxTaType = CANTP_PHYSICAL
            CanTpNbr = 0.1
            CanTpRxNSduId = 1
            CanTpRxPaddingActivation = CANTP_ON
            CanTpBs = 0
            CanTpNar = 0.1
            CanTpNcr = 0.5
            CanTpRxWftMax = 15
            CanTpSTmin = 0
            CanTpRxNSduRef = Demo_0_CAN_20_Request_oDemoFBL_Vector_SLP3_d449ce03_Rx
            CanTpTxFcNPdu_a624ba96 (CanTpTxFcNPdu): CanTpTxFcNPduConfirmationPduId=0, CanTpTxFcNPduRef=Demo_0_CAN_20_Response_Tp_oDemoFBL_Vector_SLP3_bc15b852_Tx
            CanTpRxNPdu_a624ba96 (CanTpRxNPdu): CanTpRxNPduId=0, CanTpRxNPduRef=Demo_0_CAN_20_Request_Tp_oDemoFBL_Vector_SLP3_3a7abdec_Rx
          CanTpTxNSdu_b2964663 (CanTpTxNSdu):
            CanTpTxAddressingFormat = CANTP_STANDARD
            CanTpTxDl = 8
            CanTpTxTaType = CANTP_PHYSICAL
            CanTpNas = 0.1
            CanTpNcs = 0.2
            CanTpTc = false
            CanTpTxNSduId = 0
            CanTpTxPaddingActivation = CANTP_OFF
            CanTpNbs = 0.5
            CanTpTxNSduRef = Demo_0_CAN_20_Response_oDemoFBL_Vector_SLP3_366a5b38_Tx
            CanTpRxFcNPdu_84de6e64 (CanTpRxFcNPdu): CanTpRxFcNPduId=0, CanTpRxFcNPduRef=Demo_0_CAN_20_Request_Tp_oDemoFBL_Vector_SLP3_3a7abdec_Rx
            CanTpTxNPdu_84de6e64 (CanTpTxNPdu): CanTpTxNPduConfirmationPduId=0, CanTpTxNPduRef=Demo_0_CAN_20_Response_Tp_oDemoFBL_Vector_SLP3_bc15b852_Tx
        TPCH_f05f9d6c
          CanTpRxNSdu_e190cd69 (CanTpRxNSdu):
            CanTpRxAddressingFormat = CANTP_STANDARD
            CanTpRxDl = 8
            CanTpRxTaType = CANTP_FUNCTIONAL
            CanTpNbr = 0.1
            CanTpRxNSduId = 3
            CanTpRxPaddingActivation = CANTP_ON
            CanTpRxNSduRef = Functional_CAN_20_oDemoFBL_Vector_SLP3_a93996e4_Rx
            CanTpRxNPdu_b0bf513f (CanTpRxNPdu): CanTpRxNPduId=2, CanTpRxNPduRef=Functional_CAN_20_Tp_oDemoFBL_Vector_SLP3_b4b0ddd4_Rx
        CanTpChannel
