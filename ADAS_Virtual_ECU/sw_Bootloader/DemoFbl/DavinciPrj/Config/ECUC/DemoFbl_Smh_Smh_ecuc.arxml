AUTOSAR XML (schema 00050)
package /ActiveEcuC
  module config Smh: implementation-config-variant=VARIANT-LINK-TIME, module-description=Smh_Impl
    SmhCrc: SmhCRCType=CRC_32
      SmhCrc32: SmhOptimization=SPEED, SmhInitialValue=4294967295, SmhPolynomial=3988292384, SmhMode=REFLECTED, SmhComplementValue=4294967295
    SmhVerification
      SmhMonolithicVerification:
        SmhExportVerificationWrapper = false
        SmhOperationCountOfWrapper = 4
        SmhCheckAddressRangeOverflow = false
        SmhAssertReadCount = false
        SmhCRCTotal = false
        SmhCRCWritten = false
        SmhMemoryAccessMode = ADDRESS
        SmhReadBufferSize = 64
        SmhCRCWrittenGet = false
        SmhDefaultMonolithicVerificationConfig = SmhSecurityClassVendor/SmhSecurityClassVendorConfig
        SmhSecurityClassDDD: SmhDefaultSecurityClassDDDConfig=SmhSecurityClassDDD/SmhSecurityClassDDDConfig
          SmhSecurityClassDDDConfig:
            SmhIncludeAddressAndLengthInSignature = false
            SmhSignatureOffset = 2
            SmhCRCOffset = 2
            SmhFunctionName = SecM_VerificationClassDDD_SHA256
            SmhStreamVerificationConfig = SmhSecurityClassDDD/SmhSecurityClassDDDConfig
        SmhSecurityClassVendor: SmhDefaultSecurityClassVendorConfig=SmhSecurityClassVendor/SmhSecurityClassVendorConfig
          SmhSecurityClassVendorConfig:
            SmhIncludeAddressAndLengthInSignature = false
            SmhSignatureOffset = 0
            SmhCRCOffset = 0
            SmhFunctionName = SecM_VerifyClassVendorBlock
            SmhStreamVerificationConfig = SmhSecurityClassVendor/SmhSecurityClassVendorConfig
      SmhStreamVerification: SmhDefaultStreamVerificationConfig=SmhSecurityClassDDD/SmhSecurityClassDDDConfig
        SmhSecurityClassDDD: SmhDefaultSecurityClassDDDConfig=SmhSecurityClassDDD/SmhSecurityClassDDDConfig
          SmhSecurityClassDDDConfig: SmhUpdateLengthOfHashedData=false, SmhComputationOnly=false, SmhFunctionName=SecM_VerifySHA256
            SmhSecurityClassDDDType
              SmhHash: SmhJobRef=SmhJob_CalculateHash/SmhJob_CalculateHash
        SmhSecurityClassCCC: SmhDefaultSecurityClassCCCConfig=SmhSecurityClassCCCConfig
          SmhSecurityClassCCCConfig:
            SmhFunctionName = SecM_AuthDiag_Certificate_VerifySign
            SmhUpdateLengthOfHashedData = false
            SmhContextBufferSize = 0
            SmhJobRef = SmhJob_SignatureVerify/SmhJob_SignatureVerify
        SmhSecurityClassVendor: SmhDefaultSecurityClassVendorConfig=SmhSecurityClassVendor/SmhSecurityClassVendorConfig
          SmhSecurityClassVendorConfig: SmhSizeOfVendorChecksum=1, SmhClassVendorFunctionName=SecM_VerifyClassVendorStream
    SmhSeedKey: SmhKeyTimeout=100, SmhCallCycle=10
      SmhSeedConfig: SmhSeedLength=4, SmhSeedType=HIS
        SmhSeedGeneration
          SmhLcg: SmhMultiplier=2147001325, SmhIncrement=715136305
      SmhKeyConfig: SmhKeyConstant=4294967295, SmhExternalComparison=false, SmhKeyType=HIS, SmhKeyLength=4, SmhSecretKeyLength=0, SmhExtendedApi=false, SmhAsymmetric=false
    SmhGeneral:
      SmhOperationMode = PRODUCTION
      SmhWatchdogCycleCount = 1
      SmhCryptographicKeysLocatedInRAM = false
      SmhProvidevSecPrimRandomFunction = false
      SmhSaveRestoreContext = false
      SmhUserConfigFile = $(DpaProjectFolder)\Config\user_config_smh.cfg
    SmhEncryption
    SmhCryptographicKeys: SmhElementIdRSAPublicExponent=161, SmhElementIdRSAModulus=160, SmhElementIdRSAPrivateExponent=162
      SmhKeyOperations: SmhAccessKeyElementApis=true, SmhCopyKeyElementApi=false, SmhCopyKeyApi=false
        4 x SmhAccessKeyElementOperation:
          SmhAccessKeyElementOperation_Certificate: SmhSetKeyElementMacroName=SecM_AuthDiag_Certificate_SetValue, SmhGetKeyElementMacroName=SecM_AuthDiag_Certificate_GetValue, SmhCsmKeyRef=CsmKey_KeyMCertificate_ADA_L4, SmhCryptographicKeyValueRef=SmhKeyValue_KeyM_Certificate
          SmhAccessKeyElementOperation_RoleFlag: SmhSetKeyElementMacroName=SecM_AuthDiag_SetStatus, SmhGetKeyElementMacroName=SecM_AuthDiag_GetStatus, SmhCsmKeyRef=CsmKey_RoleFlag, SmhCryptographicKeyValueRef=SmhKeyValue_RoleFlag
          SmhAccessKeyElementOperation_KeyM_GetStatus: SmhSetKeyElementMacroName=SecM_AuthDiag_Certificate_SetStatus, SmhGetKeyElementMacroName=SecM_AuthDiag_Certificate_GetStatus, SmhCsmKeyRef=CsmKey_KeyMCertificate_ADA_L4, SmhCryptographicKeyValueRef=SmhKeyValue_KeyM_GetStatus
          SmhAccessKeyElementOperation: SmhSetKeyElementMacroName=SecM_AuthDiag_Certificate_SetVerify, SmhGetKeyElementMacroName=SecM_AuthDiag_Certificate_GetVerify, SmhCsmKeyRef=CsmKey_KeyMCertificate_ADA_L4, SmhCryptographicKeyValueRef=SmhKeyValue_KeyM_Verify_Certificate
      4 x SmhKeyValue, all with SmhSuffix=, SmhValue=, SmhDescription=:
        SmhKeyValue_KeyM_Certificate: SmhCryptoKeyElementRef=Crypto_30_vHsm_KeyM_KeyM_Certificate
        SmhKeyValue_KeyM_GetStatus: SmhCryptoKeyElementRef=Crypto_30_vHsm_KeyM_KeyM_GetStatus
        SmhKeyValue_RoleFlag: SmhCryptoKeyElementRef=Crypto_30_vHsm_LibCv_RoleFlag
        SmhKeyValue_KeyM_Verify_Certificate: SmhCryptoKeyElementRef=Crypto_30_vHsm_KeyM_KeyM_VerifyCertificate
    4 x SmhJob:
      SmhJob_TRNG
        SmhJob_TRNG (SmhRandomGenerate): SmhCsmJobRef=CsmJob_TRNGGen
      SmhJob_SignatureVerify
        SmhJob_SignatureVerify (SmhSignatureVerify): SmhCsmJobRef=CsmJob_SignatureVerify_ADA
      Smh_GetCertificateElement
        Smh_GetCertificateElement (SmhAEADEncrypt): SmhJobMacroName=Smh_GetCertificateElement_ADACert, SmhCsmJobRef=CsmJob_GetRoleFromTesterCertificate
      SmhJob_CalculateHash
        SmhJob_CalculateHash (SmhHash): SmhCsmJobRef=CsmJob_CalculateHash
