AUTOSAR XML (schema 00050)
package /ActiveEcuC
  module config vMem: implementation-config-variant=VARIANT-PRE-COMPILE, module-description=vMem_Impl
    vMemInstance: vMemInstanceId=0
      vMemSectorList
        vMemSector: vMemNumberOfSectors=256, vMemPageSize=256, vMemSectorSize=131072, vMemStartAddress=2533359616  # For NOR FLASH Configuration PLAIN_TEXT This shall not be used in production case for Magna
    vMemGeneral: vMemUseIsBlank=false, vMemUserMainFunction=false, vMemUserInitFunction=false, vMemCompareAfterWrite=false, vMemInitHandling=ALL_DRIVERS_MANDATORY
    vMemInstanceMapping_vMemInstance_ExtFlash (vMemInstanceMapping): vMemvMemInstanceRef=vMemInstance_ExtFlash, vMemFblMemoryDeviceRef=FlashWrapper
