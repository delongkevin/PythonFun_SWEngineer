AUTOSAR XML (schema 00050)
package /ActiveEcuC
  module config NvM: implementation-config-variant=VARIANT-PRE-COMPILE, module-description=NvM_Impl
    NvMConfigBlock (NvMBlockDescriptor):
      NvMBlockCrcType = NVM_CRC16
      NvMNvramBlockIdentifier = 1
      NvMBlockManagementType = NVM_BLOCK_REDUNDANT
      NvMNvBlockNum = 2
      NvMBlockUseCrc = true
      NvMNvBlockLength = 2
      NvMSelectBlockForReadAll = true
      NvMResistantToChangedSw = true
      NvMUseInitCallback = false
      NvMSelectBlockForWriteAll = true
      NvMCalcRamBlockCrc = false
      NvMRomBlockDataAddress = NULL_PTR
      NvMBlockPostReadTransformCallback = NULL_PTR
      NvMBlockPreWriteTransformCallback = NULL_PTR
      NvMBlockUseSetRamBlockStatus = true
      NvMBlockJobPriority = 127
      NvMBlockUseSyncMechanism = false
      NvMBlockWriteProt = false
      NvMBswMBlockStatusInformation = false
      NvMWriteBlockOnce = false
      NvMUseServicePorts = false
      NvMUseJobendCallback = false
      NvMBlockUseCRCCompMechanism = false
      NvMInvokeCallbacksForReadAll = true
      NvMInvokeCallbacksForWriteAll = true
      NvMCheckLossOfRedundancy = false
      NvMAutomaticBlockLength = false
      NvMBlockLengthCheck = false
      NvMRamBlockDataAddress = NULL_PTR
      NvMTargetBlockReference
        NvMEaRef: NvMNameOfEaBlock=EaBlockConfiguration
    NvMCommon:
      NvMApiConfigClass = NVM_API_CONFIG_CLASS_3
      NvMBswMMultiBlockJobStatusInformation = false
      NvMCompiledConfigId = 2
      NvMCrcNumOfBytes = 64
      NvMDatasetSelectionBits = 4
      NvMDevErrorDetect = true
      NvMDrvModeSwitch = true
      NvMDynamicConfiguration = false
      NvMJobPrioritization = false
      NvMPollingMode = true
      NvMSetRamBlockStatusApi = true
      NvMSizeStandardJobQueue = 8
      NvMVersionInfoApi = false
      NvMMaxNoOfWriteRetries = 1
      NvMMainFunctionPeriod = 0.01
      NvMUseBlockIdCheck = false
      NvMRepairRedundantBlocksApi = false
      NvMSafeBswChecks = false
      NvMDetectedLossOfRedundancyCallback = NULL_PTR
    NvMCommonVendorParams: NvMDataIntegrityIntBuffer=true, NvMKillWriteAllApi=true
    31 x NvMBlockDescriptor, all with NvMBlockJobPriority=127, NvMBlockUseSyncMechanism=false, NvMBlockWriteProt=false, NvMBswMBlockStatusInformation=false, NvMResistantToChangedSw=true, NvMWriteBlockOnce=false, NvMUseJobendCallback=false, NvMUseInitCallback=false, NvMBlockUseCRCCompMechanism=false, NvMBlockUseSetRamBlockStatus=false, NvMInvokeCallbacksForReadAll=true, NvMInvokeCallbacksForWriteAll=true, NvMCheckLossOfRedundancy=false:
      SWC_ConfigMgrVIN_OriginalVal: NvMBlockManagementType=NVM_BLOCK_NATIVE, NvMBlockUseCrc=true, NvMNvBlockLength=17, NvMNvBlockNum=1, NvMNvramBlockIdentifier=27, NvMUseServicePorts=true, NvMSelectBlockForReadAll=false, NvMRamBlockDataAddress=, NvMRomBlockDataAddress=, NvMSelectBlockForWriteAll=false, NvMWriteVerification=true, NvMBlockCrcType=NVM_CRC16, NvMAutomaticBlockLength=false, NvMBlockLengthCheck=false, NvMCalcRamBlockCrc=false  # UC:Derived from NvBlockNeeds
        NvMTargetBlockReference
          NvMEaRef: NvMNameOfEaBlock=EaSWC_ConfigMgrVIN_OriginalVal
      NvMBlockDescriptor_ApplUpdate: NvMBlockManagementType=NVM_BLOCK_NATIVE, NvMBlockUseCrc=true, NvMNvBlockLength=1, NvMNvBlockNum=1, NvMNvramBlockIdentifier=2, NvMUseServicePorts=false, NvMBlockCrcType=NVM_CRC16, NvMSelectBlockForReadAll=false, NvMSelectBlockForWriteAll=false, NvMAutomaticBlockLength=false, NvMBlockLengthCheck=false, NvMBlockLengthCheckType=false, NvMCalcRamBlockCrc=false
        NvMTargetBlockReference
          NvMEaRef: NvMNameOfEaBlock=EaBlock_ApplUpdate
      NvMBlockDescriptor_SecAccessDelayFlag: NvMBlockManagementType=NVM_BLOCK_NATIVE, NvMBlockUseCrc=true, NvMNvBlockLength=1, NvMNvBlockNum=1, NvMNvramBlockIdentifier=4, NvMUseServicePorts=false, NvMAutomaticBlockLength=false, NvMBlockCrcType=NVM_CRC16, NvMBlockLengthCheck=false, NvMCalcRamBlockCrc=false
        NvMTargetBlockReference
          NvMEaRef: NvMNameOfEaBlock=EaBlockDescriptor_SecAccessDelayFlag
      NvMBlockDescriptor_SecAccessInvalidCount: NvMBlockManagementType=NVM_BLOCK_NATIVE, NvMBlockUseCrc=true, NvMNvBlockLength=1, NvMNvBlockNum=1, NvMNvramBlockIdentifier=5, NvMUseServicePorts=false, NvMAutomaticBlockLength=false, NvMBlockCrcType=NVM_CRC16, NvMBlockLengthCheck=false, NvMCalcRamBlockCrc=false
        NvMTargetBlockReference
          NvMEaRef: NvMNameOfEaBlock=EaBlockDescriptor_SecAccessInvalidCount
      NvMBlockDescriptor_ApplValidity: NvMBlockManagementType=NVM_BLOCK_NATIVE, NvMBlockUseCrc=true, NvMNvBlockLength=1, NvMNvBlockNum=1, NvMNvramBlockIdentifier=6, NvMUseServicePorts=false, NvMCalcRamBlockCrc=false, NvMBlockLengthCheckType=false, NvMBlockLengthCheck=false, NvMAutomaticBlockLength=false, NvMBlockCrcType=NVM_CRC16
        NvMTargetBlockReference
          NvMEaRef: NvMNameOfEaBlock=EaBlockDescriptor_ApplValidity
      NvMBlockDescriptor_DcmDslRxTesterSourceAddr: NvMBlockManagementType=NVM_BLOCK_NATIVE, NvMBlockUseCrc=true, NvMNvBlockLength=2, NvMNvBlockNum=1, NvMNvramBlockIdentifier=7, NvMUseServicePorts=false, NvMAutomaticBlockLength=false, NvMBlockCrcType=NVM_CRC16, NvMBlockLengthCheck=false, NvMCalcRamBlockCrc=false
        NvMTargetBlockReference
          NvMEaRef: NvMNameOfEaBlock=EaBlockDescriptor_DcmDslRxTesterSourceAddr
      NvMBlockDescriptor_ValidityFlags: NvMBlockManagementType=NVM_BLOCK_NATIVE, NvMBlockUseCrc=true, NvMNvBlockLength=2, NvMNvBlockNum=1, NvMNvramBlockIdentifier=8, NvMUseServicePorts=false, NvMAutomaticBlockLength=false, NvMBlockCrcType=NVM_CRC16, NvMBlockLengthCheck=false, NvMCalcRamBlockCrc=false
        NvMTargetBlockReference
          NvMEaRef: NvMNameOfEaBlock=EaBlockDescriptor_ValidityFlags
      NvMBlockDescriptor_ExhaustRegulationTan: NvMBlockManagementType=NVM_BLOCK_NATIVE, NvMBlockUseCrc=true, NvMNvBlockLength=6, NvMNvBlockNum=1, NvMNvramBlockIdentifier=9, NvMUseServicePorts=false, NvMAutomaticBlockLength=false, NvMBlockCrcType=NVM_CRC16, NvMBlockLengthCheck=false, NvMCalcRamBlockCrc=false
        NvMTargetBlockReference
          NvMEaRef: NvMNameOfEaBlock=EaBlockDescriptor_ExhaustRegulationTan
      NvMBlockDescriptor_ResetResponseFlag: NvMBlockManagementType=NVM_BLOCK_NATIVE, NvMBlockUseCrc=true, NvMNvBlockLength=1, NvMNvBlockNum=1, NvMNvramBlockIdentifier=10, NvMUseServicePorts=false, NvMAutomaticBlockLength=false, NvMBlockCrcType=NVM_CRC16, NvMBlockLengthCheck=false, NvMCalcRamBlockCrc=false
        NvMTargetBlockReference
          NvMEaRef: NvMNameOfEaBlock=EaBlockDescriptor_ResetResponseFlag
      NvMBlockDescriptor_DID_2010_ProgrammingStatus: NvMBlockManagementType=NVM_BLOCK_NATIVE, NvMBlockUseCrc=true, NvMNvBlockLength=2, NvMNvBlockNum=1, NvMNvramBlockIdentifier=12, NvMUseServicePorts=false, NvMAutomaticBlockLength=false, NvMBlockCrcType=NVM_CRC16, NvMBlockLengthCheck=false, NvMCalcRamBlockCrc=false
        NvMTargetBlockReference
          NvMEaRef: NvMNameOfEaBlock=EaBlockDescriptor_DID_2010_ProgrammingStatus
      NvMBlockDescriptor_MetaData: NvMBlockManagementType=NVM_BLOCK_DATASET, NvMBlockUseCrc=true, NvMNvBlockLength=126, NvMNvBlockNum=10, NvMNvramBlockIdentifier=13, NvMUseServicePorts=false, NvMAutomaticBlockLength=false, NvMBlockCrcType=NVM_CRC16, NvMBlockLengthCheck=false, NvMCalcRamBlockCrc=false
        NvMTargetBlockReference
          NvMEaRef: NvMNameOfEaBlock=EaBlockDescriptor_MetaData
      SWC_DIDMgrDID_2002_OdoFlashing_MirrorBlock: NvMBlockManagementType=NVM_BLOCK_NATIVE, NvMBlockUseCrc=true, NvMNvBlockLength=2, NvMNvBlockNum=1, NvMNvramBlockIdentifier=26, NvMUseServicePorts=true, NvMCalcRamBlockCrc=false, NvMSelectBlockForReadAll=false, NvMRamBlockDataAddress=, NvMRomBlockDataAddress=, NvMSelectBlockForWriteAll=false, NvMBlockCrcType=NVM_CRC16, NvMBlockLengthCheck=false, NvMAutomaticBlockLength=false  # UC:Derived from NvBlockNeeds
        NvMTargetBlockReference
          NvMEaRef: NvMNameOfEaBlock=EaBlockDescriptor_DID_2002_OdoFlashing
      SWC_PartNumMgrDID_F110_Ecu_Diag_Info: NvMBlockManagementType=NVM_BLOCK_NATIVE, NvMBlockUseCrc=true, NvMNvBlockLength=6, NvMNvBlockNum=1, NvMNvramBlockIdentifier=25, NvMUseServicePorts=true, NvMSelectBlockForReadAll=false, NvMRamBlockDataAddress=, NvMRomBlockDataAddress=, NvMSelectBlockForWriteAll=false, NvMAutomaticBlockLength=false, NvMBlockLengthCheck=false, NvMCalcRamBlockCrc=false, NvMBlockCrcType=NVM_CRC16  # UC:Derived from NvBlockNeeds
        NvMTargetBlockReference
          NvMEaRef: NvMNameOfEaBlock=EaBlockDescriptor_DID_F110_Ecu_Diag_Id_FlashDefinitionNumber
      SWC_PartNumMgrDID_F132_EBOM_Ecu_PartNum: NvMBlockManagementType=NVM_BLOCK_NATIVE, NvMBlockUseCrc=true, NvMNvBlockLength=10, NvMNvBlockNum=1, NvMNvramBlockIdentifier=22, NvMUseServicePorts=true, NvMSelectBlockForReadAll=false, NvMRamBlockDataAddress=, NvMRomBlockDataAddress=, NvMSelectBlockForWriteAll=false, NvMAutomaticBlockLength=false, NvMBlockLengthCheck=false, NvMCalcRamBlockCrc=false, NvMBlockCrcType=NVM_CRC16  # UC:Derived from NvBlockNeeds
        NvMTargetBlockReference
          NvMEaRef: NvMNameOfEaBlock=EaBlockDescriptor_DID_F132_EBOM_Ecu_PartNum
      SWC_PartNumMgrDID_F133_EBOM_Asm_PartNum: NvMBlockManagementType=NVM_BLOCK_NATIVE, NvMBlockUseCrc=true, NvMNvBlockLength=10, NvMNvBlockNum=1, NvMNvramBlockIdentifier=17, NvMUseServicePorts=true, NvMSelectBlockForReadAll=false, NvMRamBlockDataAddress=, NvMRomBlockDataAddress=, NvMSelectBlockForWriteAll=false, NvMAutomaticBlockLength=false, NvMBlockLengthCheck=false, NvMCalcRamBlockCrc=false, NvMBlockCrcType=NVM_CRC16  # UC:Derived from NvBlockNeeds
        NvMTargetBlockReference
          NvMEaRef: NvMNameOfEaBlock=EaBlockDescriptor_DID_F133_EBOM_Asm_PartNum
      SWC_PartNumMgrDID_F134_CODEP_Asm_PartNum: NvMBlockManagementType=NVM_BLOCK_NATIVE, NvMBlockUseCrc=true, NvMNvBlockLength=11, NvMNvBlockNum=1, NvMNvramBlockIdentifier=21, NvMUseServicePorts=true, NvMSelectBlockForReadAll=false, NvMRamBlockDataAddress=, NvMRomBlockDataAddress=, NvMSelectBlockForWriteAll=false, NvMAutomaticBlockLength=false, NvMBlockLengthCheck=false, NvMCalcRamBlockCrc=false, NvMBlockCrcType=NVM_CRC16  # UC:Derived from NvBlockNeeds
        NvMTargetBlockReference
          NvMEaRef: NvMNameOfEaBlock=EaBlockDescriptor_DID_F134_CODEP_Asm_PartNum
      SWC_PartNumMgrDID_F180_Boot_SW_Ver_Info: NvMBlockManagementType=NVM_BLOCK_NATIVE, NvMBlockUseCrc=true, NvMNvBlockLength=13, NvMNvBlockNum=1, NvMNvramBlockIdentifier=11, NvMUseServicePorts=true, NvMSelectBlockForReadAll=false, NvMRamBlockDataAddress=, NvMRomBlockDataAddress=, NvMSelectBlockForWriteAll=false, NvMAutomaticBlockLength=false, NvMBlockLengthCheck=false, NvMCalcRamBlockCrc=false, NvMBlockCrcType=NVM_CRC16  # UC:Derived from NvBlockNeeds
        NvMTargetBlockReference
          NvMEaRef: NvMNameOfEaBlock=EaBlockDescriptor_DID_F180_Boot_SW_Ver_Info
      SWC_PartNumMgrDID_F187_CODEP_Ecu_PartNum: NvMBlockManagementType=NVM_BLOCK_NATIVE, NvMBlockUseCrc=true, NvMNvBlockLength=11, NvMNvBlockNum=1, NvMNvramBlockIdentifier=20, NvMUseServicePorts=true, NvMSelectBlockForReadAll=false, NvMRamBlockDataAddress=, NvMRomBlockDataAddress=, NvMAutomaticBlockLength=false, NvMBlockLengthCheck=false, NvMCalcRamBlockCrc=false, NvMBlockCrcType=NVM_CRC16, NvMSelectBlockForWriteAll=false  # UC:Derived from NvBlockNeeds
        NvMTargetBlockReference
          NvMEaRef: NvMNameOfEaBlock=EaBlockDescriptor_DID_F187_CODEP_Ecu_PartNum
      SWC_PartNumMgrDID_F188_FCA_ESLM_Ecu_SW_Num: NvMBlockManagementType=NVM_BLOCK_NATIVE, NvMBlockUseCrc=true, NvMNvBlockLength=11, NvMNvBlockNum=1, NvMNvramBlockIdentifier=16, NvMUseServicePorts=true, NvMSelectBlockForReadAll=false, NvMRamBlockDataAddress=, NvMRomBlockDataAddress=, NvMAutomaticBlockLength=false, NvMBlockLengthCheck=false, NvMCalcRamBlockCrc=false, NvMBlockCrcType=NVM_CRC16  # UC:Derived from NvBlockNeeds
        NvMTargetBlockReference
          NvMEaRef: NvMNameOfEaBlock=EaBlockDescriptor_DID_F188_FCA_ESLM_Ecu_SW_Num
      SWC_PartNumMgrDID_F18A_FCA_ESLM_Ecu_SW_Cal_Num: NvMBlockManagementType=NVM_BLOCK_NATIVE, NvMBlockUseCrc=true, NvMNvBlockLength=10, NvMNvBlockNum=1, NvMNvramBlockIdentifier=18, NvMUseServicePorts=true, NvMSelectBlockForReadAll=false, NvMRamBlockDataAddress=, NvMRomBlockDataAddress=, NvMAutomaticBlockLength=false, NvMBlockLengthCheck=false, NvMCalcRamBlockCrc=false, NvMBlockCrcType=NVM_CRC16, NvMSelectBlockForWriteAll=false  # UC:Derived from NvBlockNeeds
        NvMTargetBlockReference
          NvMEaRef: NvMNameOfEaBlock=EaBlockDescriptor_DID_F18A_FCA_ESLM_Ecu_SW_Cal_Num
      SWC_PartNumMgrDID_F18B_FCA_ESLM_ECU_SW_App_Num: NvMBlockManagementType=NVM_BLOCK_NATIVE, NvMBlockUseCrc=true, NvMNvBlockLength=10, NvMNvBlockNum=1, NvMNvramBlockIdentifier=19, NvMUseServicePorts=true, NvMSelectBlockForReadAll=false, NvMRamBlockDataAddress=, NvMRomBlockDataAddress=, NvMSelectBlockForWriteAll=false, NvMAutomaticBlockLength=false, NvMBlockLengthCheck=false, NvMCalcRamBlockCrc=false, NvMBlockCrcType=NVM_CRC16  # UC:Derived from NvBlockNeeds
        NvMTargetBlockReference
          NvMEaRef: NvMNameOfEaBlock=EaBlockDescriptor_DID_F18B_FCA_ESLM_ECU_SW_App_Num
      SWC_PartNumMgrDID_F194_Supplier_Ecu_SW_PartNum: NvMBlockManagementType=NVM_BLOCK_NATIVE, NvMBlockUseCrc=true, NvMNvBlockLength=11, NvMNvBlockNum=1, NvMNvramBlockIdentifier=23, NvMUseServicePorts=true, NvMSelectBlockForReadAll=false, NvMRamBlockDataAddress=, NvMRomBlockDataAddress=, NvMSelectBlockForWriteAll=false, NvMAutomaticBlockLength=false, NvMBlockLengthCheck=false, NvMCalcRamBlockCrc=false, NvMBlockCrcType=NVM_CRC16  # UC:Derived from NvBlockNeeds
        NvMTargetBlockReference
          NvMEaRef: NvMNameOfEaBlock=EaBlockDescriptor_DID_F194_Supplier_Ecu_SW_PartNum
      SWC_PartNumMgrDID_F195_Supplier_Ecu_SW_VerNum: NvMBlockManagementType=NVM_BLOCK_NATIVE, NvMBlockUseCrc=true, NvMNvBlockLength=2, NvMNvBlockNum=1, NvMNvramBlockIdentifier=24, NvMUseServicePorts=true, NvMSelectBlockForReadAll=false, NvMRamBlockDataAddress=, NvMRomBlockDataAddress=, NvMAutomaticBlockLength=false, NvMBlockLengthCheck=false, NvMCalcRamBlockCrc=false, NvMBlockCrcType=NVM_CRC16, NvMSelectBlockForWriteAll=false  # UC:Derived from NvBlockNeeds
        NvMTargetBlockReference
          NvMEaRef: NvMNameOfEaBlock=EaBlockDescriptor_DID_F195_Supplier_Ecu_SW_VerNum
      SWC_SysMgrSysM_ProgReqFlag: NvMBlockManagementType=NVM_BLOCK_NATIVE, NvMBlockUseCrc=true, NvMNvBlockLength=1, NvMNvBlockNum=1, NvMNvramBlockIdentifier=3, NvMUseServicePorts=true, NvMSelectBlockForReadAll=false, NvMSelectBlockForWriteAll=false, NvMBlockCrcType=NVM_CRC16, NvMRamBlockDataAddress=, NvMRomBlockDataAddress=, NvMCalcRamBlockCrc=false  # UC:Derived from NvBlockNeeds
        NvMTargetBlockReference
          NvMEaRef: NvMNameOfEaBlock=EaBlockDescriptor_ProgReqFlag
      NvMBlockDescriptor_FileHeader: NvMBlockManagementType=NVM_BLOCK_DATASET, NvMBlockUseCrc=true, NvMNvBlockLength=176, NvMNvBlockNum=9, NvMNvramBlockIdentifier=14, NvMUseServicePorts=false, NvMAutomaticBlockLength=false, NvMBlockCrcType=NVM_CRC16, NvMBlockLengthCheck=false, NvMCalcRamBlockCrc=false
        NvMTargetBlockReference
          NvMEaRef: NvMNameOfEaBlock=EaBlockConfiguration_FileHeader
      NvMBlockDescriptor_CertAccessInfo: NvMBlockManagementType=NVM_BLOCK_DATASET, NvMBlockUseCrc=true, NvMNvBlockLength=46, NvMNvBlockNum=10, NvMNvramBlockIdentifier=15, NvMUseServicePorts=false, NvMAutomaticBlockLength=false, NvMBlockCrcType=NVM_CRC16, NvMBlockLengthCheck=false, NvMCalcRamBlockCrc=false
        NvMTargetBlockReference
          NvMEaRef: NvMNameOfEaBlock=EaBlockConfiguration_CertAccessInfo
      NvMBlockDescriptor_SecureLogGroup1: NvMBlockManagementType=NVM_BLOCK_NATIVE, NvMBlockUseCrc=false, NvMNvBlockLength=488, NvMNvBlockNum=1, NvMNvramBlockIdentifier=28, NvMUseServicePorts=false, NvMCsmMacSize=16, NvMCsmMacGenerationJobReference=CsmJob_MacGenerate, NvMCsmMacVerificationJobReference=CsmJob_MacVerify
        NvMTargetBlockReference
          NvMEaRef: NvMNameOfEaBlock=EaBlockConfiguration_SecureLogGroup1
      NvMBlockDescriptor_SecureLogGroup2: NvMBlockManagementType=NVM_BLOCK_NATIVE, NvMBlockUseCrc=false, NvMNvBlockLength=488, NvMNvBlockNum=1, NvMNvramBlockIdentifier=29, NvMUseServicePorts=false, NvMCsmMacSize=16, NvMCsmMacGenerationJobReference=CsmJob_MacGenerate, NvMCsmMacVerificationJobReference=CsmJob_MacVerify
        NvMTargetBlockReference
          NvMEaRef: NvMNameOfEaBlock=EaBlockConfiguration_SecureLogGroup2
      NvMBlockDescriptor_SecondCounter: NvMBlockManagementType=NVM_BLOCK_NATIVE, NvMBlockUseCrc=true, NvMNvBlockLength=4, NvMNvBlockNum=1, NvMNvramBlockIdentifier=30, NvMUseServicePorts=false, NvMBlockCrcType=NVM_CRC16, NvMRamBlockDataAddress=, NvMRomBlockDataAddress=, NvMSelectBlockForReadAll=false, NvMSelectBlockForWriteAll=false
        NvMTargetBlockReference
          NvMEaRef: NvMNameOfEaBlock=EaBlockDescriptor_SecondCounter
      NvMBlockDescriptor_SystemTimestamp: NvMBlockManagementType=NVM_BLOCK_NATIVE, NvMBlockUseCrc=true, NvMNvBlockLength=15, NvMNvBlockNum=1, NvMNvramBlockIdentifier=31, NvMUseServicePorts=false, NvMBlockCrcType=NVM_CRC16, NvMRamBlockDataAddress=, NvMRomBlockDataAddress=, NvMSelectBlockForReadAll=false, NvMSelectBlockForWriteAll=false
        NvMTargetBlockReference
          NvMEaRef: NvMNameOfEaBlock=EaBlockDescriptor_SystemTimestamp
      NvMBlockDescriptor_CertificateExpired: NvMBlockManagementType=NVM_BLOCK_NATIVE, NvMBlockUseCrc=true, NvMNvBlockLength=1, NvMNvBlockNum=1, NvMNvramBlockIdentifier=32, NvMUseServicePorts=false, NvMBlockCrcType=NVM_CRC16
        NvMTargetBlockReference
          NvMEaRef: NvMNameOfEaBlock=EaBlockDescriptor_CertificateExpired
