AUTOSAR XML (schema 00050)
package /ActiveEcuC
  module config vXSpi: implementation-config-variant=VARIANT-PRE-COMPILE, module-description=vXSpi_Impl
    vXSpiPublishedInformation
      vXSpiDerivativeInformation: vXSpiDataAlignment=1
        vXSpiHwUnitInformation_OSPI0 (vXSpiHwUnitInformation):
          vXSpiMemoryBaseAddress = 1342177280
          vXSpiMemorySize = 4294967295
          vXSpiNumberOfChipSelects = 4
          vXSpiRegisterEndAddress = 1191444736
          vXSpiRegisterStartAddress = 1191444480
        vXSpiHwUnitInformation_OSPI1 (vXSpiHwUnitInformation):
          vXSpiMemoryBaseAddress = 1476395008
          vXSpiMemorySize = 4294967295
          vXSpiNumberOfChipSelects = 4
          vXSpiRegisterEndAddress = 1191510272
          vXSpiRegisterStartAddress = 1191510016
    vXSpiGeneral:
      vXSpiDevErrorDetect = true
      vXSpiSafeBswChecks = false
      vXSpiUsePeripheralAccessApi = false
      vXSpiMainFunctionPeriod = 0.01
      vXSpiHardwareLoopCycles = 1000
      vXSpiSynchronousProcessing = true
      vXSpiSynchronousProcessingLoopCycles = 100000000
    vXSpiHwConfig
      vXSpiHwUnit: vXSpiHwUnitId=0, vXSpiHwUnitInformationRef=vXSpiHwUnitInformation_OSPI0
        vXSpiDevice:
          vXSpiMemorySize = 134217728
          vXSpiDeviceId = 0
          vXSpiChipSelectIndex = 0
          vXSpiMemoryBaseAddressOffset = 0
          vXSpiBaudrateDivider = 4
          vXSpiPageSize = 4095
          vXSpiClockDelayChipSelectDeassert = 64
          vXSpiClockDelayChipSelectDeactivation = 64
          vXSpiClockDelayLastTransactionBit = 8
          vXSpiClockDelayNssOut = 8
          vXSpiReadDataDelay = 0
          vXSpiReadDataDdrReadDelay = 0
          vXSpiReadDataSampleEdgeSelect = FALLING_EDGE
          vXSpiReadDataDqsEnable = false
          vXSpiReadDataBypass = true
      3 x vXSpiProtocolMode, all with vXSpiCommandDataWidth=SINGLE, vXSpiCommandDataRate=SDR, vXSpiAddressDataRate=SDR, vXSpiDataDataRate=SDR:
        vXSpiProtocolMode_Read: vXSpiAddressDataWidth=SINGLE, vXSpiDataDataWidth=OCTAL
        vXSpiProtocolMode_Write: vXSpiAddressDataWidth=OCTAL, vXSpiDataDataWidth=OCTAL
        vXSpiProtocolMode: vXSpiAddressDataWidth=SINGLE, vXSpiDataDataWidth=SINGLE
