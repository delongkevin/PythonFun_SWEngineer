AUTOSAR XML (schema 00050)
package /ActiveEcuC
  module config Dcm: implementation-config-variant=VARIANT-PRE-COMPILE, module-description=Dcm_Impl
    DcmConfigSet
      DcmGeneral:
        DcmRespondAllRequest = true
        DcmVersionInfoApi = false
        DcmBaudrateSwitch = false
        DcmKeySlotMode = false
        DcmNwStatusRxBufferSize = 0
        DcmQueuedRequest = false
        DcmTaskTime = 0
        DcmCanHardwareLoopTimeout = 100
        DcmTaskCycle = 1
        DcmDevErrorDetect = true
      DcmDsp
        DcmDspSession
          DcmDspSessionRow: DcmDspSessionLevel=0, DcmDspSessionP2ServerMax=0, DcmDspSessionP2StarServerMax=0
      DcmDsl
        DcmDslBuffer: DcmDslBufferSize=8
        DcmDslDiagResp: DcmDslDiagRespMaxNumOfDeclinedRequests=3, DcmDslDiagRespOnSecondDeclinedRequest=false
        DcmDslProtocol
          DcmDslProtocolRow_29812fbf (DcmDslProtocolRow): DcmDslProtocolID=DCM_UDS_ON_CAN
            DcmDslConnection_8ee2a6b1 (DcmDslConnection)
              DcmDslMainConnection_7a6ac838 (DcmDslMainConnection): DcmDslProtocolRxTesterSourceAddr=241, DcmDslPayloadLimit=4095
                Demo_0_CAN_Response_oDemoFBL_Vector_SLP3_aa44c06b_Tx_b84cb01a (DcmDslProtocolTx): DcmDslTxConfirmationPduId=1, DcmDslProtocolTxPduRef=Demo_0_CAN_20_Response_oDemoFBL_Vector_SLP3_aa44c06b_Tx
                Demo_0_CAN_Request_oDemoFBL_Vector_SLP3_51500fe6_Rx_a43927b4 (DcmDslProtocolRx):
                  DcmDslProtocolRxAddrType = DCM_PHYSICAL_TYPE
                  DcmDslProtocolRxPduId = 0
                  DcmDslProtocolRxComMChannelRef = CN_DemoFBL_Vector_SLP3_599e8ccc
                  DcmDslProtocolRxPduRef = Demo_0_CAN_20_Request_oDemoFBL_Vector_SLP3_51500fe6_Rx
                Functional_CAN_oDemoFBL_Vector_SLP3_3a497ac1_Rx_39a6aa48 (DcmDslProtocolRx):
                  DcmDslProtocolRxAddrType = DCM_FUNCTIONAL_TYPE
                  DcmDslProtocolRxPduId = 1
                  DcmDslProtocolRxComMChannelRef = CN_DemoFBL_Vector_SLP3_599e8ccc
                  DcmDslProtocolRxPduRef = Functional_CAN_20_oDemoFBL_Vector_SLP3_3a497ac1_Rx
            DcmDslConnection_ee2e78f1 (DcmDslConnection)
              DcmDslMainConnection: DcmDslProtocolRxTesterSourceAddr=242, DcmDslPayloadLimit=4095
                Demo_0_CAN_FD_Request_oDemoFBL_Fca_SLP5_888d0879_Rx_ba94451d (DcmDslProtocolRx):
                  DcmDslProtocolRxAddrType = DCM_PHYSICAL_TYPE
                  DcmDslProtocolRxPduId = 3
                  DcmDslProtocolRxPduRef = Demo_0_CAN_FD_Request_oDemoFBL_Fca_SLP5_888d0879_Rx
                  DcmDslProtocolRxComMChannelRef = CN_DemoFBL_Vector_SLP3_599e8ccc
                Demo_0_CAN_FD_Response_oDemoFBL_Fca_SLP5_3c1da0e3_Tx_d2d667ae (DcmDslProtocolTx): DcmDslTxConfirmationPduId=0, DcmDslProtocolTxPduRef=Demo_0_CAN_FD_Response_oDemoFBL_Fca_SLP5_3c1da0e3_Tx
                Functional_CAN_FD_oDemoFBL_Fca_SLP5_b4f709e0_Rx_5eff7b81 (DcmDslProtocolRx):
                  DcmDslProtocolRxAddrType = DCM_FUNCTIONAL_TYPE
                  DcmDslProtocolRxPduId = 2
                  DcmDslProtocolRxPduRef = Functional_CAN_FD_oDemoFBL_Fca_SLP5_b4f709e0_Rx
                  DcmDslProtocolRxComMChannelRef = CN_DemoFBL_Vector_SLP3_599e8ccc
            DcmDslConnectionGroup: DcmDslConnectionGroupId=0, DcmDslConnectionConcurrentRef=DcmDslConnection_ee2e78f1, DcmDslConnectionConcurrentRef=DcmDslConnection_8ee2a6b1
      DcmGeneration:
        DcmInterfacesForDeactivatedData = false
        DcmReduceConstantData2Define = false
        DcmReduceNumericalDataByOffsetThreshold = 2
        DcmReferringKeysInComments = false
        DcmShortSymbols = false
