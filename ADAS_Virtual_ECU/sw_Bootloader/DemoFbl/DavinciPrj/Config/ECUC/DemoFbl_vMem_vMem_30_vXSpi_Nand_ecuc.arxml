AUTOSAR XML (schema 00050)
package /ActiveEcuC
  module config vMem_30_vXSpi_Nand: definition=vMem, implementation-config-variant=VARIANT-PRE-COMPILE, module-description=vMem_Impl
    4 x vMemDeviceInformation, all with vMemEraseValue=255, vMemLutAddressLength=2, vMemLutEntryLength=4, vMemLutLength=80, vMemLutMaxEntries=20, vMemPageSize=2048, vMemSectorSize=131072:
      Winbond_W25N01GV: vMemSize=134217728
        vMemFlashCommandList
          10 x vMemFlashCommand:
            ReadStatusRegister: vMemCmdType=READ_STATUS_REGISTER, vMemCmdValue=5, vMemAddressFormat=FORMAT_1_BYTE, vMemDummyCycles=0
            WriteStatusRegister: vMemCmdType=WRITE_STATUS_REGISTER, vMemCmdValue=1, vMemAddressFormat=FORMAT_1_BYTE, vMemDummyCycles=0
            WriteEnable: vMemCmdType=WRITE_ENABLE, vMemCmdValue=6, vMemAddressFormat=FORMAT_0_BYTE, vMemDummyCycles=0
            ReplaceLogicalSector: vMemCmdType=REPLACE_LOGICAL_BLOCKS, vMemCmdValue=161, vMemAddressFormat=FORMAT_0_BYTE, vMemDummyCycles=0
            ReadBbmLut: vMemCmdType=READ_BBM_LUT, vMemCmdValue=165, vMemAddressFormat=FORMAT_1_BYTE, vMemDummyCycles=0
            Erase: vMemCmdType=ERASE, vMemCmdValue=216, vMemAddressFormat=FORMAT_0_BYTE, vMemDummyCycles=0
            ProgramExecute: vMemCmdType=PROGRAM_EXECUTE, vMemCmdValue=16, vMemAddressFormat=FORMAT_0_BYTE, vMemDummyCycles=0
            PageDataRead: vMemCmdType=PAGE_DATA_READ, vMemCmdValue=19, vMemAddressFormat=FORMAT_0_BYTE, vMemDummyCycles=8
            Read: vMemCmdType=READ, vMemCmdValue=235, vMemAddressFormat=FORMAT_2_BYTE, vMemDummyCycles=4
            ProgramDataLoad: vMemCmdType=PROGRAM_DATA_LOAD, vMemCmdValue=50, vMemAddressFormat=FORMAT_2_BYTE, vMemDummyCycles=0
        vMemStatusRegisterList
          3 x vMemStatusRegister, all with vMemStatusRegisterLength=1:
            StatusRegister3: vMemStatusRegisterAddress=192, vMemStatusRegisterName=SATUS_REGISTER_3
              vMemBitMaskList
                6 x vMemBitMask:
                  LUTF: vMemBitMaskName=LUTF_BITMASK, vMemBitMaskValue=64
                  ECC1: vMemBitMaskName=ECC1_BITMASK, vMemBitMaskValue=32
                  ECC0: vMemBitMaskName=ECC0_BITMASK, vMemBitMaskValue=16
                  ProgramFailiure: vMemBitMaskName=PROGRAM_ERROR_BITMASK, vMemBitMaskValue=8
                  EraseFailiure: vMemBitMaskName=ERASE_ERROR_BITMASK, vMemBitMaskValue=4
                  OperationInProgress: vMemBitMaskName=BUSY_FLAG_BITMASK, vMemBitMaskValue=1
            StatusRegister2: vMemStatusRegisterAddress=176, vMemStatusRegisterName=STATUS_REGISTER_2
              vMemBitMaskList
                BufferMode (vMemBitMask): vMemBitMaskName=BUFFER_READ_MODE_BITMASK, vMemBitMaskValue=8
            StatusRegister1: vMemStatusRegisterAddress=160, vMemStatusRegisterName=STATUS_REGISTER_1
              vMemBitMaskList
                Protection (vMemBitMask): vMemBitMaskName=PROTECTION_BITMASK, vMemBitMaskValue=255
        vMemDieList
          Die0 (vMemDie): vMemDieSize=134217728, vMemDieStartAddress=0
      Winbond_W25N02JW: vMemSize=268435456
        vMemFlashCommandList
          10 x vMemFlashCommand:
            ReadStatusRegister: vMemCmdType=READ_STATUS_REGISTER, vMemCmdValue=5, vMemAddressFormat=FORMAT_1_BYTE, vMemDummyCycles=0
            WriteStatusRegister: vMemCmdType=WRITE_STATUS_REGISTER, vMemCmdValue=1, vMemAddressFormat=FORMAT_1_BYTE, vMemDummyCycles=0
            WriteEnable: vMemCmdType=WRITE_ENABLE, vMemCmdValue=6, vMemAddressFormat=FORMAT_0_BYTE, vMemDummyCycles=0
            ReplaceLogicalSector: vMemCmdType=REPLACE_LOGICAL_BLOCKS, vMemCmdValue=161, vMemAddressFormat=FORMAT_0_BYTE, vMemDummyCycles=0
            ReadBbmLut: vMemCmdType=READ_BBM_LUT, vMemCmdValue=165, vMemAddressFormat=FORMAT_1_BYTE, vMemDummyCycles=0
            Erase: vMemCmdType=ERASE, vMemCmdValue=216, vMemAddressFormat=FORMAT_0_BYTE, vMemDummyCycles=0
            ProgramExecute: vMemCmdType=PROGRAM_EXECUTE, vMemCmdValue=16, vMemAddressFormat=FORMAT_0_BYTE, vMemDummyCycles=0
            PageDataRead: vMemCmdType=PAGE_DATA_READ, vMemCmdValue=19, vMemAddressFormat=FORMAT_0_BYTE, vMemDummyCycles=0
            Read: vMemCmdType=READ, vMemCmdValue=235, vMemAddressFormat=FORMAT_2_BYTE, vMemDummyCycles=4
            ProgramDataLoad: vMemCmdType=PROGRAM_DATA_LOAD, vMemCmdValue=50, vMemAddressFormat=FORMAT_2_BYTE, vMemDummyCycles=0
        vMemStatusRegisterList
          3 x vMemStatusRegister, all with vMemStatusRegisterLength=1:
            StatusRegister3: vMemStatusRegisterAddress=192, vMemStatusRegisterName=SATUS_REGISTER_3
              vMemBitMaskList
                6 x vMemBitMask:
                  LUTF: vMemBitMaskName=LUTF_BITMASK, vMemBitMaskValue=64
                  ECC1: vMemBitMaskName=ECC1_BITMASK, vMemBitMaskValue=32
                  ECC0: vMemBitMaskName=ECC0_BITMASK, vMemBitMaskValue=16
                  ProgramFailiure: vMemBitMaskName=PROGRAM_ERROR_BITMASK, vMemBitMaskValue=8
                  EraseFailiure: vMemBitMaskName=ERASE_ERROR_BITMASK, vMemBitMaskValue=4
                  OperationInProgress: vMemBitMaskName=BUSY_FLAG_BITMASK, vMemBitMaskValue=1
            StatusRegister2: vMemStatusRegisterAddress=176, vMemStatusRegisterName=STATUS_REGISTER_2
              vMemBitMaskList
                BufferMode (vMemBitMask): vMemBitMaskName=BUFFER_READ_MODE_BITMASK, vMemBitMaskValue=8
            StatusRegister1: vMemStatusRegisterAddress=160, vMemStatusRegisterName=STATUS_REGISTER_1
              vMemBitMaskList
                Protection (vMemBitMask): vMemBitMaskName=PROTECTION_BITMASK, vMemBitMaskValue=255
        vMemDieList
          Die0 (vMemDie): vMemDieSize=134217728, vMemDieStartAddress=0
          Die1 (vMemDie): vMemDieSize=134217728, vMemDieStartAddress=134217728
      Winbond_W25M02GV: vMemSize=268435456
        vMemFlashCommandList
          11 x vMemFlashCommand:
            ReadStatusRegister: vMemCmdType=READ_STATUS_REGISTER, vMemCmdValue=5, vMemAddressFormat=FORMAT_1_BYTE, vMemDummyCycles=0
            WriteStatusRegister: vMemCmdType=WRITE_STATUS_REGISTER, vMemCmdValue=1, vMemAddressFormat=FORMAT_1_BYTE, vMemDummyCycles=0
            WriteEnable: vMemCmdType=WRITE_ENABLE, vMemCmdValue=6, vMemAddressFormat=FORMAT_0_BYTE, vMemDummyCycles=0
            ReplaceLogicalSector: vMemCmdType=REPLACE_LOGICAL_BLOCKS, vMemCmdValue=161, vMemAddressFormat=FORMAT_0_BYTE, vMemDummyCycles=0
            ReadBbmLut: vMemCmdType=READ_BBM_LUT, vMemCmdValue=165, vMemAddressFormat=FORMAT_1_BYTE, vMemDummyCycles=0
            Erase: vMemCmdType=ERASE, vMemCmdValue=216, vMemAddressFormat=FORMAT_0_BYTE, vMemDummyCycles=0
            ProgramExecute: vMemCmdType=PROGRAM_EXECUTE, vMemCmdValue=16, vMemAddressFormat=FORMAT_0_BYTE, vMemDummyCycles=0
            PageDataRead: vMemCmdType=PAGE_DATA_READ, vMemCmdValue=19, vMemAddressFormat=FORMAT_0_BYTE, vMemDummyCycles=8
            Read: vMemCmdType=READ, vMemCmdValue=235, vMemAddressFormat=FORMAT_2_BYTE, vMemDummyCycles=4
            ProgramDataLoad: vMemCmdType=PROGRAM_DATA_LOAD, vMemCmdValue=50, vMemAddressFormat=FORMAT_2_BYTE, vMemDummyCycles=0
            SoftwareDieSelect: vMemCmdType=SOFTWARE_DIE_SELECT, vMemCmdValue=194, vMemAddressFormat=FORMAT_1_BYTE, vMemDummyCycles=0
        vMemStatusRegisterList
          3 x vMemStatusRegister, all with vMemStatusRegisterLength=1:
            StatusRegister3: vMemStatusRegisterAddress=192, vMemStatusRegisterName=SATUS_REGISTER_3
              vMemBitMaskList
                6 x vMemBitMask:
                  LUTF: vMemBitMaskName=LUTF_BITMASK, vMemBitMaskValue=64
                  ECC1: vMemBitMaskName=ECC1_BITMASK, vMemBitMaskValue=32
                  ECC0: vMemBitMaskName=ECC0_BITMASK, vMemBitMaskValue=16
                  ProgramFailiure: vMemBitMaskName=PROGRAM_ERROR_BITMASK, vMemBitMaskValue=8
                  EraseFailiure: vMemBitMaskName=ERASE_ERROR_BITMASK, vMemBitMaskValue=4
                  OperationInProgress: vMemBitMaskName=BUSY_FLAG_BITMASK, vMemBitMaskValue=1
            StatusRegister2: vMemStatusRegisterAddress=176, vMemStatusRegisterName=STATUS_REGISTER_2
              vMemBitMaskList
                BufferMode (vMemBitMask): vMemBitMaskName=BUFFER_READ_MODE_BITMASK, vMemBitMaskValue=8
            StatusRegister1: vMemStatusRegisterAddress=160, vMemStatusRegisterName=STATUS_REGISTER_1
              vMemBitMaskList
                Protection (vMemBitMask): vMemBitMaskName=PROTECTION_BITMASK, vMemBitMaskValue=255
        vMemDieList
          Die0 (vMemDie): vMemDieSize=134217728, vMemDieStartAddress=0
          Die1 (vMemDie): vMemDieSize=134217728, vMemDieStartAddress=134217728
      Winbond_W25N01JW: vMemSize=134217728
        vMemFlashCommandList
          11 x vMemFlashCommand:
            ReadStatusRegister: vMemCmdType=READ_STATUS_REGISTER, vMemCmdValue=5, vMemAddressFormat=FORMAT_1_BYTE, vMemDummyCycles=0
            WriteStatusRegister: vMemCmdType=WRITE_STATUS_REGISTER, vMemCmdValue=1, vMemAddressFormat=FORMAT_1_BYTE, vMemDummyCycles=0
            WriteEnable: vMemCmdType=WRITE_ENABLE, vMemCmdValue=6, vMemAddressFormat=FORMAT_0_BYTE, vMemDummyCycles=0
            ReplaceLogicalSector: vMemCmdType=REPLACE_LOGICAL_BLOCKS, vMemCmdValue=161, vMemAddressFormat=FORMAT_0_BYTE, vMemDummyCycles=0
            ReadBbmLut: vMemCmdType=READ_BBM_LUT, vMemCmdValue=165, vMemAddressFormat=FORMAT_1_BYTE, vMemDummyCycles=0
            Erase: vMemCmdType=ERASE, vMemCmdValue=216, vMemAddressFormat=FORMAT_0_BYTE, vMemDummyCycles=0
            ProgramExecute: vMemCmdType=PROGRAM_EXECUTE, vMemCmdValue=16, vMemAddressFormat=FORMAT_0_BYTE, vMemDummyCycles=0
            PageDataRead: vMemCmdType=PAGE_DATA_READ, vMemCmdValue=19, vMemAddressFormat=FORMAT_0_BYTE, vMemDummyCycles=0
            Read: vMemCmdType=READ, vMemCmdValue=235, vMemAddressFormat=FORMAT_2_BYTE, vMemDummyCycles=4
            ProgramDataLoad: vMemCmdType=PROGRAM_DATA_LOAD, vMemCmdValue=50, vMemAddressFormat=FORMAT_2_BYTE, vMemDummyCycles=0
            SoftwareDieSelect: vMemCmdType=SOFTWARE_DIE_SELECT, vMemCmdValue=194, vMemAddressFormat=FORMAT_1_BYTE, vMemDummyCycles=0
        vMemStatusRegisterList
          3 x vMemStatusRegister, all with vMemStatusRegisterLength=1:
            StatusRegister3: vMemStatusRegisterAddress=192, vMemStatusRegisterName=SATUS_REGISTER_3
              vMemBitMaskList
                6 x vMemBitMask:
                  LUTF: vMemBitMaskName=LUTF_BITMASK, vMemBitMaskValue=64
                  ECC1: vMemBitMaskName=ECC1_BITMASK, vMemBitMaskValue=32
                  ECC0: vMemBitMaskName=ECC0_BITMASK, vMemBitMaskValue=16
                  ProgramFailiure: vMemBitMaskName=PROGRAM_ERROR_BITMASK, vMemBitMaskValue=8
                  EraseFailiure: vMemBitMaskName=ERASE_ERROR_BITMASK, vMemBitMaskValue=4
                  OperationInProgress: vMemBitMaskName=BUSY_FLAG_BITMASK, vMemBitMaskValue=1
            StatusRegister2: vMemStatusRegisterAddress=176, vMemStatusRegisterName=STATUS_REGISTER_2
              vMemBitMaskList
                BufferMode (vMemBitMask): vMemBitMaskName=BUFFER_READ_MODE_BITMASK, vMemBitMaskValue=8
            StatusRegister1: vMemStatusRegisterAddress=160, vMemStatusRegisterName=STATUS_REGISTER_1
              vMemBitMaskList
                Protection (vMemBitMask): vMemBitMaskName=PROTECTION_BITMASK, vMemBitMaskValue=255
        vMemDieList
          Die0 (vMemDie): vMemDieSize=134217728, vMemDieStartAddress=0
    vMemGeneral: vMemVersionInfoApi=true, vMemDevErrorDetect=true, vMemSafeBswChecks=false, vMemReadOnlyMode=false
    vMemInstance_ExtFlash (vMemInstance):
      vMemInstanceId = 0
      vMemBusyCheckTimeoutThreshold = 65535
      vMemAutomatedBadBlockManagment = true
      vMemDeviceInformationRef = Winbond_W35N01JW_01
      vMemvXSpiDeviceRef = vXSpiDevice
      vMemvXSpiGenericProtocolModeRef = vXSpiProtocolMode
      vMemvXSpiReadDataProtocolModeRef = vXSpiProtocolMode_Read
      vMemvXSpiWriteDataProtocolModeRef = vXSpiProtocolMode_Write
      vMemSectorList
        vMemSector: vMemNumberOfSectors=502, vMemPageSize=4096, vMemSectorSize=262144, vMemStartAddress=0, vMemReplacementSector=false, vMemDieRef=vMemDieList/Die0
        vMemSector_001 (vMemSector): vMemNumberOfSectors=10, vMemPageSize=4096, vMemSectorSize=262144, vMemStartAddress=131596288, vMemReplacementSector=true, vMemDieRef=vMemDieList/Die0
    4 x vMemDeviceInformation, all with vMemEraseValue=255, vMemLutAddressLength=2, vMemLutEntryLength=4, vMemLutLength=40, vMemLutMaxEntries=10, vMemPageSize=4096, vMemSectorSize=262144:
      Winbond_W35N01JW: vMemSize=134217728
        vMemFlashCommandList
          12 x vMemFlashCommand:
            ReadStatusRegister: vMemCmdType=READ_STATUS_REGISTER, vMemCmdValue=5, vMemAddressFormat=FORMAT_1_BYTE, vMemDummyCycles=0
            WriteStatusRegister: vMemCmdType=WRITE_STATUS_REGISTER, vMemCmdValue=1, vMemAddressFormat=FORMAT_1_BYTE, vMemDummyCycles=0
            WriteEnable: vMemCmdType=WRITE_ENABLE, vMemCmdValue=6, vMemAddressFormat=FORMAT_0_BYTE, vMemDummyCycles=0
            ReplaceLogicalSector: vMemCmdType=REPLACE_LOGICAL_BLOCKS, vMemCmdValue=161, vMemAddressFormat=FORMAT_0_BYTE, vMemDummyCycles=0
            ReadBbmLut: vMemCmdType=READ_BBM_LUT, vMemCmdValue=165, vMemAddressFormat=FORMAT_1_BYTE, vMemDummyCycles=0
            Erase: vMemCmdType=ERASE, vMemCmdValue=216, vMemAddressFormat=FORMAT_0_BYTE, vMemDummyCycles=0
            ProgramExecute: vMemCmdType=PROGRAM_EXECUTE, vMemCmdValue=16, vMemAddressFormat=FORMAT_0_BYTE, vMemDummyCycles=0
            PageDataRead: vMemCmdType=PAGE_DATA_READ, vMemCmdValue=19, vMemAddressFormat=FORMAT_0_BYTE, vMemDummyCycles=0
            Read: vMemCmdType=READ, vMemCmdValue=157, vMemAddressFormat=FORMAT_2_BYTE, vMemDummyCycles=8
            ProgramDataLoad: vMemCmdType=PROGRAM_DATA_LOAD, vMemCmdValue=196, vMemAddressFormat=FORMAT_2_BYTE, vMemDummyCycles=0
            WriteVolatileConfigurationRegister: vMemCmdType=WRITE_VOLATILE_CONFIGURATION_REGISTER, vMemCmdValue=129, vMemAddressFormat=FORMAT_3_BYTE, vMemDummyCycles=0
            ReadVolatileConfigurationRegister: vMemAddressFormat=FORMAT_3_BYTE, vMemCmdType=READ_VOLATILE_CONFIGURATION_REGISTER, vMemCmdValue=133, vMemDummyCycles=8
        vMemStatusRegisterList
          3 x vMemStatusRegister, all with vMemStatusRegisterLength=1:
            StatusRegister3: vMemStatusRegisterAddress=192, vMemStatusRegisterName=SATUS_REGISTER_3
              vMemBitMaskList
                6 x vMemBitMask:
                  LUTF: vMemBitMaskName=LUTF_BITMASK, vMemBitMaskValue=64
                  ECC1: vMemBitMaskName=ECC1_BITMASK, vMemBitMaskValue=32
                  ECC0: vMemBitMaskName=ECC0_BITMASK, vMemBitMaskValue=16
                  ProgramFailiure: vMemBitMaskName=PROGRAM_ERROR_BITMASK, vMemBitMaskValue=8
                  EraseFailiure: vMemBitMaskName=ERASE_ERROR_BITMASK, vMemBitMaskValue=4
                  OperationInProgress: vMemBitMaskName=BUSY_FLAG_BITMASK, vMemBitMaskValue=1
            StatusRegister2: vMemStatusRegisterAddress=176, vMemStatusRegisterName=STATUS_REGISTER_2
              vMemBitMaskList
                BufferMode (vMemBitMask): vMemBitMaskName=BUFFER_READ_MODE_BITMASK, vMemBitMaskValue=8
            StatusRegister1: vMemStatusRegisterAddress=160, vMemStatusRegisterName=STATUS_REGISTER_1
              vMemBitMaskList
                Protection (vMemBitMask): vMemBitMaskName=PROTECTION_BITMASK, vMemBitMaskValue=255
        vMemDieList
          Die0 (vMemDie): vMemDieSize=134217728, vMemDieStartAddress=0
        vMemConfigurationRegisterList
          InputOutputMode (vMemConfigurationRegister):
            vMemConfigurationRegisterAddress = 0
            vMemConfigurationRegisterLength = 1
            vMemConfigurationRegisterName = INPUT_OUTPUT_MODE
            vMemConfigurationRegisterValue = 223
      Winbond_W35N02JW: vMemSize=268435456
        vMemFlashCommandList
          12 x vMemFlashCommand:
            ReadStatusRegister: vMemCmdType=READ_STATUS_REGISTER, vMemCmdValue=5, vMemAddressFormat=FORMAT_1_BYTE, vMemDummyCycles=0
            WriteStatusRegister: vMemCmdType=WRITE_STATUS_REGISTER, vMemCmdValue=1, vMemAddressFormat=FORMAT_1_BYTE, vMemDummyCycles=0
            WriteEnable: vMemCmdType=WRITE_ENABLE, vMemCmdValue=6, vMemAddressFormat=FORMAT_0_BYTE, vMemDummyCycles=0
            ReplaceLogicalSector: vMemCmdType=REPLACE_LOGICAL_BLOCKS, vMemCmdValue=161, vMemAddressFormat=FORMAT_0_BYTE, vMemDummyCycles=0
            ReadBbmLut: vMemCmdType=READ_BBM_LUT, vMemCmdValue=165, vMemAddressFormat=FORMAT_1_BYTE, vMemDummyCycles=0
            Erase: vMemCmdType=ERASE, vMemCmdValue=216, vMemAddressFormat=FORMAT_0_BYTE, vMemDummyCycles=0
            ProgramExecute: vMemCmdType=PROGRAM_EXECUTE, vMemCmdValue=16, vMemAddressFormat=FORMAT_0_BYTE, vMemDummyCycles=0
            PageDataRead: vMemCmdType=PAGE_DATA_READ, vMemCmdValue=19, vMemAddressFormat=FORMAT_0_BYTE, vMemDummyCycles=0
            Read: vMemCmdType=READ, vMemCmdValue=157, vMemAddressFormat=FORMAT_2_BYTE, vMemDummyCycles=8
            ProgramDataLoad: vMemCmdType=PROGRAM_DATA_LOAD, vMemCmdValue=196, vMemAddressFormat=FORMAT_2_BYTE, vMemDummyCycles=0
            WriteVolatileConfigurationRegister: vMemCmdType=WRITE_VOLATILE_CONFIGURATION_REGISTER, vMemCmdValue=129, vMemAddressFormat=FORMAT_3_BYTE, vMemDummyCycles=0
            ReadVolatileConfigurationRegister: vMemAddressFormat=FORMAT_3_BYTE, vMemCmdType=READ_VOLATILE_CONFIGURATION_REGISTER, vMemCmdValue=133, vMemDummyCycles=8
        vMemStatusRegisterList
          3 x vMemStatusRegister, all with vMemStatusRegisterLength=1:
            StatusRegister3: vMemStatusRegisterAddress=192, vMemStatusRegisterName=SATUS_REGISTER_3
              vMemBitMaskList
                6 x vMemBitMask:
                  LUTF: vMemBitMaskName=LUTF_BITMASK, vMemBitMaskValue=64
                  ECC1: vMemBitMaskName=ECC1_BITMASK, vMemBitMaskValue=32
                  ECC0: vMemBitMaskName=ECC0_BITMASK, vMemBitMaskValue=16
                  ProgramFailiure: vMemBitMaskName=PROGRAM_ERROR_BITMASK, vMemBitMaskValue=8
                  EraseFailiure: vMemBitMaskName=ERASE_ERROR_BITMASK, vMemBitMaskValue=4
                  OperationInProgress: vMemBitMaskName=BUSY_FLAG_BITMASK, vMemBitMaskValue=1
            StatusRegister2: vMemStatusRegisterAddress=176, vMemStatusRegisterName=STATUS_REGISTER_2
              vMemBitMaskList
                BufferMode (vMemBitMask): vMemBitMaskName=BUFFER_READ_MODE_BITMASK, vMemBitMaskValue=8
            StatusRegister1: vMemStatusRegisterAddress=160, vMemStatusRegisterName=STATUS_REGISTER_1
              vMemBitMaskList
                Protection (vMemBitMask): vMemBitMaskName=PROTECTION_BITMASK, vMemBitMaskValue=255
        vMemDieList
          Die0 (vMemDie): vMemDieSize=134217728, vMemDieStartAddress=0
          Die1 (vMemDie): vMemDieSize=134217728, vMemDieStartAddress=134217728
        vMemConfigurationRegisterList
          InputOutputMode (vMemConfigurationRegister):
            vMemConfigurationRegisterAddress = 0
            vMemConfigurationRegisterLength = 1
            vMemConfigurationRegisterName = INPUT_OUTPUT_MODE
            vMemConfigurationRegisterValue = 223
      Winbond_W35N04JW: vMemSize=536870912
        vMemFlashCommandList
          12 x vMemFlashCommand:
            ReadStatusRegister: vMemCmdType=READ_STATUS_REGISTER, vMemCmdValue=5, vMemAddressFormat=FORMAT_1_BYTE, vMemDummyCycles=0
            WriteStatusRegister: vMemCmdType=WRITE_STATUS_REGISTER, vMemCmdValue=1, vMemAddressFormat=FORMAT_1_BYTE, vMemDummyCycles=0
            WriteEnable: vMemCmdType=WRITE_ENABLE, vMemCmdValue=6, vMemAddressFormat=FORMAT_0_BYTE, vMemDummyCycles=0
            ReplaceLogicalSector: vMemCmdType=REPLACE_LOGICAL_BLOCKS, vMemCmdValue=161, vMemAddressFormat=FORMAT_0_BYTE, vMemDummyCycles=0
            ReadBbmLut: vMemCmdType=READ_BBM_LUT, vMemCmdValue=165, vMemAddressFormat=FORMAT_1_BYTE, vMemDummyCycles=0
            Erase: vMemCmdType=ERASE, vMemCmdValue=216, vMemAddressFormat=FORMAT_0_BYTE, vMemDummyCycles=0
            ProgramExecute: vMemCmdType=PROGRAM_EXECUTE, vMemCmdValue=16, vMemAddressFormat=FORMAT_0_BYTE, vMemDummyCycles=0
            PageDataRead: vMemCmdType=PAGE_DATA_READ, vMemCmdValue=19, vMemAddressFormat=FORMAT_0_BYTE, vMemDummyCycles=0
            Read: vMemCmdType=READ, vMemCmdValue=157, vMemAddressFormat=FORMAT_2_BYTE, vMemDummyCycles=8
            ProgramDataLoad: vMemCmdType=PROGRAM_DATA_LOAD, vMemCmdValue=196, vMemAddressFormat=FORMAT_2_BYTE, vMemDummyCycles=0
            WriteVolatileConfigurationRegister: vMemCmdType=WRITE_VOLATILE_CONFIGURATION_REGISTER, vMemCmdValue=129, vMemAddressFormat=FORMAT_3_BYTE, vMemDummyCycles=0
            ReadVolatileConfigurationRegister: vMemAddressFormat=FORMAT_3_BYTE, vMemCmdType=READ_VOLATILE_CONFIGURATION_REGISTER, vMemCmdValue=133, vMemDummyCycles=8
        vMemStatusRegisterList
          3 x vMemStatusRegister, all with vMemStatusRegisterLength=1:
            StatusRegister3: vMemStatusRegisterAddress=192, vMemStatusRegisterName=SATUS_REGISTER_3
              vMemBitMaskList
                6 x vMemBitMask:
                  LUTF: vMemBitMaskName=LUTF_BITMASK, vMemBitMaskValue=64
                  ECC1: vMemBitMaskName=ECC1_BITMASK, vMemBitMaskValue=32
                  ECC0: vMemBitMaskName=ECC0_BITMASK, vMemBitMaskValue=16
                  ProgramFailiure: vMemBitMaskName=PROGRAM_ERROR_BITMASK, vMemBitMaskValue=8
                  EraseFailiure: vMemBitMaskName=ERASE_ERROR_BITMASK, vMemBitMaskValue=4
                  OperationInProgress: vMemBitMaskName=BUSY_FLAG_BITMASK, vMemBitMaskValue=1
            StatusRegister2: vMemStatusRegisterAddress=176, vMemStatusRegisterName=STATUS_REGISTER_2
              vMemBitMaskList
                BufferMode (vMemBitMask): vMemBitMaskName=BUFFER_READ_MODE_BITMASK, vMemBitMaskValue=8
            StatusRegister1: vMemStatusRegisterAddress=160, vMemStatusRegisterName=STATUS_REGISTER_1
              vMemBitMaskList
                Protection (vMemBitMask): vMemBitMaskName=PROTECTION_BITMASK, vMemBitMaskValue=255
        vMemDieList
          4 x vMemDie, all with vMemDieSize=134217728:
            Die0: vMemDieStartAddress=0
            Die1: vMemDieStartAddress=134217728
            Die2: vMemDieStartAddress=268435456
            Die3: vMemDieStartAddress=402653184
        vMemConfigurationRegisterList
          InputOutputMode (vMemConfigurationRegister):
            vMemConfigurationRegisterAddress = 0
            vMemConfigurationRegisterLength = 1
            vMemConfigurationRegisterName = INPUT_OUTPUT_MODE
            vMemConfigurationRegisterValue = 223
      Winbond_W35N01JW_01: vMemSize=134217728
        vMemFlashCommandList
          12 x vMemFlashCommand:
            ReadStatusRegister: vMemCmdType=READ_STATUS_REGISTER, vMemCmdValue=5, vMemAddressFormat=FORMAT_1_BYTE, vMemDummyCycles=0
            WriteStatusRegister: vMemCmdType=WRITE_STATUS_REGISTER, vMemCmdValue=1, vMemAddressFormat=FORMAT_1_BYTE, vMemDummyCycles=0
            WriteEnable: vMemCmdType=WRITE_ENABLE, vMemCmdValue=6, vMemAddressFormat=FORMAT_0_BYTE, vMemDummyCycles=0
            ReplaceLogicalSector: vMemCmdType=REPLACE_LOGICAL_BLOCKS, vMemCmdValue=161, vMemAddressFormat=FORMAT_0_BYTE, vMemDummyCycles=0
            ReadBbmLut: vMemCmdType=READ_BBM_LUT, vMemCmdValue=165, vMemAddressFormat=FORMAT_1_BYTE, vMemDummyCycles=0
            Erase: vMemCmdType=ERASE, vMemCmdValue=216, vMemAddressFormat=FORMAT_0_BYTE, vMemDummyCycles=0
            ProgramExecute: vMemCmdType=PROGRAM_EXECUTE, vMemCmdValue=16, vMemAddressFormat=FORMAT_0_BYTE, vMemDummyCycles=0
            PageDataRead: vMemCmdType=PAGE_DATA_READ, vMemCmdValue=19, vMemAddressFormat=FORMAT_0_BYTE, vMemDummyCycles=0
            Read: vMemCmdType=READ, vMemCmdValue=139, vMemAddressFormat=FORMAT_2_BYTE, vMemDummyCycles=8
            ProgramDataLoad: vMemCmdType=PROGRAM_DATA_LOAD, vMemCmdValue=196, vMemAddressFormat=FORMAT_2_BYTE, vMemDummyCycles=0
            WriteVolatileConfigurationRegister: vMemCmdType=WRITE_VOLATILE_CONFIGURATION_REGISTER, vMemCmdValue=129, vMemAddressFormat=FORMAT_3_BYTE, vMemDummyCycles=0
            ReadVolatileConfigurationRegister: vMemAddressFormat=FORMAT_3_BYTE, vMemCmdType=READ_VOLATILE_CONFIGURATION_REGISTER, vMemCmdValue=133, vMemDummyCycles=8
        vMemStatusRegisterList
          3 x vMemStatusRegister, all with vMemStatusRegisterLength=1:
            StatusRegister3: vMemStatusRegisterAddress=192, vMemStatusRegisterName=SATUS_REGISTER_3
              vMemBitMaskList
                6 x vMemBitMask:
                  LUTF: vMemBitMaskName=LUTF_BITMASK, vMemBitMaskValue=64
                  ECC1: vMemBitMaskName=ECC1_BITMASK, vMemBitMaskValue=32
                  ECC0: vMemBitMaskName=ECC0_BITMASK, vMemBitMaskValue=16
                  ProgramFailiure: vMemBitMaskName=PROGRAM_ERROR_BITMASK, vMemBitMaskValue=8
                  EraseFailiure: vMemBitMaskName=ERASE_ERROR_BITMASK, vMemBitMaskValue=4
                  OperationInProgress: vMemBitMaskName=BUSY_FLAG_BITMASK, vMemBitMaskValue=1
            StatusRegister2: vMemStatusRegisterAddress=176, vMemStatusRegisterName=STATUS_REGISTER_2
              vMemBitMaskList
                BufferMode (vMemBitMask): vMemBitMaskName=BUFFER_READ_MODE_BITMASK, vMemBitMaskValue=8
            StatusRegister1: vMemStatusRegisterAddress=160, vMemStatusRegisterName=STATUS_REGISTER_1
              vMemBitMaskList
                Protection (vMemBitMask): vMemBitMaskName=PROTECTION_BITMASK, vMemBitMaskValue=255
        vMemDieList
          Die0 (vMemDie): vMemDieSize=134217728, vMemDieStartAddress=0
        vMemConfigurationRegisterList
          InputOutputMode (vMemConfigurationRegister):
            vMemConfigurationRegisterAddress = 0
            vMemConfigurationRegisterLength = 1
            vMemConfigurationRegisterName = INPUT_OUTPUT_MODE
            vMemConfigurationRegisterValue = 223
