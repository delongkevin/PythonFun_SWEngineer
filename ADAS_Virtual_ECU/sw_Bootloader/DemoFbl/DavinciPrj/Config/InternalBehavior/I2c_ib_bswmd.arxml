AUTOSAR XML (schema 4-0-3)
package /MICROSAR/I2c_Jacinto7Tii2c01_ib_bswmd/BswModuleDescriptions
  bsw module description I2c: provided-entrys=I2c_MainFunction
    bsw internal behavior I2c_Behavior
      exclusive area I2C_EXCLUSIVE_AREA_0
      exclusive area I2C_PERMGR_EXCLUSIVE_AREA_0
      bsw schedulable entity I2c_MainFunction: implemented-entry=I2c_MainFunction
      bsw timing event I2c_MainFunctionTimingEvent0: starts-on-event=I2c_MainFunction, period=0.01
  bsw module entry I2c_MainFunction: call-type=SCHEDULED, execution-context=TASK
