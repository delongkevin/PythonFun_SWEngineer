AUTOSAR XML (schema 4-0-3)
package /MICROSAR/Eep_30_XXi2c01_ib_bswmd/BswModuleDescriptions
  bsw module description Eep: provided-entrys=Eep_30_XXi2c01_MainFunction
    bsw internal behavior Eep_30_XXi2c01Behavior
      exclusive area EEP_30_XXI2C01_EXCLUSIVE_AREA_0
      bsw schedulable entity Eep_30_XXi2c01_MainFunction: implemented-entry=Eep_30_XXi2c01_MainFunction
      bsw timing event Eep_30_XXi2c01_MainFunctionTimingEvent0: starts-on-event=Eep_30_XXi2c01_MainFunction, period=0.005
  bsw module entry Eep_30_XXi2c01_MainFunction: call-type=SCHEDULED, execution-context=TASK
