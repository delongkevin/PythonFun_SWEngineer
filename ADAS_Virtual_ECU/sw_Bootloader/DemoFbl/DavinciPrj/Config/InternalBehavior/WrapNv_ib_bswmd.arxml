AUTOSAR XML (schema 4-0-3)
package /MICROSAR/WrapNv_ib_bswmd/BswModuleDescriptions
  bsw module description WrapNv
    bsw internal behavior WrapNvBehavior
      exclusive area WRAPNV_EXCLUSIVE_AREA_0
