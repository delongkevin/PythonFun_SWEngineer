AUTOSAR XML (schema 4-0-3)
package /MICROSAR/Can_Mpc5700Mcan_ib_bswmd/BswModuleDescriptions
  bsw module description Can
    provided-entrys:
      Can_30_Mcan_MainFunction_Write
      Can_30_Mcan_MainFunction_Read
      Can_30_Mcan_MainFunction_BusOff
      Can_30_Mcan_MainFunction_Wakeup
      Can_30_Mcan_MainFunction_Mode
    bsw internal behavior Can_Can_Mpc5700McanBehavior
      8 x exclusive area:
        CAN_30_MCAN_EXCLUSIVE_AREA_{0..7}
      5 x bsw schedulable entity:
        Can_30_Mcan_MainFunction_Write: implemented-entry=Can_30_Mcan_MainFunction_Write
        Can_30_Mcan_MainFunction_Read: implemented-entry=Can_30_Mcan_MainFunction_Read
        Can_30_Mcan_MainFunction_BusOff: implemented-entry=Can_30_Mcan_MainFunction_BusOff
        Can_30_Mcan_MainFunction_Wakeup: implemented-entry=Can_30_Mcan_MainFunction_Wakeup
        Can_30_Mcan_MainFunction_Mode: implemented-entry=Can_30_Mcan_MainFunction_Mode
      5 x bsw timing event:
        Can_30_Mcan_MainFunction_WriteTimingEvent0: starts-on-event=Can_30_Mcan_MainFunction_Write, period=0.005
        Can_30_Mcan_MainFunction_ReadTimingEvent0: starts-on-event=Can_30_Mcan_MainFunction_Read, period=0.005
        Can_30_Mcan_MainFunction_BusOffTimingEvent0: starts-on-event=Can_30_Mcan_MainFunction_BusOff, period=0.01
        Can_30_Mcan_MainFunction_WakeupTimingEvent0: starts-on-event=Can_30_Mcan_MainFunction_Wakeup, period=0.01
        Can_30_Mcan_MainFunction_ModeTimingEvent0: starts-on-event=Can_30_Mcan_MainFunction_Mode, period=0.01
  5 x bsw module entry, all with call-type=SCHEDULED, execution-context=TASK:
    Can_30_Mcan_MainFunction_Write
    Can_30_Mcan_MainFunction_Read
    Can_30_Mcan_MainFunction_BusOff
    Can_30_Mcan_MainFunction_Wakeup
    Can_30_Mcan_MainFunction_Mode
