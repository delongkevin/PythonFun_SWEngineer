AUTOSAR XML (schema 4-0-3)
package /MICROSAR/Crypto_30_vHsm
  module config Crypto_Pre: definition=Crypto  # Software Crypto Driver pre-configuration
    CryptoKeys
      52 x CryptoKey, all with CryptoKeyDeriveIterations=1:
        vHsm_SecureBoot_Signature: CryptoKeyId=61, CryptoKeyTypeRef=Crypto_30_vHsm_LibCv_Signature
        SymmetricKey: CryptoKeyId=48, CryptoKeyTypeRef=Crypto_30_vHsm_LibCv_Cipher
        WriteOnceKey: CryptoKeyId=49, CryptoKeyTypeRef=Crypto_30_vHsm_LibCv_WriteOnceKey
        SecureBootProtectedKey: CryptoKeyId=39, CryptoKeyTypeRef=Crypto_30_vHsm_LibCv_SecureBootProtectedKey
        Random: CryptoKeyId=38, CryptoKeyTypeRef=Crypto_30_vHsm_LibCv_Random_Nist_800_90A_DRBG_AES_NoDF
        LazyPersistKey: CryptoKeyId=37, CryptoKeyTypeRef=Crypto_30_vHsm_LibCv_LazyPersistKey
        vHsm_Custom: CryptoKeyId=52, CryptoKeyTypeRef=Crypto_30_vHsm_LibCv_Cipher
        She_Key1: CryptoKeyId=41, CryptoKeyTypeRef=Crypto_30_vHsm_LibCv_MacShe
        She_Key2: CryptoKeyId=42, CryptoKeyTypeRef=Crypto_30_vHsm_LibCv_CipherShe
        She_MasterEcuKey: CryptoKeyId=43, CryptoKeyTypeRef=Crypto_30_vHsm_LibCv_MacShe
        She_SecretKey: CryptoKeyId=44, CryptoKeyTypeRef=Crypto_30_vHsm_LibCv_MacShe
        She_Info: CryptoKeyId=40, CryptoKeyTypeRef=Crypto_30_vHsm_LibCv_SheInfoKey
        vHsm_Info: CryptoKeyId=57, CryptoKeyTypeRef=Crypto_30_vHsm_vHsm_Core_vHsmInfo_Type
        vHsm_Info_SecureBoot: CryptoKeyId=58, CryptoKeyTypeRef=Crypto_30_vHsm_vHsm_Core_vHsmSecureBootGroupInfo_Type
        vHsm_RomKey0: CryptoKeyId=59, CryptoKeyTypeRef=Crypto_30_vHsm_LibCv_Cipher
        vHsm_Aggregated_RomKey0: CryptoKeyId=50, CryptoKeyTypeRef=Crypto_30_vHsm_LibCv_Aggregated_RomKey
        vHsm_Aggregated_RomKey1: CryptoKeyId=51, CryptoKeyTypeRef=Crypto_30_vHsm_LibCv_Aggregated_RomKey
        StartApplication_CryptoKey_vHsm_Dec: CryptoKeyId=45, CryptoKeyTypeRef=Crypto_30_vHsm_LibCv_Cipher
        StartApplication_CryptoKey_vHsm_Enc: CryptoKeyId=46, CryptoKeyTypeRef=Crypto_30_vHsm_LibCv_Cipher
        StartApplication_CryptoKey_vHsm_MAC: CryptoKeyId=47, CryptoKeyTypeRef=Crypto_30_vHsm_LibCv_Mac
        CryIfKey_UserSecureLog_Key: CryptoKeyId=32, CryptoKeyTypeRef=Crypto_30_vHsm_LibCv_UserCMac
        CryIfKey_UserRsaSignVerify_Key: CryptoKeyId=31, CryptoKeyTypeRef=Crypto_30_vHsm_LibCv_Signature_Rsa_Pkcs1_Verify
        CryIfKey_CertData_ADA_L3: CryptoKeyId=1, CryptoKeyTypeRef=Crypto_30_vHsm_LibCv_KeyType_KeyM_Certificate_Type1
        CryIfKey_CertData_ADA_L4: CryptoKeyId=2, CryptoKeyTypeRef=Crypto_30_vHsm_LibCv_KeyType_KeyM_Certificate_Type1
        CryIfKey_CertData_CodeSign_ADA_L1: CryptoKeyId=3, CryptoKeyTypeRef=Crypto_30_vHsm_LibCv_KeyType_KeyM_Certificate_Type1
        CryIfKey_CertData_ADA_L2: CryptoKeyId=0, CryptoKeyTypeRef=Crypto_30_vHsm_LibCv_KeyType_KeyM_Certificate_Type1
        CryIfKey_RsaSignatureVerifyKey_ADA_L3: CryptoKeyId=18, CryptoKeyTypeRef=Crypto_30_vHsm_LibCv_Signature_Rsa_Pkcs1_Verify
        CryIfKey_RsaSignatureVerifyKey_ADA_L4: CryptoKeyId=19, CryptoKeyTypeRef=Crypto_30_vHsm_LibCv_Signature_Rsa_Pkcs1_Verify
        CryIfKey_RsaSignatureVerifyKey_CodeSign_ADA_L1: CryptoKeyId=20, CryptoKeyTypeRef=Crypto_30_vHsm_LibCv_Signature_Rsa_Pkcs1_Verify
        CryIfKey_RsaSignatureVerifyKey_ADA_L2: CryptoKeyId=17, CryptoKeyTypeRef=Crypto_30_vHsm_LibCv_Signature_Rsa_Pkcs1_Verify
        CryIfKey_KeyMCertificate_ADA_L4: CryptoKeyId=15, CryptoKeyTypeRef=Crypto_30_vHsm_KeyM_KeyType_KeyM_Certificate
        CryIfKey_RoleFlag: CryptoKeyId=16, CryptoKeyTypeRef=CryptoKeyTypes/Crypto_30_vHsm_LibCv_RoleFlag
        CryIfKey_CertData_CodeSign_App_L4: CryptoKeyId=4, CryptoKeyTypeRef=Crypto_30_vHsm_LibCv_KeyType_KeyM_Certificate_Type1
        CryIfKey_RsaSignatureVerifyKey_CodeSign_App_L4: CryptoKeyId=21, CryptoKeyTypeRef=Crypto_30_vHsm_LibCv_Signature_Rsa_Pkcs1_Verify
        CryIfKey_RsaSignatureVerifyKey_CodeSign_L3: CryptoKeyId=25, CryptoKeyTypeRef=Crypto_30_vHsm_LibCv_Signature_Rsa_Pkcs1_Verify
        CryIfKey_CertData_CodeSign_L3: CryptoKeyId=8, CryptoKeyTypeRef=Crypto_30_vHsm_LibCv_KeyType_KeyM_Certificate_Type1
        CryIfKey_CertData_CodeSign_CertStore_L4: CryptoKeyId=6, CryptoKeyTypeRef=Crypto_30_vHsm_LibCv_KeyType_KeyM_Certificate_Type1
        CryIfKey_CertData_CodeSign_C7X_L4: CryptoKeyId=5, CryptoKeyTypeRef=Crypto_30_vHsm_LibCv_KeyType_KeyM_Certificate_Type1
        CryIfKey_CertData_CodeSign_LateApp1_L4: CryptoKeyId=9, CryptoKeyTypeRef=Crypto_30_vHsm_LibCv_KeyType_KeyM_Certificate_Type1
        CryIfKey_CertData_CodeSign_LateApp2_L4: CryptoKeyId=10, CryptoKeyTypeRef=Crypto_30_vHsm_LibCv_KeyType_KeyM_Certificate_Type1
        CryIfKey_CertData_CodeSign_Qnx_L4: CryptoKeyId=11, CryptoKeyTypeRef=Crypto_30_vHsm_LibCv_KeyType_KeyM_Certificate_Type1
        CryIfKey_RsaSignatureVerifyKey_CodeSign_C7x_L4: CryptoKeyId=22, CryptoKeyTypeRef=Crypto_30_vHsm_LibCv_Signature_Rsa_Pkcs1_Verify
        CryIfKey_RsaSignatureVerifyKey_CodeSign_CertStore_L4: CryptoKeyId=23, CryptoKeyTypeRef=Crypto_30_vHsm_LibCv_Signature_Rsa_Pkcs1_Verify
        CryIfKey_RsaSignatureVerifyKey_CodeSign_LateApp1_L4: CryptoKeyId=26, CryptoKeyTypeRef=Crypto_30_vHsm_LibCv_Signature_Rsa_Pkcs1_Verify
        CryIfKey_RsaSignatureVerifyKey_CodeSign_LateApp2_L4: CryptoKeyId=27, CryptoKeyTypeRef=Crypto_30_vHsm_LibCv_Signature_Rsa_Pkcs1_Verify
        CryIfKey_RsaSignatureVerifyKey_CodeSign_Qnx_L4: CryptoKeyId=28, CryptoKeyTypeRef=Crypto_30_vHsm_LibCv_Signature_Rsa_Pkcs1_Verify
        CryIfKey_GVCS_RsaKey: CryptoKeyId=14, CryptoKeyTypeRef=Crypto_30_vHsm_LibCv_Signature_Rsa_Pkcs1_Verify
        CryIfKey_Sha256Result: CryptoKeyId=30, CryptoKeyTypeRef=Crypto_30_vHsm_LibCv_Hash_Sha256Result
        CryIfKey_CertData_CodeSign_L2: CryptoKeyId=7, CryptoKeyTypeRef=Crypto_30_vHsm_LibCv_KeyType_KeyM_Certificate_Type1
        CryIfKey_RsaSignatureVerifyKey_CodeSign_L2: CryptoKeyId=24, CryptoKeyTypeRef=Crypto_30_vHsm_LibCv_Signature_Rsa_Pkcs1_Verify
        CryIfKey_CurrentTimeStamp: CryptoKeyId=12, CryptoKeyTypeRef=Crypto_30_vHsm_LibCv_CryptoKeyType_CurrentTimeStamp
        CryIfKey_SecondCounter: CryptoKeyId=29, CryptoKeyTypeRef=Crypto_30_vHsm_LibCv_CryptoKeyType_SecondCounter
    CryptoKeyTypes
      21 x CryptoKeyType:
        Crypto_30_vHsm_LibCv_Signature: CryptoKeyElementRef=Crypto_30_vHsm_LibCv_Signature_Key
        Crypto_30_vHsm_LibCv_Cipher: CryptoKeyElementRef=Crypto_30_vHsm_LibCv_Cipher_Key, CryptoKeyElementRef=Crypto_30_vHsm_LibCv_Cipher_IV, CryptoKeyElementRef=Crypto_30_vHsm_LibCv_Cipher_Proof
        Crypto_30_vHsm_LibCv_WriteOnceKey: CryptoKeyElementRef=Crypto_30_vHsm_LibCv_Cipher_Key
        Crypto_30_vHsm_LibCv_SecureBootProtectedKey: CryptoKeyElementRef=Crypto_30_vHsm_LibCv_Cipher_IV, CryptoKeyElementRef=Crypto_30_vHsm_LibCv_Cipher_Key
        Crypto_30_vHsm_LibCv_Random_Nist_800_90A_DRBG_AES_NoDF: CryptoKeyElementRef=Crypto_30_vHsm_LibCv_Random_Algorithm_Nist_800_90A_DRBG_AES128, CryptoKeyElementRef=Crypto_30_vHsm_LibCv_Random_PrivateString, CryptoKeyElementRef=Crypto_30_vHsm_LibCv_Random_Reseed_Counter, CryptoKeyElementRef=Crypto_30_vHsm_LibCv_Random_Seed_Nist_800_90A_DRBG_AES128, CryptoKeyElementRef=Crypto_30_vHsm_LibCv_Random_AdditionalInput
        Crypto_30_vHsm_LibCv_LazyPersistKey: CryptoKeyElementRef=Crypto_30_vHsm_LibCv_vHsm_LazyPersistKey
        Crypto_30_vHsm_LibCv_MacShe: CryptoKeyElementRef=Crypto_30_vHsm_LibCv_Mac_Proof, CryptoKeyElementRef=Crypto_30_vHsm_LibCv_Mac_Key_She, CryptoKeyElementRef=Crypto_30_vHsm_LibCv_She_Counter
        Crypto_30_vHsm_LibCv_CipherShe: CryptoKeyElementRef=Crypto_30_vHsm_LibCv_Cipher_IV, CryptoKeyElementRef=Crypto_30_vHsm_LibCv_Cipher_Proof, CryptoKeyElementRef=Crypto_30_vHsm_LibCv_Cipher_Key_She, CryptoKeyElementRef=Crypto_30_vHsm_LibCv_She_Counter
        Crypto_30_vHsm_LibCv_SheInfoKey: CryptoKeyElementRef=Crypto_30_vHsm_LibCv_She_UId, CryptoKeyElementRef=Crypto_30_vHsm_LibCv_She_BootProtection, CryptoKeyElementRef=Crypto_30_vHsm_LibCv_She_DebuggerProtection
        Crypto_30_vHsm_vHsm_Core_vHsmInfo_Type: CryptoKeyElementRef=Crypto_30_vHsm_vHsm_Core_vHsmInfo_Version, CryptoKeyElementRef=Crypto_30_vHsm_vHsm_Core_vHsmInfo_PerformPersist, CryptoKeyElementRef=Crypto_30_vHsm_vHsm_Core_vHsmInfo_PerformRepersist, CryptoKeyElementRef=Crypto_30_vHsm_vHsm_Core_vHsmInfo_StartFirmwareUpdater, CryptoKeyElementRef=Crypto_30_vHsm_vHsm_Core_vHsmInfo_SecureBootEnd, CryptoKeyElementRef=Crypto_30_vHsm_vHsm_Core_vHsmInfo_SecureBootResult
        Crypto_30_vHsm_vHsm_Core_vHsmSecureBootGroupInfo_Type: CryptoKeyElementRef=Crypto_30_vHsm_vHsm_Core_vHsmSecureBootInfo_GroupState
        Crypto_30_vHsm_LibCv_Aggregated_RomKey: CryptoKeyElementRef=Crypto_30_vHsm_LibCv_Cipher_IV, CryptoKeyElementRef=Crypto_30_vHsm_LibCv_vHsm_KeyDerivation_Algorithm_NIST800108_CMAC, CryptoKeyElementRef=Crypto_30_vHsm_LibCv_vHsm_KeyDerivation_Context, CryptoKeyElementRef=Crypto_30_vHsm_LibCv_vHsm_KeyDerivation_Label
        Crypto_30_vHsm_LibCv_Mac: CryptoKeyElementRef=Crypto_30_vHsm_LibCv_Mac_Key, CryptoKeyElementRef=Crypto_30_vHsm_LibCv_Mac_Proof, CryptoKeyElementRef=Crypto_30_vHsm_LibCv_Cipher_IV
        Crypto_30_vHsm_LibCv_UserCMac: CryptoKeyElementRef=Crypto_30_vHsm_LibCv_Cipher_Key
        Crypto_30_vHsm_LibCv_Signature_Rsa_Pkcs1_Verify: CryptoKeyElementRef=Crypto_30_vHsm_LibCv_Rsa_Modulus, CryptoKeyElementRef=Crypto_30_vHsm_LibCv_Rsa_Pub_Exponent
        Crypto_30_vHsm_LibCv_KeyType_KeyM_Certificate_Type1: CryptoKeyElementRef=Crypto_30_vHsm_LibCv_KeyM_CertificateData
        Crypto_30_vHsm_KeyM_KeyType_KeyM_Certificate: CryptoKeyElementRef=Crypto_30_vHsm_KeyM_KeyM_Certificate, CryptoKeyElementRef=Crypto_30_vHsm_KeyM_KeyM_GetStatus, CryptoKeyElementRef=Crypto_30_vHsm_KeyM_KeyM_VerifyCertificate, CryptoKeyElementRef=Crypto_30_vHsm_KeyM_KeyM_VerifyCertificates
        Crypto_30_vHsm_LibCv_RoleFlag: CryptoKeyElementRef=CryptoKeyElements/Crypto_30_vHsm_LibCv_RoleFlag
        Crypto_30_vHsm_LibCv_Hash_Sha256Result: CryptoKeyElementRef=Crypto_30_vHsm_LibCv_Hash_Result_SHA256
        Crypto_30_vHsm_LibCv_CryptoKeyType_CurrentTimeStamp: CryptoKeyElementRef=Crypto_30_vHsm_LibCv_CryptoKeyElement_CurrentTimeStamp
        Crypto_30_vHsm_LibCv_CryptoKeyType_SecondCounter: CryptoKeyElementRef=Crypto_30_vHsm_LibCv_CryptoKeyElement_SecondCounter
    CryptoKeyElements
      39 x CryptoKeyElement, all with CryptoKeyElementPersist=FALSE:
        Crypto_30_vHsm_LibCv_Signature_Key: CryptoKeyElementAllowPartialAccess=TRUE, CryptoKeyElementId=1, CryptoKeyElementSize=66, CryptoKeyElementReadAccess=RA_ALLOWED, CryptoKeyElementWriteAccess=WA_ALLOWED
        Crypto_30_vHsm_LibCv_Cipher_Key: CryptoKeyElementAllowPartialAccess=FALSE, CryptoKeyElementId=1, CryptoKeyElementSize=16, CryptoKeyElementReadAccess=RA_ALLOWED, CryptoKeyElementWriteAccess=WA_ALLOWED
        Crypto_30_vHsm_LibCv_Cipher_IV: CryptoKeyElementAllowPartialAccess=FALSE, CryptoKeyElementId=5, CryptoKeyElementSize=16, CryptoKeyElementReadAccess=RA_ALLOWED, CryptoKeyElementWriteAccess=WA_ALLOWED
        Crypto_30_vHsm_LibCv_Cipher_Proof: CryptoKeyElementAllowPartialAccess=FALSE, CryptoKeyElementId=6, CryptoKeyElementSize=48, CryptoKeyElementReadAccess=RA_ALLOWED, CryptoKeyElementWriteAccess=WA_ALLOWED
        Crypto_30_vHsm_LibCv_Random_Algorithm_Nist_800_90A_DRBG_AES128: CryptoKeyElementAllowPartialAccess=FALSE, CryptoKeyElementId=4, CryptoKeyElementSize=1, CryptoKeyElementReadAccess=RA_ALLOWED, CryptoKeyElementWriteAccess=WA_ALLOWED
        Crypto_30_vHsm_LibCv_Random_PrivateString: CryptoKeyElementAllowPartialAccess=FALSE, CryptoKeyElementId=3015, CryptoKeyElementSize=16, CryptoKeyElementReadAccess=RA_ALLOWED, CryptoKeyElementWriteAccess=WA_ALLOWED
        Crypto_30_vHsm_LibCv_Random_Reseed_Counter: CryptoKeyElementAllowPartialAccess=FALSE, CryptoKeyElementId=3018, CryptoKeyElementSize=4, CryptoKeyElementReadAccess=RA_ALLOWED, CryptoKeyElementWriteAccess=WA_DENIED
        Crypto_30_vHsm_LibCv_Random_Seed_Nist_800_90A_DRBG_AES128: CryptoKeyElementAllowPartialAccess=FALSE, CryptoKeyElementId=3, CryptoKeyElementSize=32, CryptoKeyElementReadAccess=RA_DENIED, CryptoKeyElementWriteAccess=WA_ALLOWED
        Crypto_30_vHsm_LibCv_Random_AdditionalInput: CryptoKeyElementAllowPartialAccess=FALSE, CryptoKeyElementId=3016, CryptoKeyElementSize=16, CryptoKeyElementReadAccess=RA_ALLOWED, CryptoKeyElementWriteAccess=WA_ALLOWED
        Crypto_30_vHsm_LibCv_vHsm_LazyPersistKey: CryptoKeyElementAllowPartialAccess=FALSE, CryptoKeyElementId=1, CryptoKeyElementSize=16, CryptoKeyElementReadAccess=RA_ALLOWED, CryptoKeyElementWriteAccess=WA_ALLOWED
        Crypto_30_vHsm_LibCv_Mac_Proof: CryptoKeyElementAllowPartialAccess=FALSE, CryptoKeyElementId=2, CryptoKeyElementSize=48, CryptoKeyElementReadAccess=RA_ALLOWED, CryptoKeyElementWriteAccess=WA_ALLOWED
        Crypto_30_vHsm_LibCv_Mac_Key_She: CryptoKeyElementAllowPartialAccess=FALSE, CryptoKeyElementId=1, CryptoKeyElementSize=16, CryptoKeyElementReadAccess=RA_DENIED, CryptoKeyElementWriteAccess=WA_ENCRYPTED
        Crypto_30_vHsm_LibCv_She_Counter: CryptoKeyElementAllowPartialAccess=FALSE, CryptoKeyElementId=3019, CryptoKeyElementSize=4, CryptoKeyElementReadAccess=RA_ALLOWED, CryptoKeyElementWriteAccess=WA_DENIED
        Crypto_30_vHsm_LibCv_Cipher_Key_She: CryptoKeyElementAllowPartialAccess=FALSE, CryptoKeyElementId=1, CryptoKeyElementSize=16, CryptoKeyElementReadAccess=RA_DENIED, CryptoKeyElementWriteAccess=WA_ENCRYPTED
        Crypto_30_vHsm_LibCv_She_UId: CryptoKeyElementAllowPartialAccess=FALSE, CryptoKeyElementId=3021, CryptoKeyElementSize=15, CryptoKeyElementReadAccess=RA_ALLOWED, CryptoKeyElementWriteAccess=WA_DENIED
        Crypto_30_vHsm_LibCv_She_BootProtection: CryptoKeyElementAllowPartialAccess=FALSE, CryptoKeyElementId=3056, CryptoKeyElementSize=1, CryptoKeyElementReadAccess=RA_ALLOWED, CryptoKeyElementWriteAccess=WA_ALLOWED
        Crypto_30_vHsm_LibCv_She_DebuggerProtection: CryptoKeyElementAllowPartialAccess=FALSE, CryptoKeyElementId=3057, CryptoKeyElementSize=1, CryptoKeyElementReadAccess=RA_ALLOWED, CryptoKeyElementWriteAccess=WA_ALLOWED
        Crypto_30_vHsm_vHsm_Core_vHsmInfo_Version: CryptoKeyElementAllowPartialAccess=FALSE, CryptoKeyElementId=3020, CryptoKeyElementSize=3, CryptoKeyElementReadAccess=RA_ALLOWED, CryptoKeyElementWriteAccess=WA_DENIED
        Crypto_30_vHsm_vHsm_Core_vHsmInfo_PerformPersist: CryptoKeyElementAllowPartialAccess=FALSE, CryptoKeyElementId=3022, CryptoKeyElementSize=1, CryptoKeyElementReadAccess=RA_ALLOWED, CryptoKeyElementWriteAccess=WA_DENIED
        Crypto_30_vHsm_vHsm_Core_vHsmInfo_PerformRepersist: CryptoKeyElementAllowPartialAccess=FALSE, CryptoKeyElementId=3036, CryptoKeyElementSize=1, CryptoKeyElementReadAccess=RA_DENIED, CryptoKeyElementWriteAccess=WA_ALLOWED
        Crypto_30_vHsm_vHsm_Core_vHsmInfo_StartFirmwareUpdater: CryptoKeyElementAllowPartialAccess=FALSE, CryptoKeyElementId=3038, CryptoKeyElementSize=1, CryptoKeyElementReadAccess=RA_DENIED, CryptoKeyElementWriteAccess=WA_ALLOWED
        Crypto_30_vHsm_vHsm_Core_vHsmInfo_SecureBootEnd: CryptoKeyElementAllowPartialAccess=FALSE, CryptoKeyElementId=3028, CryptoKeyElementSize=1, CryptoKeyElementReadAccess=RA_ALLOWED, CryptoKeyElementWriteAccess=WA_ALLOWED
        Crypto_30_vHsm_vHsm_Core_vHsmInfo_SecureBootResult: CryptoKeyElementAllowPartialAccess=FALSE, CryptoKeyElementId=3037, CryptoKeyElementSize=1, CryptoKeyElementReadAccess=RA_ALLOWED, CryptoKeyElementWriteAccess=WA_DENIED
        Crypto_30_vHsm_vHsm_Core_vHsmSecureBootInfo_GroupState: CryptoKeyElementAllowPartialAccess=FALSE, CryptoKeyElementId=0, CryptoKeyElementSize=2, CryptoKeyElementReadAccess=RA_ALLOWED, CryptoKeyElementWriteAccess=WA_DENIED
        Crypto_30_vHsm_LibCv_vHsm_KeyDerivation_Algorithm_NIST800108_CMAC: CryptoKeyElementAllowPartialAccess=FALSE, CryptoKeyElementId=15, CryptoKeyElementSize=1, CryptoKeyElementReadAccess=RA_ALLOWED, CryptoKeyElementWriteAccess=WA_DENIED
        Crypto_30_vHsm_LibCv_vHsm_KeyDerivation_Context: CryptoKeyElementAllowPartialAccess=TRUE, CryptoKeyElementId=132, CryptoKeyElementSize=20, CryptoKeyElementReadAccess=RA_ALLOWED, CryptoKeyElementWriteAccess=WA_ALLOWED
        Crypto_30_vHsm_LibCv_vHsm_KeyDerivation_Label: CryptoKeyElementAllowPartialAccess=TRUE, CryptoKeyElementId=130, CryptoKeyElementSize=20, CryptoKeyElementReadAccess=RA_ALLOWED, CryptoKeyElementWriteAccess=WA_ALLOWED
        Crypto_30_vHsm_LibCv_Mac_Key: CryptoKeyElementAllowPartialAccess=FALSE, CryptoKeyElementId=1, CryptoKeyElementSize=16, CryptoKeyElementReadAccess=RA_ALLOWED, CryptoKeyElementWriteAccess=WA_ALLOWED
        Crypto_30_vHsm_LibCv_Rsa_Modulus: CryptoKeyElementAllowPartialAccess=FALSE, CryptoKeyElementId=160, CryptoKeyElementSize=256, CryptoKeyElementReadAccess=RA_ALLOWED, CryptoKeyElementWriteAccess=WA_ALLOWED
        Crypto_30_vHsm_LibCv_Rsa_Pub_Exponent: CryptoKeyElementAllowPartialAccess=FALSE, CryptoKeyElementId=161, CryptoKeyElementSize=3, CryptoKeyElementReadAccess=RA_ALLOWED, CryptoKeyElementWriteAccess=WA_ALLOWED
        Crypto_30_vHsm_LibCv_KeyM_CertificateData: CryptoKeyElementAllowPartialAccess=TRUE, CryptoKeyElementId=0, CryptoKeyElementSize=1536, CryptoKeyElementReadAccess=RA_ALLOWED, CryptoKeyElementWriteAccess=WA_ALLOWED
        Crypto_30_vHsm_KeyM_KeyM_Certificate: CryptoKeyElementAllowPartialAccess=TRUE, CryptoKeyElementId=3080, CryptoKeyElementSize=1536, CryptoKeyElementReadAccess=RA_ALLOWED, CryptoKeyElementWriteAccess=WA_ALLOWED
        Crypto_30_vHsm_KeyM_KeyM_GetStatus: CryptoKeyElementAllowPartialAccess=FALSE, CryptoKeyElementId=3081, CryptoKeyElementSize=1, CryptoKeyElementReadAccess=RA_ALLOWED, CryptoKeyElementWriteAccess=WA_DENIED
        Crypto_30_vHsm_KeyM_KeyM_VerifyCertificate: CryptoKeyElementAllowPartialAccess=TRUE, CryptoKeyElementId=3082, CryptoKeyElementSize=1, CryptoKeyElementReadAccess=RA_DENIED, CryptoKeyElementWriteAccess=WA_ALLOWED
        Crypto_30_vHsm_KeyM_KeyM_VerifyCertificates: CryptoKeyElementAllowPartialAccess=FALSE, CryptoKeyElementId=3083, CryptoKeyElementSize=2, CryptoKeyElementReadAccess=RA_DENIED, CryptoKeyElementWriteAccess=WA_ALLOWED
        Crypto_30_vHsm_LibCv_RoleFlag: CryptoKeyElementAllowPartialAccess=FALSE, CryptoKeyElementId=1, CryptoKeyElementSize=1, CryptoKeyElementReadAccess=RA_ALLOWED, CryptoKeyElementWriteAccess=WA_ALLOWED
        Crypto_30_vHsm_LibCv_Hash_Result_SHA256: CryptoKeyElementAllowPartialAccess=FALSE, CryptoKeyElementId=1, CryptoKeyElementSize=32, CryptoKeyElementReadAccess=RA_ALLOWED, CryptoKeyElementWriteAccess=WA_ALLOWED
        Crypto_30_vHsm_LibCv_CryptoKeyElement_CurrentTimeStamp: CryptoKeyElementAllowPartialAccess=TRUE, CryptoKeyElementId=1, CryptoKeyElementSize=15, CryptoKeyElementReadAccess=RA_ALLOWED, CryptoKeyElementWriteAccess=WA_ALLOWED
        Crypto_30_vHsm_LibCv_CryptoKeyElement_SecondCounter: CryptoKeyElementAllowPartialAccess=TRUE, CryptoKeyElementId=1, CryptoKeyElementSize=4, CryptoKeyElementReadAccess=RA_ALLOWED, CryptoKeyElementWriteAccess=WA_ALLOWED
    CryptoDriverObjects
      8 x CryptoDriverObject, all with CryptoDriverObjectQueueSize=1:
        Crypto_30_vHsm_Core: CryptoDriverObjectId=1, CryptoPrimitiveRef=Crypto_30_vHsm_vHsm_Core_vHsmSecureBoot, CryptoPrimitiveRef=Crypto_30_vHsm_vHsm_Core_vHsmFirmwareUpdate, CryptoPrimitiveRef=Crypto_30_vHsm_vHsm_Core_vHsmSecureBootUpdate, CryptoPrimitiveRef=Crypto_30_vHsm_vHsm_Core_vHsmSecureSoftwareDownload, CryptoPrimitiveRef=Crypto_30_vHsm_vHsm_Core_vHsmSecureBootConfirmation, CryptoPrimitiveRef=Crypto_30_vHsm_vHsm_Core_vHsmPersistency
        Crypto_30_vHsm_Hal: CryptoDriverObjectId=3, CryptoPrimitiveRef=Crypto_30_vHsm_Hwa_Trng, CryptoPrimitiveRef=Crypto_30_vHsm_Hwa_AesCmacGenerate, CryptoPrimitiveRef=Crypto_30_vHsm_Hwa_AesCmacVerify, CryptoPrimitiveRef=Crypto_30_vHsm_Hwa_AesDecrypt, CryptoPrimitiveRef=Crypto_30_vHsm_Hwa_AesEncrypt, CryptoPrimitiveRef=Crypto_30_vHsm_Hwa_Sha2_256
        Crypto_30_vHsm_LibCv: CryptoDriverObjectId=7, CryptoPrimitiveRef=Crypto_30_vHsm_LibCv_SHA256, CryptoPrimitiveRef=Crypto_30_vHsm_LibCv_AesDecrypt, CryptoPrimitiveRef=Crypto_30_vHsm_LibCv_AesEncrypt, CryptoPrimitiveRef=Crypto_30_vHsm_LibCv_AesCmacGenerate, CryptoPrimitiveRef=Crypto_30_vHsm_LibCv_AesCmacVerify, CryptoPrimitiveRef=Crypto_30_vHsm_LibCv_RngDrbgAes128, CryptoPrimitiveRef=Crypto_30_vHsm_LibCv_EccNistP256R1VerifySha256, CryptoPrimitiveRef=Crypto_30_vHsm_LibCv_RsaPkcs1Sha256Verify
        Crypto_30_vHsm_KeyManagement: CryptoDriverObjectId=6, CryptoPrimitiveRef=vHsmUsageForbidden
        Crypto_30_vHsm_LibCv_HighPrio: CryptoDriverObjectId=9, CryptoPrimitiveRef=Crypto_30_vHsm_LibCv_SHA256, CryptoPrimitiveRef=Crypto_30_vHsm_LibCv_AesDecrypt, CryptoPrimitiveRef=Crypto_30_vHsm_LibCv_AesEncrypt, CryptoPrimitiveRef=Crypto_30_vHsm_LibCv_AesCmacGenerate, CryptoPrimitiveRef=Crypto_30_vHsm_LibCv_AesCmacVerify, CryptoPrimitiveRef=Crypto_30_vHsm_LibCv_RngDrbgAes128
        Crypto_30_vHsm_KeyMRemote: CryptoDriverObjectId=5, CryptoPrimitiveRef=Crypto_30_vHsm_KeyM_KeyM_ServiceCertificate, CryptoPrimitiveRef=Crypto_30_vHsm_KeyM_KeyM_CertElementGet, CryptoPrimitiveRef=Crypto_30_vHsm_KeyM_KeyM_RemoteHandling
        Crypto_30_vHsm_GVCS: CryptoDriverObjectId=2, CryptoPrimitiveRef=Crypto_30_vHsm_GVCS_UpdateCertificatesAndDcl, CryptoPrimitiveRef=Crypto_30_vHsm_GVCS_ValidateHeader, CryptoPrimitiveRef=Crypto_30_vHsm_GVCS_ValidatevHsmSecureBootUpdate
        Crypto_30_vHsm_Custom: CryptoDriverObjectId=0, CryptoPrimitiveRef=Crypto_30_vHsm_vHsm_Custom_Dummy
    CryptoPrimitives
      28 x CryptoPrimitive:
        Crypto_30_vHsm_vHsm_Core_vHsmSecureBoot: CryptoPrimitiveService=CRYPTO_MAC_VERIFY, CryptoPrimitiveAlgorithmFamily=CRYPTO_ALGOFAM_CUSTOM_VHSM_SECURE_BOOT, CryptoPrimitiveAlgorithmMode=CRYPTO_ALGOMODE_CMAC, CryptoPrimitiveAlgorithmMode=CRYPTO_ALGOMODE_NOT_SET, CryptoPrimitiveAlgorithmMode=CRYPTO_ALGOMODE_CUSTOM, CryptoPrimitiveAlgorithmSecondaryFamily=CRYPTO_ALGOFAM_NOT_SET
        Crypto_30_vHsm_vHsm_Core_vHsmFirmwareUpdate: CryptoPrimitiveService=CRYPTO_AEADENCRYPT, CryptoPrimitiveAlgorithmFamily=CRYPTO_ALGOFAM_CUSTOM_VHSM_FIRMWARE_UPDATE, CryptoPrimitiveAlgorithmMode=CRYPTO_ALGOMODE_GCM, CryptoPrimitiveAlgorithmMode=CRYPTO_ALGOMODE_NOT_SET, CryptoPrimitiveAlgorithmSecondaryFamily=CRYPTO_ALGOFAM_NOT_SET
        Crypto_30_vHsm_vHsm_Core_vHsmSecureBootUpdate: CryptoPrimitiveService=CRYPTO_SIGNATURE_VERIFY, CryptoPrimitiveAlgorithmFamily=CRYPTO_ALGOFAM_CUSTOM, CryptoPrimitiveAlgorithmMode=CRYPTO_ALGOMODE_NOT_SET, CryptoPrimitiveAlgorithmSecondaryFamily=CRYPTO_ALGOFAM_NOT_SET
        Crypto_30_vHsm_vHsm_Core_vHsmSecureSoftwareDownload: CryptoPrimitiveService=CRYPTO_SIGNATURE_VERIFY, CryptoPrimitiveAlgorithmFamily=CRYPTO_ALGOFAM_CUSTOM_VHSM_SOFTWARE_DOWNLOAD, CryptoPrimitiveAlgorithmMode=CRYPTO_ALGOMODE_NOT_SET, CryptoPrimitiveAlgorithmSecondaryFamily=CRYPTO_ALGOFAM_NOT_SET
        Crypto_30_vHsm_vHsm_Core_vHsmSecureBootConfirmation: CryptoPrimitiveService=CRYPTO_SIGNATURE_VERIFY, CryptoPrimitiveAlgorithmFamily=CRYPTO_ALGOFAM_CUSTOM, CryptoPrimitiveAlgorithmMode=CRYPTO_ALGOMODE_NOT_SET, CryptoPrimitiveAlgorithmSecondaryFamily=CRYPTO_ALGOFAM_NOT_SET
        Crypto_30_vHsm_vHsm_Core_vHsmPersistency: CryptoPrimitiveService=CRYPTO_RANDOM, CryptoPrimitiveAlgorithmFamily=CRYPTO_ALGOFAM_CUSTOM, CryptoPrimitiveAlgorithmMode=CRYPTO_ALGOMODE_CUSTOM, CryptoPrimitiveAlgorithmSecondaryFamily=CRYPTO_ALGOFAM_NOT_SET
        Crypto_30_vHsm_Hwa_Trng: CryptoPrimitiveService=CRYPTO_RANDOM, CryptoPrimitiveAlgorithmFamily=CRYPTO_ALGOFAM_RNG, CryptoPrimitiveAlgorithmMode=CRYPTO_ALGOMODE_NOT_SET, CryptoPrimitiveAlgorithmSecondaryFamily=CRYPTO_ALGOFAM_NOT_SET
        Crypto_30_vHsm_Hwa_AesCmacGenerate: CryptoPrimitiveService=CRYPTO_MAC_GENERATE, CryptoPrimitiveAlgorithmFamily=CRYPTO_ALGOFAM_AES, CryptoPrimitiveAlgorithmMode=CRYPTO_ALGOMODE_CMAC, CryptoPrimitiveAlgorithmSecondaryFamily=CRYPTO_ALGOFAM_NOT_SET
        Crypto_30_vHsm_Hwa_AesCmacVerify: CryptoPrimitiveService=CRYPTO_MAC_VERIFY, CryptoPrimitiveAlgorithmFamily=CRYPTO_ALGOFAM_AES, CryptoPrimitiveAlgorithmMode=CRYPTO_ALGOMODE_CMAC, CryptoPrimitiveAlgorithmSecondaryFamily=CRYPTO_ALGOFAM_NOT_SET
        Crypto_30_vHsm_Hwa_AesDecrypt: CryptoPrimitiveService=CRYPTO_DECRYPT, CryptoPrimitiveAlgorithmFamily=CRYPTO_ALGOFAM_AES, CryptoPrimitiveAlgorithmMode=CRYPTO_ALGOMODE_ECB, CryptoPrimitiveAlgorithmMode=CRYPTO_ALGOMODE_CBC, CryptoPrimitiveAlgorithmMode=CRYPTO_ALGOMODE_CTR, CryptoPrimitiveAlgorithmSecondaryFamily=CRYPTO_ALGOFAM_NOT_SET
        Crypto_30_vHsm_Hwa_AesEncrypt: CryptoPrimitiveService=CRYPTO_ENCRYPT, CryptoPrimitiveAlgorithmFamily=CRYPTO_ALGOFAM_AES, CryptoPrimitiveAlgorithmMode=CRYPTO_ALGOMODE_ECB, CryptoPrimitiveAlgorithmMode=CRYPTO_ALGOMODE_CBC, CryptoPrimitiveAlgorithmMode=CRYPTO_ALGOMODE_CTR, CryptoPrimitiveAlgorithmSecondaryFamily=CRYPTO_ALGOFAM_NOT_SET
        Crypto_30_vHsm_Hwa_Sha2_256: CryptoPrimitiveService=CRYPTO_HASH, CryptoPrimitiveAlgorithmFamily=CRYPTO_ALGOFAM_SHA2_256, CryptoPrimitiveAlgorithmMode=CRYPTO_ALGOMODE_NOT_SET, CryptoPrimitiveAlgorithmSecondaryFamily=CRYPTO_ALGOFAM_NOT_SET
        Crypto_30_vHsm_LibCv_SHA256: CryptoPrimitiveService=CRYPTO_HASH, CryptoPrimitiveAlgorithmFamily=CRYPTO_ALGOFAM_SHA2_256, CryptoPrimitiveAlgorithmMode=CRYPTO_ALGOMODE_NOT_SET, CryptoPrimitiveAlgorithmSecondaryFamily=CRYPTO_ALGOFAM_NOT_SET
        Crypto_30_vHsm_LibCv_AesDecrypt: CryptoPrimitiveService=CRYPTO_DECRYPT, CryptoPrimitiveAlgorithmFamily=CRYPTO_ALGOFAM_AES, CryptoPrimitiveAlgorithmMode=CRYPTO_ALGOMODE_ECB, CryptoPrimitiveAlgorithmMode=CRYPTO_ALGOMODE_CBC, CryptoPrimitiveAlgorithmMode=CRYPTO_ALGOMODE_CTR, CryptoPrimitiveAlgorithmSecondaryFamily=CRYPTO_ALGOFAM_NOT_SET, CryptoPrimitiveAlgorithmSecondaryFamily=CRYPTO_ALGOFAM_CUSTOM_PADDING_PKCS7, CryptoPrimitiveAlgorithmSecondaryFamily=CRYPTO_ALGOFAM_CUSTOM
        Crypto_30_vHsm_LibCv_AesEncrypt: CryptoPrimitiveService=CRYPTO_ENCRYPT, CryptoPrimitiveAlgorithmFamily=CRYPTO_ALGOFAM_AES, CryptoPrimitiveAlgorithmMode=CRYPTO_ALGOMODE_ECB, CryptoPrimitiveAlgorithmMode=CRYPTO_ALGOMODE_CBC, CryptoPrimitiveAlgorithmMode=CRYPTO_ALGOMODE_CTR, CryptoPrimitiveAlgorithmSecondaryFamily=CRYPTO_ALGOFAM_NOT_SET, CryptoPrimitiveAlgorithmSecondaryFamily=CRYPTO_ALGOFAM_CUSTOM_PADDING_PKCS7, CryptoPrimitiveAlgorithmSecondaryFamily=CRYPTO_ALGOFAM_CUSTOM
        Crypto_30_vHsm_LibCv_AesCmacGenerate: CryptoPrimitiveService=CRYPTO_MAC_GENERATE, CryptoPrimitiveAlgorithmFamily=CRYPTO_ALGOFAM_AES, CryptoPrimitiveAlgorithmMode=CRYPTO_ALGOMODE_CMAC, CryptoPrimitiveAlgorithmSecondaryFamily=CRYPTO_ALGOFAM_NOT_SET
        Crypto_30_vHsm_LibCv_AesCmacVerify: CryptoPrimitiveService=CRYPTO_MAC_VERIFY, CryptoPrimitiveAlgorithmFamily=CRYPTO_ALGOFAM_AES, CryptoPrimitiveAlgorithmMode=CRYPTO_ALGOMODE_CMAC, CryptoPrimitiveAlgorithmSecondaryFamily=CRYPTO_ALGOFAM_NOT_SET
        Crypto_30_vHsm_LibCv_RngDrbgAes128: CryptoPrimitiveService=CRYPTO_RANDOM, CryptoPrimitiveAlgorithmFamily=CRYPTO_ALGOFAM_CUSTOM_DRBG, CryptoPrimitiveAlgorithmMode=CRYPTO_ALGOMODE_NOT_SET, CryptoPrimitiveAlgorithmSecondaryFamily=CRYPTO_ALGOFAM_AES
        Crypto_30_vHsm_LibCv_EccNistP256R1VerifySha256: CryptoPrimitiveService=CRYPTO_SIGNATURE_VERIFY, CryptoPrimitiveAlgorithmFamily=CRYPTO_ALGOFAM_ECCNIST, CryptoPrimitiveAlgorithmMode=CRYPTO_ALGOMODE_CUSTOM_P256R1, CryptoPrimitiveAlgorithmSecondaryFamily=CRYPTO_ALGOFAM_SHA2_256
        Crypto_30_vHsm_LibCv_RsaPkcs1Sha256Verify: CryptoPrimitiveService=CRYPTO_SIGNATURE_VERIFY, CryptoPrimitiveAlgorithmFamily=CRYPTO_ALGOFAM_RSA, CryptoPrimitiveAlgorithmMode=CRYPTO_ALGOMODE_RSASSA_PKCS1_v1_5, CryptoPrimitiveAlgorithmSecondaryFamily=CRYPTO_ALGOFAM_SHA2_256
        Crypto_30_vHsm_KeyM_KeyM_ServiceCertificate: CryptoPrimitiveService=CRYPTO_AEADDECRYPT, CryptoPrimitiveAlgorithmFamily=CRYPTO_ALGOFAM_CUSTOM, CryptoPrimitiveAlgorithmMode=CRYPTO_ALGOMODE_CUSTOM, CryptoPrimitiveAlgorithmSecondaryFamily=CRYPTO_ALGOFAM_NOT_SET
        Crypto_30_vHsm_KeyM_KeyM_CertElementGet: CryptoPrimitiveService=CRYPTO_AEADENCRYPT, CryptoPrimitiveAlgorithmFamily=CRYPTO_ALGOFAM_CUSTOM, CryptoPrimitiveAlgorithmMode=CRYPTO_ALGOMODE_CUSTOM, CryptoPrimitiveAlgorithmSecondaryFamily=CRYPTO_ALGOFAM_NOT_SET
        Crypto_30_vHsm_KeyM_KeyM_RemoteHandling: CryptoPrimitiveService=CRYPTO_AEADDECRYPT, CryptoPrimitiveAlgorithmFamily=CRYPTO_ALGOFAM_AES, CryptoPrimitiveAlgorithmMode=CRYPTO_ALGOMODE_GCM, CryptoPrimitiveAlgorithmSecondaryFamily=CRYPTO_ALGOFAM_NOT_SET
        Crypto_30_vHsm_GVCS_UpdateCertificatesAndDcl: CryptoPrimitiveService=CRYPTO_SIGNATURE_VERIFY, CryptoPrimitiveAlgorithmFamily=CRYPTO_ALGOFAM_CUSTOM, CryptoPrimitiveAlgorithmMode=CRYPTO_ALGOMODE_NOT_SET, CryptoPrimitiveAlgorithmSecondaryFamily=CRYPTO_ALGOFAM_CUSTOM
        Crypto_30_vHsm_GVCS_ValidateHeader: CryptoPrimitiveService=CRYPTO_SIGNATURE_VERIFY, CryptoPrimitiveAlgorithmFamily=CRYPTO_ALGOFAM_CUSTOM, CryptoPrimitiveAlgorithmMode=CRYPTO_ALGOMODE_NOT_SET, CryptoPrimitiveAlgorithmMode=CRYPTO_ALGOMODE_CUSTOM, CryptoPrimitiveAlgorithmMode=CRYPTO_ALGOMODE_CUSTOM, CryptoPrimitiveAlgorithmSecondaryFamily=CRYPTO_ALGOFAM_CUSTOM
        Crypto_30_vHsm_GVCS_ValidatevHsmSecureBootUpdate: CryptoPrimitiveService=CRYPTO_SIGNATURE_VERIFY, CryptoPrimitiveAlgorithmFamily=CRYPTO_ALGOFAM_CUSTOM, CryptoPrimitiveAlgorithmMode=CRYPTO_ALGOMODE_NOT_SET, CryptoPrimitiveAlgorithmSecondaryFamily=CRYPTO_ALGOFAM_CUSTOM
        Crypto_30_vHsm_vHsm_Custom_Dummy: CryptoPrimitiveService=CRYPTO_RANDOM, CryptoPrimitiveAlgorithmFamily=CRYPTO_ALGOFAM_NOT_SET, CryptoPrimitiveAlgorithmFamily=CRYPTO_ALGOFAM_CUSTOM, CryptoPrimitiveAlgorithmMode=CRYPTO_ALGOMODE_NOT_SET, CryptoPrimitiveAlgorithmMode=CRYPTO_ALGOMODE_CUSTOM, CryptoPrimitiveAlgorithmSecondaryFamily=CRYPTO_ALGOFAM_NOT_SET
        vHsmUsageForbidden: CryptoPrimitiveService=CRYPTO_RANDOM, CryptoPrimitiveAlgorithmFamily=CRYPTO_ALGOFAM_NOT_SET, CryptoPrimitiveAlgorithmMode=CRYPTO_ALGOMODE_NOT_SET, CryptoPrimitiveAlgorithmSecondaryFamily=CRYPTO_ALGOFAM_NOT_SET
    CryptovHsm: CryptoIpcChannels=4, CryptoIpcProtocolVersion=3, CryptoManagementDriverObject=Crypto_30_vHsm_KeyManagement
